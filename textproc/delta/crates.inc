MODCARGO_CRATES +=	adler	1.0.2	# 0BSD OR MIT OR Apache-2.0
MODCARGO_CRATES +=	aho-corasick	1.1.2	# Unlicense OR MIT
MODCARGO_CRATES +=	android-tzdata	0.1.1	# MIT OR Apache-2.0
MODCARGO_CRATES +=	android_system_properties	0.1.5	# MIT/Apache-2.0
MODCARGO_CRATES +=	ansi_colours	1.2.2	# LGPL-3.0-or-later
MODCARGO_CRATES +=	ansi_term	0.12.1	# MIT
MODCARGO_CRATES +=	anstream	0.6.5	# MIT OR Apache-2.0
MODCARGO_CRATES +=	anstyle	1.0.4	# MIT OR Apache-2.0
MODCARGO_CRATES +=	anstyle-parse	0.2.3	# MIT OR Apache-2.0
MODCARGO_CRATES +=	anstyle-query	1.0.2	# MIT OR Apache-2.0
MODCARGO_CRATES +=	anstyle-wincon	3.0.2	# MIT OR Apache-2.0
MODCARGO_CRATES +=	anyhow	1.0.79	# MIT OR Apache-2.0
MODCARGO_CRATES +=	approx	0.5.1	# Apache-2.0
MODCARGO_CRATES +=	autocfg	1.1.0	# Apache-2.0 OR MIT
MODCARGO_CRATES +=	base64	0.22.1	# MIT OR Apache-2.0
MODCARGO_CRATES +=	bat	0.24.0	# MIT OR Apache-2.0
MODCARGO_CRATES +=	bincode	1.3.3	# MIT
MODCARGO_CRATES +=	bitflags	1.3.2	# MIT/Apache-2.0
MODCARGO_CRATES +=	bitflags	2.4.1	# MIT OR Apache-2.0
MODCARGO_CRATES +=	box_drawing	0.1.2	# MIT
MODCARGO_CRATES +=	bstr	1.9.0	# MIT OR Apache-2.0
MODCARGO_CRATES +=	bumpalo	3.14.0	# MIT OR Apache-2.0
MODCARGO_CRATES +=	bytelines	2.5.0	# MIT
MODCARGO_CRATES +=	bytemuck	1.14.0	# Zlib OR Apache-2.0 OR MIT
MODCARGO_CRATES +=	bytesize	1.3.0	# Apache-2.0
MODCARGO_CRATES +=	cc	1.0.83	# MIT OR Apache-2.0
MODCARGO_CRATES +=	cfg-if	1.0.0	# MIT/Apache-2.0
MODCARGO_CRATES +=	chrono	0.4.31	# MIT OR Apache-2.0
MODCARGO_CRATES +=	chrono-humanize	0.2.3	# MIT/Apache-2.0
MODCARGO_CRATES +=	clap	4.4.13	# MIT OR Apache-2.0
MODCARGO_CRATES +=	clap_builder	4.4.12	# MIT OR Apache-2.0
MODCARGO_CRATES +=	clap_complete	4.4.6	# MIT OR Apache-2.0
MODCARGO_CRATES +=	clap_derive	4.4.7	# MIT OR Apache-2.0
MODCARGO_CRATES +=	clap_lex	0.6.0	# MIT OR Apache-2.0
MODCARGO_CRATES +=	clircle	0.4.0	# MIT OR Apache-2.0
MODCARGO_CRATES +=	colorchoice	1.0.0	# MIT OR Apache-2.0
MODCARGO_CRATES +=	console	0.15.7	# MIT
MODCARGO_CRATES +=	content_inspector	0.2.4	# MIT/Apache-2.0
MODCARGO_CRATES +=	core-foundation-sys	0.8.6	# MIT OR Apache-2.0
MODCARGO_CRATES +=	crc32fast	1.3.2	# MIT OR Apache-2.0
MODCARGO_CRATES +=	ctrlc	3.4.2	# MIT/Apache-2.0
MODCARGO_CRATES +=	deranged	0.3.11	# MIT OR Apache-2.0
MODCARGO_CRATES +=	dirs	5.0.1	# MIT OR Apache-2.0
MODCARGO_CRATES +=	dirs-sys	0.4.1	# MIT OR Apache-2.0
MODCARGO_CRATES +=	either	1.9.0	# MIT OR Apache-2.0
MODCARGO_CRATES +=	encode_unicode	0.3.6	# MIT/Apache-2.0
MODCARGO_CRATES +=	encoding_rs	0.8.33	# (Apache-2.0 OR MIT) AND BSD-3-Clause
MODCARGO_CRATES +=	equivalent	1.0.1	# Apache-2.0 OR MIT
MODCARGO_CRATES +=	errno	0.3.8	# MIT OR Apache-2.0
MODCARGO_CRATES +=	etcetera	0.8.0	# MIT OR Apache-2.0
MODCARGO_CRATES +=	fast-srgb8	1.0.0	# MIT OR Apache-2.0 OR CC0-1.0
MODCARGO_CRATES +=	flate2	1.0.28	# MIT OR Apache-2.0
MODCARGO_CRATES +=	fnv	1.0.7	# Apache-2.0 / MIT
MODCARGO_CRATES +=	form_urlencoded	1.2.1	# MIT OR Apache-2.0
MODCARGO_CRATES +=	futures	0.3.30	# MIT OR Apache-2.0
MODCARGO_CRATES +=	futures-channel	0.3.30	# MIT OR Apache-2.0
MODCARGO_CRATES +=	futures-core	0.3.30	# MIT OR Apache-2.0
MODCARGO_CRATES +=	futures-executor	0.3.30	# MIT OR Apache-2.0
MODCARGO_CRATES +=	futures-io	0.3.30	# MIT OR Apache-2.0
MODCARGO_CRATES +=	futures-macro	0.3.30	# MIT OR Apache-2.0
MODCARGO_CRATES +=	futures-sink	0.3.30	# MIT OR Apache-2.0
MODCARGO_CRATES +=	futures-task	0.3.30	# MIT OR Apache-2.0
MODCARGO_CRATES +=	futures-timer	3.0.3	# MIT/Apache-2.0
MODCARGO_CRATES +=	futures-util	0.3.30	# MIT OR Apache-2.0
MODCARGO_CRATES +=	getrandom	0.2.11	# MIT OR Apache-2.0
MODCARGO_CRATES +=	git2	0.18.2	# MIT OR Apache-2.0
MODCARGO_CRATES +=	glob	0.3.1	# MIT OR Apache-2.0
MODCARGO_CRATES +=	globset	0.4.14	# Unlicense OR MIT
MODCARGO_CRATES +=	grep-cli	0.1.10	# Unlicense OR MIT
MODCARGO_CRATES +=	hashbrown	0.14.3	# MIT OR Apache-2.0
MODCARGO_CRATES +=	heck	0.4.1	# MIT OR Apache-2.0
MODCARGO_CRATES +=	home	0.5.9	# MIT OR Apache-2.0
MODCARGO_CRATES +=	iana-time-zone	0.1.59	# MIT OR Apache-2.0
MODCARGO_CRATES +=	iana-time-zone-haiku	0.1.2	# MIT OR Apache-2.0
MODCARGO_CRATES +=	idna	0.5.0	# MIT OR Apache-2.0
MODCARGO_CRATES +=	indexmap	2.1.0	# Apache-2.0 OR MIT
MODCARGO_CRATES +=	insta	1.39.0	# Apache-2.0
MODCARGO_CRATES +=	itertools	0.10.5	# MIT/Apache-2.0
MODCARGO_CRATES +=	itoa	1.0.10	# MIT OR Apache-2.0
MODCARGO_CRATES +=	jobserver	0.1.27	# MIT/Apache-2.0
MODCARGO_CRATES +=	js-sys	0.3.66	# MIT OR Apache-2.0
MODCARGO_CRATES +=	lazy_static	1.4.0	# MIT/Apache-2.0
MODCARGO_CRATES +=	libc	0.2.155	# MIT OR Apache-2.0
MODCARGO_CRATES +=	libgit2-sys	0.16.2+1.7.2	# MIT OR Apache-2.0
MODCARGO_CRATES +=	libredox	0.0.1	# MIT
MODCARGO_CRATES +=	libz-sys	1.1.12	# MIT OR Apache-2.0
MODCARGO_CRATES +=	linked-hash-map	0.5.6	# MIT/Apache-2.0
MODCARGO_CRATES +=	linux-raw-sys	0.4.12	# Apache-2.0 WITH LLVM-exception OR Apache-2.0 OR MIT
MODCARGO_CRATES +=	log	0.4.20	# MIT OR Apache-2.0
MODCARGO_CRATES +=	memchr	2.7.1	# Unlicense OR MIT
MODCARGO_CRATES +=	miniz_oxide	0.7.1	# MIT OR Zlib OR Apache-2.0
MODCARGO_CRATES +=	mio	0.8.11	# MIT
MODCARGO_CRATES +=	nix	0.27.1	# MIT
MODCARGO_CRATES +=	ntapi	0.4.1	# Apache-2.0 OR MIT
MODCARGO_CRATES +=	nu-ansi-term	0.49.0	# MIT
MODCARGO_CRATES +=	num-conv	0.1.0	# MIT OR Apache-2.0
MODCARGO_CRATES +=	num-traits	0.2.17	# MIT OR Apache-2.0
MODCARGO_CRATES +=	once_cell	1.19.0	# MIT OR Apache-2.0
MODCARGO_CRATES +=	onig	6.4.0	# MIT
MODCARGO_CRATES +=	onig_sys	69.8.1	# MIT
MODCARGO_CRATES +=	option-ext	0.2.0	# MPL-2.0
MODCARGO_CRATES +=	palette	0.7.3	# MIT OR Apache-2.0
MODCARGO_CRATES +=	palette_derive	0.7.3	# MIT OR Apache-2.0
MODCARGO_CRATES +=	path_abs	0.5.1	# MIT OR Apache-2.0
MODCARGO_CRATES +=	pathdiff	0.2.1	# MIT/Apache-2.0
MODCARGO_CRATES +=	percent-encoding	2.3.1	# MIT OR Apache-2.0
MODCARGO_CRATES +=	phf	0.11.2	# MIT
MODCARGO_CRATES +=	phf_generator	0.11.2	# MIT
MODCARGO_CRATES +=	phf_macros	0.11.2	# MIT
MODCARGO_CRATES +=	phf_shared	0.11.2	# MIT
MODCARGO_CRATES +=	pin-project-lite	0.2.14	# Apache-2.0 OR MIT
MODCARGO_CRATES +=	pin-utils	0.1.0	# MIT OR Apache-2.0
MODCARGO_CRATES +=	pkg-config	0.3.28	# MIT OR Apache-2.0
MODCARGO_CRATES +=	plist	1.7.0	# MIT
MODCARGO_CRATES +=	powerfmt	0.2.0	# MIT OR Apache-2.0
MODCARGO_CRATES +=	proc-macro-crate	3.1.0	# MIT OR Apache-2.0
MODCARGO_CRATES +=	proc-macro2	1.0.75	# MIT OR Apache-2.0
MODCARGO_CRATES +=	quick-xml	0.32.0	# MIT
MODCARGO_CRATES +=	quote	1.0.35	# MIT OR Apache-2.0
MODCARGO_CRATES +=	rand	0.8.5	# MIT OR Apache-2.0
MODCARGO_CRATES +=	rand_core	0.6.4	# MIT OR Apache-2.0
MODCARGO_CRATES +=	redox_syscall	0.4.1	# MIT
MODCARGO_CRATES +=	redox_users	0.4.4	# MIT
MODCARGO_CRATES +=	regex	1.10.2	# MIT OR Apache-2.0
MODCARGO_CRATES +=	regex-automata	0.4.3	# MIT OR Apache-2.0
MODCARGO_CRATES +=	regex-syntax	0.8.2	# MIT OR Apache-2.0
MODCARGO_CRATES +=	relative-path	1.9.3	# MIT OR Apache-2.0
MODCARGO_CRATES +=	rgb	0.8.37	# MIT
MODCARGO_CRATES +=	rstest	0.21.0	# MIT OR Apache-2.0
MODCARGO_CRATES +=	rstest_macros	0.21.0	# MIT OR Apache-2.0
MODCARGO_CRATES +=	rustc_version	0.4.0	# MIT/Apache-2.0
MODCARGO_CRATES +=	rustix	0.38.28	# Apache-2.0 WITH LLVM-exception OR Apache-2.0 OR MIT
MODCARGO_CRATES +=	ryu	1.0.16	# Apache-2.0 OR BSL-1.0
MODCARGO_CRATES +=	same-file	1.0.6	# Unlicense/MIT
MODCARGO_CRATES +=	semver	1.0.21	# MIT OR Apache-2.0
MODCARGO_CRATES +=	serde	1.0.194	# MIT OR Apache-2.0
MODCARGO_CRATES +=	serde_derive	1.0.194	# MIT OR Apache-2.0
MODCARGO_CRATES +=	serde_json	1.0.111	# MIT OR Apache-2.0
MODCARGO_CRATES +=	serde_yaml	0.9.30	# MIT OR Apache-2.0
MODCARGO_CRATES +=	shell-words	1.1.0	# MIT/Apache-2.0
MODCARGO_CRATES +=	similar	2.5.0	# Apache-2.0
MODCARGO_CRATES +=	siphasher	0.3.11	# MIT/Apache-2.0
MODCARGO_CRATES +=	slab	0.4.9	# MIT
MODCARGO_CRATES +=	smol_str	0.1.24	# MIT OR Apache-2.0
MODCARGO_CRATES +=	std_prelude	0.2.12	# MIT
MODCARGO_CRATES +=	strsim	0.10.0	# MIT
MODCARGO_CRATES +=	syn	2.0.48	# MIT OR Apache-2.0
MODCARGO_CRATES +=	syntect	5.2.0	# MIT
MODCARGO_CRATES +=	sysinfo	0.29.11	# MIT
MODCARGO_CRATES +=	termcolor	1.4.0	# Unlicense OR MIT
MODCARGO_CRATES +=	terminal-colorsaurus	0.4.3	# MIT OR Apache-2.0
MODCARGO_CRATES +=	terminal-trx	0.2.1	# MIT OR Apache-2.0
MODCARGO_CRATES +=	terminal_size	0.3.0	# MIT OR Apache-2.0
MODCARGO_CRATES +=	thiserror	1.0.56	# MIT OR Apache-2.0
MODCARGO_CRATES +=	thiserror-impl	1.0.56	# MIT OR Apache-2.0
MODCARGO_CRATES +=	time	0.3.36	# MIT OR Apache-2.0
MODCARGO_CRATES +=	time-core	0.1.2	# MIT OR Apache-2.0
MODCARGO_CRATES +=	time-macros	0.2.18	# MIT OR Apache-2.0
MODCARGO_CRATES +=	tinyvec	1.6.0	# Zlib OR Apache-2.0 OR MIT
MODCARGO_CRATES +=	tinyvec_macros	0.1.1	# MIT OR Apache-2.0 OR Zlib
MODCARGO_CRATES +=	toml_datetime	0.6.6	# MIT OR Apache-2.0
MODCARGO_CRATES +=	toml_edit	0.21.1	# MIT OR Apache-2.0
MODCARGO_CRATES +=	unicode-bidi	0.3.14	# MIT OR Apache-2.0
MODCARGO_CRATES +=	unicode-ident	1.0.12	# (MIT OR Apache-2.0) AND Unicode-DFS-2016
MODCARGO_CRATES +=	unicode-normalization	0.1.22	# MIT/Apache-2.0
MODCARGO_CRATES +=	unicode-segmentation	1.10.1	# MIT/Apache-2.0
MODCARGO_CRATES +=	unicode-width	0.1.11	# MIT/Apache-2.0
MODCARGO_CRATES +=	unsafe-libyaml	0.2.10	# MIT
MODCARGO_CRATES +=	url	2.5.0	# MIT OR Apache-2.0
MODCARGO_CRATES +=	utf8parse	0.2.1	# Apache-2.0 OR MIT
MODCARGO_CRATES +=	vcpkg	0.2.15	# MIT/Apache-2.0
MODCARGO_CRATES +=	walkdir	2.4.0	# Unlicense/MIT
MODCARGO_CRATES +=	wasi	0.11.0+wasi-snapshot-preview1	# Apache-2.0 WITH LLVM-exception OR Apache-2.0 OR MIT
MODCARGO_CRATES +=	wasm-bindgen	0.2.89	# MIT OR Apache-2.0
MODCARGO_CRATES +=	wasm-bindgen-backend	0.2.89	# MIT OR Apache-2.0
MODCARGO_CRATES +=	wasm-bindgen-macro	0.2.89	# MIT OR Apache-2.0
MODCARGO_CRATES +=	wasm-bindgen-macro-support	0.2.89	# MIT OR Apache-2.0
MODCARGO_CRATES +=	wasm-bindgen-shared	0.2.89	# MIT OR Apache-2.0
MODCARGO_CRATES +=	wild	2.2.0	# Apache-2.0 OR MIT
MODCARGO_CRATES +=	winapi	0.3.9	# MIT/Apache-2.0
MODCARGO_CRATES +=	winapi-i686-pc-windows-gnu	0.4.0	# MIT/Apache-2.0
MODCARGO_CRATES +=	winapi-util	0.1.6	# Unlicense/MIT
MODCARGO_CRATES +=	winapi-x86_64-pc-windows-gnu	0.4.0	# MIT/Apache-2.0
MODCARGO_CRATES +=	windows-core	0.52.0	# MIT OR Apache-2.0
MODCARGO_CRATES +=	windows-sys	0.45.0	# MIT OR Apache-2.0
MODCARGO_CRATES +=	windows-sys	0.48.0	# MIT OR Apache-2.0
MODCARGO_CRATES +=	windows-sys	0.52.0	# MIT OR Apache-2.0
MODCARGO_CRATES +=	windows-targets	0.42.2	# MIT OR Apache-2.0
MODCARGO_CRATES +=	windows-targets	0.48.5	# MIT OR Apache-2.0
MODCARGO_CRATES +=	windows-targets	0.52.0	# MIT OR Apache-2.0
MODCARGO_CRATES +=	windows_aarch64_gnullvm	0.42.2	# MIT OR Apache-2.0
MODCARGO_CRATES +=	windows_aarch64_gnullvm	0.48.5	# MIT OR Apache-2.0
MODCARGO_CRATES +=	windows_aarch64_gnullvm	0.52.0	# MIT OR Apache-2.0
MODCARGO_CRATES +=	windows_aarch64_msvc	0.42.2	# MIT OR Apache-2.0
MODCARGO_CRATES +=	windows_aarch64_msvc	0.48.5	# MIT OR Apache-2.0
MODCARGO_CRATES +=	windows_aarch64_msvc	0.52.0	# MIT OR Apache-2.0
MODCARGO_CRATES +=	windows_i686_gnu	0.42.2	# MIT OR Apache-2.0
MODCARGO_CRATES +=	windows_i686_gnu	0.48.5	# MIT OR Apache-2.0
MODCARGO_CRATES +=	windows_i686_gnu	0.52.0	# MIT OR Apache-2.0
MODCARGO_CRATES +=	windows_i686_msvc	0.42.2	# MIT OR Apache-2.0
MODCARGO_CRATES +=	windows_i686_msvc	0.48.5	# MIT OR Apache-2.0
MODCARGO_CRATES +=	windows_i686_msvc	0.52.0	# MIT OR Apache-2.0
MODCARGO_CRATES +=	windows_x86_64_gnu	0.42.2	# MIT OR Apache-2.0
MODCARGO_CRATES +=	windows_x86_64_gnu	0.48.5	# MIT OR Apache-2.0
MODCARGO_CRATES +=	windows_x86_64_gnu	0.52.0	# MIT OR Apache-2.0
MODCARGO_CRATES +=	windows_x86_64_gnullvm	0.42.2	# MIT OR Apache-2.0
MODCARGO_CRATES +=	windows_x86_64_gnullvm	0.48.5	# MIT OR Apache-2.0
MODCARGO_CRATES +=	windows_x86_64_gnullvm	0.52.0	# MIT OR Apache-2.0
MODCARGO_CRATES +=	windows_x86_64_msvc	0.42.2	# MIT OR Apache-2.0
MODCARGO_CRATES +=	windows_x86_64_msvc	0.48.5	# MIT OR Apache-2.0
MODCARGO_CRATES +=	windows_x86_64_msvc	0.52.0	# MIT OR Apache-2.0
MODCARGO_CRATES +=	winnow	0.5.40	# MIT
MODCARGO_CRATES +=	xdg	2.5.2	# Apache-2.0 OR MIT
MODCARGO_CRATES +=	yaml-rust	0.4.5	# MIT/Apache-2.0
