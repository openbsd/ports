MODCARGO_CRATES +=	aho-corasick	1.0.2	# Unlicense OR MIT
MODCARGO_CRATES +=	anstream	0.3.2	# MIT OR Apache-2.0
MODCARGO_CRATES +=	anstyle	1.0.1	# MIT OR Apache-2.0
MODCARGO_CRATES +=	anstyle-parse	0.2.1	# MIT OR Apache-2.0
MODCARGO_CRATES +=	anstyle-query	1.0.0	# MIT OR Apache-2.0
MODCARGO_CRATES +=	anstyle-wincon	1.0.1	# MIT OR Apache-2.0
MODCARGO_CRATES +=	anyhow	1.0.72	# MIT OR Apache-2.0
MODCARGO_CRATES +=	assert_cmd	2.0.12	# MIT OR Apache-2.0
MODCARGO_CRATES +=	autocfg	1.1.0	# Apache-2.0 OR MIT
MODCARGO_CRATES +=	bitflags	1.3.2	# MIT/Apache-2.0
MODCARGO_CRATES +=	bitflags	2.3.3	# MIT OR Apache-2.0
MODCARGO_CRATES +=	bstr	1.6.0	# MIT OR Apache-2.0
MODCARGO_CRATES +=	cc	1.0.79	# MIT OR Apache-2.0
MODCARGO_CRATES +=	clap	4.3.19	# MIT OR Apache-2.0
MODCARGO_CRATES +=	clap_builder	4.3.19	# MIT OR Apache-2.0
MODCARGO_CRATES +=	clap_lex	0.5.0	# MIT OR Apache-2.0
MODCARGO_CRATES +=	colorchoice	1.0.0	# MIT OR Apache-2.0
MODCARGO_CRATES +=	const_format	0.2.31	# Zlib
MODCARGO_CRATES +=	const_format_proc_macros	0.2.31	# Zlib
MODCARGO_CRATES +=	diff	0.1.13	# MIT OR Apache-2.0
MODCARGO_CRATES +=	difflib	0.4.0	# MIT
MODCARGO_CRATES +=	doc-comment	0.3.3	# MIT
MODCARGO_CRATES +=	either	1.9.0	# MIT OR Apache-2.0
MODCARGO_CRATES +=	errno	0.3.1	# MIT OR Apache-2.0
MODCARGO_CRATES +=	errno-dragonfly	0.1.2	# MIT
MODCARGO_CRATES +=	float-cmp	0.9.0	# MIT
MODCARGO_CRATES +=	hermit-abi	0.3.2	# MIT OR Apache-2.0
MODCARGO_CRATES +=	io-lifetimes	1.0.11	# Apache-2.0 WITH LLVM-exception OR Apache-2.0 OR MIT
MODCARGO_CRATES +=	is-terminal	0.4.9	# MIT
MODCARGO_CRATES +=	is_ci	1.1.1	# ISC
MODCARGO_CRATES +=	itertools	0.10.5	# MIT/Apache-2.0
MODCARGO_CRATES +=	libc	0.2.147	# MIT OR Apache-2.0
MODCARGO_CRATES +=	linux-raw-sys	0.3.8	# Apache-2.0 WITH LLVM-exception OR Apache-2.0 OR MIT
MODCARGO_CRATES +=	linux-raw-sys	0.4.3	# Apache-2.0 WITH LLVM-exception OR Apache-2.0 OR MIT
MODCARGO_CRATES +=	memchr	2.5.0	# Unlicense/MIT
MODCARGO_CRATES +=	normalize-line-endings	0.3.0	# Apache-2.0
MODCARGO_CRATES +=	num-traits	0.2.16	# MIT OR Apache-2.0
MODCARGO_CRATES +=	once_cell	1.18.0	# MIT OR Apache-2.0
MODCARGO_CRATES +=	owo-colors	3.5.0	# MIT
MODCARGO_CRATES +=	predicates	2.1.5	# MIT OR Apache-2.0
MODCARGO_CRATES +=	predicates	3.0.3	# MIT OR Apache-2.0
MODCARGO_CRATES +=	predicates-core	1.0.6	# MIT OR Apache-2.0
MODCARGO_CRATES +=	predicates-tree	1.0.9	# MIT OR Apache-2.0
MODCARGO_CRATES +=	pretty_assertions	1.4.0	# MIT OR Apache-2.0
MODCARGO_CRATES +=	proc-macro2	1.0.66	# MIT OR Apache-2.0
MODCARGO_CRATES +=	quote	1.0.32	# MIT OR Apache-2.0
MODCARGO_CRATES +=	regex	1.9.1	# MIT OR Apache-2.0
MODCARGO_CRATES +=	regex-automata	0.3.3	# MIT OR Apache-2.0
MODCARGO_CRATES +=	regex-syntax	0.7.4	# MIT OR Apache-2.0
MODCARGO_CRATES +=	rustix	0.37.23	# Apache-2.0 WITH LLVM-exception OR Apache-2.0 OR MIT
MODCARGO_CRATES +=	rustix	0.38.4	# Apache-2.0 WITH LLVM-exception OR Apache-2.0 OR MIT
MODCARGO_CRATES +=	serde	1.0.175	# MIT OR Apache-2.0
MODCARGO_CRATES +=	strsim	0.10.0	# MIT
MODCARGO_CRATES +=	supports-color	2.0.0	# Apache-2.0
MODCARGO_CRATES +=	syn	2.0.27	# MIT OR Apache-2.0
MODCARGO_CRATES +=	terminal_size	0.2.6	# MIT OR Apache-2.0
MODCARGO_CRATES +=	termtree	0.4.1	# MIT
MODCARGO_CRATES +=	thiserror	1.0.44	# MIT OR Apache-2.0
MODCARGO_CRATES +=	thiserror-impl	1.0.44	# MIT OR Apache-2.0
MODCARGO_CRATES +=	unicode-ident	1.0.11	# (MIT OR Apache-2.0) AND Unicode-DFS-2016
MODCARGO_CRATES +=	unicode-xid	0.2.4	# MIT OR Apache-2.0
MODCARGO_CRATES +=	utf8parse	0.2.1	# Apache-2.0 OR MIT
MODCARGO_CRATES +=	wait-timeout	0.2.0	# MIT/Apache-2.0
MODCARGO_CRATES +=	windows-sys	0.48.0	# MIT OR Apache-2.0
MODCARGO_CRATES +=	windows-targets	0.48.1	# MIT OR Apache-2.0
MODCARGO_CRATES +=	windows_aarch64_gnullvm	0.48.0	# MIT OR Apache-2.0
MODCARGO_CRATES +=	windows_aarch64_msvc	0.48.0	# MIT OR Apache-2.0
MODCARGO_CRATES +=	windows_i686_gnu	0.48.0	# MIT OR Apache-2.0
MODCARGO_CRATES +=	windows_i686_msvc	0.48.0	# MIT OR Apache-2.0
MODCARGO_CRATES +=	windows_x86_64_gnu	0.48.0	# MIT OR Apache-2.0
MODCARGO_CRATES +=	windows_x86_64_gnullvm	0.48.0	# MIT OR Apache-2.0
MODCARGO_CRATES +=	windows_x86_64_msvc	0.48.0	# MIT OR Apache-2.0
MODCARGO_CRATES +=	yansi	0.5.1	# MIT/Apache-2.0
