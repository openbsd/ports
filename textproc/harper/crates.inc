MODCARGO_CRATES +=	adler2	2.0.1	# 0BSD OR MIT OR Apache-2.0
MODCARGO_CRATES +=	ahash	0.8.12	# MIT OR Apache-2.0
MODCARGO_CRATES +=	aho-corasick	1.1.5	# Unlicense OR MIT
MODCARGO_CRATES +=	alloca	0.4.0	# MIT
MODCARGO_CRATES +=	allocator-api2	0.2.21	# MIT OR Apache-2.0
MODCARGO_CRATES +=	ammonia	4.1.4	# MIT OR Apache-2.0
MODCARGO_CRATES +=	android_system_properties	0.1.6	# MIT OR Apache-2.0
MODCARGO_CRATES +=	anes	0.1.6	# MIT OR Apache-2.0
MODCARGO_CRATES +=	anstream	1.0.0	# MIT OR Apache-2.0
MODCARGO_CRATES +=	anstyle	1.0.14	# MIT OR Apache-2.0
MODCARGO_CRATES +=	anstyle-parse	1.0.0	# MIT OR Apache-2.0
MODCARGO_CRATES +=	anstyle-query	1.1.5	# MIT OR Apache-2.0
MODCARGO_CRATES +=	anstyle-wincon	3.0.11	# MIT OR Apache-2.0
MODCARGO_CRATES +=	anyhow	1.0.104	# MIT OR Apache-2.0
MODCARGO_CRATES +=	arbitrary	1.4.2	# MIT OR Apache-2.0
MODCARGO_CRATES +=	ariadne	0.6.0	# MIT
MODCARGO_CRATES +=	arrayvec	0.7.8	# MIT OR Apache-2.0
MODCARGO_CRATES +=	ash	0.38.0+1.3.281	# MIT OR Apache-2.0
MODCARGO_CRATES +=	async-channel	2.5.0	# Apache-2.0 OR MIT
MODCARGO_CRATES +=	atomic-waker	1.1.2	# Apache-2.0 OR MIT
MODCARGO_CRATES +=	atomic_float	1.1.0	# Apache-2.0 OR MIT OR Unlicense
MODCARGO_CRATES +=	autocfg	1.5.1	# Apache-2.0 OR MIT
MODCARGO_CRATES +=	base64	0.22.1	# MIT OR Apache-2.0
MODCARGO_CRATES +=	bincode	2.0.1	# MIT
MODCARGO_CRATES +=	bindgen	0.71.1	# BSD-3-Clause
MODCARGO_CRATES +=	bit-set	0.8.0	# Apache-2.0 OR MIT
MODCARGO_CRATES +=	bit-vec	0.8.0	# Apache-2.0 OR MIT
MODCARGO_CRATES +=	bitflags	1.3.2	# MIT/Apache-2.0
MODCARGO_CRATES +=	bitflags	2.13.1	# MIT OR Apache-2.0
MODCARGO_CRATES +=	blanket	0.4.0	# MIT
MODCARGO_CRATES +=	block	0.1.6	# MIT
MODCARGO_CRATES +=	block-buffer	0.10.4	# MIT OR Apache-2.0
MODCARGO_CRATES +=	boxcar	0.2.14	# MIT
MODCARGO_CRATES +=	bstr	1.13.1	# MIT OR Apache-2.0
MODCARGO_CRATES +=	bumpalo	3.20.3	# MIT OR Apache-2.0
MODCARGO_CRATES +=	burn	0.19.1	# MIT OR Apache-2.0
MODCARGO_CRATES +=	burn-autodiff	0.19.1	# MIT OR Apache-2.0
MODCARGO_CRATES +=	burn-candle	0.19.1	# MIT OR Apache-2.0
MODCARGO_CRATES +=	burn-common	0.19.1	# MIT OR Apache-2.0
MODCARGO_CRATES +=	burn-core	0.19.1	# MIT OR Apache-2.0
MODCARGO_CRATES +=	burn-cubecl	0.19.1	# MIT OR Apache-2.0
MODCARGO_CRATES +=	burn-cubecl-fusion	0.19.1	# MIT OR Apache-2.0
MODCARGO_CRATES +=	burn-cuda	0.19.1	# MIT OR Apache-2.0
MODCARGO_CRATES +=	burn-dataset	0.19.1	# MIT OR Apache-2.0
MODCARGO_CRATES +=	burn-derive	0.19.1	# MIT OR Apache-2.0
MODCARGO_CRATES +=	burn-fusion	0.19.1	# MIT OR Apache-2.0
MODCARGO_CRATES +=	burn-ir	0.19.1	# MIT OR Apache-2.0
MODCARGO_CRATES +=	burn-ndarray	0.19.1	# MIT OR Apache-2.0
MODCARGO_CRATES +=	burn-nn	0.19.1	# MIT OR Apache-2.0
MODCARGO_CRATES +=	burn-optim	0.19.1	# MIT OR Apache-2.0
MODCARGO_CRATES +=	burn-rocm	0.19.1	# MIT OR Apache-2.0
MODCARGO_CRATES +=	burn-router	0.19.1	# MIT OR Apache-2.0
MODCARGO_CRATES +=	burn-store	0.19.1	# MIT OR Apache-2.0
MODCARGO_CRATES +=	burn-tensor	0.19.1	# MIT OR Apache-2.0
MODCARGO_CRATES +=	burn-train	0.19.1	# MIT OR Apache-2.0
MODCARGO_CRATES +=	burn-wgpu	0.19.1	# MIT OR Apache-2.0
MODCARGO_CRATES +=	bytemuck	1.25.2	# Zlib OR Apache-2.0 OR MIT
MODCARGO_CRATES +=	bytemuck_derive	1.12.0	# Zlib OR Apache-2.0 OR MIT
MODCARGO_CRATES +=	byteorder	1.5.0	# Unlicense OR MIT
MODCARGO_CRATES +=	bytes	1.12.1	# MIT
MODCARGO_CRATES +=	cached	2.0.2	# MIT
MODCARGO_CRATES +=	cached_proc_macro	2.0.0	# MIT
MODCARGO_CRATES +=	cached_proc_macro_types	1.0.0	# MIT
MODCARGO_CRATES +=	candle-core	0.9.2	# MIT OR Apache-2.0
MODCARGO_CRATES +=	caseless	0.2.2	# MIT
MODCARGO_CRATES +=	cast	0.3.0	# MIT OR Apache-2.0
MODCARGO_CRATES +=	cc	1.4.2	# MIT OR Apache-2.0
MODCARGO_CRATES +=	cexpr	0.6.0	# Apache-2.0/MIT
MODCARGO_CRATES +=	cfg-if	1.0.4	# MIT OR Apache-2.0
MODCARGO_CRATES +=	cfg_aliases	0.2.2	# MIT
MODCARGO_CRATES +=	chacha20	0.10.1	# MIT OR Apache-2.0
MODCARGO_CRATES +=	chrono	0.4.45	# MIT OR Apache-2.0
MODCARGO_CRATES +=	ciborium	0.2.2	# Apache-2.0
MODCARGO_CRATES +=	ciborium-io	0.2.2	# Apache-2.0
MODCARGO_CRATES +=	ciborium-ll	0.2.2	# Apache-2.0
MODCARGO_CRATES +=	clang-sys	1.9.1	# Apache-2.0
MODCARGO_CRATES +=	clap	4.6.6	# MIT OR Apache-2.0
MODCARGO_CRATES +=	clap_builder	4.6.6	# MIT OR Apache-2.0
MODCARGO_CRATES +=	clap_complete	4.6.9	# MIT OR Apache-2.0
MODCARGO_CRATES +=	clap_derive	4.6.4	# MIT OR Apache-2.0
MODCARGO_CRATES +=	clap_lex	1.1.0	# MIT OR Apache-2.0
MODCARGO_CRATES +=	codespan-reporting	0.12.0	# Apache-2.0
MODCARGO_CRATES +=	colorchoice	1.0.5	# MIT OR Apache-2.0
MODCARGO_CRATES +=	colored	3.1.1	# MPL-2.0
MODCARGO_CRATES +=	comrak	0.39.1	# BSD-2-Clause
MODCARGO_CRATES +=	concurrent-queue	2.5.0	# Apache-2.0 OR MIT
MODCARGO_CRATES +=	console_error_panic_hook	0.1.7	# Apache-2.0/MIT
MODCARGO_CRATES +=	const-random	0.1.18	# MIT OR Apache-2.0
MODCARGO_CRATES +=	const-random-macro	0.1.16	# MIT OR Apache-2.0
MODCARGO_CRATES +=	constcat	0.6.1	# MIT OR Apache-2.0
MODCARGO_CRATES +=	convert_case	0.8.0	# MIT
MODCARGO_CRATES +=	convert_case	0.10.0	# MIT
MODCARGO_CRATES +=	core-foundation	0.10.1	# MIT OR Apache-2.0
MODCARGO_CRATES +=	core-foundation-sys	0.8.7	# MIT OR Apache-2.0
MODCARGO_CRATES +=	core-graphics-types	0.2.0	# MIT OR Apache-2.0
MODCARGO_CRATES +=	cpufeatures	0.2.17	# MIT OR Apache-2.0
MODCARGO_CRATES +=	cpufeatures	0.3.0	# MIT OR Apache-2.0
MODCARGO_CRATES +=	crc32fast	1.5.0	# MIT OR Apache-2.0
MODCARGO_CRATES +=	criterion	0.8.2	# Apache-2.0 OR MIT
MODCARGO_CRATES +=	criterion-plot	0.8.2	# Apache-2.0 OR MIT
MODCARGO_CRATES +=	critical-section	1.2.0	# MIT OR Apache-2.0
MODCARGO_CRATES +=	crossbeam-channel	0.5.16	# MIT OR Apache-2.0
MODCARGO_CRATES +=	crossbeam-deque	0.8.7	# MIT OR Apache-2.0
MODCARGO_CRATES +=	crossbeam-epoch	0.9.20	# MIT OR Apache-2.0
MODCARGO_CRATES +=	crossbeam-utils	0.8.22	# MIT OR Apache-2.0
MODCARGO_CRATES +=	crunchy	0.2.4	# MIT
MODCARGO_CRATES +=	crypto-common	0.1.7	# MIT OR Apache-2.0
MODCARGO_CRATES +=	cssparser	0.37.0	# MPL-2.0
MODCARGO_CRATES +=	csv	1.4.0	# Unlicense/MIT
MODCARGO_CRATES +=	csv-core	0.1.13	# Unlicense/MIT
MODCARGO_CRATES +=	cubecl	0.8.1	# MIT OR Apache-2.0
MODCARGO_CRATES +=	cubecl-common	0.8.1	# MIT OR Apache-2.0
MODCARGO_CRATES +=	cubecl-convolution	0.8.1	# MIT OR Apache-2.0
MODCARGO_CRATES +=	cubecl-core	0.8.1	# MIT OR Apache-2.0
MODCARGO_CRATES +=	cubecl-cpp	0.8.1	# MIT OR Apache-2.0
MODCARGO_CRATES +=	cubecl-cpu	0.8.1	# MIT OR Apache-2.0
MODCARGO_CRATES +=	cubecl-cuda	0.8.1	# MIT OR Apache-2.0
MODCARGO_CRATES +=	cubecl-hip	0.8.1	# MIT OR Apache-2.0
MODCARGO_CRATES +=	cubecl-hip-sys	7.14.6085000	# MIT OR Apache-2.0
MODCARGO_CRATES +=	cubecl-ir	0.8.1	# MIT OR Apache-2.0
MODCARGO_CRATES +=	cubecl-macros	0.8.1	# MIT OR Apache-2.0
MODCARGO_CRATES +=	cubecl-macros-internal	0.8.1	# MIT OR Apache-2.0
MODCARGO_CRATES +=	cubecl-matmul	0.8.1	# MIT OR Apache-2.0
MODCARGO_CRATES +=	cubecl-opt	0.8.1	# MIT OR Apache-2.0
MODCARGO_CRATES +=	cubecl-quant	0.8.1	# MIT OR Apache-2.0
MODCARGO_CRATES +=	cubecl-random	0.8.1	# MIT OR Apache-2.0
MODCARGO_CRATES +=	cubecl-reduce	0.8.1	# MIT OR Apache-2.0
MODCARGO_CRATES +=	cubecl-runtime	0.8.1	# MIT OR Apache-2.0
MODCARGO_CRATES +=	cubecl-std	0.8.1	# MIT OR Apache-2.0
MODCARGO_CRATES +=	cubecl-wgpu	0.8.1	# MIT OR Apache-2.0
MODCARGO_CRATES +=	cudarc	0.17.8	# MIT OR Apache-2.0
MODCARGO_CRATES +=	darling	0.20.11	# MIT
MODCARGO_CRATES +=	darling	0.21.3	# MIT
MODCARGO_CRATES +=	darling_core	0.20.11	# MIT
MODCARGO_CRATES +=	darling_core	0.21.3	# MIT
MODCARGO_CRATES +=	darling_macro	0.20.11	# MIT
MODCARGO_CRATES +=	darling_macro	0.21.3	# MIT
MODCARGO_CRATES +=	dashmap	6.2.1	# MIT
MODCARGO_CRATES +=	data-encoding	2.11.1	# MIT
MODCARGO_CRATES +=	deranged	0.5.8	# MIT OR Apache-2.0
MODCARGO_CRATES +=	derive-new	0.7.0	# MIT
MODCARGO_CRATES +=	derive_more	1.0.0	# MIT
MODCARGO_CRATES +=	derive_more	2.1.1	# MIT
MODCARGO_CRATES +=	derive_more-impl	1.0.0	# MIT
MODCARGO_CRATES +=	derive_more-impl	2.1.1	# MIT
MODCARGO_CRATES +=	deunicode	1.6.2	# BSD-3-Clause
MODCARGO_CRATES +=	diff	0.1.13	# MIT OR Apache-2.0
MODCARGO_CRATES +=	digest	0.10.7	# MIT OR Apache-2.0
MODCARGO_CRATES +=	dirs	4.0.0	# MIT OR Apache-2.0
MODCARGO_CRATES +=	dirs	6.0.0	# MIT OR Apache-2.0
MODCARGO_CRATES +=	dirs-sys	0.3.7	# MIT OR Apache-2.0
MODCARGO_CRATES +=	dirs-sys	0.5.0	# MIT OR Apache-2.0
MODCARGO_CRATES +=	displaydoc	0.2.7	# MIT OR Apache-2.0
MODCARGO_CRATES +=	document-features	0.2.12	# MIT OR Apache-2.0
MODCARGO_CRATES +=	dtoa	1.0.11	# MIT OR Apache-2.0
MODCARGO_CRATES +=	dtoa-short	0.3.5	# MPL-2.0
MODCARGO_CRATES +=	dyn-stack	0.13.2	# MIT
MODCARGO_CRATES +=	dyn-stack-macros	0.1.3	# MIT
MODCARGO_CRATES +=	ecow	0.2.6	# MIT OR Apache-2.0
MODCARGO_CRATES +=	either	1.17.0	# MIT OR Apache-2.0
MODCARGO_CRATES +=	embassy-futures	0.1.2	# MIT OR Apache-2.0
MODCARGO_CRATES +=	embassy-time	0.4.0	# MIT OR Apache-2.0
MODCARGO_CRATES +=	embassy-time-driver	0.2.2	# MIT OR Apache-2.0
MODCARGO_CRATES +=	embedded-hal	0.2.7	# MIT OR Apache-2.0
MODCARGO_CRATES +=	embedded-hal	1.0.0	# MIT OR Apache-2.0
MODCARGO_CRATES +=	embedded-hal-async	1.0.0	# MIT OR Apache-2.0
MODCARGO_CRATES +=	entities	1.0.1	# MIT
MODCARGO_CRATES +=	enum-as-inner	0.6.1	# MIT/Apache-2.0
MODCARGO_CRATES +=	enum_dispatch	0.3.13	# MIT OR Apache-2.0
MODCARGO_CRATES +=	enumset	1.1.14	# MIT/Apache-2.0
MODCARGO_CRATES +=	enumset_derive	0.15.0	# MIT/Apache-2.0
MODCARGO_CRATES +=	env_filter	2.0.0	# MIT OR Apache-2.0
MODCARGO_CRATES +=	env_logger	0.11.11	# MIT OR Apache-2.0
MODCARGO_CRATES +=	equivalent	1.0.2	# Apache-2.0 OR MIT
MODCARGO_CRATES +=	errno	0.3.14	# MIT OR Apache-2.0
MODCARGO_CRATES +=	event-listener	5.4.2	# Apache-2.0 OR MIT
MODCARGO_CRATES +=	event-listener-strategy	0.5.4	# Apache-2.0 OR MIT
MODCARGO_CRATES +=	fastrand	2.5.0	# Apache-2.0 OR MIT
MODCARGO_CRATES +=	fid-rs	0.2.0	# MIT OR Apache-2.0
MODCARGO_CRATES +=	filetime	0.2.29	# MIT/Apache-2.0
MODCARGO_CRATES +=	find-msvc-tools	0.1.10	# MIT OR Apache-2.0
MODCARGO_CRATES +=	fixedbitset	0.4.2	# MIT/Apache-2.0
MODCARGO_CRATES +=	flate2	1.1.9	# MIT OR Apache-2.0
MODCARGO_CRATES +=	float-ord	0.3.2	# MIT / Apache-2.0
MODCARGO_CRATES +=	float4	0.1.0	# MIT
MODCARGO_CRATES +=	float8	0.4.2	# MIT
MODCARGO_CRATES +=	float8	0.6.1	# MIT
MODCARGO_CRATES +=	fluent-uri	0.1.4	# MIT
MODCARGO_CRATES +=	fnv	1.0.7	# Apache-2.0 / MIT
MODCARGO_CRATES +=	foldhash	0.1.5	# Zlib
MODCARGO_CRATES +=	foldhash	0.2.0	# Zlib
MODCARGO_CRATES +=	foreign-types	0.5.0	# MIT/Apache-2.0
MODCARGO_CRATES +=	foreign-types-macros	0.2.4	# MIT/Apache-2.0
MODCARGO_CRATES +=	foreign-types-shared	0.3.1	# MIT/Apache-2.0
MODCARGO_CRATES +=	form_urlencoded	1.2.2	# MIT OR Apache-2.0
MODCARGO_CRATES +=	fst	0.4.7	# Unlicense/MIT
MODCARGO_CRATES +=	futures	0.3.34	# MIT OR Apache-2.0
MODCARGO_CRATES +=	futures-channel	0.3.34	# MIT OR Apache-2.0
MODCARGO_CRATES +=	futures-core	0.3.34	# MIT OR Apache-2.0
MODCARGO_CRATES +=	futures-executor	0.3.34	# MIT OR Apache-2.0
MODCARGO_CRATES +=	futures-io	0.3.34	# MIT OR Apache-2.0
MODCARGO_CRATES +=	futures-lite	2.6.1	# Apache-2.0 OR MIT
MODCARGO_CRATES +=	futures-macro	0.3.34	# MIT OR Apache-2.0
MODCARGO_CRATES +=	futures-sink	0.3.34	# MIT OR Apache-2.0
MODCARGO_CRATES +=	futures-task	0.3.34	# MIT OR Apache-2.0
MODCARGO_CRATES +=	futures-timer	3.0.4	# MIT/Apache-2.0
MODCARGO_CRATES +=	futures-util	0.3.34	# MIT OR Apache-2.0
MODCARGO_CRATES +=	gemm	0.19.0	# MIT
MODCARGO_CRATES +=	gemm-c32	0.19.0	# MIT
MODCARGO_CRATES +=	gemm-c64	0.19.0	# MIT
MODCARGO_CRATES +=	gemm-common	0.19.0	# MIT
MODCARGO_CRATES +=	gemm-f16	0.19.0	# MIT
MODCARGO_CRATES +=	gemm-f32	0.19.0	# MIT
MODCARGO_CRATES +=	gemm-f64	0.19.0	# MIT
MODCARGO_CRATES +=	generic-array	0.14.7	# MIT
MODCARGO_CRATES +=	getopts	0.2.24	# MIT OR Apache-2.0
MODCARGO_CRATES +=	getrandom	0.2.17	# MIT OR Apache-2.0
MODCARGO_CRATES +=	getrandom	0.3.4	# MIT OR Apache-2.0
MODCARGO_CRATES +=	getrandom	0.4.3	# MIT OR Apache-2.0
MODCARGO_CRATES +=	gl_generator	0.14.0	# Apache-2.0
MODCARGO_CRATES +=	glob	0.3.4	# MIT OR Apache-2.0
MODCARGO_CRATES +=	globset	0.4.20	# Unlicense OR MIT
MODCARGO_CRATES +=	glow	0.16.0	# MIT OR Apache-2.0 OR Zlib
MODCARGO_CRATES +=	glutin_wgl_sys	0.6.1	# Apache-2.0
MODCARGO_CRATES +=	gpu-alloc	0.6.2	# MIT OR Apache-2.0
MODCARGO_CRATES +=	gpu-alloc-types	0.3.1	# MIT OR Apache-2.0
MODCARGO_CRATES +=	gpu-allocator	0.27.0	# MIT OR Apache-2.0
MODCARGO_CRATES +=	gpu-descriptor	0.3.2	# MIT OR Apache-2.0
MODCARGO_CRATES +=	gpu-descriptor-types	0.2.0	# MIT OR Apache-2.0
MODCARGO_CRATES +=	h2	0.4.15	# MIT
MODCARGO_CRATES +=	half	2.7.1	# MIT OR Apache-2.0
MODCARGO_CRATES +=	harper-tree-sitter-dart	0.0.5	# MIT
MODCARGO_CRATES +=	hashbrown	0.13.2	# MIT OR Apache-2.0
MODCARGO_CRATES +=	hashbrown	0.14.5	# MIT OR Apache-2.0
MODCARGO_CRATES +=	hashbrown	0.15.5	# MIT OR Apache-2.0
MODCARGO_CRATES +=	hashbrown	0.16.1	# MIT OR Apache-2.0
MODCARGO_CRATES +=	hashbrown	0.17.1	# MIT OR Apache-2.0
MODCARGO_CRATES +=	heck	0.5.0	# MIT OR Apache-2.0
MODCARGO_CRATES +=	hermit-abi	0.5.2	# MIT OR Apache-2.0
MODCARGO_CRATES +=	hexf-parse	0.2.1	# CC0-1.0
MODCARGO_CRATES +=	html5ever	0.39.0	# MIT OR Apache-2.0
MODCARGO_CRATES +=	http	1.5.0	# MIT OR Apache-2.0
MODCARGO_CRATES +=	http-body	1.1.0	# MIT
MODCARGO_CRATES +=	http-body-util	0.1.5	# MIT
MODCARGO_CRATES +=	httparse	1.10.1	# MIT OR Apache-2.0
MODCARGO_CRATES +=	hyper	1.11.0	# MIT
MODCARGO_CRATES +=	hyper-rustls	0.27.9	# Apache-2.0 OR ISC OR MIT
MODCARGO_CRATES +=	hyper-util	0.1.20	# MIT
MODCARGO_CRATES +=	iana-time-zone	0.1.65	# MIT OR Apache-2.0
MODCARGO_CRATES +=	iana-time-zone-haiku	0.1.2	# MIT OR Apache-2.0
MODCARGO_CRATES +=	icu_collections	2.2.0	# Unicode-3.0
MODCARGO_CRATES +=	icu_locale_core	2.2.0	# Unicode-3.0
MODCARGO_CRATES +=	icu_normalizer	2.2.0	# Unicode-3.0
MODCARGO_CRATES +=	icu_normalizer_data	2.2.0	# Unicode-3.0
MODCARGO_CRATES +=	icu_properties	2.2.0	# Unicode-3.0
MODCARGO_CRATES +=	icu_properties_data	2.2.0	# Unicode-3.0
MODCARGO_CRATES +=	icu_provider	2.2.0	# Unicode-3.0
MODCARGO_CRATES +=	ident_case	1.0.1	# MIT/Apache-2.0
MODCARGO_CRATES +=	idna	1.1.0	# MIT OR Apache-2.0
MODCARGO_CRATES +=	idna_adapter	1.2.2	# Apache-2.0 OR MIT
MODCARGO_CRATES +=	indexmap	2.14.2	# Apache-2.0 OR MIT
MODCARGO_CRATES +=	ipnet	2.12.1	# MIT OR Apache-2.0
MODCARGO_CRATES +=	is-docker	0.2.0	# MIT
MODCARGO_CRATES +=	is-macro	0.3.7	# Apache-2.0
MODCARGO_CRATES +=	is-wsl	0.4.0	# MIT
MODCARGO_CRATES +=	is_terminal_polyfill	1.70.2	# MIT OR Apache-2.0
MODCARGO_CRATES +=	itertools	0.13.0	# MIT OR Apache-2.0
MODCARGO_CRATES +=	itertools	0.14.0	# MIT OR Apache-2.0
MODCARGO_CRATES +=	itertools	0.15.0	# MIT OR Apache-2.0
MODCARGO_CRATES +=	itoa	1.0.18	# MIT OR Apache-2.0
MODCARGO_CRATES +=	jni-sys	0.3.1	# MIT OR Apache-2.0
MODCARGO_CRATES +=	jni-sys	0.4.1	# MIT OR Apache-2.0
MODCARGO_CRATES +=	jni-sys-macros	0.4.1	# MIT OR Apache-2.0
MODCARGO_CRATES +=	jobserver	0.1.35	# MIT OR Apache-2.0
MODCARGO_CRATES +=	js-sys	0.3.104	# MIT OR Apache-2.0
MODCARGO_CRATES +=	khronos-egl	6.0.0	# MIT/Apache-2.0
MODCARGO_CRATES +=	khronos_api	3.1.0	# Apache-2.0
MODCARGO_CRATES +=	lazy_static	1.5.0	# MIT OR Apache-2.0
MODCARGO_CRATES +=	levenshtein_automata	0.2.1	# MIT
MODCARGO_CRATES +=	libc	0.2.189	# MIT OR Apache-2.0
MODCARGO_CRATES +=	libfuzzer-sys	0.4.13	# (MIT OR Apache-2.0) AND NCSA
MODCARGO_CRATES +=	libloading	0.8.9	# ISC
MODCARGO_CRATES +=	liblzma	0.4.8	# MIT OR Apache-2.0
MODCARGO_CRATES +=	liblzma-sys	0.4.8	# MIT OR Apache-2.0
MODCARGO_CRATES +=	libm	0.2.16	# MIT
MODCARGO_CRATES +=	libredox	0.1.19	# MIT
MODCARGO_CRATES +=	linux-raw-sys	0.12.1	# Apache-2.0 WITH LLVM-exception OR Apache-2.0 OR MIT
MODCARGO_CRATES +=	litemap	0.8.2	# Unicode-3.0
MODCARGO_CRATES +=	litrs	1.0.0	# MIT OR Apache-2.0
MODCARGO_CRATES +=	lock_api	0.4.14	# MIT OR Apache-2.0
MODCARGO_CRATES +=	log	0.4.33	# MIT OR Apache-2.0
MODCARGO_CRATES +=	louds-rs	0.7.0	# MIT OR Apache-2.0
MODCARGO_CRATES +=	lru	0.18.2	# MIT
MODCARGO_CRATES +=	lru-slab	0.1.2	# MIT OR Apache-2.0 OR Zlib
MODCARGO_CRATES +=	lsp-types	0.97.0	# MIT
MODCARGO_CRATES +=	macerator	0.2.10	# MIT OR Apache-2.0
MODCARGO_CRATES +=	macerator-macros	0.1.5	# MIT OR Apache-2.0
MODCARGO_CRATES +=	malloc_buf	0.0.6	# MIT
MODCARGO_CRATES +=	maplit	1.0.2	# MIT/Apache-2.0
MODCARGO_CRATES +=	markup5ever	0.39.0	# MIT OR Apache-2.0
MODCARGO_CRATES +=	matrixmultiply	0.3.11	# MIT/Apache-2.0
MODCARGO_CRATES +=	md5	0.8.1	# Apache-2.0 OR MIT
MODCARGO_CRATES +=	memchr	2.8.3	# Unlicense OR MIT
MODCARGO_CRATES +=	memmap2	0.9.11	# MIT OR Apache-2.0
MODCARGO_CRATES +=	metal	0.32.0	# MIT OR Apache-2.0
MODCARGO_CRATES +=	minimal-lexical	0.2.1	# MIT/Apache-2.0
MODCARGO_CRATES +=	miniz_oxide	0.8.9	# MIT OR Zlib OR Apache-2.0
MODCARGO_CRATES +=	mio	1.2.2	# MIT
MODCARGO_CRATES +=	moddef	0.3.0	# MIT
MODCARGO_CRATES +=	naga	26.0.0	# MIT OR Apache-2.0
MODCARGO_CRATES +=	nb	0.1.3	# MIT OR Apache-2.0
MODCARGO_CRATES +=	nb	1.1.0	# MIT OR Apache-2.0
MODCARGO_CRATES +=	ndarray	0.16.1	# MIT OR Apache-2.0
MODCARGO_CRATES +=	ndk-sys	0.6.0+11769913	# MIT OR Apache-2.0
MODCARGO_CRATES +=	new_debug_unreachable	1.0.6	# MIT
MODCARGO_CRATES +=	nom	7.1.3	# MIT
MODCARGO_CRATES +=	ntapi	0.4.3	# Apache-2.0 OR MIT
MODCARGO_CRATES +=	nu-ansi-term	0.50.3	# MIT
MODCARGO_CRATES +=	num	0.4.3	# MIT OR Apache-2.0
MODCARGO_CRATES +=	num-bigint	0.4.8	# MIT OR Apache-2.0
MODCARGO_CRATES +=	num-complex	0.4.6	# MIT OR Apache-2.0
MODCARGO_CRATES +=	num-conv	0.2.2	# MIT OR Apache-2.0
MODCARGO_CRATES +=	num-integer	0.1.47	# MIT OR Apache-2.0
MODCARGO_CRATES +=	num-iter	0.1.46	# MIT OR Apache-2.0
MODCARGO_CRATES +=	num-rational	0.4.2	# MIT OR Apache-2.0
MODCARGO_CRATES +=	num-traits	0.2.19	# MIT OR Apache-2.0
MODCARGO_CRATES +=	num_cpus	1.17.0	# MIT OR Apache-2.0
MODCARGO_CRATES +=	objc	0.2.7	# MIT
MODCARGO_CRATES +=	objc2-core-foundation	0.3.2	# Zlib OR Apache-2.0 OR MIT
MODCARGO_CRATES +=	objc2-io-kit	0.3.2	# Zlib OR Apache-2.0 OR MIT
MODCARGO_CRATES +=	once_cell	1.21.4	# MIT OR Apache-2.0
MODCARGO_CRATES +=	once_cell_polyfill	1.70.2	# MIT OR Apache-2.0
MODCARGO_CRATES +=	oorandom	11.1.5	# MIT
MODCARGO_CRATES +=	open	5.4.4	# MIT
MODCARGO_CRATES +=	option-ext	0.2.0	# MPL-2.0
MODCARGO_CRATES +=	ordered-float	4.6.0	# MIT
MODCARGO_CRATES +=	ordered-float	5.5.0	# MIT
MODCARGO_CRATES +=	page_size	0.6.0	# MIT/Apache-2.0
MODCARGO_CRATES +=	parking	2.2.1	# Apache-2.0 OR MIT
MODCARGO_CRATES +=	parking_lot	0.12.5	# MIT OR Apache-2.0
MODCARGO_CRATES +=	parking_lot_core	0.9.12	# MIT OR Apache-2.0
MODCARGO_CRATES +=	paste	1.0.15	# MIT OR Apache-2.0
MODCARGO_CRATES +=	percent-encoding	2.3.2	# MIT OR Apache-2.0
MODCARGO_CRATES +=	petgraph	0.6.5	# MIT OR Apache-2.0
MODCARGO_CRATES +=	phf	0.13.1	# MIT
MODCARGO_CRATES +=	phf_codegen	0.13.1	# MIT
MODCARGO_CRATES +=	phf_generator	0.13.1	# MIT
MODCARGO_CRATES +=	phf_shared	0.13.1	# MIT
MODCARGO_CRATES +=	pin-project-lite	0.2.17	# Apache-2.0 OR MIT
MODCARGO_CRATES +=	pkg-config	0.3.33	# MIT OR Apache-2.0
MODCARGO_CRATES +=	portable-atomic	1.15.0	# Apache-2.0 OR MIT
MODCARGO_CRATES +=	portable-atomic-util	0.2.7	# Apache-2.0 OR MIT
MODCARGO_CRATES +=	potential_utf	0.1.5	# Unicode-3.0
MODCARGO_CRATES +=	powerfmt	0.2.0	# MIT OR Apache-2.0
MODCARGO_CRATES +=	ppv-lite86	0.2.21	# MIT OR Apache-2.0
MODCARGO_CRATES +=	precomputed-hash	0.1.1	# MIT
MODCARGO_CRATES +=	presser	0.3.1	# MIT OR Apache-2.0
MODCARGO_CRATES +=	pretty_assertions	1.4.1	# MIT OR Apache-2.0
MODCARGO_CRATES +=	prettyplease	0.2.37	# MIT OR Apache-2.0
MODCARGO_CRATES +=	proc-macro-crate	3.5.0	# MIT OR Apache-2.0
MODCARGO_CRATES +=	proc-macro2	1.0.107	# MIT OR Apache-2.0
MODCARGO_CRATES +=	profiling	1.0.18	# MIT OR Apache-2.0
MODCARGO_CRATES +=	pulldown-cmark	0.13.4	# MIT
MODCARGO_CRATES +=	pulldown-cmark-escape	0.11.0	# MIT
MODCARGO_CRATES +=	pulp	0.22.3	# MIT
MODCARGO_CRATES +=	pulp-wasm-simd-flag	0.1.1	# MIT
MODCARGO_CRATES +=	quickcheck	1.1.0	# Unlicense OR MIT
MODCARGO_CRATES +=	quickcheck_macros	1.2.0	# Unlicense OR MIT
MODCARGO_CRATES +=	quinn	0.11.11	# MIT OR Apache-2.0
MODCARGO_CRATES +=	quinn-proto	0.11.16	# MIT OR Apache-2.0
MODCARGO_CRATES +=	quinn-udp	0.5.15	# MIT OR Apache-2.0
MODCARGO_CRATES +=	quote	1.0.47	# MIT OR Apache-2.0
MODCARGO_CRATES +=	r-efi	5.3.0	# MIT OR Apache-2.0 OR LGPL-2.1-or-later
MODCARGO_CRATES +=	r-efi	6.0.0	# MIT OR Apache-2.0 OR LGPL-2.1-or-later
MODCARGO_CRATES +=	rand	0.8.7	# MIT OR Apache-2.0
MODCARGO_CRATES +=	rand	0.9.5	# MIT OR Apache-2.0
MODCARGO_CRATES +=	rand	0.10.2	# MIT OR Apache-2.0
MODCARGO_CRATES +=	rand_chacha	0.9.0	# MIT OR Apache-2.0
MODCARGO_CRATES +=	rand_core	0.6.4	# MIT OR Apache-2.0
MODCARGO_CRATES +=	rand_core	0.9.5	# MIT OR Apache-2.0
MODCARGO_CRATES +=	rand_core	0.10.1	# MIT OR Apache-2.0
MODCARGO_CRATES +=	rand_distr	0.5.1	# MIT OR Apache-2.0
MODCARGO_CRATES +=	rand_pcg	0.10.2	# MIT OR Apache-2.0
MODCARGO_CRATES +=	range-alloc	0.1.5	# MIT OR Apache-2.0
MODCARGO_CRATES +=	raw-cpuid	11.6.0	# MIT
MODCARGO_CRATES +=	raw-window-handle	0.6.2	# MIT OR Apache-2.0 OR Zlib
MODCARGO_CRATES +=	rawpointer	0.2.1	# MIT/Apache-2.0
MODCARGO_CRATES +=	rayon	1.12.0	# MIT OR Apache-2.0
MODCARGO_CRATES +=	rayon-core	1.13.0	# MIT OR Apache-2.0
MODCARGO_CRATES +=	reborrow	0.5.5	# MIT
MODCARGO_CRATES +=	redox_syscall	0.5.18	# MIT
MODCARGO_CRATES +=	redox_users	0.4.6	# MIT
MODCARGO_CRATES +=	redox_users	0.5.2	# MIT
MODCARGO_CRATES +=	regex	1.13.1	# MIT OR Apache-2.0
MODCARGO_CRATES +=	regex-automata	0.4.18	# MIT OR Apache-2.0
MODCARGO_CRATES +=	regex-syntax	0.8.11	# MIT OR Apache-2.0
MODCARGO_CRATES +=	relative-path	1.9.3	# MIT OR Apache-2.0
MODCARGO_CRATES +=	renderdoc-sys	1.1.0	# MIT OR Apache-2.0
MODCARGO_CRATES +=	reqwest	0.12.28	# MIT OR Apache-2.0
MODCARGO_CRATES +=	resolve-path	0.1.0	# MIT OR Apache-2.0
MODCARGO_CRATES +=	ring	0.17.14	# Apache-2.0 AND ISC
MODCARGO_CRATES +=	rmp	0.8.15	# MIT
MODCARGO_CRATES +=	rmp-serde	1.3.1	# MIT
MODCARGO_CRATES +=	rs-conllu	0.3.0	# MIT OR Apache-2.0
MODCARGO_CRATES +=	rstest	0.26.1	# MIT OR Apache-2.0
MODCARGO_CRATES +=	rstest_macros	0.26.1	# MIT OR Apache-2.0
MODCARGO_CRATES +=	rustc-hash	1.1.0	# Apache-2.0/MIT
MODCARGO_CRATES +=	rustc-hash	2.1.3	# Apache-2.0 OR MIT
MODCARGO_CRATES +=	rustc_version	0.4.1	# MIT OR Apache-2.0
MODCARGO_CRATES +=	rustix	1.1.4	# Apache-2.0 WITH LLVM-exception OR Apache-2.0 OR MIT
MODCARGO_CRATES +=	rustls	0.23.43	# Apache-2.0 OR ISC OR MIT
MODCARGO_CRATES +=	rustls-pki-types	1.15.1	# MIT OR Apache-2.0
MODCARGO_CRATES +=	rustls-webpki	0.103.14	# ISC
MODCARGO_CRATES +=	rustversion	1.0.23	# MIT OR Apache-2.0
MODCARGO_CRATES +=	ruzstd	0.9.0	# MIT
MODCARGO_CRATES +=	ryu	1.0.23	# Apache-2.0 OR BSL-1.0
MODCARGO_CRATES +=	safetensors	0.6.2	# Apache-2.0
MODCARGO_CRATES +=	safetensors	0.7.0	# Apache-2.0
MODCARGO_CRATES +=	same-file	1.0.6	# Unlicense/MIT
MODCARGO_CRATES +=	sanitize-filename	0.6.0	# MIT
MODCARGO_CRATES +=	scopeguard	1.2.0	# MIT OR Apache-2.0
MODCARGO_CRATES +=	semver	1.0.28	# MIT OR Apache-2.0
MODCARGO_CRATES +=	seq-macro	0.3.6	# MIT OR Apache-2.0
MODCARGO_CRATES +=	serde	1.0.229	# MIT OR Apache-2.0
MODCARGO_CRATES +=	serde-wasm-bindgen	0.6.5	# MIT
MODCARGO_CRATES +=	serde_bytes	0.11.19	# MIT OR Apache-2.0
MODCARGO_CRATES +=	serde_core	1.0.229	# MIT OR Apache-2.0
MODCARGO_CRATES +=	serde_derive	1.0.229	# MIT OR Apache-2.0
MODCARGO_CRATES +=	serde_json	1.0.151	# MIT OR Apache-2.0
MODCARGO_CRATES +=	serde_repr	0.1.21	# MIT OR Apache-2.0
MODCARGO_CRATES +=	serde_spanned	0.6.9	# MIT OR Apache-2.0
MODCARGO_CRATES +=	serde_spanned	1.1.1	# MIT OR Apache-2.0
MODCARGO_CRATES +=	serde_urlencoded	0.7.1	# MIT/Apache-2.0
MODCARGO_CRATES +=	sha2	0.10.9	# MIT OR Apache-2.0
MODCARGO_CRATES +=	sharded-slab	0.1.7	# MIT
MODCARGO_CRATES +=	shlex	1.3.0	# MIT OR Apache-2.0
MODCARGO_CRATES +=	shlex	2.0.1	# MIT OR Apache-2.0
MODCARGO_CRATES +=	simd-adler32	0.3.10	# MIT
MODCARGO_CRATES +=	siphasher	1.0.3	# MIT/Apache-2.0
MODCARGO_CRATES +=	slab	0.4.12	# MIT
MODCARGO_CRATES +=	slotmap	1.1.1	# Zlib
MODCARGO_CRATES +=	slug	0.1.6	# MIT/Apache-2.0
MODCARGO_CRATES +=	smallvec	1.15.2	# MIT OR Apache-2.0
MODCARGO_CRATES +=	socket2	0.6.5	# MIT OR Apache-2.0
MODCARGO_CRATES +=	spin	0.10.1	# MIT
MODCARGO_CRATES +=	spirv	0.3.0+sdk-1.3.268.0	# Apache-2.0
MODCARGO_CRATES +=	stable-vec	0.4.2	# MIT/Apache-2.0
MODCARGO_CRATES +=	stable_deref_trait	1.2.1	# MIT OR Apache-2.0
MODCARGO_CRATES +=	static_assertions	1.1.0	# MIT OR Apache-2.0
MODCARGO_CRATES +=	streaming-iterator	0.1.9	# MIT OR Apache-2.0
MODCARGO_CRATES +=	string_cache	0.9.0	# MIT OR Apache-2.0
MODCARGO_CRATES +=	string_cache_codegen	0.6.1	# MIT OR Apache-2.0
MODCARGO_CRATES +=	strsim	0.11.1	# MIT
MODCARGO_CRATES +=	strum	0.27.2	# MIT
MODCARGO_CRATES +=	strum	0.28.0	# MIT
MODCARGO_CRATES +=	strum_macros	0.27.2	# MIT
MODCARGO_CRATES +=	strum_macros	0.28.0	# MIT
MODCARGO_CRATES +=	subtle	2.6.1	# BSD-3-Clause
MODCARGO_CRATES +=	symlink	0.1.0	# MIT/Apache-2.0
MODCARGO_CRATES +=	syn	2.0.119	# MIT OR Apache-2.0
MODCARGO_CRATES +=	syn	3.0.5	# MIT OR Apache-2.0
MODCARGO_CRATES +=	sync_wrapper	1.0.2	# Apache-2.0
MODCARGO_CRATES +=	synstructure	0.13.2	# MIT
MODCARGO_CRATES +=	sysctl	0.6.0	# MIT
MODCARGO_CRATES +=	sysinfo	0.36.1	# MIT
MODCARGO_CRATES +=	sysinfo	0.39.6	# MIT
MODCARGO_CRATES +=	tar	0.4.46	# MIT OR Apache-2.0
MODCARGO_CRATES +=	tempfile	3.27.0	# MIT OR Apache-2.0
MODCARGO_CRATES +=	tendril	0.5.1	# MIT OR Apache-2.0
MODCARGO_CRATES +=	termcolor	1.4.1	# Unlicense OR MIT
MODCARGO_CRATES +=	text_placeholder	0.5.1	# MIT
MODCARGO_CRATES +=	thin-vec	0.2.19	# MIT OR Apache-2.0
MODCARGO_CRATES +=	thiserror	1.0.69	# MIT OR Apache-2.0
MODCARGO_CRATES +=	thiserror	2.0.20	# MIT OR Apache-2.0
MODCARGO_CRATES +=	thiserror-impl	1.0.69	# MIT OR Apache-2.0
MODCARGO_CRATES +=	thiserror-impl	2.0.20	# MIT OR Apache-2.0
MODCARGO_CRATES +=	thread-tree	0.3.3	# MIT OR Apache-2.0
MODCARGO_CRATES +=	thread_local	1.1.10	# MIT OR Apache-2.0
MODCARGO_CRATES +=	time	0.3.55	# MIT OR Apache-2.0
MODCARGO_CRATES +=	time-core	0.1.9	# MIT OR Apache-2.0
MODCARGO_CRATES +=	time-macros	0.2.32	# MIT OR Apache-2.0
MODCARGO_CRATES +=	tiny-keccak	2.0.2	# CC0-1.0
MODCARGO_CRATES +=	tinystr	0.8.3	# Unicode-3.0
MODCARGO_CRATES +=	tinytemplate	1.2.1	# Apache-2.0 OR MIT
MODCARGO_CRATES +=	tinyvec	1.12.0	# Zlib OR Apache-2.0 OR MIT
MODCARGO_CRATES +=	tinyvec_macros	0.1.1	# MIT OR Apache-2.0 OR Zlib
MODCARGO_CRATES +=	tokio	1.53.1	# MIT
MODCARGO_CRATES +=	tokio-macros	2.7.2	# MIT
MODCARGO_CRATES +=	tokio-rustls	0.26.4	# MIT OR Apache-2.0
MODCARGO_CRATES +=	tokio-util	0.7.19	# MIT
MODCARGO_CRATES +=	toml	0.8.2	# MIT OR Apache-2.0
MODCARGO_CRATES +=	toml	0.9.12+spec-1.1.0	# MIT OR Apache-2.0
MODCARGO_CRATES +=	toml_datetime	0.6.3	# MIT OR Apache-2.0
MODCARGO_CRATES +=	toml_datetime	0.7.5+spec-1.1.0	# MIT OR Apache-2.0
MODCARGO_CRATES +=	toml_datetime	1.1.1+spec-1.1.0	# MIT OR Apache-2.0
MODCARGO_CRATES +=	toml_edit	0.20.2	# MIT OR Apache-2.0
MODCARGO_CRATES +=	toml_edit	0.25.13+spec-1.1.0	# MIT OR Apache-2.0
MODCARGO_CRATES +=	toml_parser	1.1.3+spec-1.1.0	# MIT OR Apache-2.0
MODCARGO_CRATES +=	toml_writer	1.1.2+spec-1.1.0	# MIT OR Apache-2.0
MODCARGO_CRATES +=	tower	0.5.3	# MIT
MODCARGO_CRATES +=	tower-http	0.6.11	# MIT
MODCARGO_CRATES +=	tower-layer	0.3.3	# MIT
MODCARGO_CRATES +=	tower-lsp-server	0.22.1	# MIT OR Apache-2.0
MODCARGO_CRATES +=	tower-service	0.3.3	# MIT
MODCARGO_CRATES +=	tracel-llvm	20.1.4-7	# MIT OR Apache-2.0
MODCARGO_CRATES +=	tracel-llvm-bundler	20.1.4-7	# MIT OR Apache-2.0
MODCARGO_CRATES +=	tracel-mlir-rs	20.1.4-7	# Apache-2.0
MODCARGO_CRATES +=	tracel-mlir-rs-macros	20.1.4-7	# Apache-2.0
MODCARGO_CRATES +=	tracel-mlir-sys	20.1.4-7	# MIT
MODCARGO_CRATES +=	tracel-tblgen-rs	20.1.4-7	# MIT OR Apache-2.0
MODCARGO_CRATES +=	tracing	0.1.44	# MIT
MODCARGO_CRATES +=	tracing-appender	0.2.5	# MIT
MODCARGO_CRATES +=	tracing-attributes	0.1.31	# MIT
MODCARGO_CRATES +=	tracing-core	0.1.36	# MIT
MODCARGO_CRATES +=	tracing-log	0.2.0	# MIT
MODCARGO_CRATES +=	tracing-subscriber	0.3.23	# MIT
MODCARGO_CRATES +=	tracing-wasm	0.2.1	# MIT OR Apache-2.0
MODCARGO_CRATES +=	tree-sitter	0.25.10	# MIT
MODCARGO_CRATES +=	tree-sitter-asciidoc	0.7.0	# Apache-2.0
MODCARGO_CRATES +=	tree-sitter-bash	0.25.1	# MIT
MODCARGO_CRATES +=	tree-sitter-c	0.24.2	# MIT
MODCARGO_CRATES +=	tree-sitter-c-sharp	0.23.5	# MIT
MODCARGO_CRATES +=	tree-sitter-clojure	0.1.0	# MIT
MODCARGO_CRATES +=	tree-sitter-cmake	0.7.4	# MIT
MODCARGO_CRATES +=	tree-sitter-cpp	0.23.4	# MIT
MODCARGO_CRATES +=	tree-sitter-elixir	0.3.5	# Apache-2.0
MODCARGO_CRATES +=	tree-sitter-gitcommit	0.5.0	# WTFPL
MODCARGO_CRATES +=	tree-sitter-gleam	1.0.0	# Apache-2.0
MODCARGO_CRATES +=	tree-sitter-go	0.25.0	# MIT
MODCARGO_CRATES +=	tree-sitter-groovy	0.1.2	# MIT
MODCARGO_CRATES +=	tree-sitter-haskell	0.23.1	# MIT
MODCARGO_CRATES +=	tree-sitter-html	0.23.2	# MIT
MODCARGO_CRATES +=	tree-sitter-ink-lbz	0.0.5	# MIT
MODCARGO_CRATES +=	tree-sitter-java	0.23.5	# MIT
MODCARGO_CRATES +=	tree-sitter-javascript	0.25.0	# MIT
MODCARGO_CRATES +=	tree-sitter-jjdescription	0.0.1	# MIT
MODCARGO_CRATES +=	tree-sitter-kotlin-ng	1.1.0	# MIT
MODCARGO_CRATES +=	tree-sitter-language	0.1.7	# MIT
MODCARGO_CRATES +=	tree-sitter-lua	0.5.0	# MIT
MODCARGO_CRATES +=	tree-sitter-nix	0.3.0	# MIT
MODCARGO_CRATES +=	tree-sitter-php	0.24.2	# MIT
MODCARGO_CRATES +=	tree-sitter-powershell	0.26.4	# MIT
MODCARGO_CRATES +=	tree-sitter-python	0.25.0	# MIT
MODCARGO_CRATES +=	tree-sitter-ruby	0.23.1	# MIT
MODCARGO_CRATES +=	tree-sitter-rust	0.24.2	# MIT
MODCARGO_CRATES +=	tree-sitter-scala	0.26.2	# MIT
MODCARGO_CRATES +=	tree-sitter-solidity	1.2.13	# MIT
MODCARGO_CRATES +=	tree-sitter-swift	0.7.3	# MIT
MODCARGO_CRATES +=	tree-sitter-toml-ng	0.7.0	# MIT
MODCARGO_CRATES +=	tree-sitter-typescript	0.23.2	# MIT
MODCARGO_CRATES +=	tree-sitter-zig	1.1.2	# MIT
MODCARGO_CRATES +=	trie-rs	0.4.2	# MIT OR Apache-2.0
MODCARGO_CRATES +=	try-lock	0.2.5	# MIT
MODCARGO_CRATES +=	twox-hash	2.1.3	# MIT
MODCARGO_CRATES +=	type-map	0.5.1	# MIT/Apache-2.0
MODCARGO_CRATES +=	typed-arena	2.0.2	# MIT
MODCARGO_CRATES +=	typed-path	0.12.3	# MIT OR Apache-2.0
MODCARGO_CRATES +=	typenum	1.20.1	# MIT OR Apache-2.0
MODCARGO_CRATES +=	typst-syntax	0.14.2	# Apache-2.0
MODCARGO_CRATES +=	typst-timing	0.14.2	# Apache-2.0
MODCARGO_CRATES +=	typst-utils	0.14.2	# Apache-2.0
MODCARGO_CRATES +=	unicase	2.9.0	# MIT OR Apache-2.0
MODCARGO_CRATES +=	unicode-blocks	0.1.10	# MIT
MODCARGO_CRATES +=	unicode-ident	1.0.24	# (MIT OR Apache-2.0) AND Unicode-3.0
MODCARGO_CRATES +=	unicode-math-class	0.1.0	# MIT OR Apache-2.0
MODCARGO_CRATES +=	unicode-normalization	0.1.25	# MIT OR Apache-2.0
MODCARGO_CRATES +=	unicode-script	0.5.8	# MIT OR Apache-2.0
MODCARGO_CRATES +=	unicode-segmentation	1.13.3	# MIT OR Apache-2.0
MODCARGO_CRATES +=	unicode-width	0.2.2	# MIT OR Apache-2.0
MODCARGO_CRATES +=	unicode-xid	0.2.6	# MIT OR Apache-2.0
MODCARGO_CRATES +=	unicode_categories	0.1.1	# MIT OR Apache-2.0
MODCARGO_CRATES +=	unindent	0.2.4	# MIT OR Apache-2.0
MODCARGO_CRATES +=	unscanny	0.1.0	# MIT OR Apache-2.0
MODCARGO_CRATES +=	untrusted	0.9.0	# ISC
MODCARGO_CRATES +=	unty	0.0.4	# MIT OR Apache-2.0
MODCARGO_CRATES +=	url	2.5.8	# MIT OR Apache-2.0
MODCARGO_CRATES +=	utf8_iter	1.0.4	# Apache-2.0 OR MIT
MODCARGO_CRATES +=	utf8parse	0.2.2	# Apache-2.0 OR MIT
MODCARGO_CRATES +=	uuid	1.24.1	# Apache-2.0 OR MIT
MODCARGO_CRATES +=	valuable	0.1.1	# MIT
MODCARGO_CRATES +=	variadics_please	1.1.0	# MIT OR Apache-2.0
MODCARGO_CRATES +=	version_check	0.9.5	# MIT/Apache-2.0
MODCARGO_CRATES +=	void	1.0.2	# MIT
MODCARGO_CRATES +=	walkdir	2.5.0	# Unlicense/MIT
MODCARGO_CRATES +=	want	0.3.1	# MIT
MODCARGO_CRATES +=	wasi	0.11.1+wasi-snapshot-preview1	# Apache-2.0 WITH LLVM-exception OR Apache-2.0 OR MIT
MODCARGO_CRATES +=	wasip2	1.0.4+wasi-0.2.12	# Apache-2.0 WITH LLVM-exception OR Apache-2.0 OR MIT
MODCARGO_CRATES +=	wasm-bindgen	0.2.127	# MIT OR Apache-2.0
MODCARGO_CRATES +=	wasm-bindgen-futures	0.4.77	# MIT OR Apache-2.0
MODCARGO_CRATES +=	wasm-bindgen-macro	0.2.127	# MIT OR Apache-2.0
MODCARGO_CRATES +=	wasm-bindgen-macro-support	0.2.127	# MIT OR Apache-2.0
MODCARGO_CRATES +=	wasm-bindgen-shared	0.2.127	# MIT OR Apache-2.0
MODCARGO_CRATES +=	web-sys	0.3.104	# MIT OR Apache-2.0
MODCARGO_CRATES +=	web-time	1.1.0	# MIT OR Apache-2.0
MODCARGO_CRATES +=	web_atoms	0.2.6	# MIT OR Apache-2.0
MODCARGO_CRATES +=	webpki-roots	1.0.9	# CDLA-Permissive-2.0
MODCARGO_CRATES +=	wgpu	26.0.1	# MIT OR Apache-2.0
MODCARGO_CRATES +=	wgpu-core	26.0.1	# MIT OR Apache-2.0
MODCARGO_CRATES +=	wgpu-core-deps-apple	26.0.0	# MIT OR Apache-2.0
MODCARGO_CRATES +=	wgpu-core-deps-emscripten	26.0.0	# MIT OR Apache-2.0
MODCARGO_CRATES +=	wgpu-core-deps-windows-linux-android	26.0.0	# MIT OR Apache-2.0
MODCARGO_CRATES +=	wgpu-hal	26.0.6	# MIT OR Apache-2.0
MODCARGO_CRATES +=	wgpu-types	26.0.0	# MIT OR Apache-2.0
MODCARGO_CRATES +=	winapi	0.3.9	# MIT/Apache-2.0
MODCARGO_CRATES +=	winapi-i686-pc-windows-gnu	0.4.0	# MIT/Apache-2.0
MODCARGO_CRATES +=	winapi-util	0.1.11	# Unlicense OR MIT
MODCARGO_CRATES +=	winapi-x86_64-pc-windows-gnu	0.4.0	# MIT/Apache-2.0
MODCARGO_CRATES +=	windows	0.58.0	# MIT OR Apache-2.0
MODCARGO_CRATES +=	windows	0.61.3	# MIT OR Apache-2.0
MODCARGO_CRATES +=	windows	0.62.2	# MIT OR Apache-2.0
MODCARGO_CRATES +=	windows-collections	0.2.0	# MIT OR Apache-2.0
MODCARGO_CRATES +=	windows-collections	0.3.2	# MIT OR Apache-2.0
MODCARGO_CRATES +=	windows-core	0.58.0	# MIT OR Apache-2.0
MODCARGO_CRATES +=	windows-core	0.61.2	# MIT OR Apache-2.0
MODCARGO_CRATES +=	windows-core	0.62.2	# MIT OR Apache-2.0
MODCARGO_CRATES +=	windows-future	0.2.1	# MIT OR Apache-2.0
MODCARGO_CRATES +=	windows-future	0.3.2	# MIT OR Apache-2.0
MODCARGO_CRATES +=	windows-implement	0.58.0	# MIT OR Apache-2.0
MODCARGO_CRATES +=	windows-implement	0.60.2	# MIT OR Apache-2.0
MODCARGO_CRATES +=	windows-interface	0.58.0	# MIT OR Apache-2.0
MODCARGO_CRATES +=	windows-interface	0.59.3	# MIT OR Apache-2.0
MODCARGO_CRATES +=	windows-link	0.1.3	# MIT OR Apache-2.0
MODCARGO_CRATES +=	windows-link	0.2.1	# MIT OR Apache-2.0
MODCARGO_CRATES +=	windows-numerics	0.2.0	# MIT OR Apache-2.0
MODCARGO_CRATES +=	windows-numerics	0.3.1	# MIT OR Apache-2.0
MODCARGO_CRATES +=	windows-result	0.2.0	# MIT OR Apache-2.0
MODCARGO_CRATES +=	windows-result	0.3.4	# MIT OR Apache-2.0
MODCARGO_CRATES +=	windows-result	0.4.1	# MIT OR Apache-2.0
MODCARGO_CRATES +=	windows-strings	0.1.0	# MIT OR Apache-2.0
MODCARGO_CRATES +=	windows-strings	0.4.2	# MIT OR Apache-2.0
MODCARGO_CRATES +=	windows-strings	0.5.1	# MIT OR Apache-2.0
MODCARGO_CRATES +=	windows-sys	0.52.0	# MIT OR Apache-2.0
MODCARGO_CRATES +=	windows-sys	0.61.2	# MIT OR Apache-2.0
MODCARGO_CRATES +=	windows-targets	0.52.6	# MIT OR Apache-2.0
MODCARGO_CRATES +=	windows-threading	0.1.0	# MIT OR Apache-2.0
MODCARGO_CRATES +=	windows-threading	0.2.1	# MIT OR Apache-2.0
MODCARGO_CRATES +=	windows_aarch64_gnullvm	0.52.6	# MIT OR Apache-2.0
MODCARGO_CRATES +=	windows_aarch64_msvc	0.52.6	# MIT OR Apache-2.0
MODCARGO_CRATES +=	windows_i686_gnu	0.52.6	# MIT OR Apache-2.0
MODCARGO_CRATES +=	windows_i686_gnullvm	0.52.6	# MIT OR Apache-2.0
MODCARGO_CRATES +=	windows_i686_msvc	0.52.6	# MIT OR Apache-2.0
MODCARGO_CRATES +=	windows_x86_64_gnu	0.52.6	# MIT OR Apache-2.0
MODCARGO_CRATES +=	windows_x86_64_gnullvm	0.52.6	# MIT OR Apache-2.0
MODCARGO_CRATES +=	windows_x86_64_msvc	0.52.6	# MIT OR Apache-2.0
MODCARGO_CRATES +=	winnow	0.5.40	# MIT
MODCARGO_CRATES +=	winnow	0.7.15	# MIT
MODCARGO_CRATES +=	winnow	1.0.4	# MIT
MODCARGO_CRATES +=	wit-bindgen	0.57.1	# Apache-2.0 WITH LLVM-exception OR Apache-2.0 OR MIT
MODCARGO_CRATES +=	writeable	0.6.3	# Unicode-3.0
MODCARGO_CRATES +=	xattr	1.6.1	# MIT OR Apache-2.0
MODCARGO_CRATES +=	xml-rs	0.8.29	# MIT
MODCARGO_CRATES +=	yansi	1.0.1	# MIT OR Apache-2.0
MODCARGO_CRATES +=	yoke	0.8.3	# Unicode-3.0
MODCARGO_CRATES +=	yoke-derive	0.8.2	# Unicode-3.0
MODCARGO_CRATES +=	zerocopy	0.8.56	# BSD-2-Clause OR Apache-2.0 OR MIT
MODCARGO_CRATES +=	zerocopy-derive	0.8.56	# BSD-2-Clause OR Apache-2.0 OR MIT
MODCARGO_CRATES +=	zerofrom	0.1.8	# Unicode-3.0
MODCARGO_CRATES +=	zerofrom-derive	0.1.7	# Unicode-3.0
MODCARGO_CRATES +=	zeroize	1.9.0	# Apache-2.0 OR MIT
MODCARGO_CRATES +=	zerotrie	0.2.4	# Unicode-3.0
MODCARGO_CRATES +=	zerovec	0.11.6	# Unicode-3.0
MODCARGO_CRATES +=	zerovec-derive	0.11.3	# Unicode-3.0
MODCARGO_CRATES +=	zip	7.2.0	# MIT
MODCARGO_CRATES +=	zip	8.6.0	# MIT
MODCARGO_CRATES +=	zlib-rs	0.6.7	# Zlib
MODCARGO_CRATES +=	zmij	1.0.23	# MIT
MODCARGO_CRATES +=	zopfli	0.8.3	# Apache-2.0
MODCARGO_CRATES +=	zstd	0.13.3	# MIT
MODCARGO_CRATES +=	zstd-safe	7.2.4	# MIT OR Apache-2.0
MODCARGO_CRATES +=	zstd-sys	2.0.16+zstd.1.5.7	# MIT/Apache-2.0
