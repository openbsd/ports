MODCARGO_CRATES +=	accept-language	3.1.0	# MIT
MODCARGO_CRATES +=	addr2line	0.24.2	# Apache-2.0 OR MIT
MODCARGO_CRATES +=	adler2	2.0.0	# 0BSD OR MIT OR Apache-2.0
MODCARGO_CRATES +=	ahash	0.8.12	# MIT OR Apache-2.0
MODCARGO_CRATES +=	aho-corasick	1.1.3	# Unlicense OR MIT
MODCARGO_CRATES +=	allocator-api2	0.2.21	# MIT OR Apache-2.0
MODCARGO_CRATES +=	android_system_properties	0.1.5	# MIT/Apache-2.0
MODCARGO_CRATES +=	anstream	0.6.18	# MIT OR Apache-2.0
MODCARGO_CRATES +=	anstyle	1.0.10	# MIT OR Apache-2.0
MODCARGO_CRATES +=	anstyle-parse	0.2.6	# MIT OR Apache-2.0
MODCARGO_CRATES +=	anstyle-query	1.1.2	# MIT OR Apache-2.0
MODCARGO_CRATES +=	anstyle-wincon	3.0.7	# MIT OR Apache-2.0
MODCARGO_CRATES +=	anstyle-yansi	2.0.2	# MIT OR Apache-2.0
MODCARGO_CRATES +=	anyhow	1.0.98	# MIT OR Apache-2.0
MODCARGO_CRATES +=	arbitrary	1.4.2	# MIT OR Apache-2.0
MODCARGO_CRATES +=	arraydeque	0.5.1	# MIT/Apache-2.0
MODCARGO_CRATES +=	arrayvec	0.5.2	# MIT/Apache-2.0
MODCARGO_CRATES +=	askama	0.12.1	# MIT OR Apache-2.0
MODCARGO_CRATES +=	askama_axum	0.4.0	# MIT OR Apache-2.0
MODCARGO_CRATES +=	askama_derive	0.12.5	# MIT/Apache-2.0
MODCARGO_CRATES +=	askama_escape	0.10.3	# MIT OR Apache-2.0
MODCARGO_CRATES +=	askama_parser	0.2.1	# MIT OR Apache-2.0
MODCARGO_CRATES +=	assert_cmd	2.0.17	# MIT OR Apache-2.0
MODCARGO_CRATES +=	async-trait	0.1.88	# MIT OR Apache-2.0
MODCARGO_CRATES +=	atomic-waker	1.1.2	# Apache-2.0 OR MIT
MODCARGO_CRATES +=	auto_impl	1.3.0	# MIT OR Apache-2.0
MODCARGO_CRATES +=	autocfg	1.4.0	# Apache-2.0 OR MIT
MODCARGO_CRATES +=	axum	0.7.9	# MIT
MODCARGO_CRATES +=	axum-core	0.4.5	# MIT
MODCARGO_CRATES +=	backtrace	0.3.75	# MIT OR Apache-2.0
MODCARGO_CRATES +=	base64	0.21.7	# MIT OR Apache-2.0
MODCARGO_CRATES +=	base64	0.22.1	# MIT OR Apache-2.0
MODCARGO_CRATES +=	base64ct	1.8.0	# Apache-2.0 OR MIT
MODCARGO_CRATES +=	basic-toml	0.1.10	# MIT OR Apache-2.0
MODCARGO_CRATES +=	bitflags	1.3.2	# MIT/Apache-2.0
MODCARGO_CRATES +=	bitflags	2.9.1	# MIT OR Apache-2.0
MODCARGO_CRATES +=	block-buffer	0.10.4	# MIT OR Apache-2.0
MODCARGO_CRATES +=	bstr	1.12.0	# MIT OR Apache-2.0
MODCARGO_CRATES +=	bumpalo	3.17.0	# MIT OR Apache-2.0
MODCARGO_CRATES +=	byteorder	1.5.0	# Unlicense OR MIT
MODCARGO_CRATES +=	bytes	1.10.1	# MIT
MODCARGO_CRATES +=	camino	1.1.9	# MIT OR Apache-2.0
MODCARGO_CRATES +=	cc	1.2.24	# MIT OR Apache-2.0
MODCARGO_CRATES +=	cfg-if	1.0.0	# MIT/Apache-2.0
MODCARGO_CRATES +=	cfg_aliases	0.2.1	# MIT
MODCARGO_CRATES +=	chrono	0.4.42	# MIT OR Apache-2.0
MODCARGO_CRATES +=	clap	4.5.38	# MIT OR Apache-2.0
MODCARGO_CRATES +=	clap_builder	4.5.38	# MIT OR Apache-2.0
MODCARGO_CRATES +=	clap_derive	4.5.32	# MIT OR Apache-2.0
MODCARGO_CRATES +=	clap_lex	0.7.4	# MIT OR Apache-2.0
MODCARGO_CRATES +=	codesnake	0.2.1	# MIT
MODCARGO_CRATES +=	colorchoice	1.0.3	# MIT OR Apache-2.0
MODCARGO_CRATES +=	config	0.14.1	# MIT OR Apache-2.0
MODCARGO_CRATES +=	console	0.15.11	# MIT
MODCARGO_CRATES +=	const-oid	0.9.6	# Apache-2.0 OR MIT
MODCARGO_CRATES +=	const-random	0.1.18	# MIT OR Apache-2.0
MODCARGO_CRATES +=	const-random-macro	0.1.16	# MIT OR Apache-2.0
MODCARGO_CRATES +=	convert_case	0.6.0	# MIT
MODCARGO_CRATES +=	cooklang	0.17.4	# MIT
MODCARGO_CRATES +=	cooklang-find	0.4.0	# MIT
MODCARGO_CRATES +=	cooklang-find	0.5.0	# MIT
MODCARGO_CRATES +=	cooklang-import	0.8.7	# MIT
MODCARGO_CRATES +=	cooklang-language-server	0.1.0	# MIT
MODCARGO_CRATES +=	cooklang-reports	0.2.0	# MIT
MODCARGO_CRATES +=	core-foundation	0.9.4	# MIT OR Apache-2.0
MODCARGO_CRATES +=	core-foundation-sys	0.8.7	# MIT OR Apache-2.0
MODCARGO_CRATES +=	cpufeatures	0.2.17	# MIT OR Apache-2.0
MODCARGO_CRATES +=	crc32fast	1.5.0	# MIT OR Apache-2.0
MODCARGO_CRATES +=	crossbeam-deque	0.8.6	# MIT OR Apache-2.0
MODCARGO_CRATES +=	crossbeam-epoch	0.9.18	# MIT OR Apache-2.0
MODCARGO_CRATES +=	crossbeam-utils	0.8.21	# MIT OR Apache-2.0
MODCARGO_CRATES +=	crunchy	0.2.4	# MIT
MODCARGO_CRATES +=	crypto-common	0.1.6	# MIT OR Apache-2.0
MODCARGO_CRATES +=	cssparser	0.31.2	# MPL-2.0
MODCARGO_CRATES +=	cssparser-macros	0.6.1	# MPL-2.0
MODCARGO_CRATES +=	curve25519-dalek	4.1.3	# BSD-3-Clause
MODCARGO_CRATES +=	curve25519-dalek-derive	0.1.1	# MIT/Apache-2.0
MODCARGO_CRATES +=	dashmap	5.5.3	# MIT
MODCARGO_CRATES +=	dashmap	6.1.0	# MIT
MODCARGO_CRATES +=	der	0.7.10	# Apache-2.0 OR MIT
MODCARGO_CRATES +=	deranged	0.5.3	# MIT OR Apache-2.0
MODCARGO_CRATES +=	derive_arbitrary	1.4.2	# MIT OR Apache-2.0
MODCARGO_CRATES +=	derive_more	0.99.20	# MIT
MODCARGO_CRATES +=	difflib	0.4.0	# MIT
MODCARGO_CRATES +=	digest	0.10.7	# MIT OR Apache-2.0
MODCARGO_CRATES +=	directories	6.0.0	# MIT OR Apache-2.0
MODCARGO_CRATES +=	dirs-sys	0.5.0	# MIT OR Apache-2.0
MODCARGO_CRATES +=	displaydoc	0.2.5	# MIT OR Apache-2.0
MODCARGO_CRATES +=	dlv-list	0.5.2	# MIT OR Apache-2.0
MODCARGO_CRATES +=	doc-comment	0.3.3	# MIT
MODCARGO_CRATES +=	dtoa	1.0.10	# MIT OR Apache-2.0
MODCARGO_CRATES +=	dtoa-short	0.3.5	# MPL-2.0
MODCARGO_CRATES +=	ed25519	2.2.3	# Apache-2.0 OR MIT
MODCARGO_CRATES +=	ed25519-dalek	2.2.0	# BSD-3-Clause
MODCARGO_CRATES +=	ego-tree	0.6.3	# ISC
MODCARGO_CRATES +=	either	1.15.0	# MIT OR Apache-2.0
MODCARGO_CRATES +=	encode_unicode	1.0.0	# Apache-2.0 OR MIT
MODCARGO_CRATES +=	encoding_rs	0.8.35	# (Apache-2.0 OR MIT) AND BSD-3-Clause
MODCARGO_CRATES +=	enum-map	2.7.3	# MIT OR Apache-2.0
MODCARGO_CRATES +=	enum-map-derive	0.17.0	# MIT OR Apache-2.0
MODCARGO_CRATES +=	env_filter	0.1.3	# MIT OR Apache-2.0
MODCARGO_CRATES +=	env_logger	0.11.8	# MIT OR Apache-2.0
MODCARGO_CRATES +=	equivalent	1.0.2	# Apache-2.0 OR MIT
MODCARGO_CRATES +=	errno	0.3.12	# MIT OR Apache-2.0
MODCARGO_CRATES +=	fastrand	2.3.0	# Apache-2.0 OR MIT
MODCARGO_CRATES +=	fiat-crypto	0.2.9	# MIT OR Apache-2.0 OR BSD-1-Clause
MODCARGO_CRATES +=	filetime	0.2.25	# MIT/Apache-2.0
MODCARGO_CRATES +=	finl_unicode	1.3.0	# (MIT OR Apache-2.0) AND Unicode-DFS-2016
MODCARGO_CRATES +=	flate2	1.1.2	# MIT OR Apache-2.0
MODCARGO_CRATES +=	float-cmp	0.10.0	# MIT
MODCARGO_CRATES +=	fluent	0.16.1	# Apache-2.0 OR MIT
MODCARGO_CRATES +=	fluent-bundle	0.15.3	# Apache-2.0 OR MIT
MODCARGO_CRATES +=	fluent-langneg	0.13.1	# Apache-2.0 OR MIT
MODCARGO_CRATES +=	fluent-syntax	0.11.1	# Apache-2.0 OR MIT
MODCARGO_CRATES +=	fluent-template-macros	0.10.1	# MIT/Apache-2.0
MODCARGO_CRATES +=	fluent-templates	0.10.1	# MIT/Apache-2.0
MODCARGO_CRATES +=	flume	0.11.1	# Apache-2.0/MIT
MODCARGO_CRATES +=	fnv	1.0.7	# Apache-2.0 / MIT
MODCARGO_CRATES +=	foreign-types	0.3.2	# MIT/Apache-2.0
MODCARGO_CRATES +=	foreign-types-shared	0.1.1	# MIT/Apache-2.0
MODCARGO_CRATES +=	form_urlencoded	1.2.1	# MIT OR Apache-2.0
MODCARGO_CRATES +=	futf	0.1.5	# MIT / Apache-2.0
MODCARGO_CRATES +=	futures	0.3.31	# MIT OR Apache-2.0
MODCARGO_CRATES +=	futures-channel	0.3.31	# MIT OR Apache-2.0
MODCARGO_CRATES +=	futures-core	0.3.31	# MIT OR Apache-2.0
MODCARGO_CRATES +=	futures-io	0.3.31	# MIT OR Apache-2.0
MODCARGO_CRATES +=	futures-macro	0.3.31	# MIT OR Apache-2.0
MODCARGO_CRATES +=	futures-sink	0.3.31	# MIT OR Apache-2.0
MODCARGO_CRATES +=	futures-task	0.3.31	# MIT OR Apache-2.0
MODCARGO_CRATES +=	futures-util	0.3.31	# MIT OR Apache-2.0
MODCARGO_CRATES +=	fxhash	0.2.1	# Apache-2.0/MIT
MODCARGO_CRATES +=	generic-array	0.14.7	# MIT
MODCARGO_CRATES +=	getopts	0.2.21	# MIT/Apache-2.0
MODCARGO_CRATES +=	getrandom	0.2.16	# MIT OR Apache-2.0
MODCARGO_CRATES +=	getrandom	0.3.3	# MIT OR Apache-2.0
MODCARGO_CRATES +=	gimli	0.31.1	# MIT OR Apache-2.0
MODCARGO_CRATES +=	glob	0.3.2	# MIT OR Apache-2.0
MODCARGO_CRATES +=	globset	0.4.18	# Unlicense OR MIT
MODCARGO_CRATES +=	h2	0.3.27	# MIT
MODCARGO_CRATES +=	h2	0.4.10	# MIT
MODCARGO_CRATES +=	hashbrown	0.14.5	# MIT OR Apache-2.0
MODCARGO_CRATES +=	hashbrown	0.15.3	# MIT OR Apache-2.0
MODCARGO_CRATES +=	hashlink	0.8.4	# MIT OR Apache-2.0
MODCARGO_CRATES +=	heck	0.5.0	# MIT OR Apache-2.0
MODCARGO_CRATES +=	html-escape	0.2.13	# MIT
MODCARGO_CRATES +=	html5ever	0.27.0	# MIT OR Apache-2.0
MODCARGO_CRATES +=	http	0.2.12	# MIT OR Apache-2.0
MODCARGO_CRATES +=	http	1.3.1	# MIT OR Apache-2.0
MODCARGO_CRATES +=	http-body	0.4.6	# MIT
MODCARGO_CRATES +=	http-body	1.0.1	# MIT
MODCARGO_CRATES +=	http-body-util	0.1.3	# MIT
MODCARGO_CRATES +=	http-range-header	0.4.2	# MIT
MODCARGO_CRATES +=	httparse	1.10.1	# MIT OR Apache-2.0
MODCARGO_CRATES +=	httpdate	1.0.3	# MIT OR Apache-2.0
MODCARGO_CRATES +=	humansize	2.1.3	# MIT/Apache-2.0
MODCARGO_CRATES +=	humantime	2.2.0	# MIT OR Apache-2.0
MODCARGO_CRATES +=	hyper	0.14.32	# MIT
MODCARGO_CRATES +=	hyper	1.6.0	# MIT
MODCARGO_CRATES +=	hyper-rustls	0.27.6	# Apache-2.0 OR ISC OR MIT
MODCARGO_CRATES +=	hyper-tls	0.5.0	# MIT/Apache-2.0
MODCARGO_CRATES +=	hyper-tls	0.6.0	# MIT/Apache-2.0
MODCARGO_CRATES +=	hyper-util	0.1.12	# MIT
MODCARGO_CRATES +=	iana-time-zone	0.1.64	# MIT OR Apache-2.0
MODCARGO_CRATES +=	iana-time-zone-haiku	0.1.2	# MIT OR Apache-2.0
MODCARGO_CRATES +=	icu_collections	2.0.0	# Unicode-3.0
MODCARGO_CRATES +=	icu_locale_core	2.0.0	# Unicode-3.0
MODCARGO_CRATES +=	icu_normalizer	2.0.0	# Unicode-3.0
MODCARGO_CRATES +=	icu_normalizer_data	2.0.0	# Unicode-3.0
MODCARGO_CRATES +=	icu_properties	2.0.1	# Unicode-3.0
MODCARGO_CRATES +=	icu_properties_data	2.0.1	# Unicode-3.0
MODCARGO_CRATES +=	icu_provider	2.0.0	# Unicode-3.0
MODCARGO_CRATES +=	idna	1.0.3	# MIT OR Apache-2.0
MODCARGO_CRATES +=	idna_adapter	1.2.1	# Apache-2.0 OR MIT
MODCARGO_CRATES +=	ignore	0.4.25	# Unlicense OR MIT
MODCARGO_CRATES +=	indexmap	2.9.0	# Apache-2.0 OR MIT
MODCARGO_CRATES +=	indicatif	0.17.11	# MIT
MODCARGO_CRATES +=	insta	1.43.1	# Apache-2.0
MODCARGO_CRATES +=	intl-memoizer	0.5.3	# Apache-2.0 OR MIT
MODCARGO_CRATES +=	intl_pluralrules	7.0.2	# Apache-2.0/MIT
MODCARGO_CRATES +=	ipnet	2.11.0	# MIT OR Apache-2.0
MODCARGO_CRATES +=	iri-string	0.7.8	# MIT OR Apache-2.0
MODCARGO_CRATES +=	is-docker	0.2.0	# MIT
MODCARGO_CRATES +=	is-wsl	0.4.0	# MIT
MODCARGO_CRATES +=	is_terminal_polyfill	1.70.1	# MIT OR Apache-2.0
MODCARGO_CRATES +=	itoa	1.0.15	# MIT OR Apache-2.0
MODCARGO_CRATES +=	jiff	0.2.14	# Unlicense OR MIT
MODCARGO_CRATES +=	jiff-static	0.2.14	# Unlicense OR MIT
MODCARGO_CRATES +=	js-sys	0.3.77	# MIT OR Apache-2.0
MODCARGO_CRATES +=	json5	0.4.1	# ISC
MODCARGO_CRATES +=	lazy_static	1.5.0	# MIT OR Apache-2.0
MODCARGO_CRATES +=	libc	0.2.172	# MIT OR Apache-2.0
MODCARGO_CRATES +=	libm	0.2.15	# MIT
MODCARGO_CRATES +=	libredox	0.1.3	# MIT
MODCARGO_CRATES +=	linux-raw-sys	0.9.4	# Apache-2.0 WITH LLVM-exception OR Apache-2.0 OR MIT
MODCARGO_CRATES +=	litemap	0.8.0	# Unicode-3.0
MODCARGO_CRATES +=	lock_api	0.4.12	# MIT OR Apache-2.0
MODCARGO_CRATES +=	log	0.4.27	# MIT OR Apache-2.0
MODCARGO_CRATES +=	lru-slab	0.1.2	# MIT OR Apache-2.0 OR Zlib
MODCARGO_CRATES +=	lsp-types	0.94.1	# MIT
MODCARGO_CRATES +=	mac	0.1.1	# MIT/Apache-2.0
MODCARGO_CRATES +=	markup5ever	0.12.1	# MIT OR Apache-2.0
MODCARGO_CRATES +=	matchers	0.2.0	# MIT
MODCARGO_CRATES +=	matchit	0.7.3	# MIT AND BSD-3-Clause
MODCARGO_CRATES +=	memchr	2.7.4	# Unlicense OR MIT
MODCARGO_CRATES +=	mime	0.3.17	# MIT OR Apache-2.0
MODCARGO_CRATES +=	mime_guess	2.0.5	# MIT
MODCARGO_CRATES +=	minijinja	2.12.0	# Apache-2.0
MODCARGO_CRATES +=	minimal-lexical	0.2.1	# MIT/Apache-2.0
MODCARGO_CRATES +=	miniz_oxide	0.8.8	# MIT OR Zlib OR Apache-2.0
MODCARGO_CRATES +=	mio	1.0.3	# MIT
MODCARGO_CRATES +=	native-tls	0.2.14	# MIT OR Apache-2.0
MODCARGO_CRATES +=	new_debug_unreachable	1.0.6	# MIT
MODCARGO_CRATES +=	nohash-hasher	0.2.0	# Apache-2.0 OR MIT
MODCARGO_CRATES +=	nom	7.1.3	# MIT
MODCARGO_CRATES +=	normalize-line-endings	0.3.0	# Apache-2.0
MODCARGO_CRATES +=	nu-ansi-term	0.50.1	# MIT
MODCARGO_CRATES +=	num-conv	0.1.0	# MIT OR Apache-2.0
MODCARGO_CRATES +=	num-traits	0.2.19	# MIT OR Apache-2.0
MODCARGO_CRATES +=	number_prefix	0.4.0	# MIT
MODCARGO_CRATES +=	object	0.36.7	# Apache-2.0 OR MIT
MODCARGO_CRATES +=	once_cell	1.21.3	# MIT OR Apache-2.0
MODCARGO_CRATES +=	open	5.3.2	# MIT
MODCARGO_CRATES +=	openssl	0.10.72	# Apache-2.0
MODCARGO_CRATES +=	openssl-macros	0.1.1	# MIT/Apache-2.0
MODCARGO_CRATES +=	openssl-probe	0.1.6	# MIT/Apache-2.0
MODCARGO_CRATES +=	openssl-src	300.5.0+3.5.0	# MIT/Apache-2.0
MODCARGO_CRATES +=	openssl-sys	0.9.108	# MIT
MODCARGO_CRATES +=	option-ext	0.2.0	# MPL-2.0
MODCARGO_CRATES +=	ordered-multimap	0.7.3	# MIT
MODCARGO_CRATES +=	parking_lot	0.12.3	# MIT OR Apache-2.0
MODCARGO_CRATES +=	parking_lot_core	0.9.10	# MIT OR Apache-2.0
MODCARGO_CRATES +=	pathdiff	0.2.3	# MIT/Apache-2.0
MODCARGO_CRATES +=	percent-encoding	2.3.1	# MIT OR Apache-2.0
MODCARGO_CRATES +=	pest	2.8.4	# MIT OR Apache-2.0
MODCARGO_CRATES +=	pest_derive	2.8.4	# MIT OR Apache-2.0
MODCARGO_CRATES +=	pest_generator	2.8.4	# MIT OR Apache-2.0
MODCARGO_CRATES +=	pest_meta	2.8.4	# MIT OR Apache-2.0
MODCARGO_CRATES +=	phf	0.10.1	# MIT
MODCARGO_CRATES +=	phf	0.11.3	# MIT
MODCARGO_CRATES +=	phf_codegen	0.10.0	# MIT
MODCARGO_CRATES +=	phf_codegen	0.11.3	# MIT
MODCARGO_CRATES +=	phf_generator	0.10.0	# MIT
MODCARGO_CRATES +=	phf_generator	0.11.3	# MIT
MODCARGO_CRATES +=	phf_macros	0.11.3	# MIT
MODCARGO_CRATES +=	phf_shared	0.10.0	# MIT
MODCARGO_CRATES +=	phf_shared	0.11.3	# MIT
MODCARGO_CRATES +=	pin-project	1.1.10	# Apache-2.0 OR MIT
MODCARGO_CRATES +=	pin-project-internal	1.1.10	# Apache-2.0 OR MIT
MODCARGO_CRATES +=	pin-project-lite	0.2.16	# Apache-2.0 OR MIT
MODCARGO_CRATES +=	pin-utils	0.1.0	# MIT OR Apache-2.0
MODCARGO_CRATES +=	pkcs8	0.10.2	# Apache-2.0 OR MIT
MODCARGO_CRATES +=	pkg-config	0.3.32	# MIT OR Apache-2.0
MODCARGO_CRATES +=	portable-atomic	1.11.0	# Apache-2.0 OR MIT
MODCARGO_CRATES +=	portable-atomic-util	0.2.4	# Apache-2.0 OR MIT
MODCARGO_CRATES +=	potential_utf	0.1.2	# Unicode-3.0
MODCARGO_CRATES +=	powerfmt	0.2.0	# MIT OR Apache-2.0
MODCARGO_CRATES +=	ppv-lite86	0.2.21	# MIT OR Apache-2.0
MODCARGO_CRATES +=	precomputed-hash	0.1.1	# MIT
MODCARGO_CRATES +=	predicates	3.1.3	# MIT OR Apache-2.0
MODCARGO_CRATES +=	predicates-core	1.0.9	# MIT OR Apache-2.0
MODCARGO_CRATES +=	predicates-tree	1.0.12	# MIT OR Apache-2.0
MODCARGO_CRATES +=	prettyplease	0.2.34	# MIT OR Apache-2.0
MODCARGO_CRATES +=	proc-macro-hack	0.5.20+deprecated	# MIT OR Apache-2.0
MODCARGO_CRATES +=	proc-macro2	1.0.95	# MIT OR Apache-2.0
MODCARGO_CRATES +=	quick-xml	0.23.1	# MIT
MODCARGO_CRATES +=	quinn	0.11.9	# MIT OR Apache-2.0
MODCARGO_CRATES +=	quinn-proto	0.11.13	# MIT OR Apache-2.0
MODCARGO_CRATES +=	quinn-udp	0.5.14	# MIT OR Apache-2.0
MODCARGO_CRATES +=	quote	1.0.40	# MIT OR Apache-2.0
MODCARGO_CRATES +=	r-efi	5.2.0	# MIT OR Apache-2.0 OR LGPL-2.1-or-later
MODCARGO_CRATES +=	rand	0.8.5	# MIT OR Apache-2.0
MODCARGO_CRATES +=	rand	0.9.2	# MIT OR Apache-2.0
MODCARGO_CRATES +=	rand_chacha	0.3.1	# MIT OR Apache-2.0
MODCARGO_CRATES +=	rand_chacha	0.9.0	# MIT OR Apache-2.0
MODCARGO_CRATES +=	rand_core	0.6.4	# MIT OR Apache-2.0
MODCARGO_CRATES +=	rand_core	0.9.3	# MIT OR Apache-2.0
MODCARGO_CRATES +=	redox_syscall	0.5.12	# MIT
MODCARGO_CRATES +=	redox_users	0.5.0	# MIT
MODCARGO_CRATES +=	regex	1.11.1	# MIT OR Apache-2.0
MODCARGO_CRATES +=	regex-automata	0.4.9	# MIT OR Apache-2.0
MODCARGO_CRATES +=	regex-syntax	0.8.5	# MIT OR Apache-2.0
MODCARGO_CRATES +=	reqwest	0.11.27	# MIT OR Apache-2.0
MODCARGO_CRATES +=	reqwest	0.12.18	# MIT OR Apache-2.0
MODCARGO_CRATES +=	ring	0.17.14	# Apache-2.0 AND ISC
MODCARGO_CRATES +=	ron	0.8.1	# MIT OR Apache-2.0
MODCARGO_CRATES +=	ropey	1.6.1	# MIT
MODCARGO_CRATES +=	rust-embed	8.7.2	# MIT
MODCARGO_CRATES +=	rust-embed-impl	8.7.2	# MIT
MODCARGO_CRATES +=	rust-embed-utils	8.7.2	# MIT
MODCARGO_CRATES +=	rust-ini	0.20.0	# MIT
MODCARGO_CRATES +=	rustc-demangle	0.1.24	# MIT/Apache-2.0
MODCARGO_CRATES +=	rustc-hash	1.1.0	# Apache-2.0/MIT
MODCARGO_CRATES +=	rustc-hash	2.1.1	# Apache-2.0 OR MIT
MODCARGO_CRATES +=	rustc_version	0.4.1	# MIT OR Apache-2.0
MODCARGO_CRATES +=	rustix	1.0.7	# Apache-2.0 WITH LLVM-exception OR Apache-2.0 OR MIT
MODCARGO_CRATES +=	rustls	0.23.27	# Apache-2.0 OR ISC OR MIT
MODCARGO_CRATES +=	rustls-pemfile	1.0.4	# Apache-2.0 OR ISC OR MIT
MODCARGO_CRATES +=	rustls-pki-types	1.12.0	# MIT OR Apache-2.0
MODCARGO_CRATES +=	rustls-webpki	0.103.3	# ISC
MODCARGO_CRATES +=	rustversion	1.0.20	# MIT OR Apache-2.0
MODCARGO_CRATES +=	ryu	1.0.20	# Apache-2.0 OR BSL-1.0
MODCARGO_CRATES +=	same-file	1.0.6	# Unlicense/MIT
MODCARGO_CRATES +=	schannel	0.1.27	# MIT
MODCARGO_CRATES +=	scopeguard	1.2.0	# MIT OR Apache-2.0
MODCARGO_CRATES +=	scraper	0.20.0	# ISC
MODCARGO_CRATES +=	security-framework	2.11.1	# MIT OR Apache-2.0
MODCARGO_CRATES +=	security-framework-sys	2.14.0	# MIT OR Apache-2.0
MODCARGO_CRATES +=	selectors	0.25.0	# MPL-2.0
MODCARGO_CRATES +=	self-replace	1.5.0	# Apache-2.0
MODCARGO_CRATES +=	self_cell	0.10.3	# Apache-2.0
MODCARGO_CRATES +=	self_cell	1.2.1	# Apache-2.0 OR GPL-2.0-only
MODCARGO_CRATES +=	self_update	0.41.0	# MIT
MODCARGO_CRATES +=	semver	1.0.26	# MIT OR Apache-2.0
MODCARGO_CRATES +=	serde	1.0.219	# MIT OR Apache-2.0
MODCARGO_CRATES +=	serde_derive	1.0.219	# MIT OR Apache-2.0
MODCARGO_CRATES +=	serde_json	1.0.140	# MIT OR Apache-2.0
MODCARGO_CRATES +=	serde_path_to_error	0.1.17	# MIT OR Apache-2.0
MODCARGO_CRATES +=	serde_repr	0.1.20	# MIT OR Apache-2.0
MODCARGO_CRATES +=	serde_spanned	0.6.9	# MIT OR Apache-2.0
MODCARGO_CRATES +=	serde_spanned	1.0.0	# MIT OR Apache-2.0
MODCARGO_CRATES +=	serde_urlencoded	0.7.1	# MIT/Apache-2.0
MODCARGO_CRATES +=	serde_yaml	0.9.34+deprecated	# MIT OR Apache-2.0
MODCARGO_CRATES +=	servo_arc	0.3.0	# MIT/Apache-2.0
MODCARGO_CRATES +=	sha2	0.10.9	# MIT OR Apache-2.0
MODCARGO_CRATES +=	sharded-slab	0.1.7	# MIT
MODCARGO_CRATES +=	shlex	1.3.0	# MIT OR Apache-2.0
MODCARGO_CRATES +=	signal-hook-registry	1.4.5	# Apache-2.0/MIT
MODCARGO_CRATES +=	signature	2.2.0	# Apache-2.0 OR MIT
MODCARGO_CRATES +=	similar	2.7.0	# Apache-2.0
MODCARGO_CRATES +=	siphasher	0.3.11	# MIT/Apache-2.0
MODCARGO_CRATES +=	siphasher	1.0.1	# MIT/Apache-2.0
MODCARGO_CRATES +=	slab	0.4.9	# MIT
MODCARGO_CRATES +=	smallvec	1.15.0	# MIT OR Apache-2.0
MODCARGO_CRATES +=	smawk	0.3.2	# MIT
MODCARGO_CRATES +=	socket2	0.5.9	# MIT OR Apache-2.0
MODCARGO_CRATES +=	spin	0.9.8	# MIT
MODCARGO_CRATES +=	spki	0.7.3	# Apache-2.0 OR MIT
MODCARGO_CRATES +=	stable_deref_trait	1.2.0	# MIT/Apache-2.0
MODCARGO_CRATES +=	str_indices	0.4.4	# MIT OR Apache-2.0
MODCARGO_CRATES +=	string_cache	0.8.9	# MIT OR Apache-2.0
MODCARGO_CRATES +=	string_cache_codegen	0.5.4	# MIT OR Apache-2.0
MODCARGO_CRATES +=	strip-ansi-escapes	0.1.1	# Apache-2.0/MIT
MODCARGO_CRATES +=	strip-ansi-escapes	0.2.1	# Apache-2.0/MIT
MODCARGO_CRATES +=	strsim	0.11.1	# MIT
MODCARGO_CRATES +=	strum	0.26.3	# MIT
MODCARGO_CRATES +=	strum_macros	0.26.4	# MIT
MODCARGO_CRATES +=	subtle	2.6.1	# BSD-3-Clause
MODCARGO_CRATES +=	syn	2.0.101	# MIT OR Apache-2.0
MODCARGO_CRATES +=	sync_wrapper	0.1.2	# Apache-2.0
MODCARGO_CRATES +=	sync_wrapper	1.0.2	# Apache-2.0
MODCARGO_CRATES +=	synstructure	0.13.2	# MIT
MODCARGO_CRATES +=	system-configuration	0.5.1	# MIT OR Apache-2.0
MODCARGO_CRATES +=	system-configuration	0.6.1	# MIT OR Apache-2.0
MODCARGO_CRATES +=	system-configuration-sys	0.5.0	# MIT OR Apache-2.0
MODCARGO_CRATES +=	system-configuration-sys	0.6.0	# MIT OR Apache-2.0
MODCARGO_CRATES +=	tabular	0.2.0	# MIT OR Apache-2.0
MODCARGO_CRATES +=	tar	0.4.44	# MIT OR Apache-2.0
MODCARGO_CRATES +=	tempfile	3.20.0	# MIT OR Apache-2.0
MODCARGO_CRATES +=	tendril	0.4.3	# MIT/Apache-2.0
MODCARGO_CRATES +=	terminal_size	0.4.2	# MIT OR Apache-2.0
MODCARGO_CRATES +=	termtree	0.5.1	# MIT
MODCARGO_CRATES +=	text-size	1.1.1	# MIT OR Apache-2.0
MODCARGO_CRATES +=	textwrap	0.16.2	# MIT
MODCARGO_CRATES +=	thiserror	1.0.69	# MIT OR Apache-2.0
MODCARGO_CRATES +=	thiserror	2.0.12	# MIT OR Apache-2.0
MODCARGO_CRATES +=	thiserror-impl	1.0.69	# MIT OR Apache-2.0
MODCARGO_CRATES +=	thiserror-impl	2.0.12	# MIT OR Apache-2.0
MODCARGO_CRATES +=	thread_local	1.1.8	# MIT OR Apache-2.0
MODCARGO_CRATES +=	time	0.3.43	# MIT OR Apache-2.0
MODCARGO_CRATES +=	time-core	0.1.6	# MIT OR Apache-2.0
MODCARGO_CRATES +=	tiny-keccak	2.0.2	# CC0-1.0
MODCARGO_CRATES +=	tinystr	0.8.1	# Unicode-3.0
MODCARGO_CRATES +=	tinyvec	1.10.0	# Zlib OR Apache-2.0 OR MIT
MODCARGO_CRATES +=	tinyvec_macros	0.1.1	# MIT OR Apache-2.0 OR Zlib
MODCARGO_CRATES +=	tokio	1.45.0	# MIT
MODCARGO_CRATES +=	tokio-macros	2.5.0	# MIT
MODCARGO_CRATES +=	tokio-native-tls	0.3.1	# MIT
MODCARGO_CRATES +=	tokio-rustls	0.26.2	# MIT OR Apache-2.0
MODCARGO_CRATES +=	tokio-util	0.7.15	# MIT
MODCARGO_CRATES +=	toml	0.8.23	# MIT OR Apache-2.0
MODCARGO_CRATES +=	toml	0.9.5	# MIT OR Apache-2.0
MODCARGO_CRATES +=	toml_datetime	0.6.11	# MIT OR Apache-2.0
MODCARGO_CRATES +=	toml_datetime	0.7.0	# MIT OR Apache-2.0
MODCARGO_CRATES +=	toml_edit	0.22.27	# MIT OR Apache-2.0
MODCARGO_CRATES +=	toml_parser	1.0.2	# MIT OR Apache-2.0
MODCARGO_CRATES +=	toml_write	0.1.2	# MIT OR Apache-2.0
MODCARGO_CRATES +=	toml_writer	1.0.2	# MIT OR Apache-2.0
MODCARGO_CRATES +=	tower	0.4.13	# MIT
MODCARGO_CRATES +=	tower	0.5.2	# MIT
MODCARGO_CRATES +=	tower-http	0.5.2	# MIT
MODCARGO_CRATES +=	tower-http	0.6.4	# MIT
MODCARGO_CRATES +=	tower-layer	0.3.3	# MIT
MODCARGO_CRATES +=	tower-lsp	0.20.0	# MIT OR Apache-2.0
MODCARGO_CRATES +=	tower-lsp-macros	0.9.0	# MIT OR Apache-2.0
MODCARGO_CRATES +=	tower-service	0.3.3	# MIT
MODCARGO_CRATES +=	tracing	0.1.41	# MIT
MODCARGO_CRATES +=	tracing-attributes	0.1.28	# MIT
MODCARGO_CRATES +=	tracing-core	0.1.33	# MIT
MODCARGO_CRATES +=	tracing-log	0.2.0	# MIT
MODCARGO_CRATES +=	tracing-subscriber	0.3.20	# MIT
MODCARGO_CRATES +=	try-lock	0.2.5	# MIT
MODCARGO_CRATES +=	type-map	0.5.1	# MIT/Apache-2.0
MODCARGO_CRATES +=	typenum	1.18.0	# MIT OR Apache-2.0
MODCARGO_CRATES +=	ucd-trie	0.1.7	# MIT OR Apache-2.0
MODCARGO_CRATES +=	unic-langid	0.9.6	# MIT OR Apache-2.0
MODCARGO_CRATES +=	unic-langid-impl	0.9.6	# MIT OR Apache-2.0
MODCARGO_CRATES +=	unic-langid-macros	0.9.6	# MIT OR Apache-2.0
MODCARGO_CRATES +=	unic-langid-macros-impl	0.9.6	# MIT OR Apache-2.0
MODCARGO_CRATES +=	unicase	2.8.1	# MIT OR Apache-2.0
MODCARGO_CRATES +=	unicode-ident	1.0.18	# (MIT OR Apache-2.0) AND Unicode-3.0
MODCARGO_CRATES +=	unicode-linebreak	0.1.5	# Apache-2.0
MODCARGO_CRATES +=	unicode-segmentation	1.12.0	# MIT OR Apache-2.0
MODCARGO_CRATES +=	unicode-width	0.1.14	# MIT OR Apache-2.0
MODCARGO_CRATES +=	unicode-width	0.2.0	# MIT OR Apache-2.0
MODCARGO_CRATES +=	unsafe-libyaml	0.2.11	# MIT
MODCARGO_CRATES +=	untrusted	0.9.0	# ISC
MODCARGO_CRATES +=	url	2.5.4	# MIT OR Apache-2.0
MODCARGO_CRATES +=	urlencoding	2.1.3	# MIT
MODCARGO_CRATES +=	utf-8	0.7.6	# MIT OR Apache-2.0
MODCARGO_CRATES +=	utf8-width	0.1.7	# MIT
MODCARGO_CRATES +=	utf8_iter	1.0.4	# Apache-2.0 OR MIT
MODCARGO_CRATES +=	utf8parse	0.2.2	# Apache-2.0 OR MIT
MODCARGO_CRATES +=	valuable	0.1.1	# MIT
MODCARGO_CRATES +=	vcpkg	0.2.15	# MIT/Apache-2.0
MODCARGO_CRATES +=	version_check	0.9.5	# MIT/Apache-2.0
MODCARGO_CRATES +=	vte	0.10.1	# Apache-2.0 OR MIT
MODCARGO_CRATES +=	vte	0.14.1	# Apache-2.0 OR MIT
MODCARGO_CRATES +=	vte_generate_state_changes	0.1.2	# Apache-2.0 OR MIT
MODCARGO_CRATES +=	wait-timeout	0.2.1	# MIT/Apache-2.0
MODCARGO_CRATES +=	walkdir	2.5.0	# Unlicense/MIT
MODCARGO_CRATES +=	want	0.3.1	# MIT
MODCARGO_CRATES +=	wasi	0.11.0+wasi-snapshot-preview1	# Apache-2.0 WITH LLVM-exception OR Apache-2.0 OR MIT
MODCARGO_CRATES +=	wasi	0.14.2+wasi-0.2.4	# Apache-2.0 WITH LLVM-exception OR Apache-2.0 OR MIT
MODCARGO_CRATES +=	wasm-bindgen	0.2.100	# MIT OR Apache-2.0
MODCARGO_CRATES +=	wasm-bindgen-backend	0.2.100	# MIT OR Apache-2.0
MODCARGO_CRATES +=	wasm-bindgen-futures	0.4.50	# MIT OR Apache-2.0
MODCARGO_CRATES +=	wasm-bindgen-macro	0.2.100	# MIT OR Apache-2.0
MODCARGO_CRATES +=	wasm-bindgen-macro-support	0.2.100	# MIT OR Apache-2.0
MODCARGO_CRATES +=	wasm-bindgen-shared	0.2.100	# MIT OR Apache-2.0
MODCARGO_CRATES +=	web-sys	0.3.77	# MIT OR Apache-2.0
MODCARGO_CRATES +=	web-time	1.1.0	# MIT OR Apache-2.0
MODCARGO_CRATES +=	webpki-roots	1.0.2	# CDLA-Permissive-2.0
MODCARGO_CRATES +=	winapi-util	0.1.10	# Unlicense OR MIT
MODCARGO_CRATES +=	windows-core	0.62.0	# MIT OR Apache-2.0
MODCARGO_CRATES +=	windows-implement	0.60.0	# MIT OR Apache-2.0
MODCARGO_CRATES +=	windows-interface	0.59.1	# MIT OR Apache-2.0
MODCARGO_CRATES +=	windows-link	0.1.1	# MIT OR Apache-2.0
MODCARGO_CRATES +=	windows-link	0.2.0	# MIT OR Apache-2.0
MODCARGO_CRATES +=	windows-registry	0.4.0	# MIT OR Apache-2.0
MODCARGO_CRATES +=	windows-result	0.3.4	# MIT OR Apache-2.0
MODCARGO_CRATES +=	windows-result	0.4.0	# MIT OR Apache-2.0
MODCARGO_CRATES +=	windows-strings	0.3.1	# MIT OR Apache-2.0
MODCARGO_CRATES +=	windows-strings	0.5.0	# MIT OR Apache-2.0
MODCARGO_CRATES +=	windows-sys	0.48.0	# MIT OR Apache-2.0
MODCARGO_CRATES +=	windows-sys	0.52.0	# MIT OR Apache-2.0
MODCARGO_CRATES +=	windows-sys	0.59.0	# MIT OR Apache-2.0
MODCARGO_CRATES +=	windows-targets	0.48.5	# MIT OR Apache-2.0
MODCARGO_CRATES +=	windows-targets	0.52.6	# MIT OR Apache-2.0
MODCARGO_CRATES +=	windows-targets	0.53.0	# MIT OR Apache-2.0
MODCARGO_CRATES +=	windows_aarch64_gnullvm	0.48.5	# MIT OR Apache-2.0
MODCARGO_CRATES +=	windows_aarch64_gnullvm	0.52.6	# MIT OR Apache-2.0
MODCARGO_CRATES +=	windows_aarch64_gnullvm	0.53.0	# MIT OR Apache-2.0
MODCARGO_CRATES +=	windows_aarch64_msvc	0.48.5	# MIT OR Apache-2.0
MODCARGO_CRATES +=	windows_aarch64_msvc	0.52.6	# MIT OR Apache-2.0
MODCARGO_CRATES +=	windows_aarch64_msvc	0.53.0	# MIT OR Apache-2.0
MODCARGO_CRATES +=	windows_i686_gnu	0.48.5	# MIT OR Apache-2.0
MODCARGO_CRATES +=	windows_i686_gnu	0.52.6	# MIT OR Apache-2.0
MODCARGO_CRATES +=	windows_i686_gnu	0.53.0	# MIT OR Apache-2.0
MODCARGO_CRATES +=	windows_i686_gnullvm	0.52.6	# MIT OR Apache-2.0
MODCARGO_CRATES +=	windows_i686_gnullvm	0.53.0	# MIT OR Apache-2.0
MODCARGO_CRATES +=	windows_i686_msvc	0.48.5	# MIT OR Apache-2.0
MODCARGO_CRATES +=	windows_i686_msvc	0.52.6	# MIT OR Apache-2.0
MODCARGO_CRATES +=	windows_i686_msvc	0.53.0	# MIT OR Apache-2.0
MODCARGO_CRATES +=	windows_x86_64_gnu	0.48.5	# MIT OR Apache-2.0
MODCARGO_CRATES +=	windows_x86_64_gnu	0.52.6	# MIT OR Apache-2.0
MODCARGO_CRATES +=	windows_x86_64_gnu	0.53.0	# MIT OR Apache-2.0
MODCARGO_CRATES +=	windows_x86_64_gnullvm	0.48.5	# MIT OR Apache-2.0
MODCARGO_CRATES +=	windows_x86_64_gnullvm	0.52.6	# MIT OR Apache-2.0
MODCARGO_CRATES +=	windows_x86_64_gnullvm	0.53.0	# MIT OR Apache-2.0
MODCARGO_CRATES +=	windows_x86_64_msvc	0.48.5	# MIT OR Apache-2.0
MODCARGO_CRATES +=	windows_x86_64_msvc	0.52.6	# MIT OR Apache-2.0
MODCARGO_CRATES +=	windows_x86_64_msvc	0.53.0	# MIT OR Apache-2.0
MODCARGO_CRATES +=	winnow	0.7.12	# MIT
MODCARGO_CRATES +=	winreg	0.50.0	# MIT
MODCARGO_CRATES +=	wit-bindgen-rt	0.39.0	# Apache-2.0 WITH LLVM-exception OR Apache-2.0 OR MIT
MODCARGO_CRATES +=	writeable	0.6.1	# Unicode-3.0
MODCARGO_CRATES +=	xattr	1.5.1	# MIT OR Apache-2.0
MODCARGO_CRATES +=	yaml-datastore	0.1.0	# MIT
MODCARGO_CRATES +=	yaml-rust2	0.8.1	# MIT OR Apache-2.0
MODCARGO_CRATES +=	yansi	1.0.1	# MIT OR Apache-2.0
MODCARGO_CRATES +=	yoke	0.8.0	# Unicode-3.0
MODCARGO_CRATES +=	yoke-derive	0.8.0	# Unicode-3.0
MODCARGO_CRATES +=	zerocopy	0.8.25	# BSD-2-Clause OR Apache-2.0 OR MIT
MODCARGO_CRATES +=	zerocopy-derive	0.8.25	# BSD-2-Clause OR Apache-2.0 OR MIT
MODCARGO_CRATES +=	zerofrom	0.1.6	# Unicode-3.0
MODCARGO_CRATES +=	zerofrom-derive	0.1.6	# Unicode-3.0
MODCARGO_CRATES +=	zeroize	1.8.1	# Apache-2.0 OR MIT
MODCARGO_CRATES +=	zerotrie	0.2.2	# Unicode-3.0
MODCARGO_CRATES +=	zerovec	0.11.2	# Unicode-3.0
MODCARGO_CRATES +=	zerovec-derive	0.11.1	# Unicode-3.0
MODCARGO_CRATES +=	zip	2.4.2	# MIT
MODCARGO_CRATES +=	zipsign-api	0.1.5	# MIT OR Apache-2.0 OR Apache-2.0 WITH LLVM-exception
