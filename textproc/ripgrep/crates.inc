MODCARGO_CRATES +=	aho-corasick	1.1.4	# Unlicense OR MIT
MODCARGO_CRATES +=	anyhow	1.0.103	# MIT OR Apache-2.0
MODCARGO_CRATES +=	arbitrary	1.4.2	# MIT OR Apache-2.0
MODCARGO_CRATES +=	bstr	1.13.0	# MIT OR Apache-2.0
MODCARGO_CRATES +=	cc	1.2.67	# MIT OR Apache-2.0
MODCARGO_CRATES +=	cfg-if	1.0.4	# MIT OR Apache-2.0
MODCARGO_CRATES +=	crossbeam-channel	0.5.16	# MIT OR Apache-2.0
MODCARGO_CRATES +=	crossbeam-deque	0.8.7	# MIT OR Apache-2.0
MODCARGO_CRATES +=	crossbeam-epoch	0.9.20	# MIT OR Apache-2.0
MODCARGO_CRATES +=	crossbeam-utils	0.8.22	# MIT OR Apache-2.0
MODCARGO_CRATES +=	derive_arbitrary	1.4.2	# MIT OR Apache-2.0
MODCARGO_CRATES +=	encoding_rs	0.8.35	# (Apache-2.0 OR MIT) AND BSD-3-Clause
MODCARGO_CRATES +=	encoding_rs_io	0.1.7	# MIT OR Apache-2.0
MODCARGO_CRATES +=	find-msvc-tools	0.1.9	# MIT OR Apache-2.0
MODCARGO_CRATES +=	getrandom	0.4.3	# MIT OR Apache-2.0
MODCARGO_CRATES +=	glob	0.3.3	# MIT OR Apache-2.0
MODCARGO_CRATES +=	itoa	1.0.18	# MIT OR Apache-2.0
MODCARGO_CRATES +=	jobserver	0.1.35	# MIT OR Apache-2.0
MODCARGO_CRATES +=	lexopt	0.3.2	# MIT
MODCARGO_CRATES +=	libc	0.2.186	# MIT OR Apache-2.0
MODCARGO_CRATES +=	log	0.4.33	# MIT OR Apache-2.0
MODCARGO_CRATES +=	memchr	2.8.3	# Unlicense OR MIT
MODCARGO_CRATES +=	memmap2	0.9.11	# MIT OR Apache-2.0
MODCARGO_CRATES +=	pcre2	0.2.11	# Unlicense OR MIT
MODCARGO_CRATES +=	pcre2-sys	0.2.10	# Unlicense OR MIT
MODCARGO_CRATES +=	pkg-config	0.3.33	# MIT OR Apache-2.0
MODCARGO_CRATES +=	proc-macro2	1.0.106	# MIT OR Apache-2.0
MODCARGO_CRATES +=	quote	1.0.46	# MIT OR Apache-2.0
MODCARGO_CRATES +=	r-efi	6.0.0	# MIT OR Apache-2.0 OR LGPL-2.1-or-later
MODCARGO_CRATES +=	regex	1.13.0	# MIT OR Apache-2.0
MODCARGO_CRATES +=	regex-automata	0.4.15	# MIT OR Apache-2.0
MODCARGO_CRATES +=	regex-syntax	0.8.11	# MIT OR Apache-2.0
MODCARGO_CRATES +=	same-file	1.0.6	# Unlicense/MIT
MODCARGO_CRATES +=	serde	1.0.228	# MIT OR Apache-2.0
MODCARGO_CRATES +=	serde_core	1.0.228	# MIT OR Apache-2.0
MODCARGO_CRATES +=	serde_derive	1.0.228	# MIT OR Apache-2.0
MODCARGO_CRATES +=	serde_json	1.0.150	# MIT OR Apache-2.0
MODCARGO_CRATES +=	shlex	2.0.1	# MIT OR Apache-2.0
MODCARGO_CRATES +=	syn	2.0.119	# MIT OR Apache-2.0
MODCARGO_CRATES +=	termcolor	1.4.1	# Unlicense OR MIT
MODCARGO_CRATES +=	textwrap	0.16.2	# MIT
MODCARGO_CRATES +=	tikv-jemalloc-sys	0.7.1+5.3.1-0-g81034ce1f1373e37dc865038e1bc8eeecf559ce8	# MIT/Apache-2.0
MODCARGO_CRATES +=	tikv-jemallocator	0.7.0	# MIT/Apache-2.0
MODCARGO_CRATES +=	unicode-ident	1.0.24	# (MIT OR Apache-2.0) AND Unicode-3.0
MODCARGO_CRATES +=	walkdir	2.5.0	# Unlicense/MIT
MODCARGO_CRATES +=	winapi-util	0.1.11	# Unlicense OR MIT
MODCARGO_CRATES +=	windows-link	0.2.1	# MIT OR Apache-2.0
MODCARGO_CRATES +=	windows-sys	0.61.2	# MIT OR Apache-2.0
MODCARGO_CRATES +=	zmij	1.0.23	# MIT
