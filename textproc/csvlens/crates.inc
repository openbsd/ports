MODCARGO_CRATES +=	ahash	0.8.12	# MIT OR Apache-2.0
MODCARGO_CRATES +=	aho-corasick	1.1.4	# Unlicense OR MIT
MODCARGO_CRATES +=	allocator-api2	0.2.21	# MIT OR Apache-2.0
MODCARGO_CRATES +=	android_system_properties	0.1.5	# MIT/Apache-2.0
MODCARGO_CRATES +=	ansi-to-tui	7.0.0	# MIT
MODCARGO_CRATES +=	anstream	0.6.21	# MIT OR Apache-2.0
MODCARGO_CRATES +=	anstyle	1.0.13	# MIT OR Apache-2.0
MODCARGO_CRATES +=	anstyle-parse	0.2.7	# MIT OR Apache-2.0
MODCARGO_CRATES +=	anstyle-query	1.1.4	# MIT OR Apache-2.0
MODCARGO_CRATES +=	anstyle-wincon	3.0.10	# MIT OR Apache-2.0
MODCARGO_CRATES +=	anyhow	1.0.100	# MIT OR Apache-2.0
MODCARGO_CRATES +=	arboard	3.6.1	# MIT OR Apache-2.0
MODCARGO_CRATES +=	arrow	56.2.0	# Apache-2.0
MODCARGO_CRATES +=	arrow-arith	56.2.0	# Apache-2.0
MODCARGO_CRATES +=	arrow-array	56.2.0	# Apache-2.0
MODCARGO_CRATES +=	arrow-buffer	56.2.0	# Apache-2.0
MODCARGO_CRATES +=	arrow-cast	56.2.0	# Apache-2.0
MODCARGO_CRATES +=	arrow-csv	56.2.0	# Apache-2.0
MODCARGO_CRATES +=	arrow-data	56.2.0	# Apache-2.0
MODCARGO_CRATES +=	arrow-ord	56.2.0	# Apache-2.0
MODCARGO_CRATES +=	arrow-row	56.2.0	# Apache-2.0
MODCARGO_CRATES +=	arrow-schema	56.2.0	# Apache-2.0
MODCARGO_CRATES +=	arrow-select	56.2.0	# Apache-2.0
MODCARGO_CRATES +=	arrow-string	56.2.0	# Apache-2.0
MODCARGO_CRATES +=	atoi	2.0.0	# MIT
MODCARGO_CRATES +=	autocfg	1.5.0	# Apache-2.0 OR MIT
MODCARGO_CRATES +=	base64	0.22.1	# MIT OR Apache-2.0
MODCARGO_CRATES +=	bitflags	2.10.0	# MIT OR Apache-2.0
MODCARGO_CRATES +=	bumpalo	3.19.0	# MIT OR Apache-2.0
MODCARGO_CRATES +=	bytecount	0.6.9	# Apache-2.0/MIT
MODCARGO_CRATES +=	bytes	1.10.1	# MIT
MODCARGO_CRATES +=	cassowary	0.3.0	# MIT / Apache-2.0
MODCARGO_CRATES +=	castaway	0.2.4	# MIT
MODCARGO_CRATES +=	cc	1.2.43	# MIT OR Apache-2.0
MODCARGO_CRATES +=	cfg-if	1.0.4	# MIT OR Apache-2.0
MODCARGO_CRATES +=	chrono	0.4.42	# MIT OR Apache-2.0
MODCARGO_CRATES +=	clap	4.5.50	# MIT OR Apache-2.0
MODCARGO_CRATES +=	clap_builder	4.5.50	# MIT OR Apache-2.0
MODCARGO_CRATES +=	clap_derive	4.5.49	# MIT OR Apache-2.0
MODCARGO_CRATES +=	clap_lex	0.7.6	# MIT OR Apache-2.0
MODCARGO_CRATES +=	clipboard-win	5.4.1	# BSL-1.0
MODCARGO_CRATES +=	colorchoice	1.0.4	# MIT OR Apache-2.0
MODCARGO_CRATES +=	compact_str	0.8.1	# MIT
MODCARGO_CRATES +=	const-random	0.1.18	# MIT OR Apache-2.0
MODCARGO_CRATES +=	const-random-macro	0.1.16	# MIT OR Apache-2.0
MODCARGO_CRATES +=	core-foundation-sys	0.8.7	# MIT OR Apache-2.0
MODCARGO_CRATES +=	crossterm	0.28.1	# MIT
MODCARGO_CRATES +=	crossterm_winapi	0.9.1	# MIT
MODCARGO_CRATES +=	crunchy	0.2.4	# MIT
MODCARGO_CRATES +=	csv	1.4.0	# Unlicense/MIT
MODCARGO_CRATES +=	csv-core	0.1.13	# Unlicense/MIT
MODCARGO_CRATES +=	darling	0.20.11	# MIT
MODCARGO_CRATES +=	darling_core	0.20.11	# MIT
MODCARGO_CRATES +=	darling_macro	0.20.11	# MIT
MODCARGO_CRATES +=	dispatch2	0.3.0	# Zlib OR Apache-2.0 OR MIT
MODCARGO_CRATES +=	downcast-rs	1.2.1	# MIT/Apache-2.0
MODCARGO_CRATES +=	either	1.15.0	# MIT OR Apache-2.0
MODCARGO_CRATES +=	equivalent	1.0.2	# Apache-2.0 OR MIT
MODCARGO_CRATES +=	errno	0.3.14	# MIT OR Apache-2.0
MODCARGO_CRATES +=	error-code	3.3.2	# BSL-1.0
MODCARGO_CRATES +=	fast-float2	0.2.3	# MIT OR Apache-2.0
MODCARGO_CRATES +=	fastrand	2.3.0	# Apache-2.0 OR MIT
MODCARGO_CRATES +=	filedescriptor	0.8.3	# MIT
MODCARGO_CRATES +=	find-msvc-tools	0.1.4	# MIT OR Apache-2.0
MODCARGO_CRATES +=	fixedbitset	0.4.2	# MIT/Apache-2.0
MODCARGO_CRATES +=	fnv	1.0.7	# Apache-2.0 / MIT
MODCARGO_CRATES +=	foldhash	0.1.5	# Zlib
MODCARGO_CRATES +=	gethostname	1.1.0	# Apache-2.0
MODCARGO_CRATES +=	getrandom	0.2.16	# MIT OR Apache-2.0
MODCARGO_CRATES +=	getrandom	0.3.4	# MIT OR Apache-2.0
MODCARGO_CRATES +=	half	2.7.1	# MIT OR Apache-2.0
MODCARGO_CRATES +=	hashbrown	0.15.5	# MIT OR Apache-2.0
MODCARGO_CRATES +=	hashbrown	0.16.0	# MIT OR Apache-2.0
MODCARGO_CRATES +=	heck	0.5.0	# MIT OR Apache-2.0
MODCARGO_CRATES +=	iana-time-zone	0.1.64	# MIT OR Apache-2.0
MODCARGO_CRATES +=	iana-time-zone-haiku	0.1.2	# MIT OR Apache-2.0
MODCARGO_CRATES +=	ident_case	1.0.1	# MIT/Apache-2.0
MODCARGO_CRATES +=	indexmap	2.12.0	# Apache-2.0 OR MIT
MODCARGO_CRATES +=	indoc	2.0.7	# MIT OR Apache-2.0
MODCARGO_CRATES +=	instability	0.3.9	# MIT
MODCARGO_CRATES +=	is_terminal_polyfill	1.70.2	# MIT OR Apache-2.0
MODCARGO_CRATES +=	itertools	0.13.0	# MIT OR Apache-2.0
MODCARGO_CRATES +=	itoa	1.0.15	# MIT OR Apache-2.0
MODCARGO_CRATES +=	js-sys	0.3.82	# MIT OR Apache-2.0
MODCARGO_CRATES +=	lexical-core	1.0.6	# MIT/Apache-2.0
MODCARGO_CRATES +=	lexical-parse-float	1.0.6	# MIT/Apache-2.0
MODCARGO_CRATES +=	lexical-parse-integer	1.0.6	# MIT/Apache-2.0
MODCARGO_CRATES +=	lexical-util	1.0.7	# MIT/Apache-2.0
MODCARGO_CRATES +=	lexical-write-float	1.0.6	# MIT/Apache-2.0
MODCARGO_CRATES +=	lexical-write-integer	1.0.6	# MIT/Apache-2.0
MODCARGO_CRATES +=	libc	0.2.177	# MIT OR Apache-2.0
MODCARGO_CRATES +=	libm	0.2.15	# MIT
MODCARGO_CRATES +=	linux-raw-sys	0.4.15	# Apache-2.0 WITH LLVM-exception OR Apache-2.0 OR MIT
MODCARGO_CRATES +=	linux-raw-sys	0.11.0	# Apache-2.0 WITH LLVM-exception OR Apache-2.0 OR MIT
MODCARGO_CRATES +=	lock_api	0.4.14	# MIT OR Apache-2.0
MODCARGO_CRATES +=	log	0.4.28	# MIT OR Apache-2.0
MODCARGO_CRATES +=	lru	0.12.5	# MIT
MODCARGO_CRATES +=	memchr	2.7.6	# Unlicense OR MIT
MODCARGO_CRATES +=	minimal-lexical	0.2.1	# MIT/Apache-2.0
MODCARGO_CRATES +=	mio	1.1.0	# MIT
MODCARGO_CRATES +=	nom	7.1.3	# MIT
MODCARGO_CRATES +=	num	0.4.3	# MIT OR Apache-2.0
MODCARGO_CRATES +=	num-bigint	0.4.6	# MIT OR Apache-2.0
MODCARGO_CRATES +=	num-complex	0.4.6	# MIT OR Apache-2.0
MODCARGO_CRATES +=	num-integer	0.1.46	# MIT OR Apache-2.0
MODCARGO_CRATES +=	num-iter	0.1.45	# MIT OR Apache-2.0
MODCARGO_CRATES +=	num-rational	0.4.2	# MIT OR Apache-2.0
MODCARGO_CRATES +=	num-traits	0.2.19	# MIT OR Apache-2.0
MODCARGO_CRATES +=	objc2	0.6.3	# MIT
MODCARGO_CRATES +=	objc2-app-kit	0.3.2	# Zlib OR Apache-2.0 OR MIT
MODCARGO_CRATES +=	objc2-core-foundation	0.3.2	# Zlib OR Apache-2.0 OR MIT
MODCARGO_CRATES +=	objc2-core-graphics	0.3.2	# Zlib OR Apache-2.0 OR MIT
MODCARGO_CRATES +=	objc2-encode	4.1.0	# MIT
MODCARGO_CRATES +=	objc2-foundation	0.3.2	# MIT
MODCARGO_CRATES +=	objc2-io-surface	0.3.2	# Zlib OR Apache-2.0 OR MIT
MODCARGO_CRATES +=	once_cell	1.21.3	# MIT OR Apache-2.0
MODCARGO_CRATES +=	once_cell_polyfill	1.70.2	# MIT OR Apache-2.0
MODCARGO_CRATES +=	os_pipe	1.2.3	# MIT
MODCARGO_CRATES +=	parking_lot	0.12.5	# MIT OR Apache-2.0
MODCARGO_CRATES +=	parking_lot_core	0.9.12	# MIT OR Apache-2.0
MODCARGO_CRATES +=	paste	1.0.15	# MIT OR Apache-2.0
MODCARGO_CRATES +=	percent-encoding	2.3.2	# MIT OR Apache-2.0
MODCARGO_CRATES +=	petgraph	0.6.5	# MIT OR Apache-2.0
MODCARGO_CRATES +=	pkg-config	0.3.32	# MIT OR Apache-2.0
MODCARGO_CRATES +=	proc-macro2	1.0.103	# MIT OR Apache-2.0
MODCARGO_CRATES +=	qsv-dateparser	0.13.0	# MIT
MODCARGO_CRATES +=	qsv-sniffer	0.11.0	# MIT
MODCARGO_CRATES +=	quick-xml	0.37.5	# MIT
MODCARGO_CRATES +=	quote	1.0.41	# MIT OR Apache-2.0
MODCARGO_CRATES +=	r-efi	5.3.0	# MIT OR Apache-2.0 OR LGPL-2.1-or-later
MODCARGO_CRATES +=	ratatui	0.29.0	# MIT
MODCARGO_CRATES +=	redox_syscall	0.5.18	# MIT
MODCARGO_CRATES +=	regex	1.12.2	# MIT OR Apache-2.0
MODCARGO_CRATES +=	regex-automata	0.4.13	# MIT OR Apache-2.0
MODCARGO_CRATES +=	regex-syntax	0.8.8	# MIT OR Apache-2.0
MODCARGO_CRATES +=	rustix	0.38.44	# Apache-2.0 WITH LLVM-exception OR Apache-2.0 OR MIT
MODCARGO_CRATES +=	rustix	1.1.2	# Apache-2.0 WITH LLVM-exception OR Apache-2.0 OR MIT
MODCARGO_CRATES +=	rustversion	1.0.22	# MIT OR Apache-2.0
MODCARGO_CRATES +=	ryu	1.0.20	# Apache-2.0 OR BSL-1.0
MODCARGO_CRATES +=	scopeguard	1.2.0	# MIT OR Apache-2.0
MODCARGO_CRATES +=	serde_core	1.0.228	# MIT OR Apache-2.0
MODCARGO_CRATES +=	serde_derive	1.0.228	# MIT OR Apache-2.0
MODCARGO_CRATES +=	shlex	1.3.0	# MIT OR Apache-2.0
MODCARGO_CRATES +=	signal-hook	0.3.18	# Apache-2.0/MIT
MODCARGO_CRATES +=	signal-hook-mio	0.2.5	# MIT OR Apache-2.0
MODCARGO_CRATES +=	signal-hook-registry	1.4.6	# Apache-2.0/MIT
MODCARGO_CRATES +=	simdutf8	0.1.5	# MIT OR Apache-2.0
MODCARGO_CRATES +=	smallvec	1.15.1	# MIT OR Apache-2.0
MODCARGO_CRATES +=	sorted-vec	0.8.10	# Apache-2.0
MODCARGO_CRATES +=	static_assertions	1.1.0	# MIT OR Apache-2.0
MODCARGO_CRATES +=	strsim	0.11.1	# MIT
MODCARGO_CRATES +=	strum	0.26.3	# MIT
MODCARGO_CRATES +=	strum_macros	0.26.4	# MIT
MODCARGO_CRATES +=	syn	2.0.108	# MIT OR Apache-2.0
MODCARGO_CRATES +=	tabwriter	1.4.1	# Unlicense/MIT
MODCARGO_CRATES +=	tempfile	3.23.0	# MIT OR Apache-2.0
MODCARGO_CRATES +=	terminal-colorsaurus	1.0.1	# MIT OR Apache-2.0
MODCARGO_CRATES +=	terminal-trx	0.2.5	# MIT OR Apache-2.0
MODCARGO_CRATES +=	terminal_size	0.4.3	# MIT OR Apache-2.0
MODCARGO_CRATES +=	thiserror	1.0.69	# MIT OR Apache-2.0
MODCARGO_CRATES +=	thiserror	2.0.17	# MIT OR Apache-2.0
MODCARGO_CRATES +=	thiserror-impl	1.0.69	# MIT OR Apache-2.0
MODCARGO_CRATES +=	thiserror-impl	2.0.17	# MIT OR Apache-2.0
MODCARGO_CRATES +=	tiny-keccak	2.0.2	# CC0-1.0
MODCARGO_CRATES +=	tree_magic_mini	3.2.0	# MIT
MODCARGO_CRATES +=	tui-input	0.13.0	# MIT
MODCARGO_CRATES +=	unicode-ident	1.0.20	# (MIT OR Apache-2.0) AND Unicode-3.0
MODCARGO_CRATES +=	unicode-segmentation	1.12.0	# MIT OR Apache-2.0
MODCARGO_CRATES +=	unicode-truncate	1.1.0	# MIT OR Apache-2.0
MODCARGO_CRATES +=	unicode-width	0.1.14	# MIT OR Apache-2.0
MODCARGO_CRATES +=	unicode-width	0.2.0	# MIT OR Apache-2.0
MODCARGO_CRATES +=	utf8parse	0.2.2	# Apache-2.0 OR MIT
MODCARGO_CRATES +=	version_check	0.9.5	# MIT/Apache-2.0
MODCARGO_CRATES +=	wasi	0.11.1+wasi-snapshot-preview1	# Apache-2.0 WITH LLVM-exception OR Apache-2.0 OR MIT
MODCARGO_CRATES +=	wasip2	1.0.1+wasi-0.2.4	# Apache-2.0 WITH LLVM-exception OR Apache-2.0 OR MIT
MODCARGO_CRATES +=	wasm-bindgen	0.2.105	# MIT OR Apache-2.0
MODCARGO_CRATES +=	wasm-bindgen-macro	0.2.105	# MIT OR Apache-2.0
MODCARGO_CRATES +=	wasm-bindgen-macro-support	0.2.105	# MIT OR Apache-2.0
MODCARGO_CRATES +=	wasm-bindgen-shared	0.2.105	# MIT OR Apache-2.0
MODCARGO_CRATES +=	wayland-backend	0.3.11	# MIT
MODCARGO_CRATES +=	wayland-client	0.31.11	# MIT
MODCARGO_CRATES +=	wayland-protocols	0.32.9	# MIT
MODCARGO_CRATES +=	wayland-protocols-wlr	0.3.9	# MIT
MODCARGO_CRATES +=	wayland-scanner	0.31.7	# MIT
MODCARGO_CRATES +=	wayland-sys	0.31.7	# MIT
MODCARGO_CRATES +=	winapi	0.3.9	# MIT/Apache-2.0
MODCARGO_CRATES +=	winapi-i686-pc-windows-gnu	0.4.0	# MIT/Apache-2.0
MODCARGO_CRATES +=	winapi-x86_64-pc-windows-gnu	0.4.0	# MIT/Apache-2.0
MODCARGO_CRATES +=	windows-core	0.62.2	# MIT OR Apache-2.0
MODCARGO_CRATES +=	windows-implement	0.60.2	# MIT OR Apache-2.0
MODCARGO_CRATES +=	windows-interface	0.59.3	# MIT OR Apache-2.0
MODCARGO_CRATES +=	windows-link	0.2.1	# MIT OR Apache-2.0
MODCARGO_CRATES +=	windows-result	0.4.1	# MIT OR Apache-2.0
MODCARGO_CRATES +=	windows-strings	0.5.1	# MIT OR Apache-2.0
MODCARGO_CRATES +=	windows-sys	0.59.0	# MIT OR Apache-2.0
MODCARGO_CRATES +=	windows-sys	0.60.2	# MIT OR Apache-2.0
MODCARGO_CRATES +=	windows-sys	0.61.2	# MIT OR Apache-2.0
MODCARGO_CRATES +=	windows-targets	0.52.6	# MIT OR Apache-2.0
MODCARGO_CRATES +=	windows-targets	0.53.5	# MIT OR Apache-2.0
MODCARGO_CRATES +=	windows_aarch64_gnullvm	0.52.6	# MIT OR Apache-2.0
MODCARGO_CRATES +=	windows_aarch64_gnullvm	0.53.1	# MIT OR Apache-2.0
MODCARGO_CRATES +=	windows_aarch64_msvc	0.52.6	# MIT OR Apache-2.0
MODCARGO_CRATES +=	windows_aarch64_msvc	0.53.1	# MIT OR Apache-2.0
MODCARGO_CRATES +=	windows_i686_gnu	0.52.6	# MIT OR Apache-2.0
MODCARGO_CRATES +=	windows_i686_gnu	0.53.1	# MIT OR Apache-2.0
MODCARGO_CRATES +=	windows_i686_gnullvm	0.52.6	# MIT OR Apache-2.0
MODCARGO_CRATES +=	windows_i686_gnullvm	0.53.1	# MIT OR Apache-2.0
MODCARGO_CRATES +=	windows_i686_msvc	0.52.6	# MIT OR Apache-2.0
MODCARGO_CRATES +=	windows_i686_msvc	0.53.1	# MIT OR Apache-2.0
MODCARGO_CRATES +=	windows_x86_64_gnu	0.52.6	# MIT OR Apache-2.0
MODCARGO_CRATES +=	windows_x86_64_gnu	0.53.1	# MIT OR Apache-2.0
MODCARGO_CRATES +=	windows_x86_64_gnullvm	0.52.6	# MIT OR Apache-2.0
MODCARGO_CRATES +=	windows_x86_64_gnullvm	0.53.1	# MIT OR Apache-2.0
MODCARGO_CRATES +=	windows_x86_64_msvc	0.52.6	# MIT OR Apache-2.0
MODCARGO_CRATES +=	windows_x86_64_msvc	0.53.1	# MIT OR Apache-2.0
MODCARGO_CRATES +=	wit-bindgen	0.46.0	# Apache-2.0 WITH LLVM-exception OR Apache-2.0 OR MIT
MODCARGO_CRATES +=	wl-clipboard-rs	0.9.2	# MIT/Apache-2.0
MODCARGO_CRATES +=	x11rb	0.13.2	# MIT OR Apache-2.0
MODCARGO_CRATES +=	x11rb-protocol	0.13.2	# MIT OR Apache-2.0
MODCARGO_CRATES +=	xterm-color	1.0.1	# MIT OR Apache-2.0
MODCARGO_CRATES +=	zerocopy	0.8.27	# BSD-2-Clause OR Apache-2.0 OR MIT
MODCARGO_CRATES +=	zerocopy-derive	0.8.27	# BSD-2-Clause OR Apache-2.0 OR MIT
