MODCARGO_CRATES +=	addr2line	0.24.2	# Apache-2.0 OR MIT
MODCARGO_CRATES +=	adler2	2.0.1	# 0BSD OR MIT OR Apache-2.0
MODCARGO_CRATES +=	aho-corasick	1.1.3	# Unlicense OR MIT
MODCARGO_CRATES +=	anstream	0.6.19	# MIT OR Apache-2.0
MODCARGO_CRATES +=	anstyle	1.0.11	# MIT OR Apache-2.0
MODCARGO_CRATES +=	anstyle-parse	0.2.7	# MIT OR Apache-2.0
MODCARGO_CRATES +=	anstyle-query	1.1.3	# MIT OR Apache-2.0
MODCARGO_CRATES +=	anstyle-wincon	3.0.9	# MIT OR Apache-2.0
MODCARGO_CRATES +=	anyhow	1.0.98	# MIT OR Apache-2.0
MODCARGO_CRATES +=	async-compression	0.4.25	# MIT OR Apache-2.0
MODCARGO_CRATES +=	async-trait	0.1.88	# MIT OR Apache-2.0
MODCARGO_CRATES +=	avt	0.17.0	# Apache-2.0
MODCARGO_CRATES +=	axum	0.8.6	# MIT
MODCARGO_CRATES +=	axum-core	0.5.5	# MIT
MODCARGO_CRATES +=	backtrace	0.3.75	# MIT OR Apache-2.0
MODCARGO_CRATES +=	base64	0.22.1	# MIT OR Apache-2.0
MODCARGO_CRATES +=	bitflags	2.9.1	# MIT OR Apache-2.0
MODCARGO_CRATES +=	block-buffer	0.10.4	# MIT OR Apache-2.0
MODCARGO_CRATES +=	bumpalo	3.18.1	# MIT OR Apache-2.0
MODCARGO_CRATES +=	bytemuck	1.23.1	# Zlib OR Apache-2.0 OR MIT
MODCARGO_CRATES +=	bytes	1.10.1	# MIT
MODCARGO_CRATES +=	cc	1.2.27	# MIT OR Apache-2.0
MODCARGO_CRATES +=	cfg-if	1.0.1	# MIT OR Apache-2.0
MODCARGO_CRATES +=	cfg_aliases	0.2.1	# MIT
MODCARGO_CRATES +=	clap	4.5.40	# MIT OR Apache-2.0
MODCARGO_CRATES +=	clap_builder	4.5.40	# MIT OR Apache-2.0
MODCARGO_CRATES +=	clap_complete	4.5.54	# MIT OR Apache-2.0
MODCARGO_CRATES +=	clap_derive	4.5.40	# MIT OR Apache-2.0
MODCARGO_CRATES +=	clap_lex	0.7.5	# MIT OR Apache-2.0
MODCARGO_CRATES +=	clap_mangen	0.2.27	# MIT OR Apache-2.0
MODCARGO_CRATES +=	clipboard-win	5.4.0	# BSL-1.0
MODCARGO_CRATES +=	colorchoice	1.0.4	# MIT OR Apache-2.0
MODCARGO_CRATES +=	config	0.15.18	# MIT OR Apache-2.0
MODCARGO_CRATES +=	core-foundation	0.10.1	# MIT OR Apache-2.0
MODCARGO_CRATES +=	core-foundation-sys	0.8.7	# MIT OR Apache-2.0
MODCARGO_CRATES +=	cpufeatures	0.2.17	# MIT OR Apache-2.0
MODCARGO_CRATES +=	crc32fast	1.4.2	# MIT OR Apache-2.0
MODCARGO_CRATES +=	crypto-common	0.1.6	# MIT OR Apache-2.0
MODCARGO_CRATES +=	data-encoding	2.9.0	# MIT
MODCARGO_CRATES +=	digest	0.10.7	# MIT OR Apache-2.0
MODCARGO_CRATES +=	env_home	0.1.0	# MIT OR Apache-2.0
MODCARGO_CRATES +=	errno	0.3.13	# MIT OR Apache-2.0
MODCARGO_CRATES +=	error-code	3.3.2	# BSL-1.0
MODCARGO_CRATES +=	fastrand	2.3.0	# Apache-2.0 OR MIT
MODCARGO_CRATES +=	flate2	1.1.2	# MIT OR Apache-2.0
MODCARGO_CRATES +=	fnv	1.0.7	# Apache-2.0 / MIT
MODCARGO_CRATES +=	form_urlencoded	1.2.1	# MIT OR Apache-2.0
MODCARGO_CRATES +=	futures-channel	0.3.31	# MIT OR Apache-2.0
MODCARGO_CRATES +=	futures-core	0.3.31	# MIT OR Apache-2.0
MODCARGO_CRATES +=	futures-io	0.3.31	# MIT OR Apache-2.0
MODCARGO_CRATES +=	futures-macro	0.3.31	# MIT OR Apache-2.0
MODCARGO_CRATES +=	futures-sink	0.3.31	# MIT OR Apache-2.0
MODCARGO_CRATES +=	futures-task	0.3.31	# MIT OR Apache-2.0
MODCARGO_CRATES +=	futures-util	0.3.31	# MIT OR Apache-2.0
MODCARGO_CRATES +=	generic-array	0.14.7	# MIT
MODCARGO_CRATES +=	getrandom	0.2.16	# MIT OR Apache-2.0
MODCARGO_CRATES +=	getrandom	0.3.3	# MIT OR Apache-2.0
MODCARGO_CRATES +=	gimli	0.31.1	# MIT OR Apache-2.0
MODCARGO_CRATES +=	hashbrown	0.15.4	# MIT OR Apache-2.0
MODCARGO_CRATES +=	heck	0.5.0	# MIT OR Apache-2.0
MODCARGO_CRATES +=	http	1.3.1	# MIT OR Apache-2.0
MODCARGO_CRATES +=	http-body	1.0.1	# MIT
MODCARGO_CRATES +=	http-body-util	0.1.3	# MIT
MODCARGO_CRATES +=	httparse	1.10.1	# MIT OR Apache-2.0
MODCARGO_CRATES +=	httpdate	1.0.3	# MIT OR Apache-2.0
MODCARGO_CRATES +=	hyper	1.6.0	# MIT
MODCARGO_CRATES +=	hyper-rustls	0.27.7	# Apache-2.0 OR ISC OR MIT
MODCARGO_CRATES +=	hyper-util	0.1.14	# MIT
MODCARGO_CRATES +=	idna	1.0.3	# MIT OR Apache-2.0
MODCARGO_CRATES +=	idna_adapter	1.0.0	# Apache-2.0 OR MIT
MODCARGO_CRATES +=	ipnet	2.11.0	# MIT OR Apache-2.0
MODCARGO_CRATES +=	iri-string	0.7.8	# MIT OR Apache-2.0
MODCARGO_CRATES +=	is_terminal_polyfill	1.70.1	# MIT OR Apache-2.0
MODCARGO_CRATES +=	itoa	1.0.15	# MIT OR Apache-2.0
MODCARGO_CRATES +=	js-sys	0.3.77	# MIT OR Apache-2.0
MODCARGO_CRATES +=	lazy_static	1.5.0	# MIT OR Apache-2.0
MODCARGO_CRATES +=	libc	0.2.174	# MIT OR Apache-2.0
MODCARGO_CRATES +=	linux-raw-sys	0.9.4	# Apache-2.0 WITH LLVM-exception OR Apache-2.0 OR MIT
MODCARGO_CRATES +=	log	0.4.27	# MIT OR Apache-2.0
MODCARGO_CRATES +=	lru-slab	0.1.2	# MIT OR Apache-2.0 OR Zlib
MODCARGO_CRATES +=	matchers	0.2.0	# MIT
MODCARGO_CRATES +=	matchit	0.8.4	# MIT AND BSD-3-Clause
MODCARGO_CRATES +=	memchr	2.7.5	# Unlicense OR MIT
MODCARGO_CRATES +=	mime	0.3.17	# MIT OR Apache-2.0
MODCARGO_CRATES +=	mime_guess	2.0.5	# MIT
MODCARGO_CRATES +=	miniz_oxide	0.8.9	# MIT OR Zlib OR Apache-2.0
MODCARGO_CRATES +=	mio	1.0.4	# MIT
MODCARGO_CRATES +=	nix	0.30.1	# MIT
MODCARGO_CRATES +=	object	0.36.7	# Apache-2.0 OR MIT
MODCARGO_CRATES +=	once_cell	1.21.3	# MIT OR Apache-2.0
MODCARGO_CRATES +=	once_cell_polyfill	1.70.1	# MIT OR Apache-2.0
MODCARGO_CRATES +=	openssl-probe	0.1.6	# MIT/Apache-2.0
MODCARGO_CRATES +=	pathdiff	0.2.3	# MIT/Apache-2.0
MODCARGO_CRATES +=	percent-encoding	2.3.1	# MIT OR Apache-2.0
MODCARGO_CRATES +=	pin-project-lite	0.2.16	# Apache-2.0 OR MIT
MODCARGO_CRATES +=	pin-utils	0.1.0	# MIT OR Apache-2.0
MODCARGO_CRATES +=	ppv-lite86	0.2.21	# MIT OR Apache-2.0
MODCARGO_CRATES +=	proc-macro2	1.0.95	# MIT OR Apache-2.0
MODCARGO_CRATES +=	quinn	0.11.8	# MIT OR Apache-2.0
MODCARGO_CRATES +=	quinn-proto	0.11.12	# MIT OR Apache-2.0
MODCARGO_CRATES +=	quinn-udp	0.5.13	# MIT OR Apache-2.0
MODCARGO_CRATES +=	quote	1.0.40	# MIT OR Apache-2.0
MODCARGO_CRATES +=	r-efi	5.3.0	# MIT OR Apache-2.0 OR LGPL-2.1-or-later
MODCARGO_CRATES +=	rand	0.9.1	# MIT OR Apache-2.0
MODCARGO_CRATES +=	rand_chacha	0.9.0	# MIT OR Apache-2.0
MODCARGO_CRATES +=	rand_core	0.9.3	# MIT OR Apache-2.0
MODCARGO_CRATES +=	regex-automata	0.4.9	# MIT OR Apache-2.0
MODCARGO_CRATES +=	regex-syntax	0.8.5	# MIT OR Apache-2.0
MODCARGO_CRATES +=	reqwest	0.12.20	# MIT OR Apache-2.0
MODCARGO_CRATES +=	rgb	0.8.50	# MIT
MODCARGO_CRATES +=	ring	0.17.14	# Apache-2.0 AND ISC
MODCARGO_CRATES +=	roff	0.2.2	# MIT OR Apache-2.0
MODCARGO_CRATES +=	rust-embed	8.8.0	# MIT
MODCARGO_CRATES +=	rust-embed-impl	8.8.0	# MIT
MODCARGO_CRATES +=	rust-embed-utils	8.8.0	# MIT
MODCARGO_CRATES +=	rustc-demangle	0.1.25	# MIT/Apache-2.0
MODCARGO_CRATES +=	rustc-hash	2.1.1	# Apache-2.0 OR MIT
MODCARGO_CRATES +=	rustix	1.0.7	# Apache-2.0 WITH LLVM-exception OR Apache-2.0 OR MIT
MODCARGO_CRATES +=	rustls	0.23.34	# Apache-2.0 OR ISC OR MIT
MODCARGO_CRATES +=	rustls-native-certs	0.8.1	# Apache-2.0 OR ISC OR MIT
MODCARGO_CRATES +=	rustls-pki-types	1.12.0	# MIT OR Apache-2.0
MODCARGO_CRATES +=	rustls-webpki	0.103.7	# ISC
MODCARGO_CRATES +=	rustversion	1.0.21	# MIT OR Apache-2.0
MODCARGO_CRATES +=	rustyline	17.0.1	# MIT
MODCARGO_CRATES +=	ryu	1.0.20	# Apache-2.0 OR BSL-1.0
MODCARGO_CRATES +=	same-file	1.0.6	# Unlicense/MIT
MODCARGO_CRATES +=	schannel	0.1.27	# MIT
MODCARGO_CRATES +=	security-framework	3.2.0	# MIT OR Apache-2.0
MODCARGO_CRATES +=	security-framework-sys	2.14.0	# MIT OR Apache-2.0
MODCARGO_CRATES +=	serde	1.0.228	# MIT OR Apache-2.0
MODCARGO_CRATES +=	serde_core	1.0.228	# MIT OR Apache-2.0
MODCARGO_CRATES +=	serde_derive	1.0.228	# MIT OR Apache-2.0
MODCARGO_CRATES +=	serde_json	1.0.140	# MIT OR Apache-2.0
MODCARGO_CRATES +=	serde_spanned	1.0.3	# MIT OR Apache-2.0
MODCARGO_CRATES +=	serde_urlencoded	0.7.1	# MIT/Apache-2.0
MODCARGO_CRATES +=	sha1	0.10.6	# MIT OR Apache-2.0
MODCARGO_CRATES +=	sha2	0.10.9	# MIT OR Apache-2.0
MODCARGO_CRATES +=	sharded-slab	0.1.7	# MIT
MODCARGO_CRATES +=	shlex	1.3.0	# MIT OR Apache-2.0
MODCARGO_CRATES +=	signal-hook	0.3.18	# Apache-2.0/MIT
MODCARGO_CRATES +=	signal-hook-registry	1.4.5	# Apache-2.0/MIT
MODCARGO_CRATES +=	signal-hook-tokio	0.3.1	# Apache-2.0/MIT
MODCARGO_CRATES +=	slab	0.4.11	# MIT
MODCARGO_CRATES +=	smallvec	1.15.1	# MIT OR Apache-2.0
MODCARGO_CRATES +=	socket2	0.5.10	# MIT OR Apache-2.0
MODCARGO_CRATES +=	strsim	0.11.1	# MIT
MODCARGO_CRATES +=	subtle	2.6.1	# BSD-3-Clause
MODCARGO_CRATES +=	syn	2.0.103	# MIT OR Apache-2.0
MODCARGO_CRATES +=	sync_wrapper	1.0.2	# Apache-2.0
MODCARGO_CRATES +=	tempfile	3.23.0	# MIT OR Apache-2.0
MODCARGO_CRATES +=	terminal_size	0.4.2	# MIT OR Apache-2.0
MODCARGO_CRATES +=	thiserror	2.0.12	# MIT OR Apache-2.0
MODCARGO_CRATES +=	thiserror-impl	2.0.12	# MIT OR Apache-2.0
MODCARGO_CRATES +=	thread_local	1.1.9	# MIT OR Apache-2.0
MODCARGO_CRATES +=	tinyvec	1.9.0	# Zlib OR Apache-2.0 OR MIT
MODCARGO_CRATES +=	tinyvec_macros	0.1.1	# MIT OR Apache-2.0 OR Zlib
MODCARGO_CRATES +=	tokio	1.45.1	# MIT
MODCARGO_CRATES +=	tokio-macros	2.5.0	# MIT
MODCARGO_CRATES +=	tokio-rustls	0.26.2	# MIT OR Apache-2.0
MODCARGO_CRATES +=	tokio-stream	0.1.17	# MIT
MODCARGO_CRATES +=	tokio-tungstenite	0.28.0	# MIT
MODCARGO_CRATES +=	tokio-util	0.7.15	# MIT
MODCARGO_CRATES +=	toml	0.9.8	# MIT OR Apache-2.0
MODCARGO_CRATES +=	toml_datetime	0.7.3	# MIT OR Apache-2.0
MODCARGO_CRATES +=	toml_parser	1.0.4	# MIT OR Apache-2.0
MODCARGO_CRATES +=	tower	0.5.2	# MIT
MODCARGO_CRATES +=	tower-http	0.6.6	# MIT
MODCARGO_CRATES +=	tower-layer	0.3.3	# MIT
MODCARGO_CRATES +=	tower-service	0.3.3	# MIT
MODCARGO_CRATES +=	tracing	0.1.41	# MIT
MODCARGO_CRATES +=	tracing-core	0.1.34	# MIT
MODCARGO_CRATES +=	tracing-subscriber	0.3.20	# MIT
MODCARGO_CRATES +=	try-lock	0.2.5	# MIT
MODCARGO_CRATES +=	tungstenite	0.28.0	# MIT OR Apache-2.0
MODCARGO_CRATES +=	typenum	1.18.0	# MIT OR Apache-2.0
MODCARGO_CRATES +=	unicase	2.8.1	# MIT OR Apache-2.0
MODCARGO_CRATES +=	unicode-ident	1.0.18	# (MIT OR Apache-2.0) AND Unicode-3.0
MODCARGO_CRATES +=	unicode-segmentation	1.12.0	# MIT OR Apache-2.0
MODCARGO_CRATES +=	unicode-width	0.1.14	# MIT OR Apache-2.0
MODCARGO_CRATES +=	unicode-width	0.2.1	# MIT OR Apache-2.0
MODCARGO_CRATES +=	untrusted	0.9.0	# ISC
MODCARGO_CRATES +=	url	2.5.4	# MIT OR Apache-2.0
MODCARGO_CRATES +=	utf-8	0.7.6	# MIT OR Apache-2.0
MODCARGO_CRATES +=	utf8_iter	1.0.4	# Apache-2.0 OR MIT
MODCARGO_CRATES +=	utf8parse	0.2.2	# Apache-2.0 OR MIT
MODCARGO_CRATES +=	uuid	1.17.0	# Apache-2.0 OR MIT
MODCARGO_CRATES +=	version_check	0.9.5	# MIT/Apache-2.0
MODCARGO_CRATES +=	walkdir	2.5.0	# Unlicense/MIT
MODCARGO_CRATES +=	want	0.3.1	# MIT
MODCARGO_CRATES +=	wasi	0.11.1+wasi-snapshot-preview1	# Apache-2.0 WITH LLVM-exception OR Apache-2.0 OR MIT
MODCARGO_CRATES +=	wasi	0.14.2+wasi-0.2.4	# Apache-2.0 WITH LLVM-exception OR Apache-2.0 OR MIT
MODCARGO_CRATES +=	wasm-bindgen	0.2.100	# MIT OR Apache-2.0
MODCARGO_CRATES +=	wasm-bindgen-backend	0.2.100	# MIT OR Apache-2.0
MODCARGO_CRATES +=	wasm-bindgen-futures	0.4.50	# MIT OR Apache-2.0
MODCARGO_CRATES +=	wasm-bindgen-macro	0.2.100	# MIT OR Apache-2.0
MODCARGO_CRATES +=	wasm-bindgen-macro-support	0.2.100	# MIT OR Apache-2.0
MODCARGO_CRATES +=	wasm-bindgen-shared	0.2.100	# MIT OR Apache-2.0
MODCARGO_CRATES +=	wasm-streams	0.4.2	# MIT OR Apache-2.0
MODCARGO_CRATES +=	web-sys	0.3.77	# MIT OR Apache-2.0
MODCARGO_CRATES +=	web-time	1.1.0	# MIT OR Apache-2.0
MODCARGO_CRATES +=	which	8.0.0	# MIT
MODCARGO_CRATES +=	winapi-util	0.1.9	# Unlicense OR MIT
MODCARGO_CRATES +=	windows-sys	0.52.0	# MIT OR Apache-2.0
MODCARGO_CRATES +=	windows-sys	0.59.0	# MIT OR Apache-2.0
MODCARGO_CRATES +=	windows-sys	0.60.2	# MIT OR Apache-2.0
MODCARGO_CRATES +=	windows-targets	0.52.6	# MIT OR Apache-2.0
MODCARGO_CRATES +=	windows-targets	0.53.2	# MIT OR Apache-2.0
MODCARGO_CRATES +=	windows_aarch64_gnullvm	0.52.6	# MIT OR Apache-2.0
MODCARGO_CRATES +=	windows_aarch64_gnullvm	0.53.0	# MIT OR Apache-2.0
MODCARGO_CRATES +=	windows_aarch64_msvc	0.52.6	# MIT OR Apache-2.0
MODCARGO_CRATES +=	windows_aarch64_msvc	0.53.0	# MIT OR Apache-2.0
MODCARGO_CRATES +=	windows_i686_gnu	0.52.6	# MIT OR Apache-2.0
MODCARGO_CRATES +=	windows_i686_gnu	0.53.0	# MIT OR Apache-2.0
MODCARGO_CRATES +=	windows_i686_gnullvm	0.52.6	# MIT OR Apache-2.0
MODCARGO_CRATES +=	windows_i686_gnullvm	0.53.0	# MIT OR Apache-2.0
MODCARGO_CRATES +=	windows_i686_msvc	0.52.6	# MIT OR Apache-2.0
MODCARGO_CRATES +=	windows_i686_msvc	0.53.0	# MIT OR Apache-2.0
MODCARGO_CRATES +=	windows_x86_64_gnu	0.52.6	# MIT OR Apache-2.0
MODCARGO_CRATES +=	windows_x86_64_gnu	0.53.0	# MIT OR Apache-2.0
MODCARGO_CRATES +=	windows_x86_64_gnullvm	0.52.6	# MIT OR Apache-2.0
MODCARGO_CRATES +=	windows_x86_64_gnullvm	0.53.0	# MIT OR Apache-2.0
MODCARGO_CRATES +=	windows_x86_64_msvc	0.52.6	# MIT OR Apache-2.0
MODCARGO_CRATES +=	windows_x86_64_msvc	0.53.0	# MIT OR Apache-2.0
MODCARGO_CRATES +=	winnow	0.7.13	# MIT
MODCARGO_CRATES +=	winsafe	0.0.19	# MIT
MODCARGO_CRATES +=	wit-bindgen-rt	0.39.0	# Apache-2.0 WITH LLVM-exception OR Apache-2.0 OR MIT
MODCARGO_CRATES +=	zerocopy	0.8.26	# BSD-2-Clause OR Apache-2.0 OR MIT
MODCARGO_CRATES +=	zerocopy-derive	0.8.26	# BSD-2-Clause OR Apache-2.0 OR MIT
MODCARGO_CRATES +=	zeroize	1.8.1	# Apache-2.0 OR MIT
