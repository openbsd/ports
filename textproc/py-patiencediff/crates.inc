MODCARGO_CRATES +=	heck	0.5.0	# MIT OR Apache-2.0
MODCARGO_CRATES +=	libc	0.2.186	# MIT OR Apache-2.0
MODCARGO_CRATES +=	once_cell	1.21.4	# MIT OR Apache-2.0
MODCARGO_CRATES +=	patiencediff	0.2.1	# GPL-2.0+
MODCARGO_CRATES +=	portable-atomic	1.13.1	# Apache-2.0 OR MIT
MODCARGO_CRATES +=	proc-macro2	1.0.106	# MIT OR Apache-2.0
MODCARGO_CRATES +=	pyo3	0.29.0	# MIT OR Apache-2.0
MODCARGO_CRATES +=	pyo3-build-config	0.29.0	# MIT OR Apache-2.0
MODCARGO_CRATES +=	pyo3-ffi	0.29.0	# MIT OR Apache-2.0
MODCARGO_CRATES +=	pyo3-macros	0.29.0	# MIT OR Apache-2.0
MODCARGO_CRATES +=	pyo3-macros-backend	0.29.0	# MIT OR Apache-2.0
MODCARGO_CRATES +=	quote	1.0.45	# MIT OR Apache-2.0
MODCARGO_CRATES +=	syn	2.0.117	# MIT OR Apache-2.0
MODCARGO_CRATES +=	target-lexicon	0.13.5	# Apache-2.0 WITH LLVM-exception
MODCARGO_CRATES +=	unicode-ident	1.0.24	# (MIT OR Apache-2.0) AND Unicode-3.0
