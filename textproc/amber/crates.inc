MODCARGO_CRATES +=	aho-corasick	1.1.2	# Unlicense OR MIT
MODCARGO_CRATES +=	ansi_term	0.12.1	# MIT
MODCARGO_CRATES +=	atty	0.2.14	# MIT
MODCARGO_CRATES +=	autocfg	1.1.0	# Apache-2.0 OR MIT
MODCARGO_CRATES +=	bitflags	1.3.2	# MIT/Apache-2.0
MODCARGO_CRATES +=	bitflags	2.4.1	# MIT OR Apache-2.0
MODCARGO_CRATES +=	cfg-if	1.0.0	# MIT/Apache-2.0
MODCARGO_CRATES +=	clap	2.34.0	# MIT
MODCARGO_CRATES +=	crossbeam	0.8.3	# MIT OR Apache-2.0
MODCARGO_CRATES +=	crossbeam-channel	0.5.10	# MIT OR Apache-2.0
MODCARGO_CRATES +=	crossbeam-deque	0.8.4	# MIT OR Apache-2.0
MODCARGO_CRATES +=	crossbeam-epoch	0.9.17	# MIT OR Apache-2.0
MODCARGO_CRATES +=	crossbeam-queue	0.3.10	# MIT OR Apache-2.0
MODCARGO_CRATES +=	crossbeam-utils	0.8.18	# MIT OR Apache-2.0
MODCARGO_CRATES +=	ctrlc	3.4.2	# MIT/Apache-2.0
MODCARGO_CRATES +=	deranged	0.3.9	# MIT OR Apache-2.0
MODCARGO_CRATES +=	directories	5.0.1	# MIT OR Apache-2.0
MODCARGO_CRATES +=	dirs-next	2.0.0	# MIT OR Apache-2.0
MODCARGO_CRATES +=	dirs-sys	0.4.1	# MIT OR Apache-2.0
MODCARGO_CRATES +=	dirs-sys-next	0.1.2	# MIT OR Apache-2.0
MODCARGO_CRATES +=	equivalent	1.0.1	# Apache-2.0 OR MIT
MODCARGO_CRATES +=	errno	0.3.7	# MIT OR Apache-2.0
MODCARGO_CRATES +=	fastrand	2.0.1	# Apache-2.0 OR MIT
MODCARGO_CRATES +=	filetime	0.2.23	# MIT/Apache-2.0
MODCARGO_CRATES +=	getch	0.3.1	# Apache-2.0
MODCARGO_CRATES +=	getrandom	0.2.11	# MIT OR Apache-2.0
MODCARGO_CRATES +=	glob	0.3.1	# MIT OR Apache-2.0
MODCARGO_CRATES +=	hashbrown	0.14.3	# MIT OR Apache-2.0
MODCARGO_CRATES +=	heck	0.3.3	# MIT OR Apache-2.0
MODCARGO_CRATES +=	hermit-abi	0.1.19	# MIT/Apache-2.0
MODCARGO_CRATES +=	hermit-abi	0.3.3	# MIT OR Apache-2.0
MODCARGO_CRATES +=	indexmap	2.1.0	# Apache-2.0 OR MIT
MODCARGO_CRATES +=	lazy_static	1.4.0	# MIT/Apache-2.0
MODCARGO_CRATES +=	libc	0.2.150	# MIT OR Apache-2.0
MODCARGO_CRATES +=	libredox	0.0.1	# MIT
MODCARGO_CRATES +=	linux-raw-sys	0.4.11	# Apache-2.0 WITH LLVM-exception OR Apache-2.0 OR MIT
MODCARGO_CRATES +=	memchr	2.6.4	# Unlicense OR MIT
MODCARGO_CRATES +=	memmap	0.7.0	# MIT/Apache-2.0
MODCARGO_CRATES +=	nix	0.27.1	# MIT
MODCARGO_CRATES +=	num_cpus	1.16.0	# MIT OR Apache-2.0
MODCARGO_CRATES +=	option-ext	0.2.0	# MPL-2.0
MODCARGO_CRATES +=	powerfmt	0.2.0	# MIT OR Apache-2.0
MODCARGO_CRATES +=	ppv-lite86	0.2.17	# MIT/Apache-2.0
MODCARGO_CRATES +=	proc-macro-error	1.0.4	# MIT OR Apache-2.0
MODCARGO_CRATES +=	proc-macro-error-attr	1.0.4	# MIT OR Apache-2.0
MODCARGO_CRATES +=	proc-macro2	1.0.70	# MIT OR Apache-2.0
MODCARGO_CRATES +=	quote	1.0.33	# MIT OR Apache-2.0
MODCARGO_CRATES +=	rand	0.8.5	# MIT OR Apache-2.0
MODCARGO_CRATES +=	rand_chacha	0.3.1	# MIT OR Apache-2.0
MODCARGO_CRATES +=	rand_core	0.6.4	# MIT OR Apache-2.0
MODCARGO_CRATES +=	redox_syscall	0.4.1	# MIT
MODCARGO_CRATES +=	redox_users	0.4.4	# MIT
MODCARGO_CRATES +=	regex	1.10.2	# MIT OR Apache-2.0
MODCARGO_CRATES +=	regex-automata	0.4.3	# MIT OR Apache-2.0
MODCARGO_CRATES +=	regex-syntax	0.8.2	# MIT OR Apache-2.0
MODCARGO_CRATES +=	rlibc	1.0.0	# MIT/Apache-2.0
MODCARGO_CRATES +=	rustix	0.38.25	# Apache-2.0 WITH LLVM-exception OR Apache-2.0 OR MIT
MODCARGO_CRATES +=	rustversion	1.0.14	# MIT OR Apache-2.0
MODCARGO_CRATES +=	serde	1.0.193	# MIT OR Apache-2.0
MODCARGO_CRATES +=	serde_derive	1.0.193	# MIT OR Apache-2.0
MODCARGO_CRATES +=	serde_spanned	0.6.4	# MIT OR Apache-2.0
MODCARGO_CRATES +=	strsim	0.8.0	# MIT
MODCARGO_CRATES +=	structopt	0.3.26	# Apache-2.0 OR MIT
MODCARGO_CRATES +=	structopt-derive	0.4.18	# Apache-2.0/MIT
MODCARGO_CRATES +=	syn	1.0.109	# MIT OR Apache-2.0
MODCARGO_CRATES +=	syn	2.0.39	# MIT OR Apache-2.0
MODCARGO_CRATES +=	tempfile	3.8.1	# MIT OR Apache-2.0
MODCARGO_CRATES +=	term	0.7.0	# MIT/Apache-2.0
MODCARGO_CRATES +=	termios	0.3.3	# MIT
MODCARGO_CRATES +=	textwrap	0.11.0	# MIT
MODCARGO_CRATES +=	thiserror	1.0.50	# MIT OR Apache-2.0
MODCARGO_CRATES +=	thiserror-impl	1.0.50	# MIT OR Apache-2.0
MODCARGO_CRATES +=	time	0.3.31	# MIT OR Apache-2.0
MODCARGO_CRATES +=	time-core	0.1.2	# MIT OR Apache-2.0
MODCARGO_CRATES +=	toml	0.8.8	# MIT OR Apache-2.0
MODCARGO_CRATES +=	toml_datetime	0.6.5	# MIT OR Apache-2.0
MODCARGO_CRATES +=	toml_edit	0.21.0	# MIT OR Apache-2.0
MODCARGO_CRATES +=	unicode-ident	1.0.12	# (MIT OR Apache-2.0) AND Unicode-DFS-2016
MODCARGO_CRATES +=	unicode-segmentation	1.10.1	# MIT/Apache-2.0
MODCARGO_CRATES +=	unicode-width	0.1.11	# MIT/Apache-2.0
MODCARGO_CRATES +=	vec_map	0.8.2	# MIT/Apache-2.0
MODCARGO_CRATES +=	version_check	0.9.4	# MIT/Apache-2.0
MODCARGO_CRATES +=	wasi	0.11.0+wasi-snapshot-preview1	# Apache-2.0 WITH LLVM-exception OR Apache-2.0 OR MIT
MODCARGO_CRATES +=	winapi	0.3.9	# MIT/Apache-2.0
MODCARGO_CRATES +=	winapi-i686-pc-windows-gnu	0.4.0	# MIT/Apache-2.0
MODCARGO_CRATES +=	winapi-x86_64-pc-windows-gnu	0.4.0	# MIT/Apache-2.0
MODCARGO_CRATES +=	windows-sys	0.48.0	# MIT OR Apache-2.0
MODCARGO_CRATES +=	windows-sys	0.52.0	# MIT OR Apache-2.0
MODCARGO_CRATES +=	windows-targets	0.48.5	# MIT OR Apache-2.0
MODCARGO_CRATES +=	windows-targets	0.52.0	# MIT OR Apache-2.0
MODCARGO_CRATES +=	windows_aarch64_gnullvm	0.48.5	# MIT OR Apache-2.0
MODCARGO_CRATES +=	windows_aarch64_gnullvm	0.52.0	# MIT OR Apache-2.0
MODCARGO_CRATES +=	windows_aarch64_msvc	0.48.5	# MIT OR Apache-2.0
MODCARGO_CRATES +=	windows_aarch64_msvc	0.52.0	# MIT OR Apache-2.0
MODCARGO_CRATES +=	windows_i686_gnu	0.48.5	# MIT OR Apache-2.0
MODCARGO_CRATES +=	windows_i686_gnu	0.52.0	# MIT OR Apache-2.0
MODCARGO_CRATES +=	windows_i686_msvc	0.48.5	# MIT OR Apache-2.0
MODCARGO_CRATES +=	windows_i686_msvc	0.52.0	# MIT OR Apache-2.0
MODCARGO_CRATES +=	windows_x86_64_gnu	0.48.5	# MIT OR Apache-2.0
MODCARGO_CRATES +=	windows_x86_64_gnu	0.52.0	# MIT OR Apache-2.0
MODCARGO_CRATES +=	windows_x86_64_gnullvm	0.48.5	# MIT OR Apache-2.0
MODCARGO_CRATES +=	windows_x86_64_gnullvm	0.52.0	# MIT OR Apache-2.0
MODCARGO_CRATES +=	windows_x86_64_msvc	0.48.5	# MIT OR Apache-2.0
MODCARGO_CRATES +=	windows_x86_64_msvc	0.52.0	# MIT OR Apache-2.0
MODCARGO_CRATES +=	winnow	0.5.19	# MIT
