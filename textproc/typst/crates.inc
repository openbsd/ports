MODCARGO_CRATES +=	adler2	2.0.0	# 0BSD OR MIT OR Apache-2.0
MODCARGO_CRATES +=	ahash	0.8.11	# MIT OR Apache-2.0
MODCARGO_CRATES +=	aho-corasick	1.1.3	# Unlicense OR MIT
MODCARGO_CRATES +=	android-tzdata	0.1.1	# MIT OR Apache-2.0
MODCARGO_CRATES +=	android_system_properties	0.1.5	# MIT/Apache-2.0
MODCARGO_CRATES +=	anstream	0.6.15	# MIT OR Apache-2.0
MODCARGO_CRATES +=	anstyle	1.0.8	# MIT OR Apache-2.0
MODCARGO_CRATES +=	anstyle-parse	0.2.5	# MIT OR Apache-2.0
MODCARGO_CRATES +=	anstyle-query	1.1.1	# MIT OR Apache-2.0
MODCARGO_CRATES +=	anstyle-wincon	3.0.4	# MIT OR Apache-2.0
MODCARGO_CRATES +=	approx	0.5.1	# Apache-2.0
MODCARGO_CRATES +=	arbitrary	1.3.2	# MIT OR Apache-2.0
MODCARGO_CRATES +=	arrayref	0.3.9	# BSD-2-Clause
MODCARGO_CRATES +=	arrayvec	0.7.6	# MIT OR Apache-2.0
MODCARGO_CRATES +=	autocfg	1.4.0	# Apache-2.0 OR MIT
MODCARGO_CRATES +=	az	1.2.1	# MIT/Apache-2.0
MODCARGO_CRATES +=	base64	0.22.1	# MIT OR Apache-2.0
MODCARGO_CRATES +=	biblatex	0.10.0	# MIT OR Apache-2.0
MODCARGO_CRATES +=	bincode	1.3.3	# MIT
MODCARGO_CRATES +=	bit-set	0.5.3	# MIT/Apache-2.0
MODCARGO_CRATES +=	bit-vec	0.6.3	# MIT/Apache-2.0
MODCARGO_CRATES +=	bitflags	1.3.2	# MIT/Apache-2.0
MODCARGO_CRATES +=	bitflags	2.6.0	# MIT OR Apache-2.0
MODCARGO_CRATES +=	bitvec	1.0.1	# MIT
MODCARGO_CRATES +=	bumpalo	3.16.0	# MIT OR Apache-2.0
MODCARGO_CRATES +=	by_address	1.2.1	# MIT OR Apache-2.0
MODCARGO_CRATES +=	bytemuck	1.18.0	# Zlib OR Apache-2.0 OR MIT
MODCARGO_CRATES +=	byteorder	1.5.0	# Unlicense OR MIT
MODCARGO_CRATES +=	byteorder-lite	0.1.0	# Unlicense OR MIT
MODCARGO_CRATES +=	cc	1.1.24	# MIT OR Apache-2.0
MODCARGO_CRATES +=	cfg-if	1.0.0	# MIT/Apache-2.0
MODCARGO_CRATES +=	chinese-number	0.7.7	# MIT
MODCARGO_CRATES +=	chinese-variant	1.1.3	# MIT
MODCARGO_CRATES +=	chrono	0.4.38	# MIT OR Apache-2.0
MODCARGO_CRATES +=	ciborium	0.2.2	# Apache-2.0
MODCARGO_CRATES +=	ciborium-io	0.2.2	# Apache-2.0
MODCARGO_CRATES +=	ciborium-ll	0.2.2	# Apache-2.0
MODCARGO_CRATES +=	citationberg	0.4.0	# MIT OR Apache-2.0
MODCARGO_CRATES +=	clap	4.5.19	# MIT OR Apache-2.0
MODCARGO_CRATES +=	clap_builder	4.5.19	# MIT OR Apache-2.0
MODCARGO_CRATES +=	clap_complete	4.5.32	# MIT OR Apache-2.0
MODCARGO_CRATES +=	clap_derive	4.5.18	# MIT OR Apache-2.0
MODCARGO_CRATES +=	clap_lex	0.7.2	# MIT OR Apache-2.0
MODCARGO_CRATES +=	clap_mangen	0.2.23	# MIT OR Apache-2.0
MODCARGO_CRATES +=	cobs	0.2.3	# MIT OR Apache-2.0
MODCARGO_CRATES +=	codespan-reporting	0.11.1	# Apache-2.0
MODCARGO_CRATES +=	color-print	0.3.6	# MIT OR Apache-2.0
MODCARGO_CRATES +=	color-print-proc-macro	0.3.6	# MIT OR Apache-2.0
MODCARGO_CRATES +=	color_quant	1.1.0	# MIT
MODCARGO_CRATES +=	colorchoice	1.0.2	# MIT OR Apache-2.0
MODCARGO_CRATES +=	comemo	0.4.0	# MIT OR Apache-2.0
MODCARGO_CRATES +=	comemo-macros	0.4.0	# MIT OR Apache-2.0
MODCARGO_CRATES +=	core-foundation	0.9.4	# MIT OR Apache-2.0
MODCARGO_CRATES +=	core-foundation-sys	0.8.7	# MIT OR Apache-2.0
MODCARGO_CRATES +=	core_maths	0.1.0	# MIT
MODCARGO_CRATES +=	crc32fast	1.4.2	# MIT OR Apache-2.0
MODCARGO_CRATES +=	crossbeam-channel	0.5.13	# MIT OR Apache-2.0
MODCARGO_CRATES +=	crossbeam-deque	0.8.5	# MIT OR Apache-2.0
MODCARGO_CRATES +=	crossbeam-epoch	0.9.18	# MIT OR Apache-2.0
MODCARGO_CRATES +=	crossbeam-utils	0.8.20	# MIT OR Apache-2.0
MODCARGO_CRATES +=	crunchy	0.2.2	# MIT
MODCARGO_CRATES +=	csv	1.3.0	# Unlicense/MIT
MODCARGO_CRATES +=	csv-core	0.1.11	# Unlicense/MIT
MODCARGO_CRATES +=	data-url	0.3.1	# MIT OR Apache-2.0
MODCARGO_CRATES +=	deranged	0.3.11	# MIT OR Apache-2.0
MODCARGO_CRATES +=	derive_arbitrary	1.3.2	# MIT/Apache-2.0
MODCARGO_CRATES +=	dirs	5.0.1	# MIT OR Apache-2.0
MODCARGO_CRATES +=	dirs-sys	0.4.1	# MIT OR Apache-2.0
MODCARGO_CRATES +=	displaydoc	0.2.5	# MIT OR Apache-2.0
MODCARGO_CRATES +=	downcast-rs	1.2.1	# MIT/Apache-2.0
MODCARGO_CRATES +=	ecow	0.2.2	# MIT OR Apache-2.0
MODCARGO_CRATES +=	either	1.13.0	# MIT OR Apache-2.0
MODCARGO_CRATES +=	embedded-io	0.4.0	# MIT OR Apache-2.0
MODCARGO_CRATES +=	embedded-io	0.6.1	# MIT OR Apache-2.0
MODCARGO_CRATES +=	enum-ordinalize	4.3.0	# MIT
MODCARGO_CRATES +=	enum-ordinalize-derive	4.3.1	# MIT
MODCARGO_CRATES +=	env_proxy	0.4.1	# MIT OR Apache-2.0
MODCARGO_CRATES +=	equivalent	1.0.1	# Apache-2.0 OR MIT
MODCARGO_CRATES +=	errno	0.3.9	# MIT OR Apache-2.0
MODCARGO_CRATES +=	fancy-regex	0.11.0	# MIT
MODCARGO_CRATES +=	fast-srgb8	1.0.0	# MIT OR Apache-2.0 OR CC0-1.0
MODCARGO_CRATES +=	fastrand	2.1.1	# Apache-2.0 OR MIT
MODCARGO_CRATES +=	fdeflate	0.3.5	# MIT OR Apache-2.0
MODCARGO_CRATES +=	filetime	0.2.25	# MIT/Apache-2.0
MODCARGO_CRATES +=	flate2	1.0.34	# MIT OR Apache-2.0
MODCARGO_CRATES +=	float-cmp	0.9.0	# MIT
MODCARGO_CRATES +=	fnv	1.0.7	# Apache-2.0 / MIT
MODCARGO_CRATES +=	fontconfig-parser	0.5.7	# MIT
MODCARGO_CRATES +=	fontdb	0.21.0	# MIT
MODCARGO_CRATES +=	foreign-types	0.3.2	# MIT/Apache-2.0
MODCARGO_CRATES +=	foreign-types-shared	0.1.1	# MIT/Apache-2.0
MODCARGO_CRATES +=	form_urlencoded	1.2.1	# MIT OR Apache-2.0
MODCARGO_CRATES +=	fs_extra	1.3.0	# MIT
MODCARGO_CRATES +=	fsevent-sys	4.1.0	# MIT
MODCARGO_CRATES +=	funty	2.0.0	# MIT
MODCARGO_CRATES +=	getopts	0.2.21	# MIT/Apache-2.0
MODCARGO_CRATES +=	getrandom	0.2.15	# MIT OR Apache-2.0
MODCARGO_CRATES +=	gif	0.13.1	# MIT/Apache-2.0
MODCARGO_CRATES +=	half	2.4.1	# MIT OR Apache-2.0
MODCARGO_CRATES +=	hashbrown	0.12.3	# MIT OR Apache-2.0
MODCARGO_CRATES +=	hashbrown	0.14.5	# MIT OR Apache-2.0
MODCARGO_CRATES +=	hashbrown	0.15.0	# MIT OR Apache-2.0
MODCARGO_CRATES +=	hayagriva	0.8.0	# MIT OR Apache-2.0
MODCARGO_CRATES +=	heck	0.5.0	# MIT OR Apache-2.0
MODCARGO_CRATES +=	hypher	0.1.5	# MIT OR Apache-2.0
MODCARGO_CRATES +=	iana-time-zone	0.1.61	# MIT OR Apache-2.0
MODCARGO_CRATES +=	iana-time-zone-haiku	0.1.2	# MIT OR Apache-2.0
MODCARGO_CRATES +=	icu_collections	1.5.0	# Unicode-3.0
MODCARGO_CRATES +=	icu_locid	1.5.0	# Unicode-3.0
MODCARGO_CRATES +=	icu_locid_transform	1.5.0	# Unicode-3.0
MODCARGO_CRATES +=	icu_locid_transform_data	1.5.0	# Unicode-3.0
MODCARGO_CRATES +=	icu_properties	1.5.1	# Unicode-3.0
MODCARGO_CRATES +=	icu_properties_data	1.5.0	# Unicode-3.0
MODCARGO_CRATES +=	icu_provider	1.5.0	# Unicode-3.0
MODCARGO_CRATES +=	icu_provider_adapters	1.5.0	# Unicode-3.0
MODCARGO_CRATES +=	icu_provider_blob	1.5.0	# Unicode-3.0
MODCARGO_CRATES +=	icu_provider_macros	1.5.0	# Unicode-3.0
MODCARGO_CRATES +=	icu_segmenter	1.5.0	# Unicode-3.0
MODCARGO_CRATES +=	icu_segmenter_data	1.5.0	# Unicode-3.0
MODCARGO_CRATES +=	idna	0.5.0	# MIT OR Apache-2.0
MODCARGO_CRATES +=	if_chain	1.0.2	# MIT/Apache-2.0
MODCARGO_CRATES +=	image	0.25.2	# MIT OR Apache-2.0
MODCARGO_CRATES +=	image-webp	0.1.3	# MIT OR Apache-2.0
MODCARGO_CRATES +=	imagesize	0.13.0	# MIT
MODCARGO_CRATES +=	indexmap	1.9.3	# Apache-2.0 OR MIT
MODCARGO_CRATES +=	indexmap	2.6.0	# Apache-2.0 OR MIT
MODCARGO_CRATES +=	indexmap-nostd	0.4.0	# Apache-2.0
MODCARGO_CRATES +=	inotify	0.9.6	# ISC
MODCARGO_CRATES +=	inotify-sys	0.1.5	# ISC
MODCARGO_CRATES +=	is-docker	0.2.0	# MIT
MODCARGO_CRATES +=	is-wsl	0.4.0	# MIT
MODCARGO_CRATES +=	is_terminal_polyfill	1.70.1	# MIT OR Apache-2.0
MODCARGO_CRATES +=	itoa	1.0.11	# MIT OR Apache-2.0
MODCARGO_CRATES +=	jobserver	0.1.32	# MIT OR Apache-2.0
MODCARGO_CRATES +=	js-sys	0.3.70	# MIT OR Apache-2.0
MODCARGO_CRATES +=	kamadak-exif	0.5.5	# BSD-2-Clause
MODCARGO_CRATES +=	kqueue	1.0.8	# MIT
MODCARGO_CRATES +=	kqueue-sys	1.0.4	# MIT
MODCARGO_CRATES +=	kurbo	0.11.1	# MIT OR Apache-2.0
MODCARGO_CRATES +=	libc	0.2.159	# MIT OR Apache-2.0
MODCARGO_CRATES +=	libdeflate-sys	1.21.0	# Apache-2.0
MODCARGO_CRATES +=	libdeflater	1.21.0	# Apache-2.0
MODCARGO_CRATES +=	libfuzzer-sys	0.4.7	# MIT/Apache-2.0/NCSA
MODCARGO_CRATES +=	libm	0.2.8	# MIT OR Apache-2.0
MODCARGO_CRATES +=	libredox	0.1.3	# MIT
MODCARGO_CRATES +=	linked-hash-map	0.5.6	# MIT/Apache-2.0
MODCARGO_CRATES +=	linux-raw-sys	0.4.14	# Apache-2.0 WITH LLVM-exception OR Apache-2.0 OR MIT
MODCARGO_CRATES +=	lipsum	0.9.1	# MIT
MODCARGO_CRATES +=	litemap	0.7.3	# Unicode-3.0
MODCARGO_CRATES +=	lock_api	0.4.12	# MIT OR Apache-2.0
MODCARGO_CRATES +=	lockfree-object-pool	0.1.6	# BSL-1.0
MODCARGO_CRATES +=	log	0.4.22	# MIT OR Apache-2.0
MODCARGO_CRATES +=	lzma-sys	0.1.20	# MIT/Apache-2.0
MODCARGO_CRATES +=	memchr	2.7.4	# Unlicense OR MIT
MODCARGO_CRATES +=	memmap2	0.9.5	# MIT OR Apache-2.0
MODCARGO_CRATES +=	minimal-lexical	0.2.1	# MIT/Apache-2.0
MODCARGO_CRATES +=	miniz_oxide	0.8.0	# MIT OR Zlib OR Apache-2.0
MODCARGO_CRATES +=	mio	0.8.11	# MIT
MODCARGO_CRATES +=	multi-stash	0.2.0	# MIT/Apache-2.0
MODCARGO_CRATES +=	mutate_once	0.1.1	# BSD-2-Clause
MODCARGO_CRATES +=	native-tls	0.2.12	# MIT OR Apache-2.0
MODCARGO_CRATES +=	nom	7.1.3	# MIT
MODCARGO_CRATES +=	notify	6.1.1	# CC0-1.0
MODCARGO_CRATES +=	num-bigint	0.4.6	# MIT OR Apache-2.0
MODCARGO_CRATES +=	num-conv	0.1.0	# MIT OR Apache-2.0
MODCARGO_CRATES +=	num-derive	0.4.2	# MIT OR Apache-2.0
MODCARGO_CRATES +=	num-integer	0.1.46	# MIT OR Apache-2.0
MODCARGO_CRATES +=	num-traits	0.2.19	# MIT OR Apache-2.0
MODCARGO_CRATES +=	numerals	0.1.4	# MIT
MODCARGO_CRATES +=	once_cell	1.20.1	# MIT OR Apache-2.0
MODCARGO_CRATES +=	open	5.3.0	# MIT
MODCARGO_CRATES +=	openssl	0.10.66	# Apache-2.0
MODCARGO_CRATES +=	openssl-macros	0.1.1	# MIT/Apache-2.0
MODCARGO_CRATES +=	openssl-probe	0.1.5	# MIT/Apache-2.0
MODCARGO_CRATES +=	openssl-src	300.3.2+3.3.2	# MIT/Apache-2.0
MODCARGO_CRATES +=	openssl-sys	0.9.103	# MIT
MODCARGO_CRATES +=	option-ext	0.2.0	# MPL-2.0
MODCARGO_CRATES +=	oxipng	9.1.2	# MIT
MODCARGO_CRATES +=	palette	0.7.6	# MIT OR Apache-2.0
MODCARGO_CRATES +=	palette_derive	0.7.6	# MIT OR Apache-2.0
MODCARGO_CRATES +=	parking_lot	0.12.3	# MIT OR Apache-2.0
MODCARGO_CRATES +=	parking_lot_core	0.9.10	# MIT OR Apache-2.0
MODCARGO_CRATES +=	paste	1.0.15	# MIT OR Apache-2.0
MODCARGO_CRATES +=	pathdiff	0.2.1	# MIT/Apache-2.0
MODCARGO_CRATES +=	pdf-writer	0.12.0	# MIT OR Apache-2.0
MODCARGO_CRATES +=	percent-encoding	2.3.1	# MIT OR Apache-2.0
MODCARGO_CRATES +=	phf	0.11.2	# MIT
MODCARGO_CRATES +=	phf_generator	0.11.2	# MIT
MODCARGO_CRATES +=	phf_macros	0.11.2	# MIT
MODCARGO_CRATES +=	phf_shared	0.11.2	# MIT
MODCARGO_CRATES +=	pico-args	0.5.0	# MIT
MODCARGO_CRATES +=	pixglyph	0.5.1	# Apache-2.0
MODCARGO_CRATES +=	pkg-config	0.3.31	# MIT OR Apache-2.0
MODCARGO_CRATES +=	plist	1.7.0	# MIT
MODCARGO_CRATES +=	png	0.17.14	# MIT OR Apache-2.0
MODCARGO_CRATES +=	portable-atomic	1.9.0	# Apache-2.0 OR MIT
MODCARGO_CRATES +=	postcard	1.0.10	# MIT OR Apache-2.0
MODCARGO_CRATES +=	powerfmt	0.2.0	# MIT OR Apache-2.0
MODCARGO_CRATES +=	ppv-lite86	0.2.20	# MIT/Apache-2.0
MODCARGO_CRATES +=	proc-macro2	1.0.86	# MIT OR Apache-2.0
MODCARGO_CRATES +=	psm	0.1.23	# MIT OR Apache-2.0
MODCARGO_CRATES +=	pulldown-cmark	0.9.6	# MIT
MODCARGO_CRATES +=	qcms	0.3.0	# MIT
MODCARGO_CRATES +=	quick-error	2.0.1	# MIT/Apache-2.0
MODCARGO_CRATES +=	quick-xml	0.32.0	# MIT
MODCARGO_CRATES +=	quick-xml	0.36.2	# MIT
MODCARGO_CRATES +=	quote	1.0.37	# MIT OR Apache-2.0
MODCARGO_CRATES +=	radium	0.7.0	# MIT
MODCARGO_CRATES +=	rand	0.8.5	# MIT OR Apache-2.0
MODCARGO_CRATES +=	rand_chacha	0.3.1	# MIT OR Apache-2.0
MODCARGO_CRATES +=	rand_core	0.6.4	# MIT OR Apache-2.0
MODCARGO_CRATES +=	rayon	1.10.0	# MIT OR Apache-2.0
MODCARGO_CRATES +=	rayon-core	1.12.1	# MIT OR Apache-2.0
MODCARGO_CRATES +=	redox_syscall	0.5.7	# MIT
MODCARGO_CRATES +=	redox_users	0.4.6	# MIT
MODCARGO_CRATES +=	regex	1.11.0	# MIT OR Apache-2.0
MODCARGO_CRATES +=	regex-automata	0.4.8	# MIT OR Apache-2.0
MODCARGO_CRATES +=	regex-syntax	0.8.5	# MIT OR Apache-2.0
MODCARGO_CRATES +=	resvg	0.43.0	# MPL-2.0
MODCARGO_CRATES +=	rgb	0.8.50	# MIT
MODCARGO_CRATES +=	roff	0.2.2	# MIT OR Apache-2.0
MODCARGO_CRATES +=	roxmltree	0.20.0	# MIT OR Apache-2.0
MODCARGO_CRATES +=	rust_decimal	1.36.0	# MIT
MODCARGO_CRATES +=	rustc-hash	1.1.0	# Apache-2.0/MIT
MODCARGO_CRATES +=	rustc_version	0.4.1	# MIT OR Apache-2.0
MODCARGO_CRATES +=	rustix	0.38.37	# Apache-2.0 WITH LLVM-exception OR Apache-2.0 OR MIT
MODCARGO_CRATES +=	rustversion	1.0.17	# MIT OR Apache-2.0
MODCARGO_CRATES +=	rustybuzz	0.18.0	# MIT
MODCARGO_CRATES +=	ryu	1.0.18	# Apache-2.0 OR BSL-1.0
MODCARGO_CRATES +=	same-file	1.0.6	# Unlicense/MIT
MODCARGO_CRATES +=	schannel	0.1.24	# MIT
MODCARGO_CRATES +=	scopeguard	1.2.0	# MIT OR Apache-2.0
MODCARGO_CRATES +=	security-framework	2.11.1	# MIT OR Apache-2.0
MODCARGO_CRATES +=	security-framework-sys	2.12.0	# MIT OR Apache-2.0
MODCARGO_CRATES +=	self-replace	1.5.0	# Apache-2.0
MODCARGO_CRATES +=	semver	1.0.23	# MIT OR Apache-2.0
MODCARGO_CRATES +=	serde	1.0.210	# MIT OR Apache-2.0
MODCARGO_CRATES +=	serde_derive	1.0.210	# MIT OR Apache-2.0
MODCARGO_CRATES +=	serde_json	1.0.128	# MIT OR Apache-2.0
MODCARGO_CRATES +=	serde_spanned	0.6.8	# MIT OR Apache-2.0
MODCARGO_CRATES +=	serde_yaml	0.8.26	# MIT OR Apache-2.0
MODCARGO_CRATES +=	serde_yaml	0.9.34+deprecated	# MIT OR Apache-2.0
MODCARGO_CRATES +=	shell-escape	0.1.5	# MIT/Apache-2.0
MODCARGO_CRATES +=	shlex	1.3.0	# MIT OR Apache-2.0
MODCARGO_CRATES +=	simd-adler32	0.3.7	# MIT
MODCARGO_CRATES +=	simplecss	0.2.1	# MIT/Apache-2.0
MODCARGO_CRATES +=	siphasher	0.3.11	# MIT/Apache-2.0
MODCARGO_CRATES +=	siphasher	1.0.1	# MIT/Apache-2.0
MODCARGO_CRATES +=	slotmap	1.0.7	# Zlib
MODCARGO_CRATES +=	smallvec	1.13.2	# MIT OR Apache-2.0
MODCARGO_CRATES +=	spin	0.9.8	# MIT
MODCARGO_CRATES +=	stable_deref_trait	1.2.0	# MIT/Apache-2.0
MODCARGO_CRATES +=	stacker	0.1.17	# MIT OR Apache-2.0
MODCARGO_CRATES +=	strict-num	0.1.1	# MIT
MODCARGO_CRATES +=	string-interner	0.17.0	# MIT/Apache-2.0
MODCARGO_CRATES +=	strsim	0.11.1	# MIT
MODCARGO_CRATES +=	strum	0.26.3	# MIT
MODCARGO_CRATES +=	strum_macros	0.26.4	# MIT
MODCARGO_CRATES +=	subsetter	0.2.0	# MIT OR Apache-2.0
MODCARGO_CRATES +=	svg2pdf	0.12.0	# MIT OR Apache-2.0
MODCARGO_CRATES +=	svgtypes	0.15.2	# MIT/Apache-2.0
MODCARGO_CRATES +=	syn	2.0.79	# MIT OR Apache-2.0
MODCARGO_CRATES +=	synstructure	0.13.1	# MIT
MODCARGO_CRATES +=	syntect	5.2.0	# MIT
MODCARGO_CRATES +=	tap	1.0.1	# MIT
MODCARGO_CRATES +=	tar	0.4.42	# MIT OR Apache-2.0
MODCARGO_CRATES +=	tempfile	3.13.0	# MIT OR Apache-2.0
MODCARGO_CRATES +=	termcolor	1.4.1	# Unlicense OR MIT
MODCARGO_CRATES +=	terminal_size	0.4.0	# MIT OR Apache-2.0
MODCARGO_CRATES +=	thin-vec	0.2.13	# MIT/Apache-2.0
MODCARGO_CRATES +=	thiserror	1.0.64	# MIT OR Apache-2.0
MODCARGO_CRATES +=	thiserror-impl	1.0.64	# MIT OR Apache-2.0
MODCARGO_CRATES +=	time	0.3.36	# MIT OR Apache-2.0
MODCARGO_CRATES +=	time-core	0.1.2	# MIT OR Apache-2.0
MODCARGO_CRATES +=	time-macros	0.2.18	# MIT OR Apache-2.0
MODCARGO_CRATES +=	tiny-skia	0.11.4	# BSD-3-Clause
MODCARGO_CRATES +=	tiny-skia-path	0.11.4	# BSD-3-Clause
MODCARGO_CRATES +=	tinystr	0.7.6	# Unicode-3.0
MODCARGO_CRATES +=	tinyvec	1.8.0	# Zlib OR Apache-2.0 OR MIT
MODCARGO_CRATES +=	tinyvec_macros	0.1.1	# MIT OR Apache-2.0 OR Zlib
MODCARGO_CRATES +=	toml	0.8.19	# MIT OR Apache-2.0
MODCARGO_CRATES +=	toml_datetime	0.6.8	# MIT OR Apache-2.0
MODCARGO_CRATES +=	toml_edit	0.22.22	# MIT OR Apache-2.0
MODCARGO_CRATES +=	ttf-parser	0.24.1	# MIT OR Apache-2.0
MODCARGO_CRATES +=	two-face	0.4.0	# MIT OR Apache-2.0
MODCARGO_CRATES +=	typed-arena	2.0.2	# MIT
MODCARGO_CRATES +=	typst-assets	0.12.0	# Apache-2.0
MODCARGO_CRATES +=	unic-langid	0.9.5	# MIT OR Apache-2.0
MODCARGO_CRATES +=	unic-langid-impl	0.9.5	# MIT OR Apache-2.0
MODCARGO_CRATES +=	unicase	2.7.0	# MIT/Apache-2.0
MODCARGO_CRATES +=	unicode-bidi	0.3.17	# MIT OR Apache-2.0
MODCARGO_CRATES +=	unicode-bidi-mirroring	0.3.0	# MIT/Apache-2.0
MODCARGO_CRATES +=	unicode-ccc	0.3.0	# MIT/Apache-2.0
MODCARGO_CRATES +=	unicode-ident	1.0.13	# (MIT OR Apache-2.0) AND Unicode-DFS-2016
MODCARGO_CRATES +=	unicode-math-class	0.1.0	# MIT OR Apache-2.0
MODCARGO_CRATES +=	unicode-normalization	0.1.24	# MIT/Apache-2.0
MODCARGO_CRATES +=	unicode-properties	0.1.3	# MIT/Apache-2.0
MODCARGO_CRATES +=	unicode-script	0.5.7	# MIT OR Apache-2.0
MODCARGO_CRATES +=	unicode-segmentation	1.12.0	# MIT OR Apache-2.0
MODCARGO_CRATES +=	unicode-vo	0.1.0	# MIT/Apache-2.0
MODCARGO_CRATES +=	unicode-width	0.1.14	# MIT OR Apache-2.0
MODCARGO_CRATES +=	unsafe-libyaml	0.2.11	# MIT
MODCARGO_CRATES +=	unscanny	0.1.0	# MIT OR Apache-2.0
MODCARGO_CRATES +=	ureq	2.10.1	# MIT OR Apache-2.0
MODCARGO_CRATES +=	url	2.5.2	# MIT OR Apache-2.0
MODCARGO_CRATES +=	usvg	0.43.0	# MPL-2.0
MODCARGO_CRATES +=	utf8_iter	1.0.4	# Apache-2.0 OR MIT
MODCARGO_CRATES +=	utf8parse	0.2.2	# Apache-2.0 OR MIT
MODCARGO_CRATES +=	vcpkg	0.2.15	# MIT/Apache-2.0
MODCARGO_CRATES +=	version_check	0.9.5	# MIT/Apache-2.0
MODCARGO_CRATES +=	walkdir	2.5.0	# Unlicense/MIT
MODCARGO_CRATES +=	wasi	0.11.0+wasi-snapshot-preview1	# Apache-2.0 WITH LLVM-exception OR Apache-2.0 OR MIT
MODCARGO_CRATES +=	wasm-bindgen	0.2.93	# MIT OR Apache-2.0
MODCARGO_CRATES +=	wasm-bindgen-backend	0.2.93	# MIT OR Apache-2.0
MODCARGO_CRATES +=	wasm-bindgen-macro	0.2.93	# MIT OR Apache-2.0
MODCARGO_CRATES +=	wasm-bindgen-macro-support	0.2.93	# MIT OR Apache-2.0
MODCARGO_CRATES +=	wasm-bindgen-shared	0.2.93	# MIT OR Apache-2.0
MODCARGO_CRATES +=	wasmi	0.35.0	# MIT/Apache-2.0
MODCARGO_CRATES +=	wasmi_collections	0.35.0	# MIT/Apache-2.0
MODCARGO_CRATES +=	wasmi_core	0.35.0	# MIT/Apache-2.0
MODCARGO_CRATES +=	wasmparser-nostd	0.100.2	# Apache-2.0 WITH LLVM-exception
MODCARGO_CRATES +=	weezl	0.1.8	# MIT OR Apache-2.0
MODCARGO_CRATES +=	winapi-util	0.1.9	# Unlicense OR MIT
MODCARGO_CRATES +=	windows-core	0.52.0	# MIT OR Apache-2.0
MODCARGO_CRATES +=	windows-sys	0.48.0	# MIT OR Apache-2.0
MODCARGO_CRATES +=	windows-sys	0.52.0	# MIT OR Apache-2.0
MODCARGO_CRATES +=	windows-sys	0.59.0	# MIT OR Apache-2.0
MODCARGO_CRATES +=	windows-targets	0.48.5	# MIT OR Apache-2.0
MODCARGO_CRATES +=	windows-targets	0.52.6	# MIT OR Apache-2.0
MODCARGO_CRATES +=	windows_aarch64_gnullvm	0.48.5	# MIT OR Apache-2.0
MODCARGO_CRATES +=	windows_aarch64_gnullvm	0.52.6	# MIT OR Apache-2.0
MODCARGO_CRATES +=	windows_aarch64_msvc	0.48.5	# MIT OR Apache-2.0
MODCARGO_CRATES +=	windows_aarch64_msvc	0.52.6	# MIT OR Apache-2.0
MODCARGO_CRATES +=	windows_i686_gnu	0.48.5	# MIT OR Apache-2.0
MODCARGO_CRATES +=	windows_i686_gnu	0.52.6	# MIT OR Apache-2.0
MODCARGO_CRATES +=	windows_i686_gnullvm	0.52.6	# MIT OR Apache-2.0
MODCARGO_CRATES +=	windows_i686_msvc	0.48.5	# MIT OR Apache-2.0
MODCARGO_CRATES +=	windows_i686_msvc	0.52.6	# MIT OR Apache-2.0
MODCARGO_CRATES +=	windows_x86_64_gnu	0.48.5	# MIT OR Apache-2.0
MODCARGO_CRATES +=	windows_x86_64_gnu	0.52.6	# MIT OR Apache-2.0
MODCARGO_CRATES +=	windows_x86_64_gnullvm	0.48.5	# MIT OR Apache-2.0
MODCARGO_CRATES +=	windows_x86_64_gnullvm	0.52.6	# MIT OR Apache-2.0
MODCARGO_CRATES +=	windows_x86_64_msvc	0.48.5	# MIT OR Apache-2.0
MODCARGO_CRATES +=	windows_x86_64_msvc	0.52.6	# MIT OR Apache-2.0
MODCARGO_CRATES +=	winnow	0.6.20	# MIT
MODCARGO_CRATES +=	writeable	0.5.5	# Unicode-3.0
MODCARGO_CRATES +=	wyz	0.5.1	# MIT
MODCARGO_CRATES +=	xattr	1.3.1	# MIT/Apache-2.0
MODCARGO_CRATES +=	xmlparser	0.13.6	# MIT/Apache-2.0
MODCARGO_CRATES +=	xmlwriter	0.1.0	# MIT
MODCARGO_CRATES +=	xmp-writer	0.3.0	# MIT OR Apache-2.0
MODCARGO_CRATES +=	xz2	0.1.7	# MIT/Apache-2.0
MODCARGO_CRATES +=	yaml-front-matter	0.1.0	# MIT OR Apache-2.0
MODCARGO_CRATES +=	yaml-rust	0.4.5	# MIT/Apache-2.0
MODCARGO_CRATES +=	yoke	0.7.4	# Unicode-3.0
MODCARGO_CRATES +=	yoke-derive	0.7.4	# Unicode-3.0
MODCARGO_CRATES +=	zerocopy	0.7.35	# BSD-2-Clause OR Apache-2.0 OR MIT
MODCARGO_CRATES +=	zerocopy-derive	0.7.35	# BSD-2-Clause OR Apache-2.0 OR MIT
MODCARGO_CRATES +=	zerofrom	0.1.4	# Unicode-3.0
MODCARGO_CRATES +=	zerofrom-derive	0.1.4	# Unicode-3.0
MODCARGO_CRATES +=	zerotrie	0.1.3	# Unicode-3.0
MODCARGO_CRATES +=	zerovec	0.10.4	# Unicode-3.0
MODCARGO_CRATES +=	zerovec-derive	0.10.3	# Unicode-3.0
MODCARGO_CRATES +=	zip	2.2.0	# MIT
MODCARGO_CRATES +=	zopfli	0.8.1	# Apache-2.0
MODCARGO_CRATES +=	zune-core	0.4.12	# MIT OR Apache-2.0 OR Zlib
MODCARGO_CRATES +=	zune-jpeg	0.4.13	# MIT OR Apache-2.0 OR Zlib
