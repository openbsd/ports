MODCARGO_CRATES +=	ansi_term	0.11.0	# MIT
MODCARGO_CRATES +=	atty	0.2.14	# MIT
MODCARGO_CRATES +=	bitflags	1.3.2	# MIT/Apache-2.0
MODCARGO_CRATES +=	byteorder	1.4.3	# Unlicense OR MIT
MODCARGO_CRATES +=	cfg-if	1.0.0	# MIT/Apache-2.0
MODCARGO_CRATES +=	clap	2.33.3	# MIT
MODCARGO_CRATES +=	convert_case	0.4.0	# MIT
MODCARGO_CRATES +=	cssparser	0.27.2	# MPL-2.0
MODCARGO_CRATES +=	cssparser-macros	0.6.0	# MPL-2.0
MODCARGO_CRATES +=	derive_more	0.99.16	# MIT
MODCARGO_CRATES +=	dtoa	0.4.8	# MIT OR Apache-2.0
MODCARGO_CRATES +=	dtoa-short	0.3.3	# MPL-2.0
MODCARGO_CRATES +=	form_urlencoded	1.0.1	# MIT/Apache-2.0
MODCARGO_CRATES +=	futf	0.1.4	# MIT / Apache-2.0
MODCARGO_CRATES +=	fxhash	0.2.1	# Apache-2.0/MIT
MODCARGO_CRATES +=	getrandom	0.1.16	# MIT OR Apache-2.0
MODCARGO_CRATES +=	hermit-abi	0.1.19	# MIT/Apache-2.0
MODCARGO_CRATES +=	html5ever	0.25.1	# MIT / Apache-2.0
MODCARGO_CRATES +=	idna	0.2.3	# MIT/Apache-2.0
MODCARGO_CRATES +=	itoa	0.4.8	# MIT OR Apache-2.0
MODCARGO_CRATES +=	kuchiki	0.8.1	# MIT
MODCARGO_CRATES +=	lazy_static	1.4.0	# MIT/Apache-2.0
MODCARGO_CRATES +=	libc	0.2.144	# MIT OR Apache-2.0
MODCARGO_CRATES +=	log	0.4.14	# MIT OR Apache-2.0
MODCARGO_CRATES +=	mac	0.1.1	# MIT/Apache-2.0
MODCARGO_CRATES +=	markup5ever	0.10.1	# MIT / Apache-2.0
MODCARGO_CRATES +=	matches	0.1.9	# MIT
MODCARGO_CRATES +=	new_debug_unreachable	1.0.4	# MIT
MODCARGO_CRATES +=	nodrop	0.1.14	# MIT/Apache-2.0
MODCARGO_CRATES +=	percent-encoding	2.1.0	# MIT/Apache-2.0
MODCARGO_CRATES +=	pest	2.1.3	# MIT/Apache-2.0
MODCARGO_CRATES +=	phf	0.8.0	# MIT
MODCARGO_CRATES +=	phf_codegen	0.8.0	# MIT
MODCARGO_CRATES +=	phf_generator	0.8.0	# MIT
MODCARGO_CRATES +=	phf_macros	0.8.0	# MIT
MODCARGO_CRATES +=	phf_shared	0.8.0	# MIT
MODCARGO_CRATES +=	ppv-lite86	0.2.10	# MIT/Apache-2.0
MODCARGO_CRATES +=	precomputed-hash	0.1.1	# MIT
MODCARGO_CRATES +=	proc-macro-hack	0.5.19	# MIT OR Apache-2.0
MODCARGO_CRATES +=	proc-macro2	1.0.29	# MIT OR Apache-2.0
MODCARGO_CRATES +=	quote	1.0.9	# MIT OR Apache-2.0
MODCARGO_CRATES +=	rand	0.7.3	# MIT OR Apache-2.0
MODCARGO_CRATES +=	rand_chacha	0.2.2	# MIT OR Apache-2.0
MODCARGO_CRATES +=	rand_core	0.5.1	# MIT OR Apache-2.0
MODCARGO_CRATES +=	rand_hc	0.2.0	# MIT/Apache-2.0
MODCARGO_CRATES +=	rand_pcg	0.2.1	# MIT OR Apache-2.0
MODCARGO_CRATES +=	rustc_version	0.3.3	# MIT/Apache-2.0
MODCARGO_CRATES +=	selectors	0.22.0	# MPL-2.0
MODCARGO_CRATES +=	semver	0.11.0	# MIT/Apache-2.0
MODCARGO_CRATES +=	semver-parser	0.10.2	# MIT/Apache-2.0
MODCARGO_CRATES +=	serde	1.0.130	# MIT OR Apache-2.0
MODCARGO_CRATES +=	servo_arc	0.1.1	# MIT/Apache-2.0
MODCARGO_CRATES +=	siphasher	0.3.7	# MIT/Apache-2.0
MODCARGO_CRATES +=	smallvec	1.6.1	# MIT/Apache-2.0
MODCARGO_CRATES +=	stable_deref_trait	1.2.0	# MIT/Apache-2.0
MODCARGO_CRATES +=	string_cache	0.8.1	# MIT / Apache-2.0
MODCARGO_CRATES +=	string_cache_codegen	0.5.1	# MIT / Apache-2.0
MODCARGO_CRATES +=	strsim	0.8.0	# MIT
MODCARGO_CRATES +=	syn	1.0.76	# MIT OR Apache-2.0
MODCARGO_CRATES +=	tendril	0.4.2	# MIT/Apache-2.0
MODCARGO_CRATES +=	textwrap	0.11.0	# MIT
MODCARGO_CRATES +=	thin-slice	0.1.1	# MPL-2.0
MODCARGO_CRATES +=	tinyvec	1.3.1	# Zlib OR Apache-2.0 OR MIT
MODCARGO_CRATES +=	tinyvec_macros	0.1.0	# MIT OR Apache-2.0 OR Zlib
MODCARGO_CRATES +=	ucd-trie	0.1.3	# MIT/Apache-2.0
MODCARGO_CRATES +=	unicode-bidi	0.3.6	# MIT / Apache-2.0
MODCARGO_CRATES +=	unicode-normalization	0.1.19	# MIT/Apache-2.0
MODCARGO_CRATES +=	unicode-width	0.1.8	# MIT/Apache-2.0
MODCARGO_CRATES +=	unicode-xid	0.2.2	# MIT OR Apache-2.0
MODCARGO_CRATES +=	url	2.2.2	# MIT/Apache-2.0
MODCARGO_CRATES +=	utf-8	0.7.6	# MIT OR Apache-2.0
MODCARGO_CRATES +=	vec_map	0.8.2	# MIT/Apache-2.0
MODCARGO_CRATES +=	wasi	0.9.0+wasi-snapshot-preview1	# Apache-2.0 WITH LLVM-exception OR Apache-2.0 OR MIT
MODCARGO_CRATES +=	winapi	0.3.9	# MIT/Apache-2.0
MODCARGO_CRATES +=	winapi-i686-pc-windows-gnu	0.4.0	# MIT/Apache-2.0
MODCARGO_CRATES +=	winapi-x86_64-pc-windows-gnu	0.4.0	# MIT/Apache-2.0
