===>  Generating configure for jless-0.8.0
===>  Configuring for jless-0.8.0
MODCARGO_CRATES +=	aho-corasick	0.7.18	# Unlicense/MIT
MODCARGO_CRATES +=	atty	0.2.14	# MIT
MODCARGO_CRATES +=	autocfg	1.0.1	# Apache-2.0 OR MIT
MODCARGO_CRATES +=	beef	0.5.1	# MIT OR Apache-2.0
MODCARGO_CRATES +=	bitflags	1.2.1	# MIT/Apache-2.0
MODCARGO_CRATES +=	block	0.1.6	# MIT
MODCARGO_CRATES +=	cc	1.0.69	# MIT/Apache-2.0
MODCARGO_CRATES +=	cfg-if	0.1.10	# MIT/Apache-2.0
MODCARGO_CRATES +=	cfg-if	1.0.0	# MIT/Apache-2.0
MODCARGO_CRATES +=	clap	3.0.14	# MIT OR Apache-2.0
MODCARGO_CRATES +=	clap_derive	3.0.14	# MIT OR Apache-2.0
MODCARGO_CRATES +=	clipboard	0.5.0	# MIT / Apache-2.0
MODCARGO_CRATES +=	clipboard-win	2.2.0	# MIT
MODCARGO_CRATES +=	clipboard-win	4.2.1	# BSL-1.0
MODCARGO_CRATES +=	dirs-next	2.0.0	# MIT OR Apache-2.0
MODCARGO_CRATES +=	dirs-sys-next	0.1.2	# MIT OR Apache-2.0
MODCARGO_CRATES +=	endian-type	0.1.2	# MIT
MODCARGO_CRATES +=	error-code	2.3.0	# BSL-1.0
MODCARGO_CRATES +=	fd-lock	3.0.0	# MIT OR Apache-2.0
MODCARGO_CRATES +=	fnv	1.0.7	# Apache-2.0 / MIT
MODCARGO_CRATES +=	getrandom	0.2.3	# MIT OR Apache-2.0
MODCARGO_CRATES +=	hashbrown	0.11.2	# Apache-2.0/MIT
MODCARGO_CRATES +=	heck	0.4.0	# MIT OR Apache-2.0
MODCARGO_CRATES +=	hermit-abi	0.1.18	# MIT/Apache-2.0
MODCARGO_CRATES +=	indexmap	1.8.0	# Apache-2.0/MIT
MODCARGO_CRATES +=	indoc	1.0.4	# MIT OR Apache-2.0
MODCARGO_CRATES +=	isatty	0.1.9	# MIT/Apache-2.0
MODCARGO_CRATES +=	lazy_static	1.4.0	# MIT/Apache-2.0
MODCARGO_CRATES +=	libc	0.2.99	# MIT OR Apache-2.0
MODCARGO_CRATES +=	libc-stdhandle	0.1.0	# MIT/Apache-2.0
MODCARGO_CRATES +=	linked-hash-map	0.5.4	# MIT/Apache-2.0
MODCARGO_CRATES +=	log	0.4.14	# MIT OR Apache-2.0
MODCARGO_CRATES +=	logos	0.12.0	# MIT OR Apache-2.0
MODCARGO_CRATES +=	logos-derive	0.12.0	# MIT OR Apache-2.0
MODCARGO_CRATES +=	malloc_buf	0.0.6	# MIT
MODCARGO_CRATES +=	memchr	2.4.1	# Unlicense/MIT
MODCARGO_CRATES +=	memoffset	0.6.4	# MIT
MODCARGO_CRATES +=	nibble_vec	0.1.0	# MIT
MODCARGO_CRATES +=	nix	0.22.1	# MIT
MODCARGO_CRATES +=	numtoa	0.1.0	# MIT OR Apache-2.0
MODCARGO_CRATES +=	objc	0.2.7	# MIT
MODCARGO_CRATES +=	objc-foundation	0.1.1	# MIT
MODCARGO_CRATES +=	objc_id	0.1.1	# MIT
MODCARGO_CRATES +=	os_str_bytes	6.0.0	# MIT OR Apache-2.0
MODCARGO_CRATES +=	proc-macro-error	1.0.4	# MIT OR Apache-2.0
MODCARGO_CRATES +=	proc-macro-error-attr	1.0.4	# MIT OR Apache-2.0
MODCARGO_CRATES +=	proc-macro2	1.0.36	# MIT OR Apache-2.0
MODCARGO_CRATES +=	quote	1.0.9	# MIT OR Apache-2.0
MODCARGO_CRATES +=	radix_trie	0.2.1	# MIT
MODCARGO_CRATES +=	redox_syscall	0.1.57	# MIT
MODCARGO_CRATES +=	redox_syscall	0.2.6	# MIT
MODCARGO_CRATES +=	redox_termios	0.1.2	# MIT
MODCARGO_CRATES +=	redox_users	0.4.0	# MIT
MODCARGO_CRATES +=	regex	1.5.5	# MIT OR Apache-2.0
MODCARGO_CRATES +=	regex-syntax	0.6.25	# MIT/Apache-2.0
MODCARGO_CRATES +=	rustyline	9.0.0	# MIT
MODCARGO_CRATES +=	scopeguard	1.1.0	# MIT/Apache-2.0
MODCARGO_CRATES +=	signal-hook	0.3.8	# Apache-2.0/MIT
MODCARGO_CRATES +=	signal-hook-registry	1.3.0	# Apache-2.0/MIT
MODCARGO_CRATES +=	smallvec	1.6.1	# MIT/Apache-2.0
MODCARGO_CRATES +=	str-buf	1.0.5	# BSL-1.0
MODCARGO_CRATES +=	strsim	0.10.0	# MIT
MODCARGO_CRATES +=	syn	1.0.86	# MIT OR Apache-2.0
MODCARGO_CRATES +=	termcolor	1.1.2	# Unlicense OR MIT
MODCARGO_CRATES +=	termion	1.5.6	# MIT
MODCARGO_CRATES +=	textwrap	0.14.2	# MIT
MODCARGO_CRATES +=	unicode-segmentation	1.7.1	# MIT/Apache-2.0
MODCARGO_CRATES +=	unicode-width	0.1.8	# MIT/Apache-2.0
MODCARGO_CRATES +=	unicode-xid	0.2.1	# MIT OR Apache-2.0
MODCARGO_CRATES +=	unindent	0.1.8	# MIT OR Apache-2.0
MODCARGO_CRATES +=	utf8-ranges	1.0.4	# Unlicense/MIT
MODCARGO_CRATES +=	utf8parse	0.2.0	# Apache-2.0 OR MIT
MODCARGO_CRATES +=	version_check	0.9.3	# MIT/Apache-2.0
MODCARGO_CRATES +=	wasi	0.10.2+wasi-snapshot-preview1	# Apache-2.0 WITH LLVM-exception OR Apache-2.0 OR MIT
MODCARGO_CRATES +=	winapi	0.3.9	# MIT/Apache-2.0
MODCARGO_CRATES +=	winapi-i686-pc-windows-gnu	0.4.0	# MIT/Apache-2.0
MODCARGO_CRATES +=	winapi-util	0.1.5	# Unlicense/MIT
MODCARGO_CRATES +=	winapi-x86_64-pc-windows-gnu	0.4.0	# MIT/Apache-2.0
MODCARGO_CRATES +=	x11-clipboard	0.3.3	# MIT
MODCARGO_CRATES +=	xcb	0.8.2	# MIT
MODCARGO_CRATES +=	yaml-rust	0.4.5	# MIT/Apache-2.0
