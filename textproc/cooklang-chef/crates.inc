MODCARGO_CRATES +=	adler32	1.2.0	# Zlib
MODCARGO_CRATES +=	aho-corasick	1.1.4	# Unlicense OR MIT
MODCARGO_CRATES +=	allocator-api2	0.2.21	# MIT OR Apache-2.0
MODCARGO_CRATES +=	ansi-to-html	0.2.2	# MIT
MODCARGO_CRATES +=	anstream	0.6.21	# MIT OR Apache-2.0
MODCARGO_CRATES +=	anstyle	1.0.13	# MIT OR Apache-2.0
MODCARGO_CRATES +=	anstyle-parse	0.2.7	# MIT OR Apache-2.0
MODCARGO_CRATES +=	anstyle-query	1.1.5	# MIT OR Apache-2.0
MODCARGO_CRATES +=	anstyle-wincon	3.0.11	# MIT OR Apache-2.0
MODCARGO_CRATES +=	anstyle-yansi	2.0.3	# MIT OR Apache-2.0
MODCARGO_CRATES +=	anyhow	1.0.100	# MIT OR Apache-2.0
MODCARGO_CRATES +=	arrayvec	0.5.2	# MIT/Apache-2.0
MODCARGO_CRATES +=	atomic-waker	1.1.2	# Apache-2.0 OR MIT
MODCARGO_CRATES +=	axum	0.8.7	# MIT
MODCARGO_CRATES +=	axum-core	0.5.5	# MIT
MODCARGO_CRATES +=	bitflags	1.3.2	# MIT/Apache-2.0
MODCARGO_CRATES +=	bitflags	2.10.0	# MIT OR Apache-2.0
MODCARGO_CRATES +=	block-buffer	0.10.4	# MIT OR Apache-2.0
MODCARGO_CRATES +=	bstr	1.12.1	# MIT OR Apache-2.0
MODCARGO_CRATES +=	byteorder	1.5.0	# Unlicense OR MIT
MODCARGO_CRATES +=	bytes	1.11.0	# MIT
MODCARGO_CRATES +=	camino	1.2.1	# MIT OR Apache-2.0
MODCARGO_CRATES +=	cc	1.2.48	# MIT OR Apache-2.0
MODCARGO_CRATES +=	cfg-if	1.0.4	# MIT OR Apache-2.0
MODCARGO_CRATES +=	clap	4.5.53	# MIT OR Apache-2.0
MODCARGO_CRATES +=	clap_builder	4.5.53	# MIT OR Apache-2.0
MODCARGO_CRATES +=	clap_complete	4.5.61	# MIT OR Apache-2.0
MODCARGO_CRATES +=	clap_derive	4.5.49	# MIT OR Apache-2.0
MODCARGO_CRATES +=	clap_lex	0.7.6	# MIT OR Apache-2.0
MODCARGO_CRATES +=	codesnake	0.2.1	# MIT
MODCARGO_CRATES +=	colorchoice	1.0.4	# MIT OR Apache-2.0
MODCARGO_CRATES +=	colorchoice-clap	1.0.7	# MIT OR Apache-2.0
MODCARGO_CRATES +=	cooklang	0.15.0	# MIT
MODCARGO_CRATES +=	core2	0.4.0	# Apache-2.0 OR MIT
MODCARGO_CRATES +=	cpufeatures	0.2.17	# MIT OR Apache-2.0
MODCARGO_CRATES +=	crc32fast	1.5.0	# MIT OR Apache-2.0
MODCARGO_CRATES +=	crossterm	0.25.0	# MIT
MODCARGO_CRATES +=	crossterm_winapi	0.9.1	# MIT
MODCARGO_CRATES +=	crypto-common	0.1.7	# MIT OR Apache-2.0
MODCARGO_CRATES +=	dary_heap	0.3.8	# MIT OR Apache-2.0
MODCARGO_CRATES +=	digest	0.10.7	# MIT OR Apache-2.0
MODCARGO_CRATES +=	directories	6.0.0	# MIT OR Apache-2.0
MODCARGO_CRATES +=	dirs-sys	0.5.0	# MIT OR Apache-2.0
MODCARGO_CRATES +=	dyn-clone	1.0.20	# MIT OR Apache-2.0
MODCARGO_CRATES +=	emojis	0.8.0	# MIT OR Apache-2.0
MODCARGO_CRATES +=	enum-map	2.7.3	# MIT OR Apache-2.0
MODCARGO_CRATES +=	enum-map-derive	0.17.0	# MIT OR Apache-2.0
MODCARGO_CRATES +=	equivalent	1.0.2	# Apache-2.0 OR MIT
MODCARGO_CRATES +=	errno	0.3.14	# MIT OR Apache-2.0
MODCARGO_CRATES +=	find-msvc-tools	0.1.5	# MIT OR Apache-2.0
MODCARGO_CRATES +=	finl_unicode	1.4.0	# (MIT OR Apache-2.0) AND Unicode-DFS-2016
MODCARGO_CRATES +=	foldhash	0.2.0	# Zlib
MODCARGO_CRATES +=	form_urlencoded	1.2.2	# MIT OR Apache-2.0
MODCARGO_CRATES +=	fsevent-sys	4.1.0	# MIT
MODCARGO_CRATES +=	futures	0.3.31	# MIT OR Apache-2.0
MODCARGO_CRATES +=	futures-channel	0.3.31	# MIT OR Apache-2.0
MODCARGO_CRATES +=	futures-core	0.3.31	# MIT OR Apache-2.0
MODCARGO_CRATES +=	futures-executor	0.3.31	# MIT OR Apache-2.0
MODCARGO_CRATES +=	futures-io	0.3.31	# MIT OR Apache-2.0
MODCARGO_CRATES +=	futures-macro	0.3.31	# MIT OR Apache-2.0
MODCARGO_CRATES +=	futures-sink	0.3.31	# MIT OR Apache-2.0
MODCARGO_CRATES +=	futures-task	0.3.31	# MIT OR Apache-2.0
MODCARGO_CRATES +=	futures-util	0.3.31	# MIT OR Apache-2.0
MODCARGO_CRATES +=	fuzzy-matcher	0.3.7	# MIT
MODCARGO_CRATES +=	fxhash	0.2.1	# Apache-2.0/MIT
MODCARGO_CRATES +=	generic-array	0.14.7	# MIT
MODCARGO_CRATES +=	getrandom	0.2.16	# MIT OR Apache-2.0
MODCARGO_CRATES +=	getrandom	0.3.4	# MIT OR Apache-2.0
MODCARGO_CRATES +=	globset	0.4.18	# Unlicense OR MIT
MODCARGO_CRATES +=	hashbrown	0.16.1	# MIT OR Apache-2.0
MODCARGO_CRATES +=	heck	0.5.0	# MIT OR Apache-2.0
MODCARGO_CRATES +=	http	1.4.0	# MIT OR Apache-2.0
MODCARGO_CRATES +=	http-body	1.0.1	# MIT
MODCARGO_CRATES +=	http-body-util	0.1.3	# MIT
MODCARGO_CRATES +=	http-range-header	0.4.2	# MIT
MODCARGO_CRATES +=	httparse	1.10.1	# MIT OR Apache-2.0
MODCARGO_CRATES +=	httpdate	1.0.3	# MIT OR Apache-2.0
MODCARGO_CRATES +=	humantime	2.3.0	# MIT OR Apache-2.0
MODCARGO_CRATES +=	hyper	1.8.1	# MIT
MODCARGO_CRATES +=	hyper-util	0.1.18	# MIT
MODCARGO_CRATES +=	include-flate	0.3.1	# Apache-2.0
MODCARGO_CRATES +=	include-flate-codegen	0.3.1	# Apache-2.0
MODCARGO_CRATES +=	include-flate-compress	0.3.1	# Apache-2.0
MODCARGO_CRATES +=	indexmap	2.12.1	# Apache-2.0 OR MIT
MODCARGO_CRATES +=	inotify	0.11.0	# ISC
MODCARGO_CRATES +=	inotify-sys	0.1.5	# ISC
MODCARGO_CRATES +=	inquire	0.7.5	# MIT
MODCARGO_CRATES +=	is-docker	0.2.0	# MIT
MODCARGO_CRATES +=	is-wsl	0.4.0	# MIT
MODCARGO_CRATES +=	is_terminal_polyfill	1.70.2	# MIT OR Apache-2.0
MODCARGO_CRATES +=	itoa	1.0.15	# MIT OR Apache-2.0
MODCARGO_CRATES +=	jobserver	0.1.34	# MIT OR Apache-2.0
MODCARGO_CRATES +=	kqueue	1.1.1	# MIT
MODCARGO_CRATES +=	kqueue-sys	1.0.4	# MIT
MODCARGO_CRATES +=	lazy_static	1.5.0	# MIT OR Apache-2.0
MODCARGO_CRATES +=	libc	0.2.177	# MIT OR Apache-2.0
MODCARGO_CRATES +=	libflate	2.2.1	# MIT
MODCARGO_CRATES +=	libflate_lz77	2.2.0	# MIT
MODCARGO_CRATES +=	libredox	0.1.10	# MIT
MODCARGO_CRATES +=	linux-raw-sys	0.11.0	# Apache-2.0 WITH LLVM-exception OR Apache-2.0 OR MIT
MODCARGO_CRATES +=	lock_api	0.4.14	# MIT OR Apache-2.0
MODCARGO_CRATES +=	log	0.4.28	# MIT OR Apache-2.0
MODCARGO_CRATES +=	matchit	0.8.4	# MIT AND BSD-3-Clause
MODCARGO_CRATES +=	memchr	2.7.6	# Unlicense OR MIT
MODCARGO_CRATES +=	memo-map	0.3.3	# Apache-2.0
MODCARGO_CRATES +=	mime	0.3.17	# MIT OR Apache-2.0
MODCARGO_CRATES +=	mime_guess	2.0.5	# MIT
MODCARGO_CRATES +=	minijinja	2.13.0	# Apache-2.0
MODCARGO_CRATES +=	mio	0.8.11	# MIT
MODCARGO_CRATES +=	mio	1.1.0	# MIT
MODCARGO_CRATES +=	newline-converter	0.3.0	# MIT
MODCARGO_CRATES +=	notify	8.2.0	# CC0-1.0
MODCARGO_CRATES +=	notify-types	2.0.0	# MIT OR Apache-2.0
MODCARGO_CRATES +=	nu-ansi-term	0.50.3	# MIT
MODCARGO_CRATES +=	once_cell	1.21.3	# MIT OR Apache-2.0
MODCARGO_CRATES +=	once_cell_polyfill	1.70.2	# MIT OR Apache-2.0
MODCARGO_CRATES +=	open	5.3.3	# MIT
MODCARGO_CRATES +=	option-ext	0.2.0	# MPL-2.0
MODCARGO_CRATES +=	parking_lot	0.12.5	# MIT OR Apache-2.0
MODCARGO_CRATES +=	parking_lot_core	0.9.12	# MIT OR Apache-2.0
MODCARGO_CRATES +=	pathdiff	0.2.3	# MIT/Apache-2.0
MODCARGO_CRATES +=	percent-encoding	2.3.2	# MIT OR Apache-2.0
MODCARGO_CRATES +=	phf	0.13.1	# MIT
MODCARGO_CRATES +=	phf_shared	0.13.1	# MIT
MODCARGO_CRATES +=	pin-project-lite	0.2.16	# Apache-2.0 OR MIT
MODCARGO_CRATES +=	pin-utils	0.1.0	# MIT OR Apache-2.0
MODCARGO_CRATES +=	pkg-config	0.3.32	# MIT OR Apache-2.0
MODCARGO_CRATES +=	prettyplease	0.2.37	# MIT OR Apache-2.0
MODCARGO_CRATES +=	proc-macro-error	1.0.4	# MIT OR Apache-2.0
MODCARGO_CRATES +=	proc-macro-error-attr	1.0.4	# MIT OR Apache-2.0
MODCARGO_CRATES +=	proc-macro2	1.0.103	# MIT OR Apache-2.0
MODCARGO_CRATES +=	quote	1.0.42	# MIT OR Apache-2.0
MODCARGO_CRATES +=	r-efi	5.3.0	# MIT OR Apache-2.0 OR LGPL-2.1-or-later
MODCARGO_CRATES +=	redox_syscall	0.5.18	# MIT
MODCARGO_CRATES +=	redox_users	0.5.2	# MIT
MODCARGO_CRATES +=	regex	1.12.2	# MIT OR Apache-2.0
MODCARGO_CRATES +=	regex-automata	0.4.13	# MIT OR Apache-2.0
MODCARGO_CRATES +=	regex-syntax	0.8.8	# MIT OR Apache-2.0
MODCARGO_CRATES +=	rle-decode-fast	1.0.3	# MIT OR Apache-2.0
MODCARGO_CRATES +=	rust-embed	8.9.0	# MIT
MODCARGO_CRATES +=	rust-embed-impl	8.9.0	# MIT
MODCARGO_CRATES +=	rust-embed-utils	8.9.0	# MIT
MODCARGO_CRATES +=	rustix	1.1.2	# Apache-2.0 WITH LLVM-exception OR Apache-2.0 OR MIT
MODCARGO_CRATES +=	rustversion	1.0.22	# MIT OR Apache-2.0
MODCARGO_CRATES +=	ryu	1.0.20	# Apache-2.0 OR BSL-1.0
MODCARGO_CRATES +=	same-file	1.0.6	# Unlicense/MIT
MODCARGO_CRATES +=	scopeguard	1.2.0	# MIT OR Apache-2.0
MODCARGO_CRATES +=	self_cell	1.2.1	# Apache-2.0 OR GPL-2.0-only
MODCARGO_CRATES +=	serde	1.0.228	# MIT OR Apache-2.0
MODCARGO_CRATES +=	serde_core	1.0.228	# MIT OR Apache-2.0
MODCARGO_CRATES +=	serde_derive	1.0.228	# MIT OR Apache-2.0
MODCARGO_CRATES +=	serde_json	1.0.145	# MIT OR Apache-2.0
MODCARGO_CRATES +=	serde_path_to_error	0.1.20	# MIT OR Apache-2.0
MODCARGO_CRATES +=	serde_spanned	0.6.9	# MIT OR Apache-2.0
MODCARGO_CRATES +=	serde_spanned	1.0.3	# MIT OR Apache-2.0
MODCARGO_CRATES +=	serde_urlencoded	0.7.1	# MIT/Apache-2.0
MODCARGO_CRATES +=	serde_yaml	0.9.34+deprecated	# MIT OR Apache-2.0
MODCARGO_CRATES +=	sha2	0.10.9	# MIT OR Apache-2.0
MODCARGO_CRATES +=	sharded-slab	0.1.7	# MIT
MODCARGO_CRATES +=	shell-words	1.1.0	# MIT/Apache-2.0
MODCARGO_CRATES +=	shlex	1.3.0	# MIT OR Apache-2.0
MODCARGO_CRATES +=	signal-hook	0.3.18	# Apache-2.0/MIT
MODCARGO_CRATES +=	signal-hook-mio	0.2.5	# MIT OR Apache-2.0
MODCARGO_CRATES +=	signal-hook-registry	1.4.7	# MIT OR Apache-2.0
MODCARGO_CRATES +=	siphasher	1.0.1	# MIT/Apache-2.0
MODCARGO_CRATES +=	slab	0.4.11	# MIT
MODCARGO_CRATES +=	smallvec	1.15.1	# MIT OR Apache-2.0
MODCARGO_CRATES +=	smawk	0.3.2	# MIT
MODCARGO_CRATES +=	socket2	0.6.1	# MIT OR Apache-2.0
MODCARGO_CRATES +=	strip-ansi-escapes	0.1.1	# Apache-2.0/MIT
MODCARGO_CRATES +=	strsim	0.11.1	# MIT
MODCARGO_CRATES +=	strum	0.26.3	# MIT
MODCARGO_CRATES +=	strum_macros	0.26.4	# MIT
MODCARGO_CRATES +=	syn	1.0.109	# MIT OR Apache-2.0
MODCARGO_CRATES +=	syn	2.0.111	# MIT OR Apache-2.0
MODCARGO_CRATES +=	sync_wrapper	1.0.2	# Apache-2.0
MODCARGO_CRATES +=	tabular	0.2.0	# MIT OR Apache-2.0
MODCARGO_CRATES +=	terminal_size	0.4.3	# MIT OR Apache-2.0
MODCARGO_CRATES +=	textwrap	0.16.2	# MIT
MODCARGO_CRATES +=	thiserror	1.0.69	# MIT OR Apache-2.0
MODCARGO_CRATES +=	thiserror	2.0.17	# MIT OR Apache-2.0
MODCARGO_CRATES +=	thiserror-impl	1.0.69	# MIT OR Apache-2.0
MODCARGO_CRATES +=	thiserror-impl	2.0.17	# MIT OR Apache-2.0
MODCARGO_CRATES +=	thread_local	1.1.9	# MIT OR Apache-2.0
MODCARGO_CRATES +=	tokio	1.48.0	# MIT
MODCARGO_CRATES +=	tokio-macros	2.6.0	# MIT
MODCARGO_CRATES +=	tokio-stream	0.1.17	# MIT
MODCARGO_CRATES +=	tokio-util	0.7.17	# MIT
MODCARGO_CRATES +=	toml	0.8.23	# MIT OR Apache-2.0
MODCARGO_CRATES +=	toml	0.9.8	# MIT OR Apache-2.0
MODCARGO_CRATES +=	toml_datetime	0.6.11	# MIT OR Apache-2.0
MODCARGO_CRATES +=	toml_datetime	0.7.3	# MIT OR Apache-2.0
MODCARGO_CRATES +=	toml_edit	0.22.27	# MIT OR Apache-2.0
MODCARGO_CRATES +=	toml_parser	1.0.4	# MIT OR Apache-2.0
MODCARGO_CRATES +=	toml_write	0.1.2	# MIT OR Apache-2.0
MODCARGO_CRATES +=	toml_writer	1.0.4	# MIT OR Apache-2.0
MODCARGO_CRATES +=	tower	0.5.2	# MIT
MODCARGO_CRATES +=	tower-http	0.6.7	# MIT
MODCARGO_CRATES +=	tower-layer	0.3.3	# MIT
MODCARGO_CRATES +=	tower-service	0.3.3	# MIT
MODCARGO_CRATES +=	tracing	0.1.43	# MIT
MODCARGO_CRATES +=	tracing-attributes	0.1.31	# MIT
MODCARGO_CRATES +=	tracing-core	0.1.35	# MIT
MODCARGO_CRATES +=	tracing-log	0.2.0	# MIT
MODCARGO_CRATES +=	tracing-subscriber	0.3.22	# MIT
MODCARGO_CRATES +=	typenum	1.19.0	# MIT OR Apache-2.0
MODCARGO_CRATES +=	unicase	2.8.1	# MIT OR Apache-2.0
MODCARGO_CRATES +=	unicode-ident	1.0.22	# (MIT OR Apache-2.0) AND Unicode-3.0
MODCARGO_CRATES +=	unicode-linebreak	0.1.5	# Apache-2.0
MODCARGO_CRATES +=	unicode-segmentation	1.12.0	# MIT OR Apache-2.0
MODCARGO_CRATES +=	unicode-width	0.1.14	# MIT OR Apache-2.0
MODCARGO_CRATES +=	unicode-width	0.2.2	# MIT OR Apache-2.0
MODCARGO_CRATES +=	unsafe-libyaml	0.2.11	# MIT
MODCARGO_CRATES +=	utf8parse	0.2.2	# Apache-2.0 OR MIT
MODCARGO_CRATES +=	valuable	0.1.1	# MIT
MODCARGO_CRATES +=	version_check	0.9.5	# MIT/Apache-2.0
MODCARGO_CRATES +=	vte	0.10.1	# Apache-2.0 OR MIT
MODCARGO_CRATES +=	vte_generate_state_changes	0.1.2	# Apache-2.0 OR MIT
MODCARGO_CRATES +=	walkdir	2.5.0	# Unlicense/MIT
MODCARGO_CRATES +=	wasi	0.11.1+wasi-snapshot-preview1	# Apache-2.0 WITH LLVM-exception OR Apache-2.0 OR MIT
MODCARGO_CRATES +=	wasip2	1.0.1+wasi-0.2.4	# Apache-2.0 WITH LLVM-exception OR Apache-2.0 OR MIT
MODCARGO_CRATES +=	winapi	0.3.9	# MIT/Apache-2.0
MODCARGO_CRATES +=	winapi-i686-pc-windows-gnu	0.4.0	# MIT/Apache-2.0
MODCARGO_CRATES +=	winapi-util	0.1.11	# Unlicense OR MIT
MODCARGO_CRATES +=	winapi-x86_64-pc-windows-gnu	0.4.0	# MIT/Apache-2.0
MODCARGO_CRATES +=	windows-link	0.2.1	# MIT OR Apache-2.0
MODCARGO_CRATES +=	windows-sys	0.48.0	# MIT OR Apache-2.0
MODCARGO_CRATES +=	windows-sys	0.60.2	# MIT OR Apache-2.0
MODCARGO_CRATES +=	windows-sys	0.61.2	# MIT OR Apache-2.0
MODCARGO_CRATES +=	windows-targets	0.48.5	# MIT OR Apache-2.0
MODCARGO_CRATES +=	windows-targets	0.53.5	# MIT OR Apache-2.0
MODCARGO_CRATES +=	windows_aarch64_gnullvm	0.48.5	# MIT OR Apache-2.0
MODCARGO_CRATES +=	windows_aarch64_gnullvm	0.53.1	# MIT OR Apache-2.0
MODCARGO_CRATES +=	windows_aarch64_msvc	0.48.5	# MIT OR Apache-2.0
MODCARGO_CRATES +=	windows_aarch64_msvc	0.53.1	# MIT OR Apache-2.0
MODCARGO_CRATES +=	windows_i686_gnu	0.48.5	# MIT OR Apache-2.0
MODCARGO_CRATES +=	windows_i686_gnu	0.53.1	# MIT OR Apache-2.0
MODCARGO_CRATES +=	windows_i686_gnullvm	0.53.1	# MIT OR Apache-2.0
MODCARGO_CRATES +=	windows_i686_msvc	0.48.5	# MIT OR Apache-2.0
MODCARGO_CRATES +=	windows_i686_msvc	0.53.1	# MIT OR Apache-2.0
MODCARGO_CRATES +=	windows_x86_64_gnu	0.48.5	# MIT OR Apache-2.0
MODCARGO_CRATES +=	windows_x86_64_gnu	0.53.1	# MIT OR Apache-2.0
MODCARGO_CRATES +=	windows_x86_64_gnullvm	0.48.5	# MIT OR Apache-2.0
MODCARGO_CRATES +=	windows_x86_64_gnullvm	0.53.1	# MIT OR Apache-2.0
MODCARGO_CRATES +=	windows_x86_64_msvc	0.48.5	# MIT OR Apache-2.0
MODCARGO_CRATES +=	windows_x86_64_msvc	0.53.1	# MIT OR Apache-2.0
MODCARGO_CRATES +=	winnow	0.7.14	# MIT
MODCARGO_CRATES +=	wit-bindgen	0.46.0	# Apache-2.0 WITH LLVM-exception OR Apache-2.0 OR MIT
MODCARGO_CRATES +=	yansi	1.0.1	# MIT OR Apache-2.0
MODCARGO_CRATES +=	zstd	0.13.3	# MIT
MODCARGO_CRATES +=	zstd-safe	7.2.4	# MIT OR Apache-2.0
MODCARGO_CRATES +=	zstd-sys	2.0.16+zstd.1.5.7	# MIT/Apache-2.0
