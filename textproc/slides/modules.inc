MODGO_MODULES =	\
	github.com/!microsoft/go-winio		 v0.4.16 \
	github.com/!proton!mail/go-crypto	 v0.0.0-20210428141323-04723f9f07d7 \
	github.com/acomagu/bufpipe		 v1.0.3 \
	github.com/alecthomas/chroma		 v0.10.0 \
	github.com/anmitsu/go-shlex		 v0.0.0-20200514113438-38f4b401e2be \
	github.com/atotto/clipboard		 v0.1.4 \
	github.com/aymanbagabas/go-osc52	 v1.0.3 \
	github.com/aymerick/douceur		 v0.2.0 \
	github.com/caarlos0/sshmarshal		 v0.1.0 \
	github.com/charmbracelet/bubbles	 v0.14.0 \
	github.com/charmbracelet/bubbletea	 v0.21.1-0.20220623121936-ca32c4c62873 \
	github.com/charmbracelet/glamour	 v0.5.0 \
	github.com/charmbracelet/harmonica	 v0.2.0 \
	github.com/charmbracelet/keygen		 v0.3.0 \
	github.com/charmbracelet/lipgloss	 v0.5.1-0.20220407020210-a86f21a0ae43 \
	github.com/charmbracelet/wish		 v0.5.0 \
	github.com/containerd/console		 v1.0.3 \
	github.com/cpuguy83/go-md2man/v2	 v2.0.1 \
	github.com/davecgh/go-spew		 v1.1.1 \
	github.com/dlclark/regexp2		 v1.4.0 \
	github.com/emirpasic/gods		 v1.12.0 \
	github.com/gliderlabs/ssh		 v0.3.5 \
	github.com/go-git/gcfg			 v1.5.0 \
	github.com/go-git/go-billy/v5		 v5.3.1 \
	github.com/go-git/go-git/v5		 v5.4.2 \
	github.com/google/go-cmp		 v0.5.5 \
	github.com/gorilla/css			 v1.0.0 \
	github.com/hashicorp/golang-lru		 v0.5.4 \
	github.com/imdario/mergo		 v0.3.12 \
	github.com/inconshreveable/mousetrap	 v1.0.0 \
	github.com/jbenet/go-context		 v0.0.0-20150711004518-d14ea06fba99 \
	github.com/kevinburke/ssh_config	 v0.0.0-20201106050909-4977a11b4351 \
	github.com/kylelemons/godebug		 v1.1.0 \
	github.com/lucasb-eyer/go-colorful	 v1.2.0 \
	github.com/matryer/is			 v1.4.0 \
	github.com/mattn/go-isatty		 v0.0.14 \
	github.com/mattn/go-runewidth		 v0.0.13 \
	github.com/microcosm-cc/bluemonday	 v1.0.18 \
	github.com/mitchellh/go-homedir		 v1.1.0 \
	github.com/muesli/ansi			 v0.0.0-20211031195517-c9f0611b6c70 \
	github.com/muesli/cancelreader		 v0.2.1 \
	github.com/muesli/coral			 v1.0.0 \
	github.com/muesli/reflow		 v0.3.0 \
	github.com/muesli/termenv		 v0.12.1-0.20220615005108-4e9068de9898 \
	github.com/olekukonko/tablewriter	 v0.0.5 \
	github.com/pmezard/go-difflib		 v1.0.0 \
	github.com/rivo/uniseg			 v0.2.0 \
	github.com/russross/blackfriday/v2	 v2.1.0 \
	github.com/sahilm/fuzzy			 v0.1.0 \
	github.com/sergi/go-diff		 v1.1.0 \
	github.com/spf13/pflag			 v1.0.5 \
	github.com/stretchr/objx		 v0.4.0 \
	github.com/stretchr/testify		 v1.8.0 \
	github.com/xanzy/ssh-agent		 v0.3.0 \
	github.com/yuin/goldmark		 v1.4.7 \
	github.com/yuin/goldmark-emoji		 v1.0.1 \
	golang.org/x/crypto			 v0.0.0-20220826181053-bd7e27e6170d \
	golang.org/x/net			 v0.0.0-20220826154423-83b083e8dc8b \
	golang.org/x/sync			 v0.0.0-20210220032951-036812b2e83c \
	golang.org/x/sys			 v0.0.0-20220825204002-c680a09ffe64 \
	golang.org/x/term			 v0.0.0-20220722155259-a9ba230a4035 \
	golang.org/x/text			 v0.3.7 \
	golang.org/x/time			 v0.0.0-20220411224347-583f2d630306 \
	golang.org/x/tools			 v0.0.0-20180917221912-90fa682c2a6e \
	gopkg.in/check.v1			 v0.0.0-20161208181325-20d25e280405 \
	gopkg.in/warnings.v0			 v0.1.2 \
	gopkg.in/yaml.v2			 v2.4.0 \
	gopkg.in/yaml.v3			 v3.0.1

MODGO_MODFILES =	\
	github.com/caarlos0/sshmarshal		 v0.0.0-20220308164159-9ddb9f83c6b3 \
	github.com/charmbracelet/bubbletea	 v0.20.0 \
	github.com/charmbracelet/bubbletea	 v0.21.0 \
	github.com/charmbracelet/lipgloss	 v0.4.0 \
	github.com/charmbracelet/lipgloss	 v0.5.0 \
	github.com/davecgh/go-spew		 v1.1.0 \
	github.com/gliderlabs/ssh		 v0.3.4 \
	github.com/mattn/go-isatty		 v0.0.13 \
	github.com/mattn/go-runewidth		 v0.0.10 \
	github.com/mattn/go-runewidth		 v0.0.12 \
	github.com/mattn/go-runewidth		 v0.0.9 \
	github.com/microcosm-cc/bluemonday	 v1.0.17 \
	github.com/muesli/ansi			 v0.0.0-20211018074035-2e021307bc4b \
	github.com/muesli/cancelreader		 v0.2.0 \
	github.com/muesli/reflow		 v0.2.1-0.20210115123740-9e1d0d53df68 \
	github.com/muesli/termenv		 v0.11.1-0.20220204035834-5ac8409525e0 \
	github.com/muesli/termenv		 v0.11.1-0.20220212125758-44cd13922739 \
	github.com/muesli/termenv		 v0.9.0 \
	github.com/rivo/uniseg			 v0.1.0 \
	github.com/stretchr/objx		 v0.1.0 \
	github.com/stretchr/testify		 v1.7.0 \
	github.com/stretchr/testify		 v1.7.1 \
	github.com/yuin/goldmark		 v1.2.1 \
	github.com/yuin/goldmark		 v1.4.4 \
	golang.org/x/crypto			 v0.0.0-20220307211146-efcb8507fb70 \
	golang.org/x/net			 v0.0.0-20210614182718-04defd469f4e \
	golang.org/x/net			 v0.0.0-20211112202133-69e39bad7dc2 \
	golang.org/x/sys			 v0.0.0-20200116001909-b77594299b42 \
	golang.org/x/sys			 v0.0.0-20201119102817-f84b799fce68 \
	golang.org/x/sys			 v0.0.0-20210124154548-22da62e12c0c \
	golang.org/x/sys			 v0.0.0-20210423082822-04245dca01da \
	golang.org/x/sys			 v0.0.0-20210615035016-665e8c7367d1 \
	golang.org/x/sys			 v0.0.0-20210616094352-59db8d763f22 \
	golang.org/x/sys			 v0.0.0-20210630005230-0f9fa26af87c \
	golang.org/x/sys			 v0.0.0-20220204135822-1c1b9b1eba6a \
	golang.org/x/sys			 v0.0.0-20220209214540-3681064d5158 \
	golang.org/x/sys			 v0.0.0-20220728004956-3c1f35247d10 \
	golang.org/x/term			 v0.0.0-20201126162022-7de9c90e9dd1 \
	golang.org/x/term			 v0.0.0-20210422114643-f5beecf764ed \
	golang.org/x/term			 v0.0.0-20210927222741-03fcf44c2211 \
	golang.org/x/text			 v0.3.6 \
	gopkg.in/yaml.v3			 v3.0.0-20200313102051-9f266ea9e77c

