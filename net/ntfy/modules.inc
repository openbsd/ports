MODGO_MODULES =	\
	cel.dev/expr										 v0.24.0 \
	cloud.google.com/go									 v0.121.4 \
	cloud.google.com/go/accessapproval							 v1.8.7 \
	cloud.google.com/go/accesscontextmanager						 v1.9.6 \
	cloud.google.com/go/aiplatform								 v1.96.0 \
	cloud.google.com/go/analytics								 v0.29.0 \
	cloud.google.com/go/apigateway								 v1.7.7 \
	cloud.google.com/go/apigeeconnect							 v1.7.7 \
	cloud.google.com/go/apigeeregistry							 v0.9.6 \
	cloud.google.com/go/appengine								 v1.9.7 \
	cloud.google.com/go/area120								 v0.9.7 \
	cloud.google.com/go/artifactregistry							 v1.17.1 \
	cloud.google.com/go/asset								 v1.21.1 \
	cloud.google.com/go/assuredworkloads							 v1.12.6 \
	cloud.google.com/go/auth								 v0.16.3 \
	cloud.google.com/go/auth/oauth2adapt							 v0.2.8 \
	cloud.google.com/go/automl								 v1.14.7 \
	cloud.google.com/go/baremetalsolution							 v1.3.6 \
	cloud.google.com/go/batch								 v1.12.2 \
	cloud.google.com/go/beyondcorp								 v1.1.6 \
	cloud.google.com/go/bigquery								 v1.69.0 \
	cloud.google.com/go/bigtable								 v1.38.0 \
	cloud.google.com/go/billing								 v1.20.4 \
	cloud.google.com/go/binaryauthorization							 v1.9.5 \
	cloud.google.com/go/certificatemanager							 v1.9.5 \
	cloud.google.com/go/channel								 v1.20.0 \
	cloud.google.com/go/cloudbuild								 v1.22.3 \
	cloud.google.com/go/clouddms								 v1.8.7 \
	cloud.google.com/go/cloudtasks								 v1.13.6 \
	cloud.google.com/go/compute								 v1.41.0 \
	cloud.google.com/go/compute/metadata							 v0.7.0 \
	cloud.google.com/go/contactcenterinsights						 v1.17.3 \
	cloud.google.com/go/container								 v1.44.0 \
	cloud.google.com/go/containeranalysis							 v0.14.1 \
	cloud.google.com/go/datacatalog								 v1.26.0 \
	cloud.google.com/go/dataflow								 v0.11.0 \
	cloud.google.com/go/dataform								 v0.12.0 \
	cloud.google.com/go/datafusion								 v1.8.6 \
	cloud.google.com/go/datalabeling							 v0.9.6 \
	cloud.google.com/go/dataplex								 v1.26.0 \
	cloud.google.com/go/dataproc/v2								 v2.14.0 \
	cloud.google.com/go/dataqna								 v0.9.7 \
	cloud.google.com/go/datastore								 v1.20.0 \
	cloud.google.com/go/datastream								 v1.14.1 \
	cloud.google.com/go/deploy								 v1.27.2 \
	cloud.google.com/go/dialogflow								 v1.69.0 \
	cloud.google.com/go/dlp									 v1.24.0 \
	cloud.google.com/go/documentai								 v1.37.0 \
	cloud.google.com/go/domains								 v0.10.6 \
	cloud.google.com/go/edgecontainer							 v1.4.3 \
	cloud.google.com/go/errorreporting							 v0.3.2 \
	cloud.google.com/go/essentialcontacts							 v1.7.6 \
	cloud.google.com/go/eventarc								 v1.15.5 \
	cloud.google.com/go/filestore								 v1.10.2 \
	cloud.google.com/go/firestore								 v1.18.0 \
	cloud.google.com/go/functions								 v1.19.6 \
	cloud.google.com/go/gkebackup								 v1.8.0 \
	cloud.google.com/go/gkeconnect								 v0.12.4 \
	cloud.google.com/go/gkehub								 v0.15.6 \
	cloud.google.com/go/gkemulticloud							 v1.5.3 \
	cloud.google.com/go/gsuiteaddons							 v1.7.7 \
	cloud.google.com/go/iam									 v1.5.2 \
	cloud.google.com/go/iap									 v1.11.2 \
	cloud.google.com/go/ids									 v1.5.6 \
	cloud.google.com/go/iot									 v1.8.6 \
	cloud.google.com/go/kms									 v1.22.0 \
	cloud.google.com/go/language								 v1.14.5 \
	cloud.google.com/go/lifesciences							 v0.10.6 \
	cloud.google.com/go/logging								 v1.13.0 \
	cloud.google.com/go/longrunning								 v0.6.7 \
	cloud.google.com/go/managedidentities							 v1.7.6 \
	cloud.google.com/go/maps								 v1.22.0 \
	cloud.google.com/go/mediatranslation							 v0.9.6 \
	cloud.google.com/go/memcache								 v1.11.6 \
	cloud.google.com/go/metastore								 v1.14.7 \
	cloud.google.com/go/monitoring								 v1.24.2 \
	cloud.google.com/go/networkconnectivity							 v1.18.0 \
	cloud.google.com/go/networkmanagement							 v1.19.1 \
	cloud.google.com/go/networksecurity							 v0.10.6 \
	cloud.google.com/go/notebooks								 v1.12.6 \
	cloud.google.com/go/optimization							 v1.7.6 \
	cloud.google.com/go/orchestration							 v1.11.9 \
	cloud.google.com/go/orgpolicy								 v1.15.0 \
	cloud.google.com/go/osconfig								 v1.14.6 \
	cloud.google.com/go/oslogin								 v1.14.6 \
	cloud.google.com/go/phishingprotection							 v0.9.6 \
	cloud.google.com/go/policytroubleshooter						 v1.11.6 \
	cloud.google.com/go/privatecatalog							 v0.10.7 \
	cloud.google.com/go/pubsub								 v1.50.0 \
	cloud.google.com/go/pubsub/v2								 v2.0.0 \
	cloud.google.com/go/pubsublite								 v1.8.2 \
	cloud.google.com/go/recaptchaenterprise/v2						 v2.20.4 \
	cloud.google.com/go/recommendationengine						 v0.9.6 \
	cloud.google.com/go/recommender								 v1.13.5 \
	cloud.google.com/go/redis								 v1.18.2 \
	cloud.google.com/go/resourcemanager							 v1.10.6 \
	cloud.google.com/go/resourcesettings							 v1.8.3 \
	cloud.google.com/go/retail								 v1.24.0 \
	cloud.google.com/go/run									 v1.11.0 \
	cloud.google.com/go/scheduler								 v1.11.7 \
	cloud.google.com/go/secretmanager							 v1.15.0 \
	cloud.google.com/go/security								 v1.19.0 \
	cloud.google.com/go/securitycenter							 v1.37.0 \
	cloud.google.com/go/servicedirectory							 v1.12.6 \
	cloud.google.com/go/shell								 v1.8.6 \
	cloud.google.com/go/spanner								 v1.83.0 \
	cloud.google.com/go/speech								 v1.28.0 \
	cloud.google.com/go/storage								 v1.56.0 \
	cloud.google.com/go/storagetransfer							 v1.13.0 \
	cloud.google.com/go/talent								 v1.8.3 \
	cloud.google.com/go/texttospeech							 v1.13.0 \
	cloud.google.com/go/tpu									 v1.8.3 \
	cloud.google.com/go/trace								 v1.11.6 \
	cloud.google.com/go/translate								 v1.12.6 \
	cloud.google.com/go/video								 v1.25.0 \
	cloud.google.com/go/videointelligence							 v1.12.6 \
	cloud.google.com/go/vision/v2								 v2.9.5 \
	cloud.google.com/go/vmmigration								 v1.8.6 \
	cloud.google.com/go/vmwareengine							 v1.3.5 \
	cloud.google.com/go/vpcaccess								 v1.8.6 \
	cloud.google.com/go/webrisk								 v1.11.1 \
	cloud.google.com/go/websecurityscanner							 v1.7.6 \
	cloud.google.com/go/workflows								 v1.14.2 \
	firebase.google.com/go/v4								 v4.18.0 \
	github.com/!alek!si/pointer								 v1.2.0 \
	github.com/!burnt!sushi/toml								 v1.5.0 \
	github.com/!google!cloud!platform/opentelemetry-operations-go/detectors/gcp		 v1.29.0 \
	github.com/!google!cloud!platform/opentelemetry-operations-go/exporter/metric		 v0.53.0 \
	github.com/!google!cloud!platform/opentelemetry-operations-go/internal/cloudmock	 v0.53.0 \
	github.com/!google!cloud!platform/opentelemetry-operations-go/internal/resourcemapping	 v0.53.0 \
	github.com/!micah!parks/keyfunc								 v1.9.0 \
	github.com/!microsoft/go-winio								 v0.6.2 \
	github.com/!sher!clock!holmes/webpush-go						 v1.4.0 \
	github.com/alecthomas/kingpin/v2							 v2.4.0 \
	github.com/alecthomas/units								 v0.0.0-20211218093645-b94a6e3cc137 \
	github.com/aymerick/douceur								 v0.2.0 \
	github.com/beorn7/perks									 v1.0.1 \
	github.com/cespare/xxhash/v2								 v2.3.0 \
	github.com/cncf/xds/go									 v0.0.0-20250501225837-2ac532fd4443 \
	github.com/cpuguy83/go-md2man/v2							 v2.0.7 \
	github.com/davecgh/go-spew								 v1.1.2-0.20180830191138-d8f796af33cc \
	github.com/emersion/go-sasl								 v0.0.0-20241020182733-b788ff22d5a6 \
	github.com/emersion/go-smtp								 v0.17.0 \
	github.com/emersion/go-smtp								 v0.18.0 \
	github.com/envoyproxy/go-control-plane							 v0.13.4 \
	github.com/envoyproxy/go-control-plane/envoy						 v1.32.4 \
	github.com/envoyproxy/go-control-plane/ratelimit					 v0.1.0 \
	github.com/envoyproxy/protoc-gen-validate						 v1.2.1 \
	github.com/felixge/httpsnoop								 v1.0.4 \
	github.com/gabriel-vasile/mimetype							 v1.4.9 \
	github.com/go-jose/go-jose/v4								 v4.1.2 \
	github.com/go-logr/logr									 v1.4.3 \
	github.com/go-logr/stdr									 v1.2.2 \
	github.com/golang-jwt/jwt/v4								 v4.5.2 \
	github.com/golang-jwt/jwt/v5								 v5.3.0 \
	github.com/golang/glog									 v1.2.5 \
	github.com/golang/groupcache								 v0.0.0-20210331224755-41bb18bfe9da \
	github.com/golang/protobuf								 v1.5.4 \
	github.com/golang/snappy								 v0.0.4 \
	github.com/google/go-cmp								 v0.7.0 \
	github.com/google/go-pkcs11								 v0.3.0 \
	github.com/google/martian/v3								 v3.3.3 \
	github.com/google/s2a-go								 v0.1.9 \
	github.com/google/uuid									 v1.6.0 \
	github.com/googleapis/enterprise-certificate-proxy					 v0.3.6 \
	github.com/googleapis/gax-go/v2								 v2.15.0 \
	github.com/gorilla/css									 v1.0.1 \
	github.com/gorilla/websocket								 v1.5.3 \
	github.com/iancoleman/strcase								 v0.3.0 \
	github.com/jpillora/backoff								 v1.0.0 \
	github.com/json-iterator/go								 v1.1.12 \
	github.com/julienschmidt/httprouter							 v1.3.0 \
	github.com/klauspost/compress								 v1.18.0 \
	github.com/kr/pretty									 v0.3.1 \
	github.com/kr/text									 v0.2.0 \
	github.com/kylelemons/godebug								 v1.1.0 \
	github.com/lyft/protoc-gen-star/v2							 v2.0.4-0.20230330145011-496ad1ac90a4 \
	github.com/mattn/go-sqlite3								 v1.14.30 \
	github.com/microcosm-cc/bluemonday							 v1.0.27 \
	github.com/modern-go/concurrent								 v0.0.0-20180306012644-bacd9c7ef1dd \
	github.com/modern-go/reflect2								 v1.0.2 \
	github.com/munnerz/goautoneg								 v0.0.0-20191010083416-a7dc8b61c822 \
	github.com/mwitkow/go-conntrack								 v0.0.0-20190716064945-2f068394615f \
	github.com/olebedev/when								 v1.1.0 \
	github.com/pkg/errors									 v0.9.1 \
	github.com/planetscale/vtprotobuf							 v0.6.1-0.20240319094008-0393e58bdf10 \
	github.com/pmezard/go-difflib								 v1.0.1-0.20181226105442-5d4384ee4fb2 \
	github.com/prometheus/client_golang							 v1.23.0 \
	github.com/prometheus/client_model							 v0.6.2 \
	github.com/prometheus/common								 v0.65.0 \
	github.com/prometheus/procfs								 v0.17.0 \
	github.com/rogpeppe/go-internal								 v1.13.1 \
	github.com/russross/blackfriday/v2							 v2.1.0 \
	github.com/spf13/afero									 v1.10.0 \
	github.com/spiffe/go-spiffe/v2								 v2.5.0 \
	github.com/stretchr/objx								 v0.5.2 \
	github.com/stretchr/testify								 v1.10.0 \
	github.com/stripe/stripe-go/v74								 v74.30.0 \
	github.com/urfave/cli/v2								 v2.27.7 \
	github.com/xhit/go-str2duration/v2							 v2.1.0 \
	github.com/xrash/smetrics								 v0.0.0-20250705151800-55b8f293f342 \
	github.com/yuin/goldmark								 v1.4.13 \
	github.com/zeebo/errs									 v1.4.0 \
	go.opencensus.io									 v0.24.0 \
	go.opentelemetry.io/auto/sdk								 v1.1.0 \
	go.opentelemetry.io/contrib/detectors/gcp						 v1.37.0 \
	go.opentelemetry.io/contrib/instrumentation/google.golang.org/grpc/otelgrpc		 v0.62.0 \
	go.opentelemetry.io/contrib/instrumentation/net/http/otelhttp				 v0.62.0 \
	go.opentelemetry.io/otel								 v1.37.0 \
	go.opentelemetry.io/otel/exporters/stdout/stdoutmetric					 v1.36.0 \
	go.opentelemetry.io/otel/metric								 v1.37.0 \
	go.opentelemetry.io/otel/sdk								 v1.37.0 \
	go.opentelemetry.io/otel/sdk/metric							 v1.37.0 \
	go.opentelemetry.io/otel/trace								 v1.37.0 \
	go.opentelemetry.io/proto/otlp								 v1.0.0 \
	go.uber.org/goleak									 v1.3.0 \
	golang.org/x/crypto									 v0.40.0 \
	golang.org/x/mod									 v0.25.0 \
	golang.org/x/net									 v0.42.0 \
	golang.org/x/oauth2									 v0.30.0 \
	golang.org/x/sync									 v0.16.0 \
	golang.org/x/sys									 v0.34.0 \
	golang.org/x/telemetry									 v0.0.0-20240228155512-f48c80bd79b2 \
	golang.org/x/term									 v0.33.0 \
	golang.org/x/text									 v0.27.0 \
	golang.org/x/time									 v0.12.0 \
	golang.org/x/tools									 v0.34.0 \
	golang.org/x/xerrors									 v0.0.0-20191204190536-9bdfabe68543 \
	google.golang.org/api									 v0.244.0 \
	google.golang.org/appengine								 v1.6.8 \
	google.golang.org/appengine/v2								 v2.0.6 \
	google.golang.org/genproto								 v0.0.0-20250804133106-a7a43d27e69b \
	google.golang.org/genproto/googleapis/api						 v0.0.0-20250804133106-a7a43d27e69b \
	google.golang.org/genproto/googleapis/bytestream					 v0.0.0-20250728155136-f173205681a0 \
	google.golang.org/genproto/googleapis/rpc						 v0.0.0-20250804133106-a7a43d27e69b \
	google.golang.org/grpc									 v1.74.2 \
	google.golang.org/grpc/examples								 v0.0.0-20230224211313-3775f633ce20 \
	google.golang.org/protobuf								 v1.36.6 \
	gopkg.in/check.v1									 v1.0.0-20201130134442-10cb98267c6c \
	gopkg.in/yaml.v2									 v2.4.0 \
	gopkg.in/yaml.v3									 v3.0.1

MODGO_MODFILES =	\
	cel.dev/expr										 v0.15.0 \
	cel.dev/expr										 v0.19.0 \
	cel.dev/expr										 v0.23.0 \
	cel.dev/expr										 v0.23.1 \
	cloud.google.com/go									 v0.112.2 \
	cloud.google.com/go									 v0.117.0 \
	cloud.google.com/go									 v0.118.3 \
	cloud.google.com/go									 v0.120.0 \
	cloud.google.com/go									 v0.121.0 \
	cloud.google.com/go/auth								 v0.13.0 \
	cloud.google.com/go/auth								 v0.15.0 \
	cloud.google.com/go/auth								 v0.16.0 \
	cloud.google.com/go/auth								 v0.16.1 \
	cloud.google.com/go/auth								 v0.16.2 \
	cloud.google.com/go/auth								 v0.3.0 \
	cloud.google.com/go/auth/oauth2adapt							 v0.2.2 \
	cloud.google.com/go/auth/oauth2adapt							 v0.2.6 \
	cloud.google.com/go/compute/metadata							 v0.3.0 \
	cloud.google.com/go/compute/metadata							 v0.6.0 \
	cloud.google.com/go/longrunning								 v0.5.6 \
	cloud.google.com/go/longrunning								 v0.6.2 \
	cloud.google.com/go/longrunning								 v0.6.6 \
	cloud.google.com/go/storage								 v1.53.0 \
	cloud.google.com/go/storage								 v1.55.0 \
	cloud.google.com/go/translate								 v1.10.3 \
	github.com/!alek!si/pointer								 v1.0.0 \
	github.com/!google!cloud!platform/opentelemetry-operations-go/detectors/gcp		 v1.27.0 \
	github.com/!google!cloud!platform/opentelemetry-operations-go/exporter/metric		 v0.51.0 \
	github.com/!google!cloud!platform/opentelemetry-operations-go/internal/resourcemapping	 v0.51.0 \
	github.com/cncf/xds/go									 v0.0.0-20240905190251-b4127c9b8d78 \
	github.com/cncf/xds/go									 v0.0.0-20250326154945-ae57f3c0d45f \
	github.com/davecgh/go-spew								 v1.1.0 \
	github.com/davecgh/go-spew								 v1.1.1 \
	github.com/emersion/go-sasl								 v0.0.0-20200509203442-7bfe0ed36a21 \
	github.com/envoyproxy/protoc-gen-validate						 v1.0.4 \
	github.com/go-jose/go-jose/v4								 v4.0.4 \
	github.com/go-jose/go-jose/v4								 v4.0.5 \
	github.com/go-logr/logr									 v1.2.2 \
	github.com/go-logr/logr									 v1.4.1 \
	github.com/go-logr/logr									 v1.4.2 \
	github.com/golang-jwt/jwt/v4								 v4.4.2 \
	github.com/golang-jwt/jwt/v5								 v5.2.1 \
	github.com/golang/protobuf								 v1.5.0 \
	github.com/golang/protobuf								 v1.5.3 \
	github.com/google/go-cmp								 v0.5.5 \
	github.com/google/go-cmp								 v0.5.9 \
	github.com/google/go-cmp								 v0.6.0 \
	github.com/google/s2a-go								 v0.1.8 \
	github.com/googleapis/enterprise-certificate-proxy					 v0.3.2 \
	github.com/googleapis/enterprise-certificate-proxy					 v0.3.4 \
	github.com/googleapis/enterprise-certificate-proxy					 v0.3.5 \
	github.com/googleapis/gax-go/v2								 v2.12.3 \
	github.com/googleapis/gax-go/v2								 v2.14.0 \
	github.com/googleapis/gax-go/v2								 v2.14.1 \
	github.com/googleapis/gax-go/v2								 v2.14.2 \
	github.com/kr/pretty									 v0.1.0 \
	github.com/pkg/errors									 v0.8.1 \
	github.com/pmezard/go-difflib								 v1.0.0 \
	github.com/prometheus/client_golang							 v1.20.4 \
	github.com/prometheus/client_model							 v0.6.1 \
	github.com/prometheus/procfs								 v0.15.1 \
	github.com/prometheus/procfs								 v0.16.1 \
	github.com/rogpeppe/go-internal								 v1.10.0 \
	github.com/stretchr/objx								 v0.1.0 \
	github.com/stretchr/testify								 v1.3.0 \
	github.com/stretchr/testify								 v1.7.0 \
	github.com/stretchr/testify								 v1.8.4 \
	github.com/xrash/smetrics								 v0.0.0-20240521201337-686a1a2994c1 \
	go.opentelemetry.io/contrib/detectors/gcp						 v1.35.0 \
	go.opentelemetry.io/contrib/detectors/gcp						 v1.36.0 \
	go.opentelemetry.io/contrib/instrumentation/google.golang.org/grpc/otelgrpc		 v0.49.0 \
	go.opentelemetry.io/contrib/instrumentation/google.golang.org/grpc/otelgrpc		 v0.54.0 \
	go.opentelemetry.io/contrib/instrumentation/google.golang.org/grpc/otelgrpc		 v0.60.0 \
	go.opentelemetry.io/contrib/instrumentation/google.golang.org/grpc/otelgrpc		 v0.61.0 \
	go.opentelemetry.io/contrib/instrumentation/net/http/otelhttp				 v0.49.0 \
	go.opentelemetry.io/contrib/instrumentation/net/http/otelhttp				 v0.54.0 \
	go.opentelemetry.io/contrib/instrumentation/net/http/otelhttp				 v0.60.0 \
	go.opentelemetry.io/contrib/instrumentation/net/http/otelhttp				 v0.61.0 \
	go.opentelemetry.io/otel								 v1.24.0 \
	go.opentelemetry.io/otel								 v1.29.0 \
	go.opentelemetry.io/otel								 v1.32.0 \
	go.opentelemetry.io/otel								 v1.35.0 \
	go.opentelemetry.io/otel								 v1.36.0 \
	go.opentelemetry.io/otel/metric								 v1.24.0 \
	go.opentelemetry.io/otel/metric								 v1.29.0 \
	go.opentelemetry.io/otel/metric								 v1.35.0 \
	go.opentelemetry.io/otel/metric								 v1.36.0 \
	go.opentelemetry.io/otel/sdk								 v1.29.0 \
	go.opentelemetry.io/otel/sdk								 v1.35.0 \
	go.opentelemetry.io/otel/sdk								 v1.36.0 \
	go.opentelemetry.io/otel/sdk/metric							 v1.35.0 \
	go.opentelemetry.io/otel/sdk/metric							 v1.36.0 \
	go.opentelemetry.io/otel/trace								 v1.24.0 \
	go.opentelemetry.io/otel/trace								 v1.29.0 \
	go.opentelemetry.io/otel/trace								 v1.32.0 \
	go.opentelemetry.io/otel/trace								 v1.35.0 \
	go.opentelemetry.io/otel/trace								 v1.36.0 \
	golang.org/x/crypto									 v0.0.0-20190308221718-c2843e01d9a2 \
	golang.org/x/crypto									 v0.0.0-20210921155107-089bfa567519 \
	golang.org/x/crypto									 v0.13.0 \
	golang.org/x/crypto									 v0.19.0 \
	golang.org/x/crypto									 v0.23.0 \
	golang.org/x/crypto									 v0.31.0 \
	golang.org/x/crypto									 v0.35.0 \
	golang.org/x/crypto									 v0.37.0 \
	golang.org/x/crypto									 v0.38.0 \
	golang.org/x/crypto									 v0.39.0 \
	golang.org/x/mod									 v0.12.0 \
	golang.org/x/mod									 v0.15.0 \
	golang.org/x/mod									 v0.17.0 \
	golang.org/x/mod									 v0.6.0-dev.0.20220419223038-86c51ed26bb4 \
	golang.org/x/mod									 v0.8.0 \
	golang.org/x/net									 v0.0.0-20190620200207-3b0461eec859 \
	golang.org/x/net									 v0.0.0-20210226172049-e18ecbb05110 \
	golang.org/x/net									 v0.0.0-20210520170846-37e1c6afe023 \
	golang.org/x/net									 v0.0.0-20220722155237-a158d28d115b \
	golang.org/x/net									 v0.10.0 \
	golang.org/x/net									 v0.14.0 \
	golang.org/x/net									 v0.15.0 \
	golang.org/x/net									 v0.20.0 \
	golang.org/x/net									 v0.21.0 \
	golang.org/x/net									 v0.25.0 \
	golang.org/x/net									 v0.26.0 \
	golang.org/x/net									 v0.33.0 \
	golang.org/x/net									 v0.34.0 \
	golang.org/x/net									 v0.37.0 \
	golang.org/x/net									 v0.39.0 \
	golang.org/x/net									 v0.40.0 \
	golang.org/x/net									 v0.41.0 \
	golang.org/x/net									 v0.6.0 \
	golang.org/x/oauth2									 v0.19.0 \
	golang.org/x/oauth2									 v0.24.0 \
	golang.org/x/oauth2									 v0.28.0 \
	golang.org/x/oauth2									 v0.29.0 \
	golang.org/x/sync									 v0.0.0-20190423024810-112230192c58 \
	golang.org/x/sync									 v0.0.0-20220722155255-886fb9371eb4 \
	golang.org/x/sync									 v0.1.0 \
	golang.org/x/sync									 v0.10.0 \
	golang.org/x/sync									 v0.13.0 \
	golang.org/x/sync									 v0.14.0 \
	golang.org/x/sync									 v0.15.0 \
	golang.org/x/sync									 v0.3.0 \
	golang.org/x/sync									 v0.6.0 \
	golang.org/x/sync									 v0.7.0 \
	golang.org/x/sys									 v0.0.0-20190215142949-d0b11bdaac8a \
	golang.org/x/sys									 v0.0.0-20201119102817-f84b799fce68 \
	golang.org/x/sys									 v0.0.0-20210423082822-04245dca01da \
	golang.org/x/sys									 v0.0.0-20210615035016-665e8c7367d1 \
	golang.org/x/sys									 v0.0.0-20220520151302-bc2c85ada10a \
	golang.org/x/sys									 v0.0.0-20220722155257-8c9f86f7a55f \
	golang.org/x/sys									 v0.11.0 \
	golang.org/x/sys									 v0.12.0 \
	golang.org/x/sys									 v0.16.0 \
	golang.org/x/sys									 v0.17.0 \
	golang.org/x/sys									 v0.20.0 \
	golang.org/x/sys									 v0.28.0 \
	golang.org/x/sys									 v0.29.0 \
	golang.org/x/sys									 v0.30.0 \
	golang.org/x/sys									 v0.31.0 \
	golang.org/x/sys									 v0.32.0 \
	golang.org/x/sys									 v0.33.0 \
	golang.org/x/sys									 v0.5.0 \
	golang.org/x/sys									 v0.8.0 \
	golang.org/x/term									 v0.0.0-20201126162022-7de9c90e9dd1 \
	golang.org/x/term									 v0.0.0-20210927222741-03fcf44c2211 \
	golang.org/x/term									 v0.12.0 \
	golang.org/x/term									 v0.17.0 \
	golang.org/x/term									 v0.20.0 \
	golang.org/x/term									 v0.27.0 \
	golang.org/x/term									 v0.5.0 \
	golang.org/x/term									 v0.8.0 \
	golang.org/x/text									 v0.12.0 \
	golang.org/x/text									 v0.13.0 \
	golang.org/x/text									 v0.14.0 \
	golang.org/x/text									 v0.15.0 \
	golang.org/x/text									 v0.21.0 \
	golang.org/x/text									 v0.23.0 \
	golang.org/x/text									 v0.24.0 \
	golang.org/x/text									 v0.25.0 \
	golang.org/x/text									 v0.26.0 \
	golang.org/x/text									 v0.3.0 \
	golang.org/x/text									 v0.3.3 \
	golang.org/x/text									 v0.3.6 \
	golang.org/x/text									 v0.3.7 \
	golang.org/x/text									 v0.3.8 \
	golang.org/x/text									 v0.7.0 \
	golang.org/x/text									 v0.9.0 \
	golang.org/x/time									 v0.11.0 \
	golang.org/x/time									 v0.5.0 \
	golang.org/x/time									 v0.8.0 \
	golang.org/x/tools									 v0.0.0-20180917221912-90fa682c2a6e \
	golang.org/x/tools									 v0.0.0-20191119224855-298f0cb1881e \
	golang.org/x/tools									 v0.1.12 \
	golang.org/x/tools									 v0.13.0 \
	golang.org/x/tools									 v0.21.1-0.20240508182429-e35e4ccd0d2d \
	golang.org/x/tools									 v0.6.0 \
	golang.org/x/xerrors									 v0.0.0-20190717185122-a985d3407aa7 \
	google.golang.org/api									 v0.177.0 \
	google.golang.org/api									 v0.214.0 \
	google.golang.org/api									 v0.229.0 \
	google.golang.org/api									 v0.231.0 \
	google.golang.org/api									 v0.234.0 \
	google.golang.org/api									 v0.239.0 \
	google.golang.org/api									 v0.243.0 \
	google.golang.org/genproto								 v0.0.0-20241118233622-e639e219e697 \
	google.golang.org/genproto								 v0.0.0-20250303144028-a0af3efb3deb \
	google.golang.org/genproto								 v0.0.0-20250505200425-f936aa4a68b2 \
	google.golang.org/genproto								 v0.0.0-20250603155806-513f23925822 \
	google.golang.org/genproto/googleapis/api						 v0.0.0-20230822172742-b8732ec3820d \
	google.golang.org/genproto/googleapis/api						 v0.0.0-20240429193739-8cf5692501f6 \
	google.golang.org/genproto/googleapis/api						 v0.0.0-20241118233622-e639e219e697 \
	google.golang.org/genproto/googleapis/api						 v0.0.0-20241202173237-19429a94021a \
	google.golang.org/genproto/googleapis/api						 v0.0.0-20250414145226-207652e42e2e \
	google.golang.org/genproto/googleapis/api						 v0.0.0-20250505200425-f936aa4a68b2 \
	google.golang.org/genproto/googleapis/api						 v0.0.0-20250512202823-5a2f75b736a9 \
	google.golang.org/genproto/googleapis/api						 v0.0.0-20250528174236-200df99c418a \
	google.golang.org/genproto/googleapis/api						 v0.0.0-20250603155806-513f23925822 \
	google.golang.org/genproto/googleapis/api						 v0.0.0-20250721164621-a45f3dfb1074 \
	google.golang.org/genproto/googleapis/api						 v0.0.0-20250728155136-f173205681a0 \
	google.golang.org/genproto/googleapis/rpc						 v0.0.0-20230822172742-b8732ec3820d \
	google.golang.org/genproto/googleapis/rpc						 v0.0.0-20240318140521-94a12d6c2237 \
	google.golang.org/genproto/googleapis/rpc						 v0.0.0-20240429193739-8cf5692501f6 \
	google.golang.org/genproto/googleapis/rpc						 v0.0.0-20240826202546-f6391c0de4c7 \
	google.golang.org/genproto/googleapis/rpc						 v0.0.0-20241202173237-19429a94021a \
	google.golang.org/genproto/googleapis/rpc						 v0.0.0-20241209162323-e6fa225c2576 \
	google.golang.org/genproto/googleapis/rpc						 v0.0.0-20250227231956-55c901821b1e \
	google.golang.org/genproto/googleapis/rpc						 v0.0.0-20250414145226-207652e42e2e \
	google.golang.org/genproto/googleapis/rpc						 v0.0.0-20250505200425-f936aa4a68b2 \
	google.golang.org/genproto/googleapis/rpc						 v0.0.0-20250519155744-55703ea1f237 \
	google.golang.org/genproto/googleapis/rpc						 v0.0.0-20250528174236-200df99c418a \
	google.golang.org/genproto/googleapis/rpc						 v0.0.0-20250603155806-513f23925822 \
	google.golang.org/genproto/googleapis/rpc						 v0.0.0-20250721164621-a45f3dfb1074 \
	google.golang.org/genproto/googleapis/rpc						 v0.0.0-20250728155136-f173205681a0 \
	google.golang.org/grpc									 v1.58.2 \
	google.golang.org/grpc									 v1.59.0 \
	google.golang.org/grpc									 v1.63.2 \
	google.golang.org/grpc									 v1.67.3 \
	google.golang.org/grpc									 v1.70.0 \
	google.golang.org/grpc									 v1.71.0 \
	google.golang.org/grpc									 v1.71.1 \
	google.golang.org/grpc									 v1.72.0 \
	google.golang.org/grpc									 v1.72.2 \
	google.golang.org/grpc									 v1.73.0 \
	google.golang.org/protobuf								 v1.26.0-rc.1 \
	google.golang.org/protobuf								 v1.30.0 \
	google.golang.org/protobuf								 v1.31.0 \
	google.golang.org/protobuf								 v1.33.0 \
	google.golang.org/protobuf								 v1.34.2 \
	google.golang.org/protobuf								 v1.35.2 \
	google.golang.org/protobuf								 v1.36.1 \
	google.golang.org/protobuf								 v1.36.3 \
	google.golang.org/protobuf								 v1.36.4 \
	gopkg.in/check.v1									 v0.0.0-20161208181325-20d25e280405 \
	gopkg.in/check.v1									 v1.0.0-20180628173108-788fd7840127 \
	gopkg.in/yaml.v3									 v3.0.0-20200313102051-9f266ea9e77c
