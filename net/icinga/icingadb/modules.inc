MODGO_MODULES =	\
	filippo.io/edwards25519				 v1.1.0 \
	github.com/!vivid!cortex/ewma			 v1.2.0 \
	github.com/acarl005/stripansi			 v0.0.0-20180116102854-5a71ef0e047d \
	github.com/bsm/ginkgo/v2			 v2.12.0 \
	github.com/bsm/gomega				 v1.27.10 \
	github.com/caarlos0/env/v11			 v11.2.2 \
	github.com/cespare/xxhash/v2			 v2.2.0 \
	github.com/creasty/defaults			 v1.8.0 \
	github.com/davecgh/go-spew			 v1.1.1 \
	github.com/dgryski/go-rendezvous		 v0.0.0-20200823014737-9f7001d12a5f \
	github.com/fatih/color				 v1.18.0 \
	github.com/gabriel-vasile/mimetype		 v1.4.3 \
	github.com/go-playground/locales		 v0.14.1 \
	github.com/go-playground/universal-translator	 v0.18.1 \
	github.com/go-playground/validator/v10		 v10.22.1 \
	github.com/go-sql-driver/mysql			 v1.8.1 \
	github.com/goccy/go-yaml			 v1.13.0 \
	github.com/google/go-cmp			 v0.6.0 \
	github.com/google/uuid				 v1.6.0 \
	github.com/icinga/icinga-go-library		 v0.4.0 \
	github.com/jessevdk/go-flags			 v1.6.1 \
	github.com/jmoiron/sqlx				 v1.4.0 \
	github.com/kr/text				 v0.2.0 \
	github.com/leodido/go-urn			 v1.4.0 \
	github.com/lib/pq				 v1.10.9 \
	github.com/mattn/go-colorable			 v0.1.13 \
	github.com/mattn/go-isatty			 v0.0.20 \
	github.com/mattn/go-runewidth			 v0.0.12 \
	github.com/mattn/go-sqlite3			 v1.14.24 \
	github.com/okzk/sdnotify			 v0.0.0-20180710141335-d9becc38acbd \
	github.com/pkg/errors				 v0.9.1 \
	github.com/pmezard/go-difflib			 v1.0.0 \
	github.com/redis/go-redis/v9			 v9.7.0 \
	github.com/rivo/uniseg				 v0.2.0 \
	github.com/ssgreg/journald			 v1.0.0 \
	github.com/stretchr/objx			 v0.5.2 \
	github.com/stretchr/testify			 v1.10.0 \
	github.com/vbauerster/mpb/v6			 v6.0.4 \
	go.uber.org/goleak				 v1.3.0 \
	go.uber.org/multierr				 v1.11.0 \
	go.uber.org/zap					 v1.27.0 \
	golang.org/x/crypto				 v0.28.0 \
	golang.org/x/exp				 v0.0.0-20240506185415-9bf2ced13842 \
	golang.org/x/mod				 v0.17.0 \
	golang.org/x/net				 v0.30.0 \
	golang.org/x/sync				 v0.10.0 \
	golang.org/x/sys				 v0.26.0 \
	golang.org/x/text				 v0.19.0 \
	golang.org/x/tools				 v0.21.0 \
	gopkg.in/check.v1				 v0.0.0-20161208181325-20d25e280405 \
	gopkg.in/yaml.v3				 v3.0.1

MODGO_MODFILES =	\
	github.com/mattn/go-isatty	 v0.0.16 \
	github.com/mattn/go-sqlite3	 v1.14.22 \
	github.com/rivo/uniseg		 v0.1.0 \
	github.com/stretchr/testify	 v1.7.0 \
	github.com/stretchr/testify	 v1.8.1 \
	go.uber.org/multierr		 v1.10.0 \
	golang.org/x/sync		 v0.7.0 \
	golang.org/x/sys		 v0.0.0-20210514084401-e8d321eab015 \
	golang.org/x/sys		 v0.0.0-20220811171246-fbc7d0a398ab \
	golang.org/x/sys		 v0.21.0 \
	golang.org/x/sys		 v0.25.0 \
	golang.org/x/sys		 v0.6.0

