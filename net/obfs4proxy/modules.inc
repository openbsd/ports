MODGO_MODULES =	\
	filippo.io/edwards25519					 v1.0.0-rc.1.0.20210721174708-390f27c3be20 \
	git.torproject.org/pluggable-transports/goptlib.git	 v1.0.0 \
	github.com/dchest/siphash				 v1.2.1 \
	gitlab.com/yawning/edwards25519-extra.git		 v0.0.0-20211229043746-2f91fcc9fbdb \
	golang.org/x/crypto					 v0.0.0-20210711020723-a769d52b0f97 \
	golang.org/x/net					 v0.0.0-20210226172049-e18ecbb05110 \
	golang.org/x/sys					 v0.0.0-20210615035016-665e8c7367d1 \
	golang.org/x/term					 v0.0.0-20201126162022-7de9c90e9dd1 \
	golang.org/x/text					 v0.3.3 \
	golang.org/x/tools					 v0.0.0-20180917221912-90fa682c2a6e

MODGO_MODFILES =	\
	golang.org/x/sys	 v0.0.0-20201119102817-f84b799fce68
