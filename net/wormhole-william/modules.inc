MODGO_MODULES =	\
	github.com/!vivid!cortex/ewma		 v1.2.0 \
	github.com/cheggaaa/pb/v3		 v3.1.5 \
	github.com/cpuguy83/go-md2man/v2	 v2.0.4 \
	github.com/fatih/color			 v1.15.0 \
	github.com/gorilla/websocket		 v1.5.3 \
	github.com/inconshreveable/mousetrap	 v1.1.0 \
	github.com/klauspost/compress		 v1.17.11 \
	github.com/mattn/go-colorable		 v0.1.13 \
	github.com/mattn/go-isatty		 v0.0.20 \
	github.com/mattn/go-runewidth		 v0.0.15 \
	github.com/mdp/qrterminal/v3		 v3.2.0 \
	github.com/rivo/uniseg			 v0.2.0 \
	github.com/russross/blackfriday/v2	 v2.1.0 \
	github.com/spf13/cobra			 v1.8.1 \
	github.com/spf13/pflag			 v1.0.5 \
	golang.org/x/crypto			 v0.31.0 \
	golang.org/x/net			 v0.21.0 \
	golang.org/x/sys			 v0.28.0 \
	golang.org/x/term			 v0.27.0 \
	golang.org/x/text			 v0.21.0 \
	gopkg.in/check.v1			 v0.0.0-20161208181325-20d25e280405 \
	gopkg.in/yaml.v3			 v3.0.1 \
	nhooyr.io/websocket			 v1.8.17 \
	rsc.io/qr				 v0.2.0 \
	salsa.debian.org/vasudev/gospake2	 v0.0.0-20210510093858-d91629950ad1

MODGO_MODFILES =	\
	github.com/mattn/go-isatty	 v0.0.16 \
	github.com/mattn/go-isatty	 v0.0.17 \
	github.com/mattn/go-isatty	 v0.0.19 \
	golang.org/x/sys		 v0.0.0-20220811171246-fbc7d0a398ab \
	golang.org/x/sys		 v0.14.0 \
	golang.org/x/sys		 v0.6.0 \
	golang.org/x/term		 v0.13.0

