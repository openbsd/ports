MODGO_MODULES =	\
	cloud.google.com/go/compute		 v1.20.1 \
	cloud.google.com/go/compute/metadata	 v0.2.3 \
	github.com/!puerkito!bio/goquery	 v1.9.1 \
	github.com/abadojack/whatlanggo		 v1.0.1 \
	github.com/alecthomas/kingpin/v2	 v2.4.0 \
	github.com/alecthomas/units		 v0.0.0-20211218093645-b94a6e3cc137 \
	github.com/andybalholm/cascadia		 v1.3.2 \
	github.com/beorn7/perks			 v1.0.1 \
	github.com/cespare/xxhash/v2		 v2.2.0 \
	github.com/cheekybits/is		 v0.0.0-20150225183255-68e9c0620927 \
	github.com/coreos/go-oidc/v3		 v3.10.0 \
	github.com/davecgh/go-spew		 v1.1.1 \
	github.com/djherbis/atime		 v1.1.0 \
	github.com/fsnotify/fsnotify		 v1.7.0 \
	github.com/fxamacker/cbor/v2		 v2.6.0 \
	github.com/go-jose/go-jose/v4		 v4.0.1 \
	github.com/go-kit/log			 v0.2.1 \
	github.com/go-logfmt/logfmt		 v0.5.1 \
	github.com/go-webauthn/webauthn		 v0.10.2 \
	github.com/go-webauthn/x		 v0.1.9 \
	github.com/golang-jwt/jwt/v5		 v5.2.1 \
	github.com/golang/protobuf		 v1.5.3 \
	github.com/google/go-cmp		 v0.6.0 \
	github.com/google/go-tpm		 v0.9.0 \
	github.com/google/go-tpm-tools		 v0.3.13-0.20230620182252-4639ecce2aba \
	github.com/google/uuid			 v1.6.0 \
	github.com/gorilla/mux			 v1.8.1 \
	github.com/jpillora/backoff		 v1.0.0 \
	github.com/json-iterator/go		 v1.1.12 \
	github.com/julienschmidt/httprouter	 v1.3.0 \
	github.com/kr/pretty			 v0.3.1 \
	github.com/lib/pq			 v1.10.9 \
	github.com/matryer/try			 v0.0.0-20161228173917-9ac251b645a2 \
	github.com/mitchellh/mapstructure	 v1.5.0 \
	github.com/modern-go/concurrent		 v0.0.0-20180306012644-bacd9c7ef1dd \
	github.com/modern-go/reflect2		 v1.0.2 \
	github.com/mwitkow/go-conntrack		 v0.0.0-20190716064945-2f068394615f \
	github.com/pmezard/go-difflib		 v1.0.0 \
	github.com/prometheus/client_golang	 v1.19.0 \
	github.com/prometheus/client_model	 v0.5.0 \
	github.com/prometheus/common		 v0.48.0 \
	github.com/prometheus/procfs		 v0.12.0 \
	github.com/rogpeppe/go-internal		 v1.10.0 \
	github.com/stretchr/testify		 v1.9.0 \
	github.com/tdewolff/argp		 v0.0.0-20240126212256-acdb2fb50090 \
	github.com/tdewolff/minify/v2		 v2.20.19 \
	github.com/tdewolff/parse/v2		 v2.7.12 \
	github.com/tdewolff/test		 v1.0.11-0.20240106005702-7de5f7df4739 \
	github.com/x448/float16			 v0.8.4 \
	github.com/xhit/go-str2duration/v2	 v2.1.0 \
	github.com/yuin/goldmark		 v1.7.0 \
	golang.org/x/crypto			 v0.21.0 \
	golang.org/x/mod			 v0.10.0 \
	golang.org/x/net			 v0.22.0 \
	golang.org/x/oauth2			 v0.18.0 \
	golang.org/x/sync			 v0.3.0 \
	golang.org/x/sys			 v0.18.0 \
	golang.org/x/term			 v0.18.0 \
	golang.org/x/text			 v0.14.0 \
	golang.org/x/tools			 v0.6.0 \
	golang.org/x/xerrors			 v0.0.0-20191204190536-9bdfabe68543 \
	google.golang.org/appengine		 v1.6.8 \
	google.golang.org/protobuf		 v1.33.0 \
	gopkg.in/check.v1			 v1.0.0-20201130134442-10cb98267c6c \
	gopkg.in/yaml.v2			 v2.4.0 \
	gopkg.in/yaml.v3			 v3.0.1 \
	mvdan.cc/xurls/v2			 v2.5.0

MODGO_MODFILES =	\
	github.com/golang/protobuf		 v1.5.0 \
	github.com/golang/protobuf		 v1.5.2 \
	github.com/google/go-cmp		 v0.5.5 \
	github.com/google/go-cmp		 v0.5.9 \
	github.com/prometheus/client_golang	 v1.18.0 \
	github.com/stretchr/testify		 v1.8.2 \
	github.com/tdewolff/test		 v1.0.11-0.20231101010635-f1265d231d52 \
	github.com/yuin/goldmark		 v1.4.13 \
	golang.org/x/crypto			 v0.0.0-20190308221718-c2843e01d9a2 \
	golang.org/x/crypto			 v0.0.0-20210921155107-089bfa567519 \
	golang.org/x/crypto			 v0.19.0 \
	golang.org/x/mod			 v0.6.0-dev.0.20220419223038-86c51ed26bb4 \
	golang.org/x/mod			 v0.8.0 \
	golang.org/x/net			 v0.0.0-20190620200207-3b0461eec859 \
	golang.org/x/net			 v0.0.0-20210226172049-e18ecbb05110 \
	golang.org/x/net			 v0.0.0-20220722155237-a158d28d115b \
	golang.org/x/net			 v0.17.0 \
	golang.org/x/net			 v0.20.0 \
	golang.org/x/net			 v0.21.0 \
	golang.org/x/net			 v0.6.0 \
	golang.org/x/net			 v0.9.0 \
	golang.org/x/oauth2			 v0.13.0 \
	golang.org/x/oauth2			 v0.16.0 \
	golang.org/x/sync			 v0.0.0-20190423024810-112230192c58 \
	golang.org/x/sync			 v0.0.0-20220722155255-886fb9371eb4 \
	golang.org/x/sync			 v0.1.0 \
	golang.org/x/sys			 v0.0.0-20190215142949-d0b11bdaac8a \
	golang.org/x/sys			 v0.0.0-20201119102817-f84b799fce68 \
	golang.org/x/sys			 v0.0.0-20210615035016-665e8c7367d1 \
	golang.org/x/sys			 v0.0.0-20220520151302-bc2c85ada10a \
	golang.org/x/sys			 v0.0.0-20220722155257-8c9f86f7a55f \
	golang.org/x/sys			 v0.12.0 \
	golang.org/x/sys			 v0.16.0 \
	golang.org/x/sys			 v0.5.0 \
	golang.org/x/sys			 v0.7.0 \
	golang.org/x/sys			 v0.8.0 \
	golang.org/x/term			 v0.0.0-20201126162022-7de9c90e9dd1 \
	golang.org/x/term			 v0.0.0-20210927222741-03fcf44c2211 \
	golang.org/x/term			 v0.5.0 \
	golang.org/x/term			 v0.7.0 \
	golang.org/x/text			 v0.3.0 \
	golang.org/x/text			 v0.3.3 \
	golang.org/x/text			 v0.3.7 \
	golang.org/x/text			 v0.3.8 \
	golang.org/x/text			 v0.7.0 \
	golang.org/x/text			 v0.9.0 \
	golang.org/x/tools			 v0.0.0-20180917221912-90fa682c2a6e \
	golang.org/x/tools			 v0.0.0-20191119224855-298f0cb1881e \
	golang.org/x/tools			 v0.1.12 \
	golang.org/x/xerrors			 v0.0.0-20190717185122-a985d3407aa7 \
	google.golang.org/appengine		 v1.6.7 \
	google.golang.org/protobuf		 v1.26.0 \
	google.golang.org/protobuf		 v1.26.0-rc.1 \
	google.golang.org/protobuf		 v1.31.0 \
	google.golang.org/protobuf		 v1.32.0

