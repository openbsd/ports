MODCARGO_CRATES +=	Inflector	0.11.4	# BSD-2-Clause
MODCARGO_CRATES +=	adler2	2.0.1	# 0BSD OR MIT OR Apache-2.0
MODCARGO_CRATES +=	aead	0.5.2	# MIT OR Apache-2.0
MODCARGO_CRATES +=	aho-corasick	1.1.4	# Unlicense OR MIT
MODCARGO_CRATES +=	alloc-no-stdlib	2.0.4	# BSD-3-Clause
MODCARGO_CRATES +=	alloc-stdlib	0.2.2	# BSD-3-Clause
MODCARGO_CRATES +=	android_system_properties	0.1.5	# MIT/Apache-2.0
MODCARGO_CRATES +=	anstream	1.0.0	# MIT OR Apache-2.0
MODCARGO_CRATES +=	anstyle	1.0.14	# MIT OR Apache-2.0
MODCARGO_CRATES +=	anstyle-parse	1.0.0	# MIT OR Apache-2.0
MODCARGO_CRATES +=	anstyle-query	1.1.5	# MIT OR Apache-2.0
MODCARGO_CRATES +=	anstyle-wincon	3.0.11	# MIT OR Apache-2.0
MODCARGO_CRATES +=	anyhow	1.0.102	# MIT OR Apache-2.0
MODCARGO_CRATES +=	ascii	1.1.0	# Apache-2.0 OR MIT
MODCARGO_CRATES +=	askama	0.14.0	# MIT OR Apache-2.0
MODCARGO_CRATES +=	askama_derive	0.14.0	# MIT OR Apache-2.0
MODCARGO_CRATES +=	askama_parser	0.14.0	# MIT OR Apache-2.0
MODCARGO_CRATES +=	async-trait	0.1.89	# MIT OR Apache-2.0
MODCARGO_CRATES +=	atk	0.18.2	# MIT
MODCARGO_CRATES +=	atk-sys	0.18.2	# MIT
MODCARGO_CRATES +=	atomic-waker	1.1.2	# Apache-2.0 OR MIT
MODCARGO_CRATES +=	autocfg	1.5.0	# Apache-2.0 OR MIT
MODCARGO_CRATES +=	autotools	0.2.7	# MIT
MODCARGO_CRATES +=	axum	0.8.9	# MIT
MODCARGO_CRATES +=	axum-core	0.5.6	# MIT
MODCARGO_CRATES +=	base64	0.21.7	# MIT OR Apache-2.0
MODCARGO_CRATES +=	base64	0.22.1	# MIT OR Apache-2.0
MODCARGO_CRATES +=	basic-toml	0.1.10	# MIT OR Apache-2.0
MODCARGO_CRATES +=	bit-set	0.8.0	# Apache-2.0 OR MIT
MODCARGO_CRATES +=	bit-vec	0.8.0	# Apache-2.0 OR MIT
MODCARGO_CRATES +=	bitflags	1.3.2	# MIT/Apache-2.0
MODCARGO_CRATES +=	bitflags	2.11.1	# MIT OR Apache-2.0
MODCARGO_CRATES +=	block-buffer	0.10.4	# MIT OR Apache-2.0
MODCARGO_CRATES +=	block2	0.6.2	# MIT
MODCARGO_CRATES +=	brotli	8.0.2	# BSD-3-Clause AND MIT
MODCARGO_CRATES +=	brotli-decompressor	5.0.0	# BSD-3-Clause/MIT
MODCARGO_CRATES +=	bumpalo	3.20.2	# MIT OR Apache-2.0
MODCARGO_CRATES +=	bytemuck	1.25.0	# Zlib OR Apache-2.0 OR MIT
MODCARGO_CRATES +=	byteorder	1.5.0	# Unlicense OR MIT
MODCARGO_CRATES +=	bytes	1.11.1	# MIT
MODCARGO_CRATES +=	cairo-rs	0.18.5	# MIT
MODCARGO_CRATES +=	cairo-sys-rs	0.18.2	# MIT
MODCARGO_CRATES +=	camino	1.2.2	# MIT OR Apache-2.0
MODCARGO_CRATES +=	cargo-platform	0.1.9	# MIT OR Apache-2.0
MODCARGO_CRATES +=	cargo_metadata	0.19.2	# MIT
MODCARGO_CRATES +=	cargo_toml	0.22.3	# Apache-2.0 OR MIT
MODCARGO_CRATES +=	cc	1.2.61	# MIT OR Apache-2.0
MODCARGO_CRATES +=	cesu8	1.1.0	# Apache-2.0/MIT
MODCARGO_CRATES +=	cfb	0.7.3	# MIT
MODCARGO_CRATES +=	cfg-expr	0.15.8	# MIT OR Apache-2.0
MODCARGO_CRATES +=	cfg-if	1.0.4	# MIT OR Apache-2.0
MODCARGO_CRATES +=	cfg_aliases	0.2.1	# MIT
MODCARGO_CRATES +=	chacha20	0.9.1	# Apache-2.0 OR MIT
MODCARGO_CRATES +=	chacha20poly1305	0.10.1	# Apache-2.0 OR MIT
MODCARGO_CRATES +=	chrono	0.4.44	# MIT OR Apache-2.0
MODCARGO_CRATES +=	chunked_transfer	1.5.0	# MIT OR Apache-2.0
MODCARGO_CRATES +=	cipher	0.4.4	# MIT OR Apache-2.0
MODCARGO_CRATES +=	clap	4.6.1	# MIT OR Apache-2.0
MODCARGO_CRATES +=	clap-verbosity-flag	3.0.4	# MIT OR Apache-2.0
MODCARGO_CRATES +=	clap_builder	4.6.0	# MIT OR Apache-2.0
MODCARGO_CRATES +=	clap_derive	4.6.1	# MIT OR Apache-2.0
MODCARGO_CRATES +=	clap_lex	1.1.0	# MIT OR Apache-2.0
MODCARGO_CRATES +=	colorchoice	1.0.5	# MIT OR Apache-2.0
MODCARGO_CRATES +=	combine	4.6.7	# MIT
MODCARGO_CRATES +=	compile-time	0.2.0	# MIT OR Apache-2.0
MODCARGO_CRATES +=	convert_case	0.10.0	# MIT
MODCARGO_CRATES +=	cookie	0.18.1	# MIT OR Apache-2.0
MODCARGO_CRATES +=	core-foundation	0.9.4	# MIT OR Apache-2.0
MODCARGO_CRATES +=	core-foundation	0.10.1	# MIT OR Apache-2.0
MODCARGO_CRATES +=	core-foundation-sys	0.8.7	# MIT OR Apache-2.0
MODCARGO_CRATES +=	core-graphics	0.25.0	# MIT OR Apache-2.0
MODCARGO_CRATES +=	core-graphics-types	0.2.0	# MIT OR Apache-2.0
MODCARGO_CRATES +=	cpufeatures	0.2.17	# MIT OR Apache-2.0
MODCARGO_CRATES +=	crc32fast	1.5.0	# MIT OR Apache-2.0
MODCARGO_CRATES +=	crossbeam-channel	0.5.15	# MIT OR Apache-2.0
MODCARGO_CRATES +=	crossbeam-deque	0.8.6	# MIT OR Apache-2.0
MODCARGO_CRATES +=	crossbeam-epoch	0.9.18	# MIT OR Apache-2.0
MODCARGO_CRATES +=	crossbeam-utils	0.8.21	# MIT OR Apache-2.0
MODCARGO_CRATES +=	crossterm	0.29.0	# MIT
MODCARGO_CRATES +=	crossterm_winapi	0.9.1	# MIT
MODCARGO_CRATES +=	crypto-common	0.1.7	# MIT OR Apache-2.0
MODCARGO_CRATES +=	cssparser	0.36.0	# MPL-2.0
MODCARGO_CRATES +=	cssparser-macros	0.6.1	# MPL-2.0
MODCARGO_CRATES +=	ctor	0.8.0	# Apache-2.0 OR MIT
MODCARGO_CRATES +=	ctor-proc-macro	0.0.7	# Apache-2.0 OR MIT
MODCARGO_CRATES +=	darling	0.23.0	# MIT
MODCARGO_CRATES +=	darling_core	0.23.0	# MIT
MODCARGO_CRATES +=	darling_macro	0.23.0	# MIT
MODCARGO_CRATES +=	data-encoding	2.11.0	# MIT
MODCARGO_CRATES +=	dbus	0.9.11	# Apache-2.0/MIT
MODCARGO_CRATES +=	deranged	0.5.8	# MIT OR Apache-2.0
MODCARGO_CRATES +=	derive_more	2.1.1	# MIT
MODCARGO_CRATES +=	derive_more-impl	2.1.1	# MIT
MODCARGO_CRATES +=	digest	0.10.7	# MIT OR Apache-2.0
MODCARGO_CRATES +=	directories	6.0.0	# MIT OR Apache-2.0
MODCARGO_CRATES +=	dirs	6.0.0	# MIT OR Apache-2.0
MODCARGO_CRATES +=	dirs-sys	0.5.0	# MIT OR Apache-2.0
MODCARGO_CRATES +=	dispatch2	0.3.1	# Zlib OR Apache-2.0 OR MIT
MODCARGO_CRATES +=	displaydoc	0.2.5	# MIT OR Apache-2.0
MODCARGO_CRATES +=	dlopen2	0.5.0	# MIT
MODCARGO_CRATES +=	dlopen2	0.8.2	# MIT
MODCARGO_CRATES +=	dlopen2_derive	0.4.3	# MIT
MODCARGO_CRATES +=	dns-lookup	3.0.1	# MIT/Apache-2.0
MODCARGO_CRATES +=	document-features	0.2.12	# MIT OR Apache-2.0
MODCARGO_CRATES +=	dom_query	0.27.0	# MIT
MODCARGO_CRATES +=	dpi	0.1.2	# Apache-2.0 AND MIT
MODCARGO_CRATES +=	dtoa	1.0.11	# MIT OR Apache-2.0
MODCARGO_CRATES +=	dtoa-short	0.3.5	# MPL-2.0
MODCARGO_CRATES +=	dtor	0.3.0	# Apache-2.0 OR MIT
MODCARGO_CRATES +=	dtor-proc-macro	0.0.6	# Apache-2.0 OR MIT
MODCARGO_CRATES +=	dunce	1.0.5	# CC0-1.0 OR MIT-0 OR Apache-2.0
MODCARGO_CRATES +=	dyn-clone	1.0.20	# MIT OR Apache-2.0
MODCARGO_CRATES +=	either	1.15.0	# MIT OR Apache-2.0
MODCARGO_CRATES +=	embed-resource	3.0.9	# MIT
MODCARGO_CRATES +=	embed_plist	1.2.2	# MIT OR Apache-2.0
MODCARGO_CRATES +=	encoding_rs	0.8.35	# (Apache-2.0 OR MIT) AND BSD-3-Clause
MODCARGO_CRATES +=	env_filter	1.0.1	# MIT OR Apache-2.0
MODCARGO_CRATES +=	env_logger	0.11.10	# MIT OR Apache-2.0
MODCARGO_CRATES +=	equivalent	1.0.2	# Apache-2.0 OR MIT
MODCARGO_CRATES +=	erased-serde	0.4.10	# MIT OR Apache-2.0
MODCARGO_CRATES +=	errno	0.3.14	# MIT OR Apache-2.0
MODCARGO_CRATES +=	fastrand	2.4.1	# Apache-2.0 OR MIT
MODCARGO_CRATES +=	fdeflate	0.3.7	# MIT OR Apache-2.0
MODCARGO_CRATES +=	field-offset	0.3.6	# MIT OR Apache-2.0
MODCARGO_CRATES +=	filetime	0.2.27	# MIT/Apache-2.0
MODCARGO_CRATES +=	find-msvc-tools	0.1.9	# MIT OR Apache-2.0
MODCARGO_CRATES +=	flate2	1.1.9	# MIT OR Apache-2.0
MODCARGO_CRATES +=	fnv	1.0.7	# Apache-2.0 / MIT
MODCARGO_CRATES +=	foldhash	0.1.5	# Zlib
MODCARGO_CRATES +=	foldhash	0.2.0	# Zlib
MODCARGO_CRATES +=	foreign-types	0.3.2	# MIT/Apache-2.0
MODCARGO_CRATES +=	foreign-types	0.5.0	# MIT/Apache-2.0
MODCARGO_CRATES +=	foreign-types-macros	0.2.3	# MIT/Apache-2.0
MODCARGO_CRATES +=	foreign-types-shared	0.1.1	# MIT/Apache-2.0
MODCARGO_CRATES +=	foreign-types-shared	0.3.1	# MIT/Apache-2.0
MODCARGO_CRATES +=	form_urlencoded	1.2.2	# MIT OR Apache-2.0
MODCARGO_CRATES +=	fs_extra	1.3.0	# MIT
MODCARGO_CRATES +=	futures	0.3.32	# MIT OR Apache-2.0
MODCARGO_CRATES +=	futures-channel	0.3.32	# MIT OR Apache-2.0
MODCARGO_CRATES +=	futures-core	0.3.32	# MIT OR Apache-2.0
MODCARGO_CRATES +=	futures-executor	0.3.32	# MIT OR Apache-2.0
MODCARGO_CRATES +=	futures-io	0.3.32	# MIT OR Apache-2.0
MODCARGO_CRATES +=	futures-macro	0.3.32	# MIT OR Apache-2.0
MODCARGO_CRATES +=	futures-sink	0.3.32	# MIT OR Apache-2.0
MODCARGO_CRATES +=	futures-task	0.3.32	# MIT OR Apache-2.0
MODCARGO_CRATES +=	futures-util	0.3.32	# MIT OR Apache-2.0
MODCARGO_CRATES +=	fuzzy-matcher	0.3.7	# MIT
MODCARGO_CRATES +=	gdk	0.18.2	# MIT
MODCARGO_CRATES +=	gdk-pixbuf	0.18.5	# MIT
MODCARGO_CRATES +=	gdk-pixbuf-sys	0.18.0	# MIT
MODCARGO_CRATES +=	gdk-sys	0.18.2	# MIT
MODCARGO_CRATES +=	gdkwayland-sys	0.18.2	# MIT
MODCARGO_CRATES +=	gdkx11	0.18.2	# MIT
MODCARGO_CRATES +=	gdkx11-sys	0.18.2	# MIT
MODCARGO_CRATES +=	generic-array	0.14.7	# MIT
MODCARGO_CRATES +=	getrandom	0.2.17	# MIT OR Apache-2.0
MODCARGO_CRATES +=	getrandom	0.3.4	# MIT OR Apache-2.0
MODCARGO_CRATES +=	getrandom	0.4.2	# MIT OR Apache-2.0
MODCARGO_CRATES +=	gio	0.18.4	# MIT
MODCARGO_CRATES +=	gio-sys	0.18.1	# MIT
MODCARGO_CRATES +=	glib	0.18.5	# MIT
MODCARGO_CRATES +=	glib-macros	0.18.5	# MIT
MODCARGO_CRATES +=	glib-sys	0.18.1	# MIT
MODCARGO_CRATES +=	glob	0.3.3	# MIT OR Apache-2.0
MODCARGO_CRATES +=	gobject-sys	0.18.0	# MIT
MODCARGO_CRATES +=	gtk	0.18.2	# MIT
MODCARGO_CRATES +=	gtk-sys	0.18.2	# MIT
MODCARGO_CRATES +=	gtk3-macros	0.18.2	# MIT
MODCARGO_CRATES +=	h2	0.4.14	# MIT
MODCARGO_CRATES +=	hashbrown	0.12.3	# MIT OR Apache-2.0
MODCARGO_CRATES +=	hashbrown	0.15.5	# MIT OR Apache-2.0
MODCARGO_CRATES +=	hashbrown	0.17.0	# MIT OR Apache-2.0
MODCARGO_CRATES +=	heck	0.4.1	# MIT OR Apache-2.0
MODCARGO_CRATES +=	heck	0.5.0	# MIT OR Apache-2.0
MODCARGO_CRATES +=	hex	0.4.3	# MIT OR Apache-2.0
MODCARGO_CRATES +=	home	0.5.11	# MIT OR Apache-2.0
MODCARGO_CRATES +=	html-escape	0.2.13	# MIT
MODCARGO_CRATES +=	html5ever	0.38.0	# MIT OR Apache-2.0
MODCARGO_CRATES +=	http	1.4.0	# MIT OR Apache-2.0
MODCARGO_CRATES +=	http-body	1.0.1	# MIT
MODCARGO_CRATES +=	http-body-util	0.1.3	# MIT
MODCARGO_CRATES +=	httparse	1.10.1	# MIT OR Apache-2.0
MODCARGO_CRATES +=	httpdate	1.0.3	# MIT OR Apache-2.0
MODCARGO_CRATES +=	humantime	2.3.0	# MIT OR Apache-2.0
MODCARGO_CRATES +=	hyper	1.9.0	# MIT
MODCARGO_CRATES +=	hyper-rustls	0.27.9	# Apache-2.0 OR ISC OR MIT
MODCARGO_CRATES +=	hyper-tls	0.6.0	# MIT/Apache-2.0
MODCARGO_CRATES +=	hyper-util	0.1.20	# MIT
MODCARGO_CRATES +=	iana-time-zone	0.1.65	# MIT OR Apache-2.0
MODCARGO_CRATES +=	iana-time-zone-haiku	0.1.2	# MIT OR Apache-2.0
MODCARGO_CRATES +=	ico	0.5.0	# MIT
MODCARGO_CRATES +=	icu_collections	2.2.0	# Unicode-3.0
MODCARGO_CRATES +=	icu_locale_core	2.2.0	# Unicode-3.0
MODCARGO_CRATES +=	icu_normalizer	2.2.0	# Unicode-3.0
MODCARGO_CRATES +=	icu_normalizer_data	2.2.0	# Unicode-3.0
MODCARGO_CRATES +=	icu_properties	2.2.0	# Unicode-3.0
MODCARGO_CRATES +=	icu_properties_data	2.2.0	# Unicode-3.0
MODCARGO_CRATES +=	icu_provider	2.2.0	# Unicode-3.0
MODCARGO_CRATES +=	id-arena	2.3.0	# MIT/Apache-2.0
MODCARGO_CRATES +=	ident_case	1.0.1	# MIT/Apache-2.0
MODCARGO_CRATES +=	idna	1.1.0	# MIT OR Apache-2.0
MODCARGO_CRATES +=	idna_adapter	1.2.2	# Apache-2.0 OR MIT
MODCARGO_CRATES +=	indexmap	1.9.3	# Apache-2.0 OR MIT
MODCARGO_CRATES +=	indexmap	2.14.0	# Apache-2.0 OR MIT
MODCARGO_CRATES +=	infer	0.19.0	# MIT
MODCARGO_CRATES +=	inout	0.1.4	# MIT OR Apache-2.0
MODCARGO_CRATES +=	inquire	0.9.4	# MIT
MODCARGO_CRATES +=	ipnet	2.12.0	# MIT OR Apache-2.0
MODCARGO_CRATES +=	is-docker	0.2.0	# MIT
MODCARGO_CRATES +=	is-wsl	0.4.0	# MIT
MODCARGO_CRATES +=	is_executable	1.0.5	# MIT OR Apache-2.0
MODCARGO_CRATES +=	is_terminal_polyfill	1.70.2	# MIT OR Apache-2.0
MODCARGO_CRATES +=	itoa	1.0.18	# MIT OR Apache-2.0
MODCARGO_CRATES +=	javascriptcore-rs	1.1.2	# MIT
MODCARGO_CRATES +=	javascriptcore-rs-sys	1.1.1	# MIT
MODCARGO_CRATES +=	jiff	0.2.24	# Unlicense OR MIT
MODCARGO_CRATES +=	jiff-static	0.2.24	# Unlicense OR MIT
MODCARGO_CRATES +=	jni	0.21.1	# MIT/Apache-2.0
MODCARGO_CRATES +=	jni	0.22.4	# MIT OR Apache-2.0
MODCARGO_CRATES +=	jni-macros	0.22.4	# MIT OR Apache-2.0
MODCARGO_CRATES +=	jni-sys	0.3.1	# MIT OR Apache-2.0
MODCARGO_CRATES +=	jni-sys	0.4.1	# MIT OR Apache-2.0
MODCARGO_CRATES +=	jni-sys-macros	0.4.1	# MIT OR Apache-2.0
MODCARGO_CRATES +=	js-sys	0.3.97	# MIT OR Apache-2.0
MODCARGO_CRATES +=	json-patch	3.0.1	# MIT/Apache-2.0
MODCARGO_CRATES +=	jsonptr	0.6.3	# MIT OR Apache-2.0
MODCARGO_CRATES +=	keyboard-types	0.7.0	# MIT OR Apache-2.0
MODCARGO_CRATES +=	leb128fmt	0.1.0	# MIT OR Apache-2.0
MODCARGO_CRATES +=	libappindicator	0.9.0	# Apache-2.0 OR MIT
MODCARGO_CRATES +=	libappindicator-sys	0.9.0	# Apache-2.0 OR MIT
MODCARGO_CRATES +=	libc	0.2.186	# MIT OR Apache-2.0
MODCARGO_CRATES +=	libdbus-sys	0.2.7	# Apache-2.0/MIT
MODCARGO_CRATES +=	libloading	0.7.4	# ISC
MODCARGO_CRATES +=	libredox	0.1.16	# MIT
MODCARGO_CRATES +=	linux-raw-sys	0.12.1	# Apache-2.0 WITH LLVM-exception OR Apache-2.0 OR MIT
MODCARGO_CRATES +=	litemap	0.8.2	# Unicode-3.0
MODCARGO_CRATES +=	litrs	1.0.0	# MIT OR Apache-2.0
MODCARGO_CRATES +=	lock_api	0.4.14	# MIT OR Apache-2.0
MODCARGO_CRATES +=	log	0.4.29	# MIT OR Apache-2.0
MODCARGO_CRATES +=	log-reload	0.1.3	# MIT OR Apache-2.0
MODCARGO_CRATES +=	lzma-sys	0.1.20	# MIT/Apache-2.0
MODCARGO_CRATES +=	mac-addr	0.3.0	# MIT
MODCARGO_CRATES +=	machine-uid	0.5.4	# MIT
MODCARGO_CRATES +=	markup5ever	0.38.0	# MIT OR Apache-2.0
MODCARGO_CRATES +=	matchit	0.8.4	# MIT AND BSD-3-Clause
MODCARGO_CRATES +=	md5	0.8.0	# Apache-2.0/MIT
MODCARGO_CRATES +=	memchr	2.8.0	# Unlicense OR MIT
MODCARGO_CRATES +=	memoffset	0.9.1	# MIT
MODCARGO_CRATES +=	mime	0.3.17	# MIT OR Apache-2.0
MODCARGO_CRATES +=	miniz_oxide	0.8.9	# MIT OR Zlib OR Apache-2.0
MODCARGO_CRATES +=	mio	1.2.0	# MIT
MODCARGO_CRATES +=	muda	0.19.1	# Apache-2.0 OR MIT
MODCARGO_CRATES +=	native-tls	0.2.18	# MIT OR Apache-2.0
MODCARGO_CRATES +=	ndk	0.9.0	# MIT OR Apache-2.0
MODCARGO_CRATES +=	ndk-context	0.1.1	# MIT OR Apache-2.0
MODCARGO_CRATES +=	ndk-sys	0.6.0+11769913	# MIT OR Apache-2.0
MODCARGO_CRATES +=	netdev	0.40.1	# MIT
MODCARGO_CRATES +=	netlink-packet-core	0.8.1	# MIT
MODCARGO_CRATES +=	netlink-packet-route	0.29.0	# MIT
MODCARGO_CRATES +=	netlink-sys	0.8.8	# MIT
MODCARGO_CRATES +=	new_debug_unreachable	1.0.6	# MIT
MODCARGO_CRATES +=	nix	0.30.1	# MIT
MODCARGO_CRATES +=	ntapi	0.4.3	# Apache-2.0 OR MIT
MODCARGO_CRATES +=	num-conv	0.2.1	# MIT OR Apache-2.0
MODCARGO_CRATES +=	num-traits	0.2.19	# MIT OR Apache-2.0
MODCARGO_CRATES +=	num_enum	0.7.6	# BSD-3-Clause OR MIT OR Apache-2.0
MODCARGO_CRATES +=	num_enum_derive	0.7.6	# BSD-3-Clause OR MIT OR Apache-2.0
MODCARGO_CRATES +=	objc2	0.6.4	# MIT
MODCARGO_CRATES +=	objc2-app-kit	0.3.2	# Zlib OR Apache-2.0 OR MIT
MODCARGO_CRATES +=	objc2-cloud-kit	0.3.2	# Zlib OR Apache-2.0 OR MIT
MODCARGO_CRATES +=	objc2-core-data	0.3.2	# Zlib OR Apache-2.0 OR MIT
MODCARGO_CRATES +=	objc2-core-foundation	0.3.2	# Zlib OR Apache-2.0 OR MIT
MODCARGO_CRATES +=	objc2-core-graphics	0.3.2	# Zlib OR Apache-2.0 OR MIT
MODCARGO_CRATES +=	objc2-core-image	0.3.2	# Zlib OR Apache-2.0 OR MIT
MODCARGO_CRATES +=	objc2-core-location	0.3.2	# Zlib OR Apache-2.0 OR MIT
MODCARGO_CRATES +=	objc2-core-text	0.3.2	# Zlib OR Apache-2.0 OR MIT
MODCARGO_CRATES +=	objc2-encode	4.1.0	# MIT
MODCARGO_CRATES +=	objc2-exception-helper	0.1.1	# Zlib OR Apache-2.0 OR MIT
MODCARGO_CRATES +=	objc2-foundation	0.3.2	# MIT
MODCARGO_CRATES +=	objc2-io-kit	0.3.2	# Zlib OR Apache-2.0 OR MIT
MODCARGO_CRATES +=	objc2-io-surface	0.3.2	# Zlib OR Apache-2.0 OR MIT
MODCARGO_CRATES +=	objc2-javascript-core	0.3.2	# Zlib OR Apache-2.0 OR MIT
MODCARGO_CRATES +=	objc2-quartz-core	0.3.2	# Zlib OR Apache-2.0 OR MIT
MODCARGO_CRATES +=	objc2-security	0.3.2	# Zlib OR Apache-2.0 OR MIT
MODCARGO_CRATES +=	objc2-system-configuration	0.3.2	# Zlib OR Apache-2.0 OR MIT
MODCARGO_CRATES +=	objc2-ui-kit	0.3.2	# Zlib OR Apache-2.0 OR MIT
MODCARGO_CRATES +=	objc2-user-notifications	0.3.2	# Zlib OR Apache-2.0 OR MIT
MODCARGO_CRATES +=	objc2-web-kit	0.3.2	# Zlib OR Apache-2.0 OR MIT
MODCARGO_CRATES +=	once_cell	1.21.4	# MIT OR Apache-2.0
MODCARGO_CRATES +=	once_cell_polyfill	1.70.2	# MIT OR Apache-2.0
MODCARGO_CRATES +=	opaque-debug	0.3.1	# MIT OR Apache-2.0
MODCARGO_CRATES +=	open	5.3.4	# MIT
MODCARGO_CRATES +=	openssl	0.10.79	# Apache-2.0
MODCARGO_CRATES +=	openssl-macros	0.1.1	# MIT/Apache-2.0
MODCARGO_CRATES +=	openssl-probe	0.2.1	# MIT OR Apache-2.0
MODCARGO_CRATES +=	openssl-sys	0.9.115	# MIT
MODCARGO_CRATES +=	option-ext	0.2.0	# MPL-2.0
MODCARGO_CRATES +=	os_info	3.14.0	# MIT
MODCARGO_CRATES +=	pango	0.18.3	# MIT
MODCARGO_CRATES +=	pango-sys	0.18.0	# MIT
MODCARGO_CRATES +=	parking_lot	0.12.5	# MIT OR Apache-2.0
MODCARGO_CRATES +=	parking_lot_core	0.9.12	# MIT OR Apache-2.0
MODCARGO_CRATES +=	paste	1.0.15	# MIT OR Apache-2.0
MODCARGO_CRATES +=	pathdiff	0.2.3	# MIT/Apache-2.0
MODCARGO_CRATES +=	pem	3.0.6	# MIT
MODCARGO_CRATES +=	percent-encoding	2.3.2	# MIT OR Apache-2.0
MODCARGO_CRATES +=	phf	0.13.1	# MIT
MODCARGO_CRATES +=	phf_codegen	0.13.1	# MIT
MODCARGO_CRATES +=	phf_generator	0.13.1	# MIT
MODCARGO_CRATES +=	phf_macros	0.13.1	# MIT
MODCARGO_CRATES +=	phf_shared	0.13.1	# MIT
MODCARGO_CRATES +=	pin-project-lite	0.2.17	# Apache-2.0 OR MIT
MODCARGO_CRATES +=	pkg-config	0.3.33	# MIT OR Apache-2.0
MODCARGO_CRATES +=	plain	0.2.3	# MIT/Apache-2.0
MODCARGO_CRATES +=	plist	1.9.0	# MIT
MODCARGO_CRATES +=	png	0.17.16	# MIT OR Apache-2.0
MODCARGO_CRATES +=	png	0.18.1	# MIT OR Apache-2.0
MODCARGO_CRATES +=	poly1305	0.8.0	# Apache-2.0 OR MIT
MODCARGO_CRATES +=	portable-atomic	1.13.1	# Apache-2.0 OR MIT
MODCARGO_CRATES +=	portable-atomic-util	0.2.7	# Apache-2.0 OR MIT
MODCARGO_CRATES +=	potential_utf	0.1.5	# Unicode-3.0
MODCARGO_CRATES +=	powerfmt	0.2.0	# MIT OR Apache-2.0
MODCARGO_CRATES +=	ppv-lite86	0.2.21	# MIT OR Apache-2.0
MODCARGO_CRATES +=	precomputed-hash	0.1.1	# MIT
MODCARGO_CRATES +=	prettyplease	0.2.37	# MIT OR Apache-2.0
MODCARGO_CRATES +=	proc-macro-crate	1.3.1	# MIT OR Apache-2.0
MODCARGO_CRATES +=	proc-macro-crate	2.0.2	# MIT OR Apache-2.0
MODCARGO_CRATES +=	proc-macro-crate	3.5.0	# MIT OR Apache-2.0
MODCARGO_CRATES +=	proc-macro-error	1.0.4	# MIT OR Apache-2.0
MODCARGO_CRATES +=	proc-macro-error-attr	1.0.4	# MIT OR Apache-2.0
MODCARGO_CRATES +=	proc-macro2	1.0.106	# MIT OR Apache-2.0
MODCARGO_CRATES +=	quick-xml	0.39.3	# MIT
MODCARGO_CRATES +=	quote	1.0.45	# MIT OR Apache-2.0
MODCARGO_CRATES +=	r-efi	5.3.0	# MIT OR Apache-2.0 OR LGPL-2.1-or-later
MODCARGO_CRATES +=	r-efi	6.0.0	# MIT OR Apache-2.0 OR LGPL-2.1-or-later
MODCARGO_CRATES +=	rand	0.9.4	# MIT OR Apache-2.0
MODCARGO_CRATES +=	rand_chacha	0.9.0	# MIT OR Apache-2.0
MODCARGO_CRATES +=	rand_core	0.6.4	# MIT OR Apache-2.0
MODCARGO_CRATES +=	rand_core	0.9.5	# MIT OR Apache-2.0
MODCARGO_CRATES +=	raw-window-handle	0.6.2	# MIT OR Apache-2.0 OR Zlib
MODCARGO_CRATES +=	rayon	1.12.0	# MIT OR Apache-2.0
MODCARGO_CRATES +=	rayon-core	1.13.0	# MIT OR Apache-2.0
MODCARGO_CRATES +=	redact-engine	0.1.2	# Apache-2.0
MODCARGO_CRATES +=	redox_syscall	0.5.18	# MIT
MODCARGO_CRATES +=	redox_syscall	0.7.5	# MIT
MODCARGO_CRATES +=	redox_users	0.5.2	# MIT
MODCARGO_CRATES +=	ref-cast	1.0.25	# MIT OR Apache-2.0
MODCARGO_CRATES +=	ref-cast-impl	1.0.25	# MIT OR Apache-2.0
MODCARGO_CRATES +=	regex	1.12.3	# MIT OR Apache-2.0
MODCARGO_CRATES +=	regex-automata	0.4.14	# MIT OR Apache-2.0
MODCARGO_CRATES +=	regex-syntax	0.8.10	# MIT OR Apache-2.0
MODCARGO_CRATES +=	reqwest	0.12.28	# MIT OR Apache-2.0
MODCARGO_CRATES +=	reqwest	0.13.3	# MIT OR Apache-2.0
MODCARGO_CRATES +=	ring	0.17.14	# Apache-2.0 AND ISC
MODCARGO_CRATES +=	rustc-hash	2.1.2	# Apache-2.0 OR MIT
MODCARGO_CRATES +=	rustc_version	0.4.1	# MIT OR Apache-2.0
MODCARGO_CRATES +=	rustix	1.1.4	# Apache-2.0 WITH LLVM-exception OR Apache-2.0 OR MIT
MODCARGO_CRATES +=	rustls	0.23.40	# Apache-2.0 OR ISC OR MIT
MODCARGO_CRATES +=	rustls-pki-types	1.14.1	# MIT OR Apache-2.0
MODCARGO_CRATES +=	rustls-webpki	0.103.13	# ISC
MODCARGO_CRATES +=	rustversion	1.0.22	# MIT OR Apache-2.0
MODCARGO_CRATES +=	ryu	1.0.23	# Apache-2.0 OR BSL-1.0
MODCARGO_CRATES +=	same-file	1.0.6	# Unlicense/MIT
MODCARGO_CRATES +=	schannel	0.1.29	# MIT
MODCARGO_CRATES +=	schemars	0.8.22	# MIT
MODCARGO_CRATES +=	schemars	0.9.0	# MIT
MODCARGO_CRATES +=	schemars	1.2.1	# MIT
MODCARGO_CRATES +=	schemars_derive	0.8.22	# MIT
MODCARGO_CRATES +=	scopeguard	1.2.0	# MIT OR Apache-2.0
MODCARGO_CRATES +=	security-framework	3.7.0	# MIT OR Apache-2.0
MODCARGO_CRATES +=	security-framework-sys	2.17.0	# MIT OR Apache-2.0
MODCARGO_CRATES +=	selectors	0.36.1	# MPL-2.0
MODCARGO_CRATES +=	semver	1.0.28	# MIT OR Apache-2.0
MODCARGO_CRATES +=	serde	1.0.228	# MIT OR Apache-2.0
MODCARGO_CRATES +=	serde-untagged	0.1.9	# MIT OR Apache-2.0
MODCARGO_CRATES +=	serde_core	1.0.228	# MIT OR Apache-2.0
MODCARGO_CRATES +=	serde_derive	1.0.228	# MIT OR Apache-2.0
MODCARGO_CRATES +=	serde_derive_internals	0.29.1	# MIT OR Apache-2.0
MODCARGO_CRATES +=	serde_json	1.0.149	# MIT OR Apache-2.0
MODCARGO_CRATES +=	serde_path_to_error	0.1.20	# MIT OR Apache-2.0
MODCARGO_CRATES +=	serde_regex	1.1.0	# MIT/Apache-2.0
MODCARGO_CRATES +=	serde_repr	0.1.20	# MIT OR Apache-2.0
MODCARGO_CRATES +=	serde_spanned	0.6.9	# MIT OR Apache-2.0
MODCARGO_CRATES +=	serde_spanned	1.1.1	# MIT OR Apache-2.0
MODCARGO_CRATES +=	serde_urlencoded	0.7.1	# MIT/Apache-2.0
MODCARGO_CRATES +=	serde_with	3.19.0	# MIT OR Apache-2.0
MODCARGO_CRATES +=	serde_with_macros	3.19.0	# MIT OR Apache-2.0
MODCARGO_CRATES +=	serialize-to-javascript	0.1.2	# MIT OR Apache-2.0
MODCARGO_CRATES +=	serialize-to-javascript-impl	0.1.2	# MIT OR Apache-2.0
MODCARGO_CRATES +=	servo_arc	0.4.3	# MIT OR Apache-2.0
MODCARGO_CRATES +=	sha1	0.10.6	# MIT OR Apache-2.0
MODCARGO_CRATES +=	sha1_smol	1.0.1	# BSD-3-Clause
MODCARGO_CRATES +=	sha2	0.10.9	# MIT OR Apache-2.0
MODCARGO_CRATES +=	sha256	1.6.0	# MIT OR Apache-2.0
MODCARGO_CRATES +=	shlex	1.3.0	# MIT OR Apache-2.0
MODCARGO_CRATES +=	signal-hook	0.3.18	# Apache-2.0/MIT
MODCARGO_CRATES +=	signal-hook-mio	0.2.5	# MIT OR Apache-2.0
MODCARGO_CRATES +=	signal-hook-registry	1.4.8	# MIT OR Apache-2.0
MODCARGO_CRATES +=	simd-adler32	0.3.9	# MIT
MODCARGO_CRATES +=	simd_cesu8	1.1.1	# Apache-2.0 OR MIT
MODCARGO_CRATES +=	simdutf8	0.1.5	# MIT OR Apache-2.0
MODCARGO_CRATES +=	siphasher	1.0.3	# MIT/Apache-2.0
MODCARGO_CRATES +=	slab	0.4.12	# MIT
MODCARGO_CRATES +=	smallvec	1.15.1	# MIT OR Apache-2.0
MODCARGO_CRATES +=	socket2	0.6.3	# MIT OR Apache-2.0
MODCARGO_CRATES +=	softbuffer	0.4.8	# MIT OR Apache-2.0
MODCARGO_CRATES +=	soup3	0.5.0	# MIT
MODCARGO_CRATES +=	soup3-sys	0.5.0	# MIT
MODCARGO_CRATES +=	specta	2.0.0-rc.20	# MIT
MODCARGO_CRATES +=	specta-macros	2.0.0-rc.17	# MIT
MODCARGO_CRATES +=	stable_deref_trait	1.2.1	# MIT OR Apache-2.0
MODCARGO_CRATES +=	string_cache	0.9.0	# MIT OR Apache-2.0
MODCARGO_CRATES +=	string_cache_codegen	0.6.1	# MIT OR Apache-2.0
MODCARGO_CRATES +=	strsim	0.11.1	# MIT
MODCARGO_CRATES +=	subtle	2.6.1	# BSD-3-Clause
MODCARGO_CRATES +=	swift-rs	1.0.7	# MIT OR Apache-2.0
MODCARGO_CRATES +=	syn	1.0.109	# MIT OR Apache-2.0
MODCARGO_CRATES +=	syn	2.0.117	# MIT OR Apache-2.0
MODCARGO_CRATES +=	sync_wrapper	1.0.2	# Apache-2.0
MODCARGO_CRATES +=	synstructure	0.13.2	# MIT
MODCARGO_CRATES +=	sysinfo	0.36.1	# MIT
MODCARGO_CRATES +=	system-configuration	0.7.0	# MIT OR Apache-2.0
MODCARGO_CRATES +=	system-configuration-sys	0.6.0	# MIT OR Apache-2.0
MODCARGO_CRATES +=	system-deps	6.2.2	# MIT OR Apache-2.0
MODCARGO_CRATES +=	tao	0.35.2	# Apache-2.0
MODCARGO_CRATES +=	tao-macros	0.1.3	# MIT OR Apache-2.0
MODCARGO_CRATES +=	tar	0.4.45	# MIT OR Apache-2.0
MODCARGO_CRATES +=	target-lexicon	0.12.16	# Apache-2.0 WITH LLVM-exception
MODCARGO_CRATES +=	tauri	2.11.1	# Apache-2.0 OR MIT
MODCARGO_CRATES +=	tauri-build	2.6.1	# Apache-2.0 OR MIT
MODCARGO_CRATES +=	tauri-codegen	2.6.1	# Apache-2.0 OR MIT
MODCARGO_CRATES +=	tauri-macros	2.6.1	# Apache-2.0 OR MIT
MODCARGO_CRATES +=	tauri-runtime	2.11.1	# Apache-2.0 OR MIT
MODCARGO_CRATES +=	tauri-runtime-wry	2.11.1	# Apache-2.0 OR MIT
MODCARGO_CRATES +=	tauri-utils	2.9.1	# Apache-2.0 OR MIT
MODCARGO_CRATES +=	tauri-winres	0.3.6	# MIT
MODCARGO_CRATES +=	tempfile	3.27.0	# MIT OR Apache-2.0
MODCARGO_CRATES +=	tendril	0.5.0	# MIT OR Apache-2.0
MODCARGO_CRATES +=	thiserror	1.0.69	# MIT OR Apache-2.0
MODCARGO_CRATES +=	thiserror	2.0.18	# MIT OR Apache-2.0
MODCARGO_CRATES +=	thiserror-impl	1.0.69	# MIT OR Apache-2.0
MODCARGO_CRATES +=	thiserror-impl	2.0.18	# MIT OR Apache-2.0
MODCARGO_CRATES +=	thread_local	1.1.9	# MIT OR Apache-2.0
MODCARGO_CRATES +=	time	0.3.47	# MIT OR Apache-2.0
MODCARGO_CRATES +=	time-core	0.1.8	# MIT OR Apache-2.0
MODCARGO_CRATES +=	time-macros	0.2.27	# MIT OR Apache-2.0
MODCARGO_CRATES +=	tiny_http	0.12.0	# MIT OR Apache-2.0
MODCARGO_CRATES +=	tinystr	0.8.3	# Unicode-3.0
MODCARGO_CRATES +=	tokio	1.52.2	# MIT
MODCARGO_CRATES +=	tokio-macros	2.7.0	# MIT
MODCARGO_CRATES +=	tokio-native-tls	0.3.1	# MIT
MODCARGO_CRATES +=	tokio-rustls	0.26.4	# MIT OR Apache-2.0
MODCARGO_CRATES +=	tokio-tungstenite	0.29.0	# MIT
MODCARGO_CRATES +=	tokio-util	0.7.18	# MIT
MODCARGO_CRATES +=	toml	0.8.2	# MIT OR Apache-2.0
MODCARGO_CRATES +=	toml	0.9.12+spec-1.1.0	# MIT OR Apache-2.0
MODCARGO_CRATES +=	toml	1.1.2+spec-1.1.0	# MIT OR Apache-2.0
MODCARGO_CRATES +=	toml_datetime	0.6.3	# MIT OR Apache-2.0
MODCARGO_CRATES +=	toml_datetime	0.7.5+spec-1.1.0	# MIT OR Apache-2.0
MODCARGO_CRATES +=	toml_datetime	1.1.1+spec-1.1.0	# MIT OR Apache-2.0
MODCARGO_CRATES +=	toml_edit	0.19.15	# MIT OR Apache-2.0
MODCARGO_CRATES +=	toml_edit	0.20.2	# MIT OR Apache-2.0
MODCARGO_CRATES +=	toml_edit	0.25.11+spec-1.1.0	# MIT OR Apache-2.0
MODCARGO_CRATES +=	toml_parser	1.1.2+spec-1.1.0	# MIT OR Apache-2.0
MODCARGO_CRATES +=	toml_writer	1.1.1+spec-1.1.0	# MIT OR Apache-2.0
MODCARGO_CRATES +=	tower	0.5.3	# MIT
MODCARGO_CRATES +=	tower-http	0.6.9	# MIT
MODCARGO_CRATES +=	tower-layer	0.3.3	# MIT
MODCARGO_CRATES +=	tower-service	0.3.3	# MIT
MODCARGO_CRATES +=	tracing	0.1.44	# MIT
MODCARGO_CRATES +=	tracing-core	0.1.36	# MIT
MODCARGO_CRATES +=	tray-icon	0.23.1	# MIT OR Apache-2.0
MODCARGO_CRATES +=	try-lock	0.2.5	# MIT
MODCARGO_CRATES +=	tungstenite	0.29.0	# MIT OR Apache-2.0
MODCARGO_CRATES +=	typeid	1.0.3	# MIT OR Apache-2.0
MODCARGO_CRATES +=	typenum	1.20.0	# MIT OR Apache-2.0
MODCARGO_CRATES +=	unic-char-property	0.9.0	# MIT/Apache-2.0
MODCARGO_CRATES +=	unic-char-range	0.9.0	# MIT/Apache-2.0
MODCARGO_CRATES +=	unic-common	0.9.0	# MIT/Apache-2.0
MODCARGO_CRATES +=	unic-ucd-ident	0.9.0	# MIT/Apache-2.0
MODCARGO_CRATES +=	unic-ucd-version	0.9.0	# MIT/Apache-2.0
MODCARGO_CRATES +=	unicode-ident	1.0.24	# (MIT OR Apache-2.0) AND Unicode-3.0
MODCARGO_CRATES +=	unicode-segmentation	1.13.2	# MIT OR Apache-2.0
MODCARGO_CRATES +=	unicode-width	0.2.2	# MIT OR Apache-2.0
MODCARGO_CRATES +=	unicode-xid	0.2.6	# MIT OR Apache-2.0
MODCARGO_CRATES +=	universal-hash	0.5.1	# MIT OR Apache-2.0
MODCARGO_CRATES +=	untrusted	0.9.0	# ISC
MODCARGO_CRATES +=	url	2.5.8	# MIT OR Apache-2.0
MODCARGO_CRATES +=	urlencoding	2.1.3	# MIT
MODCARGO_CRATES +=	urlpattern	0.3.0	# MIT
MODCARGO_CRATES +=	utf-8	0.7.6	# MIT OR Apache-2.0
MODCARGO_CRATES +=	utf8-width	0.1.8	# MIT
MODCARGO_CRATES +=	utf8_iter	1.0.4	# Apache-2.0 OR MIT
MODCARGO_CRATES +=	utf8parse	0.2.2	# Apache-2.0 OR MIT
MODCARGO_CRATES +=	uuid	1.23.1	# Apache-2.0 OR MIT
MODCARGO_CRATES +=	uzers	0.12.2	# MIT
MODCARGO_CRATES +=	vcpkg	0.2.15	# MIT/Apache-2.0
MODCARGO_CRATES +=	version-compare	0.2.1	# MIT
MODCARGO_CRATES +=	version_check	0.9.5	# MIT/Apache-2.0
MODCARGO_CRATES +=	vswhom	0.1.0	# MIT
MODCARGO_CRATES +=	vswhom-sys	0.1.3	# MIT
MODCARGO_CRATES +=	walkdir	2.5.0	# Unlicense/MIT
MODCARGO_CRATES +=	want	0.3.1	# MIT
MODCARGO_CRATES +=	wasi	0.11.1+wasi-snapshot-preview1	# Apache-2.0 WITH LLVM-exception OR Apache-2.0 OR MIT
MODCARGO_CRATES +=	wasip2	1.0.3+wasi-0.2.9	# Apache-2.0 WITH LLVM-exception OR Apache-2.0 OR MIT
MODCARGO_CRATES +=	wasip3	0.4.0+wasi-0.3.0-rc-2026-01-06	# Apache-2.0 WITH LLVM-exception OR Apache-2.0 OR MIT
MODCARGO_CRATES +=	wasite	0.1.0	# Apache-2.0 OR BSL-1.0 OR MIT
MODCARGO_CRATES +=	wasm-bindgen	0.2.120	# MIT OR Apache-2.0
MODCARGO_CRATES +=	wasm-bindgen-futures	0.4.70	# MIT OR Apache-2.0
MODCARGO_CRATES +=	wasm-bindgen-macro	0.2.120	# MIT OR Apache-2.0
MODCARGO_CRATES +=	wasm-bindgen-macro-support	0.2.120	# MIT OR Apache-2.0
MODCARGO_CRATES +=	wasm-bindgen-shared	0.2.120	# MIT OR Apache-2.0
MODCARGO_CRATES +=	wasm-encoder	0.244.0	# Apache-2.0 WITH LLVM-exception OR Apache-2.0 OR MIT
MODCARGO_CRATES +=	wasm-metadata	0.244.0	# Apache-2.0 WITH LLVM-exception OR Apache-2.0 OR MIT
MODCARGO_CRATES +=	wasm-streams	0.4.2	# MIT OR Apache-2.0
MODCARGO_CRATES +=	wasm-streams	0.5.0	# MIT OR Apache-2.0
MODCARGO_CRATES +=	wasmparser	0.244.0	# Apache-2.0 WITH LLVM-exception OR Apache-2.0 OR MIT
MODCARGO_CRATES +=	web-sys	0.3.97	# MIT OR Apache-2.0
MODCARGO_CRATES +=	web_atoms	0.2.4	# MIT OR Apache-2.0
MODCARGO_CRATES +=	webbrowser	1.2.1	# MIT OR Apache-2.0
MODCARGO_CRATES +=	webkit2gtk	2.0.2	# MIT
MODCARGO_CRATES +=	webkit2gtk-sys	2.0.2	# MIT
MODCARGO_CRATES +=	webview2-com	0.38.2	# MIT
MODCARGO_CRATES +=	webview2-com-macros	0.8.1	# MIT
MODCARGO_CRATES +=	webview2-com-sys	0.38.2	# MIT
MODCARGO_CRATES +=	which	8.0.2	# MIT
MODCARGO_CRATES +=	whoami	1.6.1	# Apache-2.0 OR BSL-1.0 OR MIT
MODCARGO_CRATES +=	winapi	0.3.9	# MIT/Apache-2.0
MODCARGO_CRATES +=	winapi-i686-pc-windows-gnu	0.4.0	# MIT/Apache-2.0
MODCARGO_CRATES +=	winapi-util	0.1.11	# Unlicense OR MIT
MODCARGO_CRATES +=	winapi-x86_64-pc-windows-gnu	0.4.0	# MIT/Apache-2.0
MODCARGO_CRATES +=	window-vibrancy	0.6.0	# Apache-2.0 OR MIT
MODCARGO_CRATES +=	windows	0.61.3	# MIT OR Apache-2.0
MODCARGO_CRATES +=	windows-collections	0.2.0	# MIT OR Apache-2.0
MODCARGO_CRATES +=	windows-core	0.61.2	# MIT OR Apache-2.0
MODCARGO_CRATES +=	windows-core	0.62.2	# MIT OR Apache-2.0
MODCARGO_CRATES +=	windows-future	0.2.1	# MIT OR Apache-2.0
MODCARGO_CRATES +=	windows-implement	0.60.2	# MIT OR Apache-2.0
MODCARGO_CRATES +=	windows-interface	0.59.3	# MIT OR Apache-2.0
MODCARGO_CRATES +=	windows-link	0.1.3	# MIT OR Apache-2.0
MODCARGO_CRATES +=	windows-link	0.2.1	# MIT OR Apache-2.0
MODCARGO_CRATES +=	windows-numerics	0.2.0	# MIT OR Apache-2.0
MODCARGO_CRATES +=	windows-registry	0.6.1	# MIT OR Apache-2.0
MODCARGO_CRATES +=	windows-result	0.3.4	# MIT OR Apache-2.0
MODCARGO_CRATES +=	windows-result	0.4.1	# MIT OR Apache-2.0
MODCARGO_CRATES +=	windows-strings	0.4.2	# MIT OR Apache-2.0
MODCARGO_CRATES +=	windows-strings	0.5.1	# MIT OR Apache-2.0
MODCARGO_CRATES +=	windows-sys	0.45.0	# MIT OR Apache-2.0
MODCARGO_CRATES +=	windows-sys	0.52.0	# MIT OR Apache-2.0
MODCARGO_CRATES +=	windows-sys	0.59.0	# MIT OR Apache-2.0
MODCARGO_CRATES +=	windows-sys	0.60.2	# MIT OR Apache-2.0
MODCARGO_CRATES +=	windows-sys	0.61.2	# MIT OR Apache-2.0
MODCARGO_CRATES +=	windows-targets	0.42.2	# MIT OR Apache-2.0
MODCARGO_CRATES +=	windows-targets	0.52.6	# MIT OR Apache-2.0
MODCARGO_CRATES +=	windows-targets	0.53.5	# MIT OR Apache-2.0
MODCARGO_CRATES +=	windows-threading	0.1.0	# MIT OR Apache-2.0
MODCARGO_CRATES +=	windows-version	0.1.7	# MIT OR Apache-2.0
MODCARGO_CRATES +=	windows_aarch64_gnullvm	0.42.2	# MIT OR Apache-2.0
MODCARGO_CRATES +=	windows_aarch64_gnullvm	0.52.6	# MIT OR Apache-2.0
MODCARGO_CRATES +=	windows_aarch64_gnullvm	0.53.1	# MIT OR Apache-2.0
MODCARGO_CRATES +=	windows_aarch64_msvc	0.42.2	# MIT OR Apache-2.0
MODCARGO_CRATES +=	windows_aarch64_msvc	0.52.6	# MIT OR Apache-2.0
MODCARGO_CRATES +=	windows_aarch64_msvc	0.53.1	# MIT OR Apache-2.0
MODCARGO_CRATES +=	windows_i686_gnu	0.42.2	# MIT OR Apache-2.0
MODCARGO_CRATES +=	windows_i686_gnu	0.52.6	# MIT OR Apache-2.0
MODCARGO_CRATES +=	windows_i686_gnu	0.53.1	# MIT OR Apache-2.0
MODCARGO_CRATES +=	windows_i686_gnullvm	0.52.6	# MIT OR Apache-2.0
MODCARGO_CRATES +=	windows_i686_gnullvm	0.53.1	# MIT OR Apache-2.0
MODCARGO_CRATES +=	windows_i686_msvc	0.42.2	# MIT OR Apache-2.0
MODCARGO_CRATES +=	windows_i686_msvc	0.52.6	# MIT OR Apache-2.0
MODCARGO_CRATES +=	windows_i686_msvc	0.53.1	# MIT OR Apache-2.0
MODCARGO_CRATES +=	windows_x86_64_gnu	0.42.2	# MIT OR Apache-2.0
MODCARGO_CRATES +=	windows_x86_64_gnu	0.52.6	# MIT OR Apache-2.0
MODCARGO_CRATES +=	windows_x86_64_gnu	0.53.1	# MIT OR Apache-2.0
MODCARGO_CRATES +=	windows_x86_64_gnullvm	0.42.2	# MIT OR Apache-2.0
MODCARGO_CRATES +=	windows_x86_64_gnullvm	0.52.6	# MIT OR Apache-2.0
MODCARGO_CRATES +=	windows_x86_64_gnullvm	0.53.1	# MIT OR Apache-2.0
MODCARGO_CRATES +=	windows_x86_64_msvc	0.42.2	# MIT OR Apache-2.0
MODCARGO_CRATES +=	windows_x86_64_msvc	0.52.6	# MIT OR Apache-2.0
MODCARGO_CRATES +=	windows_x86_64_msvc	0.53.1	# MIT OR Apache-2.0
MODCARGO_CRATES +=	winnow	0.5.40	# MIT
MODCARGO_CRATES +=	winnow	0.7.15	# MIT
MODCARGO_CRATES +=	winnow	1.0.2	# MIT
MODCARGO_CRATES +=	winreg	0.55.0	# MIT
MODCARGO_CRATES +=	wit-bindgen	0.51.0	# Apache-2.0 WITH LLVM-exception OR Apache-2.0 OR MIT
MODCARGO_CRATES +=	wit-bindgen	0.57.1	# Apache-2.0 WITH LLVM-exception OR Apache-2.0 OR MIT
MODCARGO_CRATES +=	wit-bindgen-core	0.51.0	# Apache-2.0 WITH LLVM-exception OR Apache-2.0 OR MIT
MODCARGO_CRATES +=	wit-bindgen-rust	0.51.0	# Apache-2.0 WITH LLVM-exception OR Apache-2.0 OR MIT
MODCARGO_CRATES +=	wit-bindgen-rust-macro	0.51.0	# Apache-2.0 WITH LLVM-exception OR Apache-2.0 OR MIT
MODCARGO_CRATES +=	wit-component	0.244.0	# Apache-2.0 WITH LLVM-exception OR Apache-2.0 OR MIT
MODCARGO_CRATES +=	wit-parser	0.244.0	# Apache-2.0 WITH LLVM-exception OR Apache-2.0 OR MIT
MODCARGO_CRATES +=	writeable	0.6.3	# Unicode-3.0
MODCARGO_CRATES +=	wry	0.55.1	# Apache-2.0 OR MIT
MODCARGO_CRATES +=	x11	2.21.0	# MIT
MODCARGO_CRATES +=	x11-dl	2.21.0	# MIT
MODCARGO_CRATES +=	xattr	1.6.1	# MIT OR Apache-2.0
MODCARGO_CRATES +=	xml	1.2.1	# MIT
MODCARGO_CRATES +=	xmltree	0.12.0	# MIT
MODCARGO_CRATES +=	xz2	0.1.7	# MIT/Apache-2.0
MODCARGO_CRATES +=	yoke	0.8.2	# Unicode-3.0
MODCARGO_CRATES +=	yoke-derive	0.8.2	# Unicode-3.0
MODCARGO_CRATES +=	zerocopy	0.8.48	# BSD-2-Clause OR Apache-2.0 OR MIT
MODCARGO_CRATES +=	zerocopy-derive	0.8.48	# BSD-2-Clause OR Apache-2.0 OR MIT
MODCARGO_CRATES +=	zerofrom	0.1.7	# Unicode-3.0
MODCARGO_CRATES +=	zerofrom-derive	0.1.7	# Unicode-3.0
MODCARGO_CRATES +=	zeroize	1.8.2	# Apache-2.0 OR MIT
MODCARGO_CRATES +=	zerotrie	0.2.4	# Unicode-3.0
MODCARGO_CRATES +=	zerovec	0.11.6	# Unicode-3.0
MODCARGO_CRATES +=	zerovec-derive	0.11.3	# Unicode-3.0
MODCARGO_CRATES +=	zmij	1.0.21	# MIT
