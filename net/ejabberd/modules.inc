MODERL_PLUGINS =	provider_asn1		0.4.1 \
			rebar3_hex		7.0.8 \
			rebar3_fmt		1.18.0 \
			getopt			1.0.1 \
			verl			1.1.1 \
			pc			1.15.0 \
			providers		1.8.1 \
			hex_core		0.10.1

MODERL_MODULES =	cache_tab		1.0.34 \
			eimp			1.0.27 \
			epam			1.0.14 \
			eredis			1.7.1 \
			erlydtl			_none \
			esip			1.0.60 \
			ezlib			1.0.16 \
			fast_tls		1.1.26 \
			fast_xml		1.1.58 \
			fast_yaml		1.0.40 \
			idna			7.1.0 \
			jose			1.11.12 \
			luerl			1.2.3 \
			mqtree			1.0.20 \
			p1_acme			1.0.31 \
			p1_mysql		1.0.28 \
			p1_oauth2		0.6.14 \
			p1_pgsql		1.1.41 \
			p1_utils		1.0.29 \
			pkix			1.0.10 \
			sqlite3			1.1.15 \
			stringprep		1.0.34 \
			stun			1.2.22 \
			xmpp			1.13.1 \
			yconf			1.0.23
