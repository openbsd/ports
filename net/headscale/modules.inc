MODGO_MODULES =	\
	4d63.com/gocheckcompilerdirectives						 v1.2.1 \
	4d63.com/gochecknoglobals							 v0.2.1 \
	atomicgo.dev/assert								 v0.0.2 \
	atomicgo.dev/cursor								 v0.2.0 \
	atomicgo.dev/keyboard								 v0.2.9 \
	atomicgo.dev/schedule								 v0.1.0 \
	cel.dev/expr									 v0.20.0 \
	cloud.google.com/go								 v0.26.0 \
	cloud.google.com/go/compute/metadata						 v0.6.0 \
	dario.cat/mergo									 v1.0.1 \
	filippo.io/edwards25519								 v1.1.0 \
	filippo.io/mkcert								 v1.4.4 \
	fyne.io/systray									 v1.11.0 \
	github.com/!abirdcfly/dupword							 v0.0.14 \
	github.com/!alec!aivazis/survey/v2						 v2.3.7 \
	github.com/!alek!si/pointer							 v1.2.0 \
	github.com/!antonboom/errname							 v0.1.12 \
	github.com/!antonboom/nilnil							 v0.1.7 \
	github.com/!antonboom/testifylint						 v1.2.0 \
	github.com/!azure/go-ansiterm							 v0.0.0-20250102033503-faa5f7b0171c \
	github.com/!burnt!sushi/toml							 v1.4.1-0.20240526193622-a339e1f7089c \
	github.com/!djarvur/go-err113							 v0.1.0 \
	github.com/!gaijin!entertainment/go-exhaustruct/v3				 v3.2.0 \
	github.com/!google!cloud!platform/opentelemetry-operations-go/detectors/gcp	 v1.26.0 \
	github.com/!marvin!j!wendt/testza						 v0.5.2 \
	github.com/!masterminds/goutils							 v1.1.1 \
	github.com/!masterminds/semver							 v1.5.0 \
	github.com/!masterminds/semver/v3						 v3.2.1 \
	github.com/!masterminds/sprig							 v2.22.0+incompatible \
	github.com/!masterminds/sprig/v3						 v3.2.3 \
	github.com/!microsoft/go-winio							 v0.6.2 \
	github.com/!microsoft/hcsshim							 v0.9.12 \
	github.com/!netflix/go-expect							 v0.0.0-20220104043353-73e0943537d2 \
	github.com/!nvveen/!gotty							 v0.0.0-20120604004816-cd527374f1e5 \
	github.com/!open!pee!dee!p/depguard/v2						 v2.2.0 \
	github.com/!proton!mail/go-crypto						 v1.1.3 \
	github.com/4meepo/tagalign							 v1.3.3 \
	github.com/akutz/memconn							 v0.1.0 \
	github.com/alecthomas/go-check-sumtype						 v0.1.4 \
	github.com/alecthomas/kingpin/v2						 v2.4.0 \
	github.com/alecthomas/units							 v0.0.0-20211218093645-b94a6e3cc137 \
	github.com/alexbrainman/sspi							 v0.0.0-20231016080023-1a75b4708caa \
	github.com/alexkohler/nakedret/v2						 v2.0.4 \
	github.com/alexkohler/prealloc							 v1.0.0 \
	github.com/alingse/asasalint							 v0.0.11 \
	github.com/andybalholm/brotli							 v1.1.0 \
	github.com/anmitsu/go-shlex							 v0.0.0-20200514113438-38f4b401e2be \
	github.com/antihax/optional							 v1.0.0 \
	github.com/arl/statsviz								 v0.6.0 \
	github.com/ashanbrown/forbidigo							 v1.6.0 \
	github.com/ashanbrown/makezero							 v1.1.1 \
	github.com/atomicgo/cursor							 v0.0.1 \
	github.com/atotto/clipboard							 v0.1.4 \
	github.com/aws/aws-sdk-go							 v1.44.267 \
	github.com/aws/aws-sdk-go-v2							 v1.36.0 \
	github.com/aws/aws-sdk-go-v2/aws/protocol/eventstream				 v1.6.8 \
	github.com/aws/aws-sdk-go-v2/config						 v1.29.5 \
	github.com/aws/aws-sdk-go-v2/credentials					 v1.17.58 \
	github.com/aws/aws-sdk-go-v2/feature/ec2/imds					 v1.16.27 \
	github.com/aws/aws-sdk-go-v2/feature/s3/manager					 v1.17.58 \
	github.com/aws/aws-sdk-go-v2/internal/configsources				 v1.3.31 \
	github.com/aws/aws-sdk-go-v2/internal/endpoints/v2				 v2.6.31 \
	github.com/aws/aws-sdk-go-v2/internal/ini					 v1.8.2 \
	github.com/aws/aws-sdk-go-v2/internal/v4a					 v1.3.31 \
	github.com/aws/aws-sdk-go-v2/service/internal/accept-encoding			 v1.12.2 \
	github.com/aws/aws-sdk-go-v2/service/internal/checksum				 v1.5.5 \
	github.com/aws/aws-sdk-go-v2/service/internal/presigned-url			 v1.12.12 \
	github.com/aws/aws-sdk-go-v2/service/internal/s3shared				 v1.18.12 \
	github.com/aws/aws-sdk-go-v2/service/s3						 v1.75.3 \
	github.com/aws/aws-sdk-go-v2/service/ssm					 v1.45.0 \
	github.com/aws/aws-sdk-go-v2/service/sso					 v1.24.14 \
	github.com/aws/aws-sdk-go-v2/service/ssooidc					 v1.28.13 \
	github.com/aws/aws-sdk-go-v2/service/sts					 v1.33.13 \
	github.com/aws/smithy-go							 v1.22.2 \
	github.com/bazelbuild/rules_go							 v0.44.2 \
	github.com/benbjohnson/clock							 v1.1.0 \
	github.com/beorn7/perks								 v1.0.1 \
	github.com/bkielbasa/cyclop							 v1.2.1 \
	github.com/blakesmith/ar							 v0.0.0-20190502131153-809d4375e1fb \
	github.com/blizzy78/varnamelen							 v0.8.0 \
	github.com/bombsimon/wsl/v4							 v4.2.1 \
	github.com/bramvdbogaerde/go-scp						 v1.4.0 \
	github.com/breml/bidichk							 v0.2.7 \
	github.com/breml/errchkjson							 v0.3.6 \
	github.com/butuzov/ireturn							 v0.3.0 \
	github.com/butuzov/mirror							 v1.1.0 \
	github.com/catenacyber/perfsprint						 v0.7.1 \
	github.com/cavaliergopher/cpio							 v1.0.1 \
	github.com/ccojocar/zxcvbn-go							 v1.0.2 \
	github.com/cenkalti/backoff							 v2.2.1+incompatible \
	github.com/cenkalti/backoff/v4							 v4.3.0 \
	github.com/census-instrumentation/opencensus-proto				 v0.2.1 \
	github.com/cespare/xxhash/v2							 v2.3.0 \
	github.com/charithe/durationcheck						 v0.0.10 \
	github.com/chasefleming/elem-go							 v0.30.0 \
	github.com/chavacava/garif							 v0.1.0 \
	github.com/checkpoint-restore/go-criu/v6					 v6.3.0 \
	github.com/chromedp/cdproto							 v0.0.0-20230802225258-3cf4e6d46a89 \
	github.com/chromedp/chromedp							 v0.9.2 \
	github.com/chromedp/sysutil							 v1.0.0 \
	github.com/chzyer/logex								 v1.2.1 \
	github.com/chzyer/readline							 v1.5.1 \
	github.com/chzyer/test								 v1.0.0 \
	github.com/cilium/ebpf								 v0.17.3 \
	github.com/ckaznocha/intrange							 v0.1.0 \
	github.com/client9/misspell							 v0.3.4 \
	github.com/cloudflare/circl							 v1.3.7 \
	github.com/cncf/udpa/go								 v0.0.0-20191209042840-269d4d468f6f \
	github.com/cncf/xds/go								 v0.0.0-20250121191232-2f005788dc42 \
	github.com/coder/websocket							 v1.8.13 \
	github.com/containerd/cgroups							 v1.0.4 \
	github.com/containerd/console							 v1.0.4 \
	github.com/containerd/containerd						 v1.6.36 \
	github.com/containerd/continuity						 v0.4.5 \
	github.com/containerd/errdefs							 v0.1.0 \
	github.com/containerd/fifo							 v1.0.0 \
	github.com/containerd/go-runc							 v1.0.0 \
	github.com/containerd/log							 v0.1.0 \
	github.com/containerd/stargz-snapshotter/estargz				 v0.16.3 \
	github.com/containerd/ttrpc							 v1.1.2 \
	github.com/containerd/typeurl							 v1.0.2 \
	github.com/coreos/go-iptables							 v0.7.1-0.20240112124308-65c67c9f46e6 \
	github.com/coreos/go-oidc/v3							 v3.14.1 \
	github.com/coreos/go-systemd							 v0.0.0-20191104093116-d3cd4ed1dbcf \
	github.com/coreos/go-systemd/v22						 v22.5.0 \
	github.com/cpuguy83/go-md2man/v2						 v2.0.6 \
	github.com/creachadair/command							 v0.1.20 \
	github.com/creachadair/ctrl							 v0.1.1 \
	github.com/creachadair/flax							 v0.0.4 \
	github.com/creachadair/mds							 v0.24.1 \
	github.com/creachadair/taskgroup						 v0.13.2 \
	github.com/creack/pty								 v1.1.23 \
	github.com/curioswitch/go-reassign						 v0.2.0 \
	github.com/cyphar/filepath-securejoin						 v0.4.1 \
	github.com/daixiang0/gci							 v0.12.3 \
	github.com/davecgh/go-spew							 v1.1.2-0.20180830191138-d8f796af33cc \
	github.com/dblohm7/wingoes							 v0.0.0-20240123200102-b75a8a7d7eb0 \
	github.com/denis-tingaikin/go-header						 v0.5.0 \
	github.com/digitalocean/go-smbios						 v0.0.0-20180907143718-390a4f403a8e \
	github.com/distribution/reference						 v0.6.0 \
	github.com/djherbis/times							 v1.6.0 \
	github.com/docker/cli								 v28.1.1+incompatible \
	github.com/docker/distribution							 v2.8.3+incompatible \
	github.com/docker/docker							 v28.1.1+incompatible \
	github.com/docker/docker-credential-helpers					 v0.8.2 \
	github.com/docker/go-connections						 v0.5.0 \
	github.com/docker/go-events							 v0.0.0-20190806004212-e31b211e4f1c \
	github.com/docker/go-units							 v0.5.0 \
	github.com/dsnet/try								 v0.0.3 \
	github.com/dustin/go-humanize							 v1.0.1 \
	github.com/dvyukov/go-fuzz							 v0.0.0-20210103155950-6a8e9d1f2415 \
	github.com/elastic/crd-ref-docs							 v0.0.12 \
	github.com/emicklei/go-restful/v3						 v3.11.2 \
	github.com/emirpasic/gods							 v1.18.1 \
	github.com/envoyproxy/go-control-plane						 v0.13.4 \
	github.com/envoyproxy/go-control-plane/envoy					 v1.32.4 \
	github.com/envoyproxy/go-control-plane/ratelimit				 v0.1.0 \
	github.com/envoyproxy/protoc-gen-validate					 v1.2.1 \
	github.com/ettle/strcase							 v0.2.0 \
	github.com/evanphx/json-patch/v5						 v5.9.0 \
	github.com/evanw/esbuild							 v0.19.11 \
	github.com/fanliao/go-promise							 v0.0.0-20141029170127-1890db352a72 \
	github.com/fatih/color								 v1.18.0 \
	github.com/fatih/structtag							 v1.2.0 \
	github.com/felixge/fgprof							 v0.9.5 \
	github.com/felixge/httpsnoop							 v1.0.4 \
	github.com/firefart/nonamedreturns						 v1.0.4 \
	github.com/fogleman/gg								 v1.3.0 \
	github.com/frankban/quicktest							 v1.14.6 \
	github.com/fsnotify/fsnotify							 v1.9.0 \
	github.com/fxamacker/cbor/v2							 v2.7.0 \
	github.com/fzipp/gocyclo							 v0.6.0 \
	github.com/gaissmai/bart							 v0.18.0 \
	github.com/ghostiam/protogetter							 v0.3.5 \
	github.com/github/fakeca							 v0.1.0 \
	github.com/glebarez/go-sqlite							 v1.22.0 \
	github.com/glebarez/sqlite							 v1.11.0 \
	github.com/go-critic/go-critic							 v0.11.2 \
	github.com/go-git/gcfg								 v1.5.1-0.20230307220236-3a3c6141e376 \
	github.com/go-git/go-billy/v5							 v5.6.1 \
	github.com/go-git/go-git/v5							 v5.13.1 \
	github.com/go-gormigrate/gormigrate/v2						 v2.1.4 \
	github.com/go-jose/go-jose/v3							 v3.0.4 \
	github.com/go-jose/go-jose/v4							 v4.1.0 \
	github.com/go-json-experiment/json						 v0.0.0-20250223041408-d3c622f1b874 \
	github.com/go-kit/log								 v0.1.0 \
	github.com/go-logfmt/logfmt							 v0.5.0 \
	github.com/go-logr/logr								 v1.4.2 \
	github.com/go-logr/stdr								 v1.2.2 \
	github.com/go-logr/zapr								 v1.3.0 \
	github.com/go-ole/go-ole							 v1.3.0 \
	github.com/go-openapi/jsonpointer						 v0.21.0 \
	github.com/go-openapi/jsonreference						 v0.20.4 \
	github.com/go-openapi/swag							 v0.23.0 \
	github.com/go-sql-driver/mysql							 v1.8.1 \
	github.com/go-stack/stack							 v1.8.0 \
	github.com/go-toolsmith/astcast							 v1.1.0 \
	github.com/go-toolsmith/astcopy							 v1.1.0 \
	github.com/go-toolsmith/astequal						 v1.2.0 \
	github.com/go-toolsmith/astfmt							 v1.1.0 \
	github.com/go-toolsmith/astp							 v1.1.0 \
	github.com/go-toolsmith/strparse						 v1.1.0 \
	github.com/go-toolsmith/typep							 v1.1.0 \
	github.com/go-viper/mapstructure/v2						 v2.2.1 \
	github.com/go-xmlfmt/xmlfmt							 v1.1.2 \
	github.com/gobuffalo/flect							 v1.0.3 \
	github.com/gobwas/glob								 v0.2.3 \
	github.com/gobwas/httphead							 v0.1.0 \
	github.com/gobwas/pool								 v0.2.1 \
	github.com/gobwas/ws								 v1.2.1 \
	github.com/goccy/go-yaml							 v1.12.0 \
	github.com/godbus/dbus/v5							 v5.1.1-0.20230522191255-76236955d466 \
	github.com/gofrs/flock								 v0.8.1 \
	github.com/gofrs/uuid/v5							 v5.3.2 \
	github.com/gogo/googleapis							 v1.4.0 \
	github.com/gogo/protobuf							 v1.3.2 \
	github.com/golang-jwt/jwt/v5							 v5.2.2 \
	github.com/golang/freetype							 v0.0.0-20170609003504-e2365dfdc4a0 \
	github.com/golang/glog								 v1.2.4 \
	github.com/golang/groupcache							 v0.0.0-20210331224755-41bb18bfe9da \
	github.com/golang/mock								 v1.7.0-rc.1 \
	github.com/golang/protobuf							 v1.5.4 \
	github.com/golang/snappy							 v0.0.4 \
	github.com/golangci/dupl							 v0.0.0-20180902072040-3e9179ac440a \
	github.com/golangci/gofmt							 v0.0.0-20231018234816-f50ced29576e \
	github.com/golangci/golangci-lint						 v1.57.1 \
	github.com/golangci/misspell							 v0.4.1 \
	github.com/golangci/plugin-module-register					 v0.1.1 \
	github.com/golangci/revgrep							 v0.5.2 \
	github.com/golangci/unconvert							 v0.0.0-20240309020433-c5143eacb3ed \
	github.com/google/btree								 v1.1.2 \
	github.com/google/gnostic-models						 v0.6.9-0.20230804172637-c7be7c783f49 \
	github.com/google/go-cmp							 v0.7.0 \
	github.com/google/go-containerregistry						 v0.20.2 \
	github.com/google/go-github							 v17.0.0+incompatible \
	github.com/google/go-github/v56							 v56.0.0 \
	github.com/google/go-querystring						 v1.1.0 \
	github.com/google/gofuzz							 v1.2.0 \
	github.com/google/gopacket							 v1.1.19 \
	github.com/google/goterm							 v0.0.0-20200907032337-555d40f16ae2 \
	github.com/google/nftables							 v0.2.1-0.20240414091927-5e242ec57806 \
	github.com/google/pprof								 v0.0.0-20250501235452-c0086092b71a \
	github.com/google/rpmpack							 v0.5.0 \
	github.com/google/shlex								 v0.0.0-20191202100458-e7afc7fbc510 \
	github.com/google/subcommands							 v1.0.2-0.20190508160503-636abe8753b8 \
	github.com/google/uuid								 v1.6.0 \
	github.com/googleapis/gnostic							 v0.5.5 \
	github.com/gookit/color								 v1.5.4 \
	github.com/gordonklaus/ineffassign						 v0.1.0 \
	github.com/goreleaser/chglog							 v0.5.0 \
	github.com/goreleaser/fileglob							 v1.3.0 \
	github.com/goreleaser/nfpm/v2							 v2.33.1 \
	github.com/gorilla/csrf								 v1.7.3 \
	github.com/gorilla/mux								 v1.8.1 \
	github.com/gorilla/securecookie							 v1.1.2 \
	github.com/gorilla/websocket							 v1.5.3 \
	github.com/gostaticanalysis/analysisutil					 v0.7.1 \
	github.com/gostaticanalysis/comment						 v1.4.2 \
	github.com/gostaticanalysis/forcetypeassert					 v0.1.0 \
	github.com/gostaticanalysis/nilerr						 v0.1.1 \
	github.com/grpc-ecosystem/go-grpc-middleware					 v1.4.0 \
	github.com/grpc-ecosystem/grpc-gateway/v2					 v2.26.3 \
	github.com/hanwen/go-fuse/v2							 v2.3.0 \
	github.com/hashicorp/errwrap							 v1.1.0 \
	github.com/hashicorp/go-multierror						 v1.1.1 \
	github.com/hashicorp/go-version							 v1.7.0 \
	github.com/hashicorp/golang-lru/v2						 v2.0.7 \
	github.com/hashicorp/hcl							 v1.0.0 \
	github.com/hdevalence/ed25519consensus						 v0.2.0 \
	github.com/hexops/gotextdiff							 v1.0.3 \
	github.com/hinshun/vt10x							 v0.0.0-20220119200601-820417d04eec \
	github.com/huandu/xstrings							 v1.5.0 \
	github.com/hugelgupf/socketpair							 v0.0.0-20190730060125-05d35a94e714 \
	github.com/ianlancetaylor/demangle						 v0.0.0-20250417193237-f615e6bd150b \
	github.com/illarion/gonotify/v3							 v3.0.2 \
	github.com/imdario/mergo							 v0.3.16 \
	github.com/inconshreveable/mousetrap						 v1.1.0 \
	github.com/inetaf/tcpproxy							 v0.0.0-20250203165043-ded522cbd03f \
	github.com/insomniacslk/dhcp							 v0.0.0-20240129002554-15c9b8791914 \
	github.com/jackc/pgpassfile							 v1.0.0 \
	github.com/jackc/pgservicefile							 v0.0.0-20240606120523-5a60cdf6a761 \
	github.com/jackc/pgx/v5								 v5.7.4 \
	github.com/jackc/puddle/v2							 v2.2.2 \
	github.com/jagottsicher/termcolor						 v1.0.2 \
	github.com/jbenet/go-context							 v0.0.0-20150711004518-d14ea06fba99 \
	github.com/jellydator/ttlcache/v3						 v3.1.0 \
	github.com/jgautheron/goconst							 v1.7.0 \
	github.com/jingyugao/rowserrcheck						 v1.1.1 \
	github.com/jinzhu/inflection							 v1.0.0 \
	github.com/jinzhu/now								 v1.1.5 \
	github.com/jirfag/go-printf-func-name						 v0.0.0-20200119135958-7558a9eaa5af \
	github.com/jjti/go-spancheck							 v0.5.3 \
	github.com/jmespath/go-jmespath							 v0.4.0 \
	github.com/jmespath/go-jmespath/internal/testify				 v1.5.1 \
	github.com/josharian/intern							 v1.0.0 \
	github.com/josharian/native							 v1.1.0 \
	github.com/jpillora/backoff							 v1.0.0 \
	github.com/jsimonetti/rtnetlink							 v1.4.1 \
	github.com/json-iterator/go							 v1.1.12 \
	github.com/julienschmidt/httprouter						 v1.3.0 \
	github.com/julz/importas							 v0.1.0 \
	github.com/karamaru-alpha/copyloopvar						 v1.0.8 \
	github.com/kballard/go-shellquote						 v0.0.0-20180428030007-95032a82bc51 \
	github.com/kevinburke/ssh_config						 v1.2.0 \
	github.com/kisielk/errcheck							 v1.7.0 \
	github.com/kisielk/gotool							 v1.0.0 \
	github.com/kk!h!a!i!k!e/contextcheck						 v1.1.4 \
	github.com/klauspost/compress							 v1.18.0 \
	github.com/klauspost/cpuid/v2							 v2.2.3 \
	github.com/klauspost/pgzip							 v1.2.6 \
	github.com/konsorten/go-windows-terminal-sequences				 v1.0.1 \
	github.com/kortschak/wol							 v0.0.0-20200729010619-da482cc4850a \
	github.com/kr/fs								 v0.1.0 \
	github.com/kr/pretty								 v0.3.1 \
	github.com/kr/pty								 v1.1.5 \
	github.com/kr/text								 v0.2.0 \
	github.com/kulti/thelper							 v0.6.3 \
	github.com/kunwardeep/paralleltest						 v1.0.10 \
	github.com/kylelemons/godebug							 v1.1.0 \
	github.com/kyoh86/exportloopref							 v0.1.11 \
	github.com/ldez/gomoddirectives							 v0.2.3 \
	github.com/ldez/tagliatelle							 v0.5.0 \
	github.com/ledongthuc/pdf							 v0.0.0-20220302134840-0c2507a12d80 \
	github.com/leonklingele/grouper							 v1.1.1 \
	github.com/lib/pq								 v1.10.9 \
	github.com/lithammer/fuzzysearch						 v1.1.8 \
	github.com/lufeee/execinquery							 v1.2.1 \
	github.com/lxn/walk								 v0.0.0-20210112085537-c389da54e794 \
	github.com/lxn/win								 v0.0.0-20210218163916-a377121e959e \
	github.com/macabu/inamedparam							 v0.1.3 \
	github.com/magiconair/properties						 v1.8.7 \
	github.com/mailru/easyjson							 v0.7.7 \
	github.com/maratori/testableexamples						 v1.0.0 \
	github.com/maratori/testpackage							 v1.1.1 \
	github.com/matoous/godox							 v0.0.0-20230222163458-006bad1f9d26 \
	github.com/mattbaird/jsonpatch							 v0.0.0-20171005235357-81af80346b1a \
	github.com/mattn/go-colorable							 v0.1.14 \
	github.com/mattn/go-isatty							 v0.0.20 \
	github.com/mattn/go-runewidth							 v0.0.16 \
	github.com/mdlayher/genetlink							 v1.3.2 \
	github.com/mdlayher/netlink							 v1.7.3-0.20250113171957-fbb4dce95f42 \
	github.com/mdlayher/packet							 v1.1.2 \
	github.com/mdlayher/sdnotify							 v1.0.0 \
	github.com/mdlayher/socket							 v0.5.0 \
	github.com/mgechev/revive							 v1.3.7 \
	github.com/mgutz/ansi								 v0.0.0-20200706080929-d51e80ef957d \
	github.com/miekg/dns								 v1.1.58 \
	github.com/mitchellh/copystructure						 v1.2.0 \
	github.com/mitchellh/go-homedir							 v1.1.0 \
	github.com/mitchellh/go-ps							 v1.0.0 \
	github.com/mitchellh/mapstructure						 v1.5.0 \
	github.com/mitchellh/reflectwalk						 v1.0.2 \
	github.com/moby/docker-image-spec						 v1.3.1 \
	github.com/moby/locker								 v1.0.1 \
	github.com/moby/sys/capability							 v0.4.0 \
	github.com/moby/sys/mountinfo							 v0.7.2 \
	github.com/moby/sys/signal							 v0.6.0 \
	github.com/moby/sys/user							 v0.4.0 \
	github.com/moby/sys/userns							 v0.1.0 \
	github.com/moby/term								 v0.5.2 \
	github.com/modern-go/concurrent							 v0.0.0-20180306012644-bacd9c7ef1dd \
	github.com/modern-go/reflect2							 v1.0.2 \
	github.com/mohae/deepcopy							 v0.0.0-20170308212314-bb9b5e7adda9 \
	github.com/moricho/tparallel							 v0.3.1 \
	github.com/mrunalp/fileutils							 v0.5.1 \
	github.com/munnerz/goautoneg							 v0.0.0-20191010083416-a7dc8b61c822 \
	github.com/mwitkow/go-conntrack							 v0.0.0-20190716064945-2f068394615f \
	github.com/nakabonne/nestif							 v0.3.1 \
	github.com/ncruces/go-strftime							 v0.1.9 \
	github.com/nfnt/resize								 v0.0.0-20180221191011-83c6a9932646 \
	github.com/niemeyer/pretty							 v0.0.0-20200227124842-a10e7caefd8e \
	github.com/nishanths/exhaustive							 v0.12.0 \
	github.com/nishanths/predeclared						 v0.2.2 \
	github.com/nunnatsa/ginkgolinter						 v0.16.1 \
	github.com/oauth2-proxy/mockoidc						 v0.0.0-20240214162133-caebfff84d25 \
	github.com/olekukonko/tablewriter						 v0.0.5 \
	github.com/opencontainers/cgroups						 v0.0.1 \
	github.com/opencontainers/go-digest						 v1.0.0 \
	github.com/opencontainers/image-spec						 v1.1.1 \
	github.com/opencontainers/runc							 v1.3.0 \
	github.com/opencontainers/runtime-spec						 v1.2.1 \
	github.com/opencontainers/selinux						 v1.11.1 \
	github.com/opentracing/opentracing-go						 v1.1.0 \
	github.com/orisano/pixelmatch							 v0.0.0-20220722002657-fb0b55479cde \
	github.com/ory/dockertest/v3							 v3.12.0 \
	github.com/pelletier/go-toml/v2							 v2.2.4 \
	github.com/peterbourgon/ff/v3							 v3.4.0 \
	github.com/petermattis/goid							 v0.0.0-20250319124200-ccd6737f222a \
	github.com/philip-bui/grpc-zerolog						 v1.0.1 \
	github.com/pierrec/lz4/v4							 v4.1.21 \
	github.com/pjbgf/sha1cd								 v0.3.0 \
	github.com/pkg/diff								 v0.0.0-20210226163009-20ebb0f2a09e \
	github.com/pkg/errors								 v0.9.1 \
	github.com/pkg/profile								 v1.7.0 \
	github.com/pkg/sftp								 v1.13.6 \
	github.com/planetscale/vtprotobuf						 v0.6.1-0.20240319094008-0393e58bdf10 \
	github.com/pmezard/go-difflib							 v1.0.1-0.20181226105442-5d4384ee4fb2 \
	github.com/polyfloyd/go-errorlint						 v1.4.8 \
	github.com/prometheus-community/pro-bing					 v0.4.0 \
	github.com/prometheus/client_golang						 v1.22.0 \
	github.com/prometheus/client_model						 v0.6.1 \
	github.com/prometheus/common							 v0.63.0 \
	github.com/prometheus/procfs							 v0.15.1 \
	github.com/prometheus/prometheus						 v0.49.2-0.20240125131847-c3b8ef1694ff \
	github.com/pterm/pterm								 v0.12.80 \
	github.com/puzpuzpuz/xsync/v3							 v3.5.1 \
	github.com/quasilyte/go-ruleguard						 v0.4.2 \
	github.com/quasilyte/gogrep							 v0.5.0 \
	github.com/quasilyte/regex/syntax						 v0.0.0-20210819130434-b3f0c404a727 \
	github.com/quasilyte/stdinfo							 v0.0.0-20220114132959-f7386bf02567 \
	github.com/remyoudompheng/bigfft						 v0.0.0-20230129092748-24d4a6f8daec \
	github.com/rivo/uniseg								 v0.4.7 \
	github.com/rogpeppe/fastuuid							 v1.2.0 \
	github.com/rogpeppe/go-internal							 v1.14.1 \
	github.com/rs/xid								 v1.6.0 \
	github.com/rs/zerolog								 v1.34.0 \
	github.com/russross/blackfriday							 v1.6.0 \
	github.com/russross/blackfriday/v2						 v2.1.0 \
	github.com/ryancurrah/gomodguard						 v1.3.1 \
	github.com/ryanrolds/sqlclosecheck						 v0.5.1 \
	github.com/safchain/ethtool							 v0.3.0 \
	github.com/sagikazarmark/locafero						 v0.9.0 \
	github.com/samber/lo								 v1.50.0 \
	github.com/sanposhiho/wastedassign/v2						 v2.0.7 \
	github.com/santhosh-tekuri/jsonschema/v5					 v5.3.1 \
	github.com/sasha-s/go-deadlock							 v0.3.5 \
	github.com/sashamelentyev/interfacebloat					 v1.1.0 \
	github.com/sashamelentyev/usestdlibvars						 v1.25.0 \
	github.com/seccomp/libseccomp-golang						 v0.10.0 \
	github.com/securego/gosec/v2							 v2.19.0 \
	github.com/sergi/go-diff							 v1.3.2-0.20230802210424-5b0b94c5c0d3 \
	github.com/shazow/go-diff							 v0.0.0-20160112020656-b6b7b6733b8c \
	github.com/shopspring/decimal							 v1.3.1 \
	github.com/sirupsen/logrus							 v1.9.3 \
	github.com/sivchari/containedctx						 v1.0.3 \
	github.com/sivchari/tenv							 v1.7.1 \
	github.com/skeema/knownhosts							 v1.3.0 \
	github.com/skip2/go-qrcode							 v0.0.0-20200617195104-da1b6568686e \
	github.com/smartystreets/goconvey						 v1.6.4 \
	github.com/sonatard/noctx							 v0.0.2 \
	github.com/sourcegraph/conc							 v0.3.0 \
	github.com/sourcegraph/go-diff							 v0.7.0 \
	github.com/spf13/afero								 v1.14.0 \
	github.com/spf13/cast								 v1.8.0 \
	github.com/spf13/cobra								 v1.9.1 \
	github.com/spf13/jwalterweatherman						 v1.1.0 \
	github.com/spf13/pflag								 v1.0.6 \
	github.com/spf13/viper								 v1.20.1 \
	github.com/spiffe/go-spiffe/v2							 v2.5.0 \
	github.com/ssgreg/nlreturn/v2							 v2.2.1 \
	github.com/stbenjam/no-sprintf-host-port					 v0.1.1 \
	github.com/stretchr/objx							 v0.5.2 \
	github.com/stretchr/testify							 v1.10.0 \
	github.com/studio-b12/gowebdav							 v0.9.0 \
	github.com/subosito/gotenv							 v1.6.0 \
	github.com/syndtr/gocapability							 v0.0.0-20200815063812-42c35b437635 \
	github.com/t-yuki/gocover-cobertura						 v0.0.0-20180217150009-aaee18c8195c \
	github.com/tailscale/certstore							 v0.1.1-0.20231202035212-d3fa0460f47e \
	github.com/tailscale/depaware							 v0.0.0-20250112153213-b748de04d81b \
	github.com/tailscale/go-winio							 v0.0.0-20231025203758-c4f33415bf55 \
	github.com/tailscale/goexpect							 v0.0.0-20210902213824-6e8c725cea41 \
	github.com/tailscale/golang-x-crypto						 v0.0.0-20250218230618-9a281fd8faca \
	github.com/tailscale/goupnp							 v1.0.1-0.20210804011211-c64d0f06ea05 \
	github.com/tailscale/hujson							 v0.0.0-20250226034555-ec1d1c113d33 \
	github.com/tailscale/mkctr							 v0.0.0-20250228050937-c75ea1476830 \
	github.com/tailscale/netlink							 v1.1.1-0.20240822203006-4d49adab4de7 \
	github.com/tailscale/peercred							 v0.0.0-20250107143737-35a0c7bd7edc \
	github.com/tailscale/setec							 v0.0.0-20250305161714-445cadbbca3d \
	github.com/tailscale/squibble							 v0.0.0-20250108170732-a4ca58afa694 \
	github.com/tailscale/tailsql							 v0.0.0-20250421235516-02f85f087b97 \
	github.com/tailscale/web-client-prebuilt					 v0.0.0-20250124233751-d4cd19a26976 \
	github.com/tailscale/wf								 v0.0.0-20240214030419-6fbb0a674ee6 \
	github.com/tailscale/wireguard-go						 v0.0.0-20250107165329-0b8b35511f19 \
	github.com/tailscale/xnet							 v0.0.0-20240729143630-8497ac4dab2e \
	github.com/tc-hib/winres							 v0.2.1 \
	github.com/tcnksm/go-httpstat							 v0.2.0 \
	github.com/tcnksm/go-latest							 v0.0.0-20170313132115-e3007ae9052e \
	github.com/tdakkota/asciicheck							 v0.2.0 \
	github.com/tetafro/godot							 v1.4.16 \
	github.com/timakin/bodyclose							 v0.0.0-20230421092635-574207250966 \
	github.com/timonwong/loggercheck						 v0.9.4 \
	github.com/tink-crypto/tink-go-awskms						 v0.0.0-20230616072154-ba4f9f22c3e9 \
	github.com/tink-crypto/tink-go/v2						 v2.1.0 \
	github.com/tomarrell/wrapcheck/v2						 v2.8.3 \
	github.com/tommy-muehle/go-mnd/v2						 v2.5.1 \
	github.com/toqueteos/webbrowser							 v1.2.0 \
	github.com/u-root/u-root							 v0.12.0 \
	github.com/u-root/uio								 v0.0.0-20240224005618-d2acac8f3701 \
	github.com/ulikunitz/xz								 v0.5.11 \
	github.com/ultraware/funlen							 v0.1.0 \
	github.com/ultraware/whitespace							 v0.1.0 \
	github.com/urfave/cli								 v1.22.16 \
	github.com/uudashr/gocognit							 v1.1.2 \
	github.com/vbatts/tar-split							 v0.11.6 \
	github.com/vishvananda/netlink							 v1.3.0 \
	github.com/vishvananda/netns							 v0.0.4 \
	github.com/x448/float16								 v0.8.4 \
	github.com/xanzy/ssh-agent							 v0.3.3 \
	github.com/xeipuuv/gojsonpointer						 v0.0.0-20190905194746-02993c407bfb \
	github.com/xeipuuv/gojsonreference						 v0.0.0-20180127040603-bd5ef7bd5415 \
	github.com/xeipuuv/gojsonschema							 v1.2.0 \
	github.com/xen0n/gosmopolitan							 v1.2.2 \
	github.com/xhit/go-str2duration/v2						 v2.1.0 \
	github.com/xo/terminfo								 v0.0.0-20220910002029-abceb7e1c41e \
	github.com/yagipy/maintidx							 v1.0.0 \
	github.com/yeya24/promlinter							 v0.2.0 \
	github.com/ykadowak/zerologlint							 v0.1.5 \
	github.com/yuin/goldmark							 v1.4.13 \
	github.com/zeebo/errs								 v1.4.0 \
	gitlab.com/bosi/decorder							 v0.4.1 \
	gitlab.com/digitalxero/go-conventional-commit					 v1.0.7 \
	go-simpler.org/musttag								 v0.9.0 \
	go-simpler.org/sloglint								 v0.5.0 \
	go.opencensus.io								 v0.24.0 \
	go.opentelemetry.io/auto/sdk							 v1.1.0 \
	go.opentelemetry.io/contrib/detectors/gcp					 v1.34.0 \
	go.opentelemetry.io/contrib/instrumentation/net/http/otelhttp			 v0.58.0 \
	go.opentelemetry.io/otel							 v1.34.0 \
	go.opentelemetry.io/otel/metric							 v1.34.0 \
	go.opentelemetry.io/otel/sdk							 v1.34.0 \
	go.opentelemetry.io/otel/sdk/metric						 v1.34.0 \
	go.opentelemetry.io/otel/trace							 v1.34.0 \
	go.uber.org/atomic								 v1.9.0 \
	go.uber.org/automaxprocs							 v1.5.3 \
	go.uber.org/goleak								 v1.1.10 \
	go.uber.org/multierr								 v1.11.0 \
	go.uber.org/zap									 v1.27.0 \
	go4.org/mem									 v0.0.0-20240501181205-ae6ca9944745 \
	go4.org/netipx									 v0.0.0-20231129151722-fdeea329fbba \
	golang.org/x/crypto								 v0.37.0 \
	golang.org/x/exp								 v0.0.0-20250408133849-7e4ce0ab07d0 \
	golang.org/x/exp/typeparams							 v0.0.0-20240314144324-c7f7c6466f7f \
	golang.org/x/image								 v0.24.0 \
	golang.org/x/lint								 v0.0.0-20190930215403-16217165b5de \
	golang.org/x/mod								 v0.24.0 \
	golang.org/x/net								 v0.39.0 \
	golang.org/x/oauth2								 v0.29.0 \
	golang.org/x/sync								 v0.13.0 \
	golang.org/x/sys								 v0.32.0 \
	golang.org/x/telemetry								 v0.0.0-20240521205824-bda55230c457 \
	golang.org/x/term								 v0.31.0 \
	golang.org/x/text								 v0.24.0 \
	golang.org/x/time								 v0.10.0 \
	golang.org/x/tools								 v0.32.0 \
	golang.org/x/xerrors								 v0.0.0-20240716161551-93cc26a95ae9 \
	golang.zx2c4.com/wintun								 v0.0.0-20230126152724-0fa3db229ce2 \
	golang.zx2c4.com/wireguard/windows						 v0.5.3 \
	gomodules.xyz/jsonpatch/v2							 v2.4.0 \
	google.golang.org/appengine							 v1.6.7 \
	google.golang.org/genproto							 v0.0.0-20230920204549-e6e6cdab5c13 \
	google.golang.org/genproto/googleapis/api					 v0.0.0-20250428153025-10db94c68c34 \
	google.golang.org/genproto/googleapis/rpc					 v0.0.0-20250428153025-10db94c68c34 \
	google.golang.org/grpc								 v1.72.0 \
	google.golang.org/grpc/cmd/protoc-gen-go-grpc					 v1.3.0 \
	google.golang.org/protobuf							 v1.36.6 \
	gopkg.in/check.v1								 v1.0.0-20201130134442-10cb98267c6c \
	gopkg.in/evanphx/json-patch.v4							 v4.12.0 \
	gopkg.in/inf.v0									 v0.9.1 \
	gopkg.in/ini.v1									 v1.67.0 \
	gopkg.in/square/go-jose.v2							 v2.6.0 \
	gopkg.in/tomb.v1								 v1.0.0-20141024135613-dd632973f1e7 \
	gopkg.in/warnings.v0								 v0.1.2 \
	gopkg.in/yaml.v2								 v2.4.0 \
	gopkg.in/yaml.v3								 v3.0.1 \
	gorm.io/driver/postgres								 v1.5.11 \
	gorm.io/gorm									 v1.25.12 \
	gotest.tools/v3									 v3.5.1 \
	gvisor.dev/gvisor								 v0.0.0-20250205023644-9414b50a5633 \
	honnef.co/go/tools								 v0.6.1 \
	howett.net/plist								 v1.0.0 \
	k8s.io/api									 v0.32.0 \
	k8s.io/apiextensions-apiserver							 v0.32.0 \
	k8s.io/apimachinery								 v0.32.0 \
	k8s.io/apiserver								 v0.32.0 \
	k8s.io/client-go								 v0.32.0 \
	k8s.io/klog/v2									 v2.130.1 \
	k8s.io/kube-openapi								 v0.0.0-20241105132330-32ad38e42d3f \
	k8s.io/utils									 v0.0.0-20241104100929-3ea5e8cea738 \
	lukechampine.com/uint128							 v1.3.0 \
	modernc.org/cc/v3								 v3.41.0 \
	modernc.org/cc/v4								 v4.25.2 \
	modernc.org/ccgo/v3								 v3.16.15 \
	modernc.org/ccgo/v4								 v4.25.1 \
	modernc.org/fileutil								 v1.3.0 \
	modernc.org/gc/v2								 v2.6.5 \
	modernc.org/gc/v3								 v3.0.0-20240107210532-573471604cb6 \
	modernc.org/libc								 v1.62.1 \
	modernc.org/mathutil								 v1.7.1 \
	modernc.org/memory								 v1.10.0 \
	modernc.org/opt									 v0.1.4 \
	modernc.org/sortutil								 v1.2.1 \
	modernc.org/sqlite								 v1.37.0 \
	modernc.org/strutil								 v1.2.1 \
	modernc.org/token								 v1.1.0 \
	mvdan.cc/gofumpt								 v0.6.0 \
	mvdan.cc/unparam								 v0.0.0-20240104100049-c549a3470d14 \
	sigs.k8s.io/controller-runtime							 v0.19.4 \
	sigs.k8s.io/controller-tools							 v0.17.0 \
	sigs.k8s.io/json								 v0.0.0-20241010143419-9aa6b5e7a4b3 \
	sigs.k8s.io/structured-merge-diff/v4						 v4.4.2 \
	sigs.k8s.io/yaml								 v1.4.0 \
	software.sslmate.com/src/go-pkcs12						 v0.4.0 \
	tailscale.com									 v1.83.0-pre.0.20250331211809-96fe8a6db6c9 \
	zgo.at/zcache/v2								 v2.1.0 \
	zombiezen.com/go/postgrestest							 v1.0.1

MODGO_MODFILES =	\
	cloud.google.com/go/compute/metadata			 v0.3.0 \
	dario.cat/mergo						 v1.0.0 \
	filippo.io/edwards25519					 v1.0.0 \
	github.com/!azure/go-ansiterm				 v0.0.0-20230124172434-306776ec8161 \
	github.com/!burnt!sushi/toml				 v0.3.1 \
	github.com/!burnt!sushi/toml				 v1.2.1 \
	github.com/!marvin!j!wendt/testza			 v0.1.0 \
	github.com/!marvin!j!wendt/testza			 v0.2.1 \
	github.com/!marvin!j!wendt/testza			 v0.2.10 \
	github.com/!marvin!j!wendt/testza			 v0.2.12 \
	github.com/!marvin!j!wendt/testza			 v0.2.8 \
	github.com/!marvin!j!wendt/testza			 v0.3.0 \
	github.com/!marvin!j!wendt/testza			 v0.4.2 \
	github.com/!microsoft/go-winio				 v0.4.14 \
	github.com/!microsoft/go-winio				 v0.6.0 \
	github.com/aws/aws-sdk-go-v2				 v1.24.1 \
	github.com/aws/aws-sdk-go-v2/internal/configsources	 v1.2.10 \
	github.com/aws/aws-sdk-go-v2/internal/endpoints/v2	 v2.5.10 \
	github.com/aws/aws-sdk-go-v2/service/ssm		 v1.44.7 \
	github.com/aws/smithy-go				 v1.19.0 \
	github.com/chzyer/logex					 v1.1.10 \
	github.com/chzyer/readline				 v0.0.0-20180603132655-2972be24d48e \
	github.com/chzyer/test					 v0.0.0-20180213035817-a1ea475d72b1 \
	github.com/cilium/ebpf					 v0.12.3 \
	github.com/cilium/ebpf					 v0.15.0 \
	github.com/coder/websocket				 v1.8.12 \
	github.com/containerd/console				 v1.0.3 \
	github.com/containerd/continuity			 v0.3.0 \
	github.com/cpuguy83/go-md2man/v2			 v2.0.5 \
	github.com/creachadair/command				 v0.1.15 \
	github.com/creachadair/flax				 v0.0.0-20240212192608-428acafa3bbe \
	github.com/creachadair/mds				 v0.17.1 \
	github.com/creachadair/mds				 v0.22.3 \
	github.com/creack/pty					 v1.1.17 \
	github.com/creack/pty					 v1.1.18 \
	github.com/creack/pty					 v1.1.9 \
	github.com/cyphar/filepath-securejoin			 v0.3.6 \
	github.com/davecgh/go-spew				 v1.1.0 \
	github.com/davecgh/go-spew				 v1.1.1 \
	github.com/dblohm7/wingoes				 v0.0.0-20240119213807-a09d6be7affa \
	github.com/docker/cli					 v27.4.1+incompatible \
	github.com/docker/docker				 v27.1.1+incompatible \
	github.com/docker/docker				 v27.4.1+incompatible \
	github.com/docker/go-units				 v0.4.0 \
	github.com/envoyproxy/go-control-plane			 v0.9.0 \
	github.com/envoyproxy/go-control-plane			 v0.9.1-0.20191026205805-5f8ba28d4473 \
	github.com/envoyproxy/go-control-plane			 v0.9.4 \
	github.com/envoyproxy/protoc-gen-validate		 v0.1.0 \
	github.com/felixge/fgprof				 v0.9.3 \
	github.com/fsnotify/fsnotify				 v1.7.0 \
	github.com/fsnotify/fsnotify				 v1.8.0 \
	github.com/glebarez/go-sqlite				 v1.21.2 \
	github.com/go-jose/go-jose/v3				 v3.0.1 \
	github.com/go-jose/go-jose/v4				 v4.0.4 \
	github.com/go-jose/go-jose/v4				 v4.0.5 \
	github.com/go-logr/logr					 v1.3.0 \
	github.com/go-viper/mapstructure/v2			 v2.0.0-alpha.1 \
	github.com/go-viper/mapstructure/v2			 v2.1.0 \
	github.com/godbus/dbus/v5				 v5.0.4 \
	github.com/godbus/dbus/v5				 v5.1.0 \
	github.com/gofrs/flock					 v0.8.0 \
	github.com/golang-jwt/jwt/v5				 v5.2.0 \
	github.com/golang/glog					 v0.0.0-20160126235308-23def4e6c14b \
	github.com/golang/mock					 v1.1.1 \
	github.com/golang/protobuf				 v1.2.0 \
	github.com/golang/protobuf				 v1.3.2 \
	github.com/golang/protobuf				 v1.3.3 \
	github.com/golang/protobuf				 v1.5.0 \
	github.com/google/btree					 v1.0.1 \
	github.com/google/go-cmp				 v0.2.0 \
	github.com/google/go-cmp				 v0.5.2 \
	github.com/google/go-cmp				 v0.5.5 \
	github.com/google/go-cmp				 v0.5.7 \
	github.com/google/go-cmp				 v0.5.8 \
	github.com/google/go-cmp				 v0.5.9 \
	github.com/google/go-cmp				 v0.6.0 \
	github.com/google/pprof					 v0.0.0-20211214055906-6f57359322fd \
	github.com/google/pprof					 v0.0.0-20221118152302-e6195bd50e26 \
	github.com/google/pprof					 v0.0.0-20240227163752-401108e1b7e7 \
	github.com/google/pprof					 v0.0.0-20250317173921-a4b03ec1a45e \
	github.com/google/uuid					 v1.3.0 \
	github.com/google/uuid					 v1.3.1 \
	github.com/google/uuid					 v1.5.0 \
	github.com/gookit/color					 v1.4.2 \
	github.com/gookit/color					 v1.5.0 \
	github.com/gorilla/csrf					 v1.7.3-0.20250123201450-9dd6af1f6d30 \
	github.com/gorilla/websocket				 v1.5.0 \
	github.com/hashicorp/go-version				 v1.6.0 \
	github.com/ianlancetaylor/demangle			 v0.0.0-20210905161508-09a460cdf81d \
	github.com/ianlancetaylor/demangle			 v0.0.0-20230524184225-eabc099b10ab \
	github.com/insomniacslk/dhcp				 v0.0.0-20231206064809-8c70d406f6d2 \
	github.com/jackc/pgservicefile				 v0.0.0-20221227161230-091c0ba34f0a \
	github.com/jackc/pgx/v5					 v5.5.5 \
	github.com/jackc/puddle/v2				 v2.2.1 \
	github.com/jsimonetti/rtnetlink				 v1.3.5 \
	github.com/jsimonetti/rtnetlink				 v1.4.0 \
	github.com/kisielk/errcheck				 v1.5.0 \
	github.com/klauspost/compress				 v1.15.9 \
	github.com/klauspost/compress				 v1.17.11 \
	github.com/klauspost/cpuid/v2				 v2.0.10 \
	github.com/klauspost/cpuid/v2				 v2.0.12 \
	github.com/klauspost/cpuid/v2				 v2.0.9 \
	github.com/kr/pretty					 v0.1.0 \
	github.com/kr/pretty					 v0.2.1 \
	github.com/kr/pretty					 v0.3.0 \
	github.com/kr/pty					 v1.1.1 \
	github.com/kr/text					 v0.1.0 \
	github.com/lib/pq					 v1.8.0 \
	github.com/mattn/go-colorable				 v0.1.13 \
	github.com/mattn/go-colorable				 v0.1.2 \
	github.com/mattn/go-isatty				 v0.0.16 \
	github.com/mattn/go-isatty				 v0.0.17 \
	github.com/mattn/go-isatty				 v0.0.19 \
	github.com/mattn/go-isatty				 v0.0.8 \
	github.com/mattn/go-runewidth				 v0.0.13 \
	github.com/mattn/go-runewidth				 v0.0.14 \
	github.com/mdlayher/netlink				 v1.7.2 \
	github.com/mdlayher/socket				 v0.4.1 \
	github.com/mgutz/ansi					 v0.0.0-20170206155736-9520e82c474b \
	github.com/moby/sys/mountinfo				 v0.6.2 \
	github.com/moby/sys/user				 v0.1.0 \
	github.com/moby/sys/user				 v0.3.0 \
	github.com/moby/term					 v0.5.0 \
	github.com/opencontainers/image-spec			 v1.0.2 \
	github.com/opencontainers/image-spec			 v1.1.0 \
	github.com/opencontainers/runc				 v1.2.3 \
	github.com/opencontainers/runtime-spec			 v1.1.0-rc.1 \
	github.com/opencontainers/selinux			 v1.10.1 \
	github.com/pelletier/go-toml/v2				 v2.2.0 \
	github.com/pelletier/go-toml/v2				 v2.2.3 \
	github.com/petermattis/goid				 v0.0.0-20240813172612-4fcff4a6cae7 \
	github.com/pierrec/lz4/v4				 v4.1.14 \
	github.com/pkg/errors					 v0.8.1 \
	github.com/pmezard/go-difflib				 v1.0.0 \
	github.com/prometheus/client_golang			 v1.19.1 \
	github.com/prometheus/client_golang			 v1.20.4 \
	github.com/prometheus/client_model			 v0.0.0-20190812154241-14fe0d1b01d4 \
	github.com/prometheus/common				 v0.55.0 \
	github.com/prometheus/common				 v0.62.0 \
	github.com/pterm/pterm					 v0.12.27 \
	github.com/pterm/pterm					 v0.12.29 \
	github.com/pterm/pterm					 v0.12.30 \
	github.com/pterm/pterm					 v0.12.31 \
	github.com/pterm/pterm					 v0.12.33 \
	github.com/pterm/pterm					 v0.12.36 \
	github.com/pterm/pterm					 v0.12.40 \
	github.com/rivo/uniseg					 v0.2.0 \
	github.com/rivo/uniseg					 v0.4.4 \
	github.com/rogpeppe/go-internal				 v1.10.0 \
	github.com/rogpeppe/go-internal				 v1.11.0 \
	github.com/rogpeppe/go-internal				 v1.13.1 \
	github.com/rogpeppe/go-internal				 v1.9.0 \
	github.com/sagikazarmark/locafero			 v0.7.0 \
	github.com/sergi/go-diff				 v1.2.0 \
	github.com/sirupsen/logrus				 v1.4.2 \
	github.com/spf13/afero					 v1.11.0 \
	github.com/spf13/afero					 v1.12.0 \
	github.com/spf13/cast					 v1.6.0 \
	github.com/spf13/cast					 v1.7.1 \
	github.com/spf13/cobra					 v1.8.1 \
	github.com/spf13/pflag					 v1.0.5 \
	github.com/spf13/viper					 v1.16.0 \
	github.com/stretchr/objx				 v0.1.0 \
	github.com/stretchr/objx				 v0.1.1 \
	github.com/stretchr/objx				 v0.4.0 \
	github.com/stretchr/testify				 v1.2.2 \
	github.com/stretchr/testify				 v1.3.0 \
	github.com/stretchr/testify				 v1.4.0 \
	github.com/stretchr/testify				 v1.6.1 \
	github.com/stretchr/testify				 v1.7.0 \
	github.com/stretchr/testify				 v1.7.1 \
	github.com/stretchr/testify				 v1.7.5 \
	github.com/stretchr/testify				 v1.8.0 \
	github.com/stretchr/testify				 v1.8.1 \
	github.com/stretchr/testify				 v1.8.4 \
	github.com/subosito/gotenv				 v1.4.2 \
	github.com/tailscale/hujson				 v0.0.0-20221223112325-20486734a56a \
	github.com/tailscale/setec				 v0.0.0-20250205144240-8898a29c3fbb \
	github.com/u-root/uio					 v0.0.0-20230220225925-ffce2a382923 \
	github.com/vishvananda/netlink				 v1.1.1-0.20211118161826-650dca95af54 \
	github.com/vishvananda/netns				 v0.0.0-20180720170159-13995c7128cc \
	github.com/vishvananda/netns				 v0.0.0-20200728191858-db3c7e526aae \
	github.com/vishvananda/netns				 v0.0.0-20210104183010-2eb08e3e575f \
	github.com/xeipuuv/gojsonpointer			 v0.0.0-20180127040702-4e3ac2762d5f \
	github.com/xo/terminfo					 v0.0.0-20210125001918-ca9a967f8778 \
	github.com/yuin/goldmark				 v1.1.27 \
	github.com/yuin/goldmark				 v1.2.1 \
	go.opentelemetry.io/otel				 v1.33.0 \
	go.opentelemetry.io/otel/metric				 v1.33.0 \
	go.opentelemetry.io/otel/trace				 v1.33.0 \
	go.uber.org/atomic					 v1.7.0 \
	go.uber.org/multierr					 v1.6.0 \
	go.uber.org/multierr					 v1.9.0 \
	go.uber.org/zap						 v1.18.1 \
	golang.org/x/crypto					 v0.0.0-20190308221718-c2843e01d9a2 \
	golang.org/x/crypto					 v0.0.0-20191011191535-87dc89f01550 \
	golang.org/x/crypto					 v0.0.0-20200622213623-75b288015ac9 \
	golang.org/x/crypto					 v0.0.0-20210921155107-089bfa567519 \
	golang.org/x/crypto					 v0.0.0-20211215153901-e495a2d5b3d3 \
	golang.org/x/crypto					 v0.0.0-20220214200702-86341886e292 \
	golang.org/x/crypto					 v0.11.0 \
	golang.org/x/crypto					 v0.13.0 \
	golang.org/x/crypto					 v0.17.0 \
	golang.org/x/crypto					 v0.19.0 \
	golang.org/x/crypto					 v0.28.0 \
	golang.org/x/crypto					 v0.31.0 \
	golang.org/x/crypto					 v0.33.0 \
	golang.org/x/crypto					 v0.35.0 \
	golang.org/x/crypto					 v0.36.0 \
	golang.org/x/exp					 v0.0.0-20190121172915-509febef88a4 \
	golang.org/x/exp					 v0.0.0-20220909182711-5c715a9e8561 \
	golang.org/x/exp					 v0.0.0-20230127140709-cafedaf64729 \
	golang.org/x/exp					 v0.0.0-20230224173230-c95f2b4c22f2 \
	golang.org/x/exp					 v0.0.0-20230725093048-515e97ebf090 \
	golang.org/x/exp					 v0.0.0-20250210185358-939b2ce775ac \
	golang.org/x/exp					 v0.0.0-20250305212735-054e65f0b394 \
	golang.org/x/exp/typeparams				 v0.0.0-20221208152030-732eee02a75a \
	golang.org/x/exp/typeparams				 v0.0.0-20231108232855-2478ac86f678 \
	golang.org/x/image					 v0.12.0 \
	golang.org/x/lint					 v0.0.0-20181026193005-c67002cb31c3 \
	golang.org/x/lint					 v0.0.0-20190227174305-5b3e6a55c961 \
	golang.org/x/lint					 v0.0.0-20190313153728-d0100b6bd8b3 \
	golang.org/x/mod					 v0.10.0 \
	golang.org/x/mod					 v0.12.0 \
	golang.org/x/mod					 v0.14.0 \
	golang.org/x/mod					 v0.17.0 \
	golang.org/x/mod					 v0.2.0 \
	golang.org/x/mod					 v0.21.0 \
	golang.org/x/mod					 v0.23.0 \
	golang.org/x/mod					 v0.3.0 \
	golang.org/x/mod					 v0.4.2 \
	golang.org/x/mod					 v0.6.0-dev.0.20220419223038-86c51ed26bb4 \
	golang.org/x/mod					 v0.8.0 \
	golang.org/x/net					 v0.0.0-20180724234803-3673e40ba225 \
	golang.org/x/net					 v0.0.0-20180826012351-8a410e7b638d \
	golang.org/x/net					 v0.0.0-20190213061140-3a22650c66bd \
	golang.org/x/net					 v0.0.0-20190311183353-d8887717615a \
	golang.org/x/net					 v0.0.0-20190404232315-eb5bcb51f2a3 \
	golang.org/x/net					 v0.0.0-20190620200207-3b0461eec859 \
	golang.org/x/net					 v0.0.0-20200226121028-0de0cce0169b \
	golang.org/x/net					 v0.0.0-20201021035429-f5854403a974 \
	golang.org/x/net					 v0.0.0-20210226172049-e18ecbb05110 \
	golang.org/x/net					 v0.0.0-20211215060638-4ddde0e984e9 \
	golang.org/x/net					 v0.0.0-20220722155237-a158d28d115b \
	golang.org/x/net					 v0.10.0 \
	golang.org/x/net					 v0.14.0 \
	golang.org/x/net					 v0.15.0 \
	golang.org/x/net					 v0.17.0 \
	golang.org/x/net					 v0.20.0 \
	golang.org/x/net					 v0.21.0 \
	golang.org/x/net					 v0.22.0 \
	golang.org/x/net					 v0.30.0 \
	golang.org/x/net					 v0.33.0 \
	golang.org/x/net					 v0.35.0 \
	golang.org/x/net					 v0.36.0 \
	golang.org/x/net					 v0.37.0 \
	golang.org/x/net					 v0.6.0 \
	golang.org/x/net					 v0.9.0 \
	golang.org/x/oauth2					 v0.0.0-20180821212333-d2e6202438be \
	golang.org/x/oauth2					 v0.23.0 \
	golang.org/x/oauth2					 v0.24.0 \
	golang.org/x/oauth2					 v0.25.0 \
	golang.org/x/oauth2					 v0.26.0 \
	golang.org/x/oauth2					 v0.27.0 \
	golang.org/x/oauth2					 v0.28.0 \
	golang.org/x/sync					 v0.0.0-20180314180146-1d60e4601c6f \
	golang.org/x/sync					 v0.0.0-20181108010431-42b317875d0f \
	golang.org/x/sync					 v0.0.0-20190423024810-112230192c58 \
	golang.org/x/sync					 v0.0.0-20190911185100-cd5d95a43a6e \
	golang.org/x/sync					 v0.0.0-20201020160332-67f06af15bc9 \
	golang.org/x/sync					 v0.0.0-20210220032951-036812b2e83c \
	golang.org/x/sync					 v0.0.0-20220722155255-886fb9371eb4 \
	golang.org/x/sync					 v0.1.0 \
	golang.org/x/sync					 v0.10.0 \
	golang.org/x/sync					 v0.11.0 \
	golang.org/x/sync					 v0.12.0 \
	golang.org/x/sync					 v0.3.0 \
	golang.org/x/sync					 v0.6.0 \
	golang.org/x/sync					 v0.7.0 \
	golang.org/x/sync					 v0.8.0 \
	golang.org/x/sys					 v0.0.0-20180830151530-49385e6e1522 \
	golang.org/x/sys					 v0.0.0-20190215142949-d0b11bdaac8a \
	golang.org/x/sys					 v0.0.0-20190222072716-a9d3bda3a223 \
	golang.org/x/sys					 v0.0.0-20190412213103-97732733099d \
	golang.org/x/sys					 v0.0.0-20190422165155-953cdadca894 \
	golang.org/x/sys					 v0.0.0-20200217220822-9197077df867 \
	golang.org/x/sys					 v0.0.0-20200728102440-3e129f6d46b1 \
	golang.org/x/sys					 v0.0.0-20200930185726-fdedc70b468f \
	golang.org/x/sys					 v0.0.0-20201119102817-f84b799fce68 \
	golang.org/x/sys					 v0.0.0-20210124154548-22da62e12c0c \
	golang.org/x/sys					 v0.0.0-20210330210617-4fbd30eecc44 \
	golang.org/x/sys					 v0.0.0-20210615035016-665e8c7367d1 \
	golang.org/x/sys					 v0.0.0-20210616094352-59db8d763f22 \
	golang.org/x/sys					 v0.0.0-20211007075335-d3039528d8ac \
	golang.org/x/sys					 v0.0.0-20211013075003-97ac67df715c \
	golang.org/x/sys					 v0.0.0-20211025201205-69cdffdb9359 \
	golang.org/x/sys					 v0.0.0-20211103235746-7861aae1554b \
	golang.org/x/sys					 v0.0.0-20211216021012-1d35b9e2eb4e \
	golang.org/x/sys					 v0.0.0-20220310020820-b874c991c1a5 \
	golang.org/x/sys					 v0.0.0-20220319134239-a9b59b0215f8 \
	golang.org/x/sys					 v0.0.0-20220520151302-bc2c85ada10a \
	golang.org/x/sys					 v0.0.0-20220622161953-175b2fd9d664 \
	golang.org/x/sys					 v0.0.0-20220715151400-c0bba94af5f8 \
	golang.org/x/sys					 v0.0.0-20220722155257-8c9f86f7a55f \
	golang.org/x/sys					 v0.0.0-20220811171246-fbc7d0a398ab \
	golang.org/x/sys					 v0.0.0-20220817070843-5a390386f1f2 \
	golang.org/x/sys					 v0.0.0-20220928140112-f11e5e49a4ec \
	golang.org/x/sys					 v0.1.0 \
	golang.org/x/sys					 v0.10.0 \
	golang.org/x/sys					 v0.11.0 \
	golang.org/x/sys					 v0.12.0 \
	golang.org/x/sys					 v0.13.0 \
	golang.org/x/sys					 v0.15.0 \
	golang.org/x/sys					 v0.16.0 \
	golang.org/x/sys					 v0.17.0 \
	golang.org/x/sys					 v0.18.0 \
	golang.org/x/sys					 v0.2.0 \
	golang.org/x/sys					 v0.20.0 \
	golang.org/x/sys					 v0.22.0 \
	golang.org/x/sys					 v0.26.0 \
	golang.org/x/sys					 v0.27.0 \
	golang.org/x/sys					 v0.28.0 \
	golang.org/x/sys					 v0.29.0 \
	golang.org/x/sys					 v0.29.1-0.20250107080300-1c14dcadc3ab \
	golang.org/x/sys					 v0.30.0 \
	golang.org/x/sys					 v0.31.0 \
	golang.org/x/sys					 v0.5.0 \
	golang.org/x/sys					 v0.6.0 \
	golang.org/x/sys					 v0.7.0 \
	golang.org/x/sys					 v0.8.0 \
	golang.org/x/term					 v0.0.0-20201126162022-7de9c90e9dd1 \
	golang.org/x/term					 v0.0.0-20210220032956-6a3ed077a48d \
	golang.org/x/term					 v0.0.0-20210615171337-6886f2dfbf5b \
	golang.org/x/term					 v0.0.0-20210927222741-03fcf44c2211 \
	golang.org/x/term					 v0.17.0 \
	golang.org/x/term					 v0.25.0 \
	golang.org/x/term					 v0.26.0 \
	golang.org/x/term					 v0.29.0 \
	golang.org/x/term					 v0.5.0 \
	golang.org/x/term					 v0.8.0 \
	golang.org/x/text					 v0.12.0 \
	golang.org/x/text					 v0.14.0 \
	golang.org/x/text					 v0.19.0 \
	golang.org/x/text					 v0.20.0 \
	golang.org/x/text					 v0.21.0 \
	golang.org/x/text					 v0.22.0 \
	golang.org/x/text					 v0.23.0 \
	golang.org/x/text					 v0.3.0 \
	golang.org/x/text					 v0.3.3 \
	golang.org/x/text					 v0.3.7 \
	golang.org/x/text					 v0.3.8-0.20211105212822-18b340fc7af2 \
	golang.org/x/text					 v0.4.0 \
	golang.org/x/text					 v0.7.0 \
	golang.org/x/text					 v0.9.0 \
	golang.org/x/time					 v0.0.0-20220210224613-90d013bbcef8 \
	golang.org/x/time					 v0.7.0 \
	golang.org/x/tools					 v0.0.0-20180917221912-90fa682c2a6e \
	golang.org/x/tools					 v0.0.0-20190114222345-bf090417da8b \
	golang.org/x/tools					 v0.0.0-20190226205152-f727befe758c \
	golang.org/x/tools					 v0.0.0-20190311212946-11955173bddd \
	golang.org/x/tools					 v0.0.0-20190524140312-2c0ae7006135 \
	golang.org/x/tools					 v0.0.0-20191108193012-7d206e10da11 \
	golang.org/x/tools					 v0.0.0-20191119224855-298f0cb1881e \
	golang.org/x/tools					 v0.0.0-20200619180055-7c47624df98f \
	golang.org/x/tools					 v0.0.0-20210106214847-113979e3529a \
	golang.org/x/tools					 v0.1.12 \
	golang.org/x/tools					 v0.1.7 \
	golang.org/x/tools					 v0.11.0 \
	golang.org/x/tools					 v0.13.0 \
	golang.org/x/tools					 v0.16.1 \
	golang.org/x/tools					 v0.17.0 \
	golang.org/x/tools					 v0.21.1-0.20240508182429-e35e4ccd0d2d \
	golang.org/x/tools					 v0.21.1-0.20240531212143-b6235391adb3 \
	golang.org/x/tools					 v0.26.0 \
	golang.org/x/tools					 v0.30.0 \
	golang.org/x/tools					 v0.31.0 \
	golang.org/x/tools					 v0.6.0 \
	golang.org/x/tools					 v0.9.4-0.20230601214343-86c93e8732cc \
	golang.org/x/xerrors					 v0.0.0-20190717185122-a985d3407aa7 \
	golang.org/x/xerrors					 v0.0.0-20191011141410-1b5146add898 \
	golang.org/x/xerrors					 v0.0.0-20191204190536-9bdfabe68543 \
	golang.org/x/xerrors					 v0.0.0-20200804184101-5ec99f83aff1 \
	golang.org/x/xerrors					 v0.0.0-20220907171357-04be3eba64a2 \
	golang.org/x/xerrors					 v0.0.0-20231012003039-104605ab7028 \
	google.golang.org/appengine				 v1.1.0 \
	google.golang.org/appengine				 v1.4.0 \
	google.golang.org/genproto				 v0.0.0-20180817151627-c66870c02cf8 \
	google.golang.org/genproto				 v0.0.0-20190819201941-24fa4b261c55 \
	google.golang.org/genproto				 v0.0.0-20200423170343-7949de9c1215 \
	google.golang.org/genproto/googleapis/api		 v0.0.0-20250218202821-56aae31c358a \
	google.golang.org/genproto/googleapis/api		 v0.0.0-20250303144028-a0af3efb3deb \
	google.golang.org/genproto/googleapis/rpc		 v0.0.0-20231002182017-d307bd883b97 \
	google.golang.org/genproto/googleapis/rpc		 v0.0.0-20250218202821-56aae31c358a \
	google.golang.org/genproto/googleapis/rpc		 v0.0.0-20250303144028-a0af3efb3deb \
	google.golang.org/genproto/googleapis/rpc		 v0.0.0-20250425173222-7b384671a197 \
	google.golang.org/grpc					 v1.19.0 \
	google.golang.org/grpc					 v1.23.0 \
	google.golang.org/grpc					 v1.25.1 \
	google.golang.org/grpc					 v1.27.0 \
	google.golang.org/grpc					 v1.29.1 \
	google.golang.org/grpc					 v1.59.0 \
	google.golang.org/grpc					 v1.70.0 \
	google.golang.org/grpc					 v1.71.0 \
	google.golang.org/protobuf				 v1.33.0 \
	google.golang.org/protobuf				 v1.35.1 \
	google.golang.org/protobuf				 v1.36.5 \
	gopkg.in/check.v1					 v0.0.0-20161208181325-20d25e280405 \
	gopkg.in/check.v1					 v1.0.0-20180628173108-788fd7840127 \
	gopkg.in/check.v1					 v1.0.0-20190902080502-41f04d3bba15 \
	gopkg.in/check.v1					 v1.0.0-20200227125254-8fa46927fb4f \
	gopkg.in/yaml.v2					 v2.2.2 \
	gopkg.in/yaml.v2					 v2.2.4 \
	gopkg.in/yaml.v2					 v2.2.8 \
	gopkg.in/yaml.v3					 v3.0.0 \
	gopkg.in/yaml.v3					 v3.0.0-20200313102051-9f266ea9e77c \
	gopkg.in/yaml.v3					 v3.0.0-20210107192922-496545a6307b \
	gorm.io/gorm						 v1.25.10 \
	gorm.io/gorm						 v1.25.7 \
	gotest.tools/v3						 v3.4.0 \
	gvisor.dev/gvisor					 v0.0.0-20230927004350-cbd86285d259 \
	honnef.co/go/tools					 v0.0.0-20190102054323-c2f93a96b099 \
	honnef.co/go/tools					 v0.0.0-20190523083050-ea95bdfd59fc \
	honnef.co/go/tools					 v0.4.5 \
	honnef.co/go/tools					 v0.5.1 \
	honnef.co/go/tools					 v0.6.0 \
	k8s.io/api						 v0.23.16 \
	k8s.io/apimachinery					 v0.23.16 \
	k8s.io/client-go					 v0.23.16 \
	k8s.io/klog/v2						 v2.30.0 \
	k8s.io/kube-openapi					 v0.0.0-20211115234752-e816edb12b65 \
	k8s.io/utils						 v0.0.0-20211116205334-6203023598ed \
	modernc.org/libc					 v1.22.5 \
	modernc.org/libc					 v1.37.6 \
	modernc.org/libc					 v1.55.3 \
	modernc.org/mathutil					 v1.5.0 \
	modernc.org/mathutil					 v1.6.0 \
	modernc.org/memory					 v1.5.0 \
	modernc.org/memory					 v1.7.2 \
	modernc.org/memory					 v1.8.0 \
	modernc.org/memory					 v1.9.1 \
	modernc.org/opt						 v0.1.3 \
	modernc.org/sqlite					 v1.23.1 \
	modernc.org/sqlite					 v1.28.0 \
	modernc.org/sqlite					 v1.34.4 \
	modernc.org/strutil					 v1.2.0 \
	sigs.k8s.io/json					 v0.0.0-20211020170558-c049b76a60c6 \
	sigs.k8s.io/structured-merge-diff/v4			 v4.2.3 \
	sigs.k8s.io/yaml					 v1.2.0 \
	software.sslmate.com/src/go-pkcs12			 v0.2.1 \
	tailscale.com						 v1.81.0-pre.0.20250303195457-5449aba94c51

