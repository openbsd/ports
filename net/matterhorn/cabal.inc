MODCABAL_MANIFEST	= \
	mattermost-api	90000.0.0	0	\
	mattermost-api-qc	90000.0.0	0	\
	Cabal	3.16.1.0	0	\
	Cabal-syntax	3.16.1.0	0	\
	HTTP	4000.5.0	1	\
	HUnit	1.6.2.0	0	\
	Hclip	3.0.0.4	0	\
	OneTuple	0.4.2.1	0	\
	QuickCheck	2.16.0.0	0	\
	SHA	1.6.4.4	0	\
	StateVar	1.2.2	0	\
	Unique	0.4.8.0	1	\
	aeson	2.2.3.0	4	\
	alex	3.5.4.0	0	\
	ansi-terminal	1.1.5	0	\
	ansi-terminal-types	1.1.3	0	\
	appar	0.1.8	0	\
	asn1-encoding	0.9.6	2	\
	asn1-parse	0.9.5	0	\
	asn1-types	0.3.4	0	\
	aspell-pipe	0.6	0	\
	assoc	1.1.1	2	\
	async	2.2.6	0	\
	attoparsec	0.14.4	6	\
	base-compat	0.12.3	0	\
	base-orphans	0.9.4	0	\
	base16-bytestring	1.0.2.0	1	\
	base64-bytestring	1.2.1.0	1	\
	basement	0.0.16	0	\
	bifunctors	5.6.3	1	\
	bimap	0.5.0	0	\
	binary	0.8.9.3	0	\
	bitvec	1.1.5.0	3	\
	blaze-builder	0.4.4.1	0	\
	blaze-html	0.9.2.0	1	\
	blaze-markup	0.8.3.0	2	\
	brick	2.8.3	1	\
	brick-skylighting	1.0	0	\
	byteorder	1.0.4	0	\
	bytestring	0.11.5.4	0	\
	cabal-doctest	1.0.12	1	\
	call-stack	0.4.0	0	\
	case-insensitive	1.2.1.0	0	\
	cborg	0.2.10.0	3	\
	cereal	0.5.8.3	0	\
	character-ps	0.1	0	\
	checkers	0.4.7	0	\
	clock	0.8.4	0	\
	colour	2.3.6	0	\
	commonmark	0.2.6.1	0	\
	commonmark-extensions	0.2.6	0	\
	comonad	5.0.10	0	\
	conduit	1.3.6.1	0	\
	conduit-extra	1.3.8	1	\
	config-ini	0.2.7.0	1	\
	containers	0.6.8	0	\
	contravariant	1.5.6	0	\
	cryptohash-md5	0.11.101.0	6	\
	cryptohash-sha1	0.11.101.0	6	\
	crypton	1.0.6	0	\
	crypton-connection	0.3.2	1	\
	crypton-x509	1.7.7	0	\
	crypton-x509-store	1.6.14	0	\
	crypton-x509-system	1.6.8	0	\
	crypton-x509-validation	1.6.14	0	\
	data-clist	0.2	1	\
	data-default	0.8.0.2	0	\
	data-default-class	0.2.0.0	0	\
	data-fix	0.3.4	2	\
	directory	1.3.10.1	0	\
	distributive	0.6.3	0	\
	dlist	1.0	2	\
	emojis	0.1.4.1	0	\
	entropy	0.4.1.11	1	\
	extensible-exceptions	0.1.1.4	0	\
	extra	1.8	0	\
	file-io	0.1.6	0	\
	filepath	1.4.301.0	1	\
	generically	0.1.1	5	\
	gitrev	1.3.1	0	\
	half	0.3.3	1	\
	happy	2.2	0	\
	happy-lib	2.2	0	\
	hashable	1.4.7.0	0	\
	haskell-lexer	1.2.1	0	\
	hourglass	0.2.12	1	\
	hsc2hs	0.68.10	5	\
	http-media	0.8.1.1	2	\
	indexed-traversable	0.1.4	1	\
	indexed-traversable-instances	0.1.2	1	\
	integer-conversion	0.1.1	2	\
	integer-logarithms	1.0.5	0	\
	iproute	1.7.15	0	\
	megaparsec	9.7.0	1	\
	memory	0.18.0	1	\
	microlens	0.4.14.0	0	\
	microlens-ghc	0.4.15.1	0	\
	microlens-mtl	0.2.1.0	0	\
	microlens-platform	0.4.4.1	0	\
	microlens-th	0.4.3.17	0	\
	modern-uri	0.3.6.1	4	\
	mono-traversable	1.0.21.0	0	\
	network	3.2.8.0	0	\
	network-info	0.2.1	0	\
	network-uri	2.6.4.2	1	\
	old-locale	1.0.0.7	2	\
	old-time	1.1.0.5	0	\
	optparse-applicative	0.19.0.0	0	\
	os-string	2.0.10	0	\
	parsec	3.1.18.0	0	\
	parser-combinators	1.3.1	0	\
	pem	0.2.4	0	\
	pretty-show	1.10	0	\
	prettyprinter	1.7.1	0	\
	prettyprinter-ansi-terminal	1.1.3	0	\
	primitive	0.9.1.0	1	\
	process	1.6.26.1	1	\
	profunctors	5.6.3	0	\
	random	1.3.1	0	\
	reflection	2.1.9	1	\
	resource-pool	0.5.0.0	0	\
	resourcet	1.3.0	0	\
	safe	0.3.21	1	\
	scientific	0.3.8.1	0	\
	semialign	1.3.1	2	\
	semigroupoids	6.0.2	1	\
	semigroups	0.19.2	2	\
	serialise	0.2.6.1	5	\
	skylighting-core	0.12.3.1	0	\
	socks	0.6.1	0	\
	split	0.2.5	0	\
	splitmix	0.1.3.2	0	\
	stm-delay	0.1.1.2	0	\
	streaming-commons	0.2.3.1	0	\
	strict	0.5.1	1	\
	tagged	0.8.10	1	\
	tasty	1.4.3	0	\
	tasty-hunit	0.10.2	0	\
	tasty-quickcheck	0.10.2	0	\
	temporary	1.3	0	\
	text	1.2.5.0	2	\
	text-iso8601	0.1.1	2	\
	text-short	0.1.6.1	0	\
	text-zipper	0.13	0	\
	th-abstraction	0.7.2.0	0	\
	th-compat	0.1.7	0	\
	these	1.2.1	2	\
	time-compat	1.9.8	0	\
	timezone-olson	0.2.1	0	\
	timezone-series	0.1.13	1	\
	tls	2.0.6	1	\
	transformers-compat	0.8	0	\
	typed-process	0.2.13.0	0	\
	unicode-data	0.8.0	0	\
	unicode-transforms	0.4.0.1	9	\
	unix	2.8.8.0	0	\
	unix-compat	0.7.4.1	0	\
	unix-time	0.4.17	0	\
	unliftio-core	0.2.1.0	4	\
	unordered-containers	0.2.21	2	\
	utf8-string	1.0.2	0	\
	uuid	1.3.16	3	\
	uuid-types	1.0.6	3	\
	vector	0.13.2.0	2	\
	vector-algorithms	0.9.1.0	0	\
	vector-stream	0.1.0.1	4	\
	vty	6.5	0	\
	vty-crossplatform	0.5.0.0	0	\
	vty-unix	0.2.0.0	0	\
	websockets	0.13.0.0	5	\
	witherable	0.5	2	\
	word-wrap	0.4.1	1	\
	xdg-basedir	0.2.2	0	\
	xml-conduit	1.9.1.4	0	\
	xml-types	0.3.8	0	\
	zlib	0.7.1.1	0	\

