MODGO_MODULES =	\
	codeberg.org/emersion/go-scfg		 v0.1.0 \
	git.sr.ht/~rockorager/vaxis		 v0.15.1-0.20260305170555-c3371e09d426 \
	github.com/containerd/console		 v1.0.4 \
	github.com/creack/pty			 v1.1.18 \
	github.com/dave/jennifer		 v1.7.1 \
	github.com/davecgh/go-spew		 v1.1.1 \
	github.com/delthas/go-libnp		 v0.2.0 \
	github.com/delthas/go-localeinfo	 v0.2.0 \
	github.com/disintegration/imaging	 v1.6.2 \
	github.com/emersion/go-varlink		 v0.0.0-20251006073247-e7ad9f7950c7 \
	github.com/go-ole/go-ole		 v1.3.0 \
	github.com/godbus/dbus/v5		 v5.1.0 \
	github.com/mattn/go-runewidth		 v0.0.16 \
	github.com/mattn/go-sixel		 v0.0.5 \
	github.com/pmezard/go-difflib		 v1.0.0 \
	github.com/rivo/uniseg			 v0.4.7 \
	github.com/rogpeppe/go-internal		 v1.10.0 \
	github.com/soniakeys/quant		 v1.0.0 \
	github.com/stretchr/testify		 v1.8.3 \
	golang.org/x/crypto			 v0.33.0 \
	golang.org/x/image			 v0.24.0 \
	golang.org/x/mod			 v0.10.0 \
	golang.org/x/net			 v0.35.0 \
	golang.org/x/sync			 v0.1.0 \
	golang.org/x/sys			 v0.30.0 \
	golang.org/x/term			 v0.29.0 \
	golang.org/x/text			 v0.22.0 \
	golang.org/x/time			 v0.10.0 \
	gopkg.in/yaml.v3			 v3.0.1 \
	mvdan.cc/xurls/v2			 v2.5.0

MODGO_MODFILES =	\
	github.com/containerd/console	 v1.0.3 \
	github.com/mattn/go-runewidth	 v0.0.14 \
	github.com/rivo/uniseg		 v0.2.0 \
	github.com/rivo/uniseg		 v0.4.4 \
	golang.org/x/image		 v0.0.0-20191009234506-e7c1f5e7dbb8 \
	golang.org/x/image		 v0.9.0 \
	golang.org/x/sys		 v0.1.0 \
	golang.org/x/sys		 v0.10.0 \
	golang.org/x/text		 v0.3.0

