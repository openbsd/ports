MODGO_MODULES =	\
	github.com/alecthomas/kingpin/v2	 v2.4.0 \
	github.com/alecthomas/units		 v0.0.0-20211218093645-b94a6e3cc137 \
	github.com/beorn7/perks			 v1.0.1 \
	github.com/cespare/xxhash/v2		 v2.3.0 \
	github.com/creack/pty			 v1.1.9 \
	github.com/davecgh/go-spew		 v1.1.1 \
	github.com/golang/protobuf		 v1.5.0 \
	github.com/google/go-cmp		 v0.7.0 \
	github.com/jpillora/backoff		 v1.0.0 \
	github.com/json-iterator/go		 v1.1.12 \
	github.com/julienschmidt/httprouter	 v1.3.0 \
	github.com/klauspost/compress		 v1.17.11 \
	github.com/kr/pretty			 v0.3.1 \
	github.com/kr/text			 v0.2.0 \
	github.com/kylelemons/godebug		 v1.1.0 \
	github.com/modern-go/concurrent		 v0.0.0-20180306012644-bacd9c7ef1dd \
	github.com/modern-go/reflect2		 v1.0.2 \
	github.com/munnerz/goautoneg		 v0.0.0-20191010083416-a7dc8b61c822 \
	github.com/mwitkow/go-conntrack		 v0.0.0-20190716064945-2f068394615f \
	github.com/pmezard/go-difflib		 v1.0.0 \
	github.com/prometheus/client_golang	 v1.21.1 \
	github.com/prometheus/client_model	 v0.6.1 \
	github.com/prometheus/common		 v0.62.0 \
	github.com/prometheus/procfs		 v0.15.1 \
	github.com/rogpeppe/go-internal		 v1.10.0 \
	github.com/sirupsen/logrus		 v1.9.3 \
	github.com/stretchr/objx		 v0.5.2 \
	github.com/stretchr/testify		 v1.10.0 \
	github.com/xhit/go-str2duration/v2	 v2.1.0 \
	golang.org/x/crypto			 v0.45.0 \
	golang.org/x/net			 v0.47.0 \
	golang.org/x/oauth2			 v0.24.0 \
	golang.org/x/sync			 v0.18.0 \
	golang.org/x/sys			 v0.38.0 \
	golang.org/x/term			 v0.37.0 \
	golang.org/x/text			 v0.31.0 \
	golang.org/x/xerrors			 v0.0.0-20191204190536-9bdfabe68543 \
	google.golang.org/protobuf		 v1.36.5 \
	gopkg.in/check.v1			 v1.0.0-20201130134442-10cb98267c6c \
	gopkg.in/yaml.v2			 v2.4.0 \
	gopkg.in/yaml.v3			 v3.0.1

MODGO_MODFILES =	\
	github.com/davecgh/go-spew		 v1.1.0 \
	github.com/google/go-cmp		 v0.5.5 \
	github.com/google/go-cmp		 v0.6.0 \
	github.com/prometheus/client_golang	 v1.20.4 \
	github.com/stretchr/objx		 v0.1.0 \
	github.com/stretchr/testify		 v1.7.0 \
	golang.org/x/net			 v0.33.0 \
	golang.org/x/sync			 v0.7.0 \
	golang.org/x/sys			 v0.0.0-20220715151400-c0bba94af5f8 \
	golang.org/x/sys			 v0.20.0 \
	golang.org/x/sys			 v0.28.0 \
	golang.org/x/text			 v0.21.0 \
	google.golang.org/protobuf		 v1.33.0 \
	google.golang.org/protobuf		 v1.36.1 \
	gopkg.in/check.v1			 v0.0.0-20161208181325-20d25e280405 \
	gopkg.in/yaml.v3			 v3.0.0-20200313102051-9f266ea9e77c

