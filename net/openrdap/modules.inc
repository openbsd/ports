MODGO_MODULES =	\
	github.com/alecthomas/kingpin/v2	 v2.4.0 \
	github.com/alecthomas/units		 v0.0.0-20240927000941-0f3dac36c52b \
	github.com/davecgh/go-spew		 v1.1.1 \
	github.com/jarcoal/httpmock		 v1.4.1 \
	github.com/maxatome/go-testdeep		 v1.14.0 \
	github.com/mitchellh/go-homedir		 v1.1.0 \
	github.com/pmezard/go-difflib		 v1.0.0 \
	github.com/stretchr/objx		 v0.5.2 \
	github.com/stretchr/testify		 v1.9.0 \
	github.com/xhit/go-str2duration/v2	 v2.1.0 \
	golang.org/x/crypto			 v0.53.0 \
	golang.org/x/net			 v0.55.0 \
	golang.org/x/sys			 v0.46.0 \
	golang.org/x/term			 v0.44.0 \
	golang.org/x/text			 v0.38.0 \
	gopkg.in/check.v1			 v0.0.0-20161208181325-20d25e280405 \
	gopkg.in/yaml.v3			 v3.0.1

MODGO_MODFILES =	\
	github.com/alecthomas/units	 v0.0.0-20211218093645-b94a6e3cc137 \
	github.com/davecgh/go-spew	 v1.1.0 \
	github.com/stretchr/objx	 v0.1.0 \
	github.com/stretchr/objx	 v0.4.0 \
	github.com/stretchr/objx	 v0.5.0 \
	github.com/stretchr/testify	 v1.7.1 \
	github.com/stretchr/testify	 v1.8.0 \
	github.com/stretchr/testify	 v1.8.2 \
	github.com/stretchr/testify	 v1.8.4 \
	gopkg.in/yaml.v3		 v3.0.0-20200313102051-9f266ea9e77c

