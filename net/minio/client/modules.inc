# $OpenBSD: modules.inc,v 1.4 2021/12/07 03:04:54 danj Exp $

MODGO_MODULES =	\
	cloud.google.com/go					 v0.65.0 \
	cloud.google.com/go/bigquery				 v1.8.0 \
	cloud.google.com/go/datastore				 v1.1.0 \
	cloud.google.com/go/pubsub				 v1.3.1 \
	cloud.google.com/go/storage				 v1.10.0 \
	dmitri.shuralyov.com/gpu/mtl				 v0.0.0-20190408044501-666a987793e9 \
	github.com/!burnt!sushi/toml				 v0.3.1 \
	github.com/!burnt!sushi/xgb				 v0.0.0-20160522181843-27f122750802 \
	github.com/!one!of!one/xxhash				 v1.2.2 \
	github.com/!stack!exchange/wmi				 v1.2.1 \
	github.com/alecthomas/template				 v0.0.0-20190718012654-fb15b899a751 \
	github.com/alecthomas/units				 v0.0.0-20190924025748-f65c72e2690d \
	github.com/antihax/optional				 v1.0.0 \
	github.com/benbjohnson/clock				 v1.1.0 \
	github.com/beorn7/perks					 v1.0.1 \
	github.com/briandowns/spinner				 v1.16.0 \
	github.com/census-instrumentation/opencensus-proto	 v0.2.1 \
	github.com/cespare/xxhash				 v1.1.0 \
	github.com/cespare/xxhash/v2				 v2.1.2 \
	github.com/cheggaaa/pb					 v1.0.29 \
	github.com/chzyer/logex					 v1.1.10 \
	github.com/chzyer/readline				 v0.0.0-20180603132655-2972be24d48e \
	github.com/chzyer/test					 v0.0.0-20180213035817-a1ea475d72b1 \
	github.com/client9/misspell				 v0.3.4 \
	github.com/cncf/udpa/go					 v0.0.0-20201120205902-5459f2c99403 \
	github.com/cncf/xds/go					 v0.0.0-20210805033703-aa0b78936158 \
	github.com/coreos/go-semver				 v0.3.0 \
	github.com/coreos/go-systemd/v22			 v22.3.2 \
	github.com/creack/pty					 v1.1.9 \
	github.com/davecgh/go-spew				 v1.1.1 \
	github.com/decred/dcrd/chaincfg/chainhash		 v1.0.2 \
	github.com/decred/dcrd/crypto/blake256			 v1.0.0 \
	github.com/decred/dcrd/dcrec/secp256k1/v3		 v3.0.0 \
	github.com/decred/dcrd/dcrec/secp256k1/v4		 v4.0.0 \
	github.com/dustin/go-humanize				 v1.0.0 \
	github.com/envoyproxy/go-control-plane			 v0.9.10-0.20210907150352-cf90f659a021 \
	github.com/envoyproxy/protoc-gen-validate		 v0.1.0 \
	github.com/fatih/color					 v1.13.0 \
	github.com/fatih/structs				 v1.1.0 \
	github.com/ghodss/yaml					 v1.0.0 \
	github.com/go-gl/glfw					 v0.0.0-20190409004039-e6da0acd62b1 \
	github.com/go-gl/glfw/v3.3/glfw				 v0.0.0-20200222043503-6f7a984d4dc4 \
	github.com/go-kit/kit					 v0.9.0 \
	github.com/go-kit/log					 v0.1.0 \
	github.com/go-logfmt/logfmt				 v0.5.0 \
	github.com/go-ole/go-ole				 v1.2.5 \
	github.com/go-stack/stack				 v1.8.0 \
	github.com/goccy/go-json				 v0.7.9 \
	github.com/godbus/dbus/v5				 v5.0.4 \
	github.com/gogo/protobuf				 v1.3.2 \
	github.com/golang-jwt/jwt				 v3.2.2+incompatible \
	github.com/golang/glog					 v0.0.0-20160126235308-23def4e6c14b \
	github.com/golang/groupcache				 v0.0.0-20200121045136-8c9f03a8e57e \
	github.com/golang/mock					 v1.4.4 \
	github.com/golang/protobuf				 v1.5.2 \
	github.com/google/btree					 v1.0.0 \
	github.com/google/go-cmp				 v0.5.5 \
	github.com/google/gofuzz				 v1.0.0 \
	github.com/google/martian				 v2.1.0+incompatible \
	github.com/google/martian/v3				 v3.0.0 \
	github.com/google/pprof					 v0.0.0-20200708004538-1a94d8640e99 \
	github.com/google/renameio				 v0.1.0 \
	github.com/google/uuid					 v1.3.0 \
	github.com/googleapis/gax-go/v2				 v2.0.5 \
	github.com/gopherjs/gopherjs				 v0.0.0-20181017120253-0766667cb4d1 \
	github.com/gorilla/mux					 v1.8.0 \
	github.com/grpc-ecosystem/go-grpc-prometheus		 v1.2.0 \
	github.com/grpc-ecosystem/grpc-gateway			 v1.16.0 \
	github.com/hashicorp/errwrap				 v1.1.0 \
	github.com/hashicorp/go-multierror			 v1.1.1 \
	github.com/hashicorp/golang-lru				 v0.5.1 \
	github.com/ianlancetaylor/demangle			 v0.0.0-20181102032728-5e5cf60278f6 \
	github.com/jpillora/backoff				 v1.0.0 \
	github.com/json-iterator/go				 v1.1.12 \
	github.com/jstemmer/go-junit-report			 v0.9.1 \
	github.com/jtolds/gls					 v4.20.0+incompatible \
	github.com/julienschmidt/httprouter			 v1.3.0 \
	github.com/kisielk/errcheck				 v1.5.0 \
	github.com/kisielk/gotool				 v1.0.0 \
	github.com/klauspost/compress				 v1.13.6 \
	github.com/klauspost/cpuid				 v1.3.1 \
	github.com/klauspost/cpuid/v2				 v2.0.9 \
	github.com/konsorten/go-windows-terminal-sequences	 v1.0.3 \
	github.com/kr/logfmt					 v0.0.0-20140226030751-b84e30acd515 \
	github.com/kr/pretty					 v0.1.0 \
	github.com/kr/pty					 v1.1.1 \
	github.com/kr/text					 v0.2.0 \
	github.com/lestrrat-go/backoff/v2			 v2.0.8 \
	github.com/lestrrat-go/blackmagic			 v1.0.0 \
	github.com/lestrrat-go/codegen				 v1.0.2 \
	github.com/lestrrat-go/httpcc				 v1.0.0 \
	github.com/lestrrat-go/iter				 v1.0.1 \
	github.com/lestrrat-go/jwx				 v1.2.7 \
	github.com/lestrrat-go/option				 v1.0.0 \
	github.com/lestrrat-go/pdebug/v3			 v3.0.1 \
	github.com/magefile/mage				 v1.10.0 \
	github.com/mattn/go-colorable				 v0.1.10 \
	github.com/mattn/go-ieproxy				 v0.0.1 \
	github.com/mattn/go-isatty				 v0.0.14 \
	github.com/mattn/go-runewidth				 v0.0.13 \
	github.com/matttproud/golang_protobuf_extensions	 v1.0.1 \
	github.com/minio/argon2					 v1.0.0 \
	github.com/minio/cli					 v1.22.0 \
	github.com/minio/colorjson				 v1.0.1 \
	github.com/minio/filepath				 v1.0.0 \
	github.com/minio/madmin-go				 v1.1.11-0.20211102182201-e51fd3d6b104 \
	github.com/minio/md5-simd				 v1.1.2 \
	github.com/minio/minio-go/v7				 v7.0.15-0.20211004160302-3b57c1e369ca \
	github.com/minio/pkg					 v1.1.3 \
	github.com/minio/selfupdate				 v0.3.1 \
	github.com/minio/sha256-simd				 v1.0.0 \
	github.com/minio/sio					 v0.2.1 \
	github.com/mitchellh/go-homedir				 v1.1.0 \
	github.com/modern-go/concurrent				 v0.0.0-20180306012644-bacd9c7ef1dd \
	github.com/modern-go/reflect2				 v1.0.2 \
	github.com/montanaflynn/stats				 v0.6.6 \
	github.com/mwitkow/go-conntrack				 v0.0.0-20190716064945-2f068394615f \
	github.com/niemeyer/pretty				 v0.0.0-20200227124842-a10e7caefd8e \
	github.com/philhofer/fwd				 v1.1.1 \
	github.com/pkg/errors					 v0.9.1 \
	github.com/pkg/profile					 v1.6.0 \
	github.com/pkg/xattr					 v0.4.3 \
	github.com/pmezard/go-difflib				 v1.0.0 \
	github.com/posener/complete				 v1.2.3 \
	github.com/prometheus/client_golang			 v1.11.0 \
	github.com/prometheus/client_model			 v0.2.0 \
	github.com/prometheus/common				 v0.31.1 \
	github.com/prometheus/procfs				 v0.7.3 \
	github.com/rivo/uniseg					 v0.2.0 \
	github.com/rjeczalik/notify				 v0.9.2 \
	github.com/rogpeppe/fastuuid				 v1.2.0 \
	github.com/rogpeppe/go-internal				 v1.3.0 \
	github.com/rs/xid					 v1.3.0 \
	github.com/secure-io/sio-go				 v0.3.1 \
	github.com/shirou/gopsutil/v3				 v3.21.8 \
	github.com/sirupsen/logrus				 v1.8.1 \
	github.com/smartystreets/assertions			 v1.1.1 \
	github.com/smartystreets/goconvey			 v1.6.4 \
	github.com/spaolacci/murmur3				 v0.0.0-20180118202830-f09979ecbc72 \
	github.com/stretchr/objx				 v0.1.1 \
	github.com/stretchr/testify				 v1.7.0 \
	github.com/tidwall/gjson				 v1.10.2 \
	github.com/tidwall/match				 v1.1.1 \
	github.com/tidwall/pretty				 v1.2.0 \
	github.com/tinylib/msgp					 v1.1.6 \
	github.com/tklauser/go-sysconf				 v0.3.9 \
	github.com/tklauser/numcpus				 v0.3.0 \
	github.com/yuin/goldmark				 v1.3.5 \
	go.etcd.io/etcd/api/v3					 v3.5.0 \
	go.etcd.io/etcd/client/pkg/v3				 v3.5.0 \
	go.etcd.io/etcd/client/v3				 v3.5.0 \
	go.opencensus.io					 v0.22.4 \
	go.opentelemetry.io/proto/otlp				 v0.7.0 \
	go.uber.org/atomic					 v1.9.0 \
	go.uber.org/goleak					 v1.1.11-0.20210813005559-691160354723 \
	go.uber.org/multierr					 v1.7.0 \
	go.uber.org/zap						 v1.19.1 \
	golang.org/x/crypto					 v0.0.0-20210921155107-089bfa567519 \
	golang.org/x/exp					 v0.0.0-20200224162631-6cc2880d07d6 \
	golang.org/x/image					 v0.0.0-20190802002840-cff245a6509b \
	golang.org/x/lint					 v0.0.0-20210508222113-6edffad5e616 \
	golang.org/x/mobile					 v0.0.0-20190719004257-d2bd2a29d028 \
	golang.org/x/mod					 v0.4.2 \
	golang.org/x/net					 v0.0.0-20210928044308-7d9f5e0b762b \
	golang.org/x/oauth2					 v0.0.0-20210514164344-f6687ab2804c \
	golang.org/x/sync					 v0.0.0-20210220032951-036812b2e83c \
	golang.org/x/sys					 v0.0.0-20210927094055-39ccf1dd6fa6 \
	golang.org/x/term					 v0.0.0-20210927222741-03fcf44c2211 \
	golang.org/x/text					 v0.3.7 \
	golang.org/x/time					 v0.0.0-20191024005414-555d28b269f0 \
	golang.org/x/tools					 v0.1.5 \
	golang.org/x/xerrors					 v0.0.0-20200804184101-5ec99f83aff1 \
	google.golang.org/api					 v0.30.0 \
	google.golang.org/appengine				 v1.6.6 \
	google.golang.org/genproto				 v0.0.0-20210928142010-c7af6a1a74c9 \
	google.golang.org/grpc					 v1.41.0 \
	google.golang.org/protobuf				 v1.27.1 \
	gopkg.in/alecthomas/kingpin.v2				 v2.2.6 \
	gopkg.in/check.v1					 v1.0.0-20200902074654-038fdea0a05b \
	gopkg.in/errgo.v2					 v2.1.0 \
	gopkg.in/h2non/filetype.v1				 v1.0.5 \
	gopkg.in/ini.v1						 v1.63.2 \
	gopkg.in/urfave/cli.v1					 v1.20.0 \
	gopkg.in/yaml.v2					 v2.4.0 \
	gopkg.in/yaml.v3					 v3.0.0-20210107192922-496545a6307b \
	honnef.co/go/tools					 v0.0.1-2020.1.4 \
	maze.io/x/duration					 v0.0.0-20160924141736-faac084b6075 \
	rsc.io/binaryregexp					 v0.2.0 \
	rsc.io/quote/v3						 v3.1.0 \
	rsc.io/sampler						 v1.3.0 \
	sigs.k8s.io/yaml					 v1.2.0

MODGO_MODFILES =	\
	cloud.google.com/go					 v0.26.0 \
	cloud.google.com/go					 v0.34.0 \
	cloud.google.com/go					 v0.38.0 \
	cloud.google.com/go					 v0.44.1 \
	cloud.google.com/go					 v0.44.2 \
	cloud.google.com/go					 v0.45.1 \
	cloud.google.com/go					 v0.46.3 \
	cloud.google.com/go					 v0.50.0 \
	cloud.google.com/go					 v0.52.0 \
	cloud.google.com/go					 v0.53.0 \
	cloud.google.com/go					 v0.54.0 \
	cloud.google.com/go					 v0.56.0 \
	cloud.google.com/go					 v0.57.0 \
	cloud.google.com/go					 v0.62.0 \
	cloud.google.com/go/bigquery				 v1.0.1 \
	cloud.google.com/go/bigquery				 v1.3.0 \
	cloud.google.com/go/bigquery				 v1.4.0 \
	cloud.google.com/go/bigquery				 v1.5.0 \
	cloud.google.com/go/bigquery				 v1.7.0 \
	cloud.google.com/go/datastore				 v1.0.0 \
	cloud.google.com/go/pubsub				 v1.0.1 \
	cloud.google.com/go/pubsub				 v1.1.0 \
	cloud.google.com/go/pubsub				 v1.2.0 \
	cloud.google.com/go/storage				 v1.0.0 \
	cloud.google.com/go/storage				 v1.5.0 \
	cloud.google.com/go/storage				 v1.6.0 \
	cloud.google.com/go/storage				 v1.8.0 \
	github.com/!stack!exchange/wmi				 v0.0.0-20190523213315-cbe66965904d \
	github.com/alecthomas/template				 v0.0.0-20160405071501-a0175ee3bccc \
	github.com/alecthomas/units				 v0.0.0-20151022065526-2efee857e7cf \
	github.com/alecthomas/units				 v0.0.0-20190717042225-c3de453c63f4 \
	github.com/beorn7/perks					 v0.0.0-20180321164747-3a771d992973 \
	github.com/beorn7/perks					 v1.0.0 \
	github.com/cespare/xxhash/v2				 v2.1.1 \
	github.com/cncf/udpa/go					 v0.0.0-20191209042840-269d4d468f6f \
	github.com/cncf/xds/go					 v0.0.0-20210312221358-fbca930ec8ed \
	github.com/coreos/go-systemd/v22			 v22.3.1 \
	github.com/davecgh/go-spew				 v1.1.0 \
	github.com/decred/dcrd/dcrec/secp256k1/v4		 v4.0.0-20210816181553-5444fa50b93d \
	github.com/envoyproxy/go-control-plane			 v0.9.0 \
	github.com/envoyproxy/go-control-plane			 v0.9.1-0.20191026205805-5f8ba28d4473 \
	github.com/envoyproxy/go-control-plane			 v0.9.4 \
	github.com/envoyproxy/go-control-plane			 v0.9.9-0.20201210154907-fd9021fe5dad \
	github.com/envoyproxy/go-control-plane			 v0.9.9-0.20210217033140-668b12f5399d \
	github.com/envoyproxy/go-control-plane			 v0.9.9-0.20210512163311-63b5d3c536b0 \
	github.com/fatih/color					 v1.12.0 \
	github.com/fatih/color					 v1.7.0 \
	github.com/fatih/color					 v1.9.0 \
	github.com/go-gl/glfw/v3.3/glfw				 v0.0.0-20191125211704-12ad95a8df72 \
	github.com/go-kit/kit					 v0.8.0 \
	github.com/go-logfmt/logfmt				 v0.3.0 \
	github.com/go-logfmt/logfmt				 v0.4.0 \
	github.com/go-ole/go-ole				 v1.2.4 \
	github.com/goccy/go-json				 v0.4.8 \
	github.com/goccy/go-json				 v0.7.8 \
	github.com/gogo/protobuf				 v1.1.1 \
	github.com/golang/groupcache				 v0.0.0-20190702054246-869f871628b6 \
	github.com/golang/groupcache				 v0.0.0-20191227052852-215e87163ea7 \
	github.com/golang/mock					 v1.1.1 \
	github.com/golang/mock					 v1.2.0 \
	github.com/golang/mock					 v1.3.1 \
	github.com/golang/mock					 v1.4.0 \
	github.com/golang/mock					 v1.4.1 \
	github.com/golang/mock					 v1.4.3 \
	github.com/golang/protobuf				 v1.2.0 \
	github.com/golang/protobuf				 v1.3.1 \
	github.com/golang/protobuf				 v1.3.2 \
	github.com/golang/protobuf				 v1.3.3 \
	github.com/golang/protobuf				 v1.3.4 \
	github.com/golang/protobuf				 v1.3.5 \
	github.com/golang/protobuf				 v1.4.0 \
	github.com/golang/protobuf				 v1.4.0-rc.1 \
	github.com/golang/protobuf				 v1.4.0-rc.1.0.20200221234624-67d41d38c208 \
	github.com/golang/protobuf				 v1.4.0-rc.2 \
	github.com/golang/protobuf				 v1.4.0-rc.4.0.20200313231945-b860323f09d0 \
	github.com/golang/protobuf				 v1.4.1 \
	github.com/golang/protobuf				 v1.4.2 \
	github.com/golang/protobuf				 v1.4.3 \
	github.com/golang/protobuf				 v1.5.0 \
	github.com/google/btree					 v0.0.0-20180813153112-4030bb1f1f0c \
	github.com/google/go-cmp				 v0.2.0 \
	github.com/google/go-cmp				 v0.3.0 \
	github.com/google/go-cmp				 v0.3.1 \
	github.com/google/go-cmp				 v0.4.0 \
	github.com/google/go-cmp				 v0.4.1 \
	github.com/google/go-cmp				 v0.5.0 \
	github.com/google/go-cmp				 v0.5.1 \
	github.com/google/go-cmp				 v0.5.4 \
	github.com/google/pprof					 v0.0.0-20181206194817-3ea8567a2e57 \
	github.com/google/pprof					 v0.0.0-20190515194954-54271f7e092f \
	github.com/google/pprof					 v0.0.0-20191218002539-d4f498aebedc \
	github.com/google/pprof					 v0.0.0-20200212024743-f11f1df84d12 \
	github.com/google/pprof					 v0.0.0-20200229191704-1ebb73c60ed3 \
	github.com/google/pprof					 v0.0.0-20200430221834-fc25d7d30c6d \
	github.com/google/uuid					 v1.1.1 \
	github.com/google/uuid					 v1.1.2 \
	github.com/googleapis/gax-go/v2				 v2.0.4 \
	github.com/hashicorp/errwrap				 v1.0.0 \
	github.com/hashicorp/go-multierror			 v1.0.0 \
	github.com/hashicorp/golang-lru				 v0.5.0 \
	github.com/json-iterator/go				 v1.1.10 \
	github.com/json-iterator/go				 v1.1.11 \
	github.com/json-iterator/go				 v1.1.6 \
	github.com/json-iterator/go				 v1.1.9 \
	github.com/jstemmer/go-junit-report			 v0.0.0-20190106144839-af01ea7f8024 \
	github.com/julienschmidt/httprouter			 v1.2.0 \
	github.com/klauspost/compress				 v1.13.5 \
	github.com/klauspost/cpuid				 v1.2.3 \
	github.com/klauspost/cpuid/v2				 v2.0.1 \
	github.com/klauspost/cpuid/v2				 v2.0.4 \
	github.com/konsorten/go-windows-terminal-sequences	 v1.0.1 \
	github.com/kr/text					 v0.1.0 \
	github.com/lestrrat-go/backoff/v2			 v2.0.7 \
	github.com/lestrrat-go/codegen				 v1.0.0 \
	github.com/lestrrat-go/jwx				 v1.2.0 \
	github.com/lestrrat-go/option				 v0.0.0-20210103042652-6f1ecfceda35 \
	github.com/mattn/go-colorable				 v0.1.2 \
	github.com/mattn/go-colorable				 v0.1.4 \
	github.com/mattn/go-colorable				 v0.1.8 \
	github.com/mattn/go-colorable				 v0.1.9 \
	github.com/mattn/go-isatty				 v0.0.11 \
	github.com/mattn/go-isatty				 v0.0.12 \
	github.com/mattn/go-isatty				 v0.0.13 \
	github.com/mattn/go-isatty				 v0.0.8 \
	github.com/mattn/go-runewidth				 v0.0.4 \
	github.com/minio/madmin-go				 v1.0.12 \
	github.com/minio/md5-simd				 v1.1.0 \
	github.com/minio/minio-go/v7				 v7.0.11-0.20210302210017-6ae69c73ce78 \
	github.com/minio/pkg					 v1.0.3 \
	github.com/minio/sha256-simd				 v0.1.1 \
	github.com/modern-go/concurrent				 v0.0.0-20180228061459-e0a39a4cb421 \
	github.com/modern-go/reflect2				 v0.0.0-20180701023420-4b7aa43c6742 \
	github.com/modern-go/reflect2				 v1.0.1 \
	github.com/mwitkow/go-conntrack				 v0.0.0-20161129095857-cc309e4a2223 \
	github.com/pkg/errors					 v0.8.0 \
	github.com/pkg/errors					 v0.8.1 \
	github.com/prometheus/client_golang			 v0.9.1 \
	github.com/prometheus/client_golang			 v1.0.0 \
	github.com/prometheus/client_golang			 v1.5.1 \
	github.com/prometheus/client_golang			 v1.7.1 \
	github.com/prometheus/client_model			 v0.0.0-20180712105110-5c3871d89910 \
	github.com/prometheus/client_model			 v0.0.0-20190129233127-fd36f4220a90 \
	github.com/prometheus/client_model			 v0.0.0-20190812154241-14fe0d1b01d4 \
	github.com/prometheus/common				 v0.10.0 \
	github.com/prometheus/common				 v0.26.0 \
	github.com/prometheus/common				 v0.4.1 \
	github.com/prometheus/common				 v0.9.1 \
	github.com/prometheus/procfs				 v0.0.0-20181005140218-185b4288413d \
	github.com/prometheus/procfs				 v0.0.2 \
	github.com/prometheus/procfs				 v0.0.8 \
	github.com/prometheus/procfs				 v0.1.3 \
	github.com/prometheus/procfs				 v0.6.0 \
	github.com/rs/xid					 v1.2.1 \
	github.com/shirou/gopsutil/v3				 v3.21.4 \
	github.com/shirou/gopsutil/v3				 v3.21.6 \
	github.com/sirupsen/logrus				 v1.2.0 \
	github.com/sirupsen/logrus				 v1.4.2 \
	github.com/sirupsen/logrus				 v1.6.0 \
	github.com/sirupsen/logrus				 v1.8.0 \
	github.com/smartystreets/assertions			 v0.0.0-20180927180507-b2de0cb4f26d \
	github.com/stretchr/objx				 v0.1.0 \
	github.com/stretchr/testify				 v1.2.2 \
	github.com/stretchr/testify				 v1.3.0 \
	github.com/stretchr/testify				 v1.4.0 \
	github.com/stretchr/testify				 v1.5.1 \
	github.com/stretchr/testify				 v1.6.1 \
	github.com/tinylib/msgp					 v1.1.3 \
	github.com/tklauser/go-sysconf				 v0.3.4 \
	github.com/tklauser/go-sysconf				 v0.3.5 \
	github.com/tklauser/go-sysconf				 v0.3.6 \
	github.com/tklauser/numcpus				 v0.2.1 \
	github.com/tklauser/numcpus				 v0.2.2 \
	github.com/yuin/goldmark				 v1.1.25 \
	github.com/yuin/goldmark				 v1.1.27 \
	github.com/yuin/goldmark				 v1.1.32 \
	github.com/yuin/goldmark				 v1.2.1 \
	go.etcd.io/etcd/api/v3					 v3.5.0-beta.4 \
	go.etcd.io/etcd/client/pkg/v3				 v3.5.0-beta.4 \
	go.etcd.io/etcd/client/v3				 v3.5.0-beta.4 \
	go.opencensus.io					 v0.21.0 \
	go.opencensus.io					 v0.22.0 \
	go.opencensus.io					 v0.22.2 \
	go.opencensus.io					 v0.22.3 \
	go.uber.org/atomic					 v1.7.0 \
	go.uber.org/multierr					 v1.6.0 \
	go.uber.org/zap						 v1.16.1-0.20210329175301-c23abee72d19 \
	go.uber.org/zap						 v1.17.0 \
	golang.org/x/crypto					 v0.0.0-20180904163835-0709b304e793 \
	golang.org/x/crypto					 v0.0.0-20190308221718-c2843e01d9a2 \
	golang.org/x/crypto					 v0.0.0-20190510104115-cbcb75029529 \
	golang.org/x/crypto					 v0.0.0-20190513172903-22d7a77e9e5f \
	golang.org/x/crypto					 v0.0.0-20190605123033-f99c8df09eb5 \
	golang.org/x/crypto					 v0.0.0-20191011191535-87dc89f01550 \
	golang.org/x/crypto					 v0.0.0-20200302210943-78000ba7a073 \
	golang.org/x/crypto					 v0.0.0-20200622213623-75b288015ac9 \
	golang.org/x/crypto					 v0.0.0-20200709230013-948cd5f35899 \
	golang.org/x/crypto					 v0.0.0-20201216223049-8b5274cf687f \
	golang.org/x/crypto					 v0.0.0-20201217014255-9d1352758620 \
	golang.org/x/crypto					 v0.0.0-20210421170649-83a5a9bb288b \
	golang.org/x/exp					 v0.0.0-20190121172915-509febef88a4 \
	golang.org/x/exp					 v0.0.0-20190306152737-a1d7652674e8 \
	golang.org/x/exp					 v0.0.0-20190510132918-efd6b22b2522 \
	golang.org/x/exp					 v0.0.0-20190829153037-c13cbed26979 \
	golang.org/x/exp					 v0.0.0-20191030013958-a1ab85dbe136 \
	golang.org/x/exp					 v0.0.0-20191129062945-2f5052295587 \
	golang.org/x/exp					 v0.0.0-20191227195350-da58074b4299 \
	golang.org/x/exp					 v0.0.0-20200119233911-0405dc783f0a \
	golang.org/x/exp					 v0.0.0-20200207192155-f17229e696bd \
	golang.org/x/image					 v0.0.0-20190227222117-0694c2d4d067 \
	golang.org/x/lint					 v0.0.0-20181026193005-c67002cb31c3 \
	golang.org/x/lint					 v0.0.0-20190227174305-5b3e6a55c961 \
	golang.org/x/lint					 v0.0.0-20190301231843-5614ed5bae6f \
	golang.org/x/lint					 v0.0.0-20190313153728-d0100b6bd8b3 \
	golang.org/x/lint					 v0.0.0-20190409202823-959b441ac422 \
	golang.org/x/lint					 v0.0.0-20190909230951-414d861bb4ac \
	golang.org/x/lint					 v0.0.0-20190930215403-16217165b5de \
	golang.org/x/lint					 v0.0.0-20191125180803-fdd1cda4f05f \
	golang.org/x/lint					 v0.0.0-20200130185559-910be7a94367 \
	golang.org/x/lint					 v0.0.0-20200302205851-738671d3881b \
	golang.org/x/mobile					 v0.0.0-20190312151609-d3739f865fa6 \
	golang.org/x/mod					 v0.0.0-20190513183733-4bf6d317e70e \
	golang.org/x/mod					 v0.1.0 \
	golang.org/x/mod					 v0.1.1-0.20191105210325-c90efee705ee \
	golang.org/x/mod					 v0.1.1-0.20191107180719-034126e5016b \
	golang.org/x/mod					 v0.2.0 \
	golang.org/x/mod					 v0.3.0 \
	golang.org/x/mod					 v0.4.1 \
	golang.org/x/net					 v0.0.0-20180724234803-3673e40ba225 \
	golang.org/x/net					 v0.0.0-20180826012351-8a410e7b638d \
	golang.org/x/net					 v0.0.0-20181114220301-adae6a3d119a \
	golang.org/x/net					 v0.0.0-20190108225652-1e06a53dbb7e \
	golang.org/x/net					 v0.0.0-20190213061140-3a22650c66bd \
	golang.org/x/net					 v0.0.0-20190311183353-d8887717615a \
	golang.org/x/net					 v0.0.0-20190404232315-eb5bcb51f2a3 \
	golang.org/x/net					 v0.0.0-20190501004415-9ce7a6920f09 \
	golang.org/x/net					 v0.0.0-20190503192946-f4e77d36d62c \
	golang.org/x/net					 v0.0.0-20190603091049-60506f45cf65 \
	golang.org/x/net					 v0.0.0-20190613194153-d28f0bde5980 \
	golang.org/x/net					 v0.0.0-20190620200207-3b0461eec859 \
	golang.org/x/net					 v0.0.0-20190628185345-da137c7871d7 \
	golang.org/x/net					 v0.0.0-20190724013045-ca1201d0de80 \
	golang.org/x/net					 v0.0.0-20191112182307-2180aed22343 \
	golang.org/x/net					 v0.0.0-20191209160850-c0dbc17a3553 \
	golang.org/x/net					 v0.0.0-20200114155413-6afb5195e5aa \
	golang.org/x/net					 v0.0.0-20200202094626-16171245cfb2 \
	golang.org/x/net					 v0.0.0-20200222125558-5a598a2470a0 \
	golang.org/x/net					 v0.0.0-20200226121028-0de0cce0169b \
	golang.org/x/net					 v0.0.0-20200301022130-244492dfa37a \
	golang.org/x/net					 v0.0.0-20200324143707-d3edc9973b7e \
	golang.org/x/net					 v0.0.0-20200501053045-e0ff5e5a1de5 \
	golang.org/x/net					 v0.0.0-20200506145744-7e3656a0809f \
	golang.org/x/net					 v0.0.0-20200513185701-a91f0712d120 \
	golang.org/x/net					 v0.0.0-20200520182314-0ba52f642ac2 \
	golang.org/x/net					 v0.0.0-20200625001655-4c5254603344 \
	golang.org/x/net					 v0.0.0-20200707034311-ab3426394381 \
	golang.org/x/net					 v0.0.0-20200822124328-c89045814202 \
	golang.org/x/net					 v0.0.0-20201021035429-f5854403a974 \
	golang.org/x/net					 v0.0.0-20210226172049-e18ecbb05110 \
	golang.org/x/net					 v0.0.0-20210405180319-a5a99cb37ef4 \
	golang.org/x/net					 v0.0.0-20210421230115-4e50805a0758 \
	golang.org/x/net					 v0.0.0-20210525063256-abc453219eb5 \
	golang.org/x/oauth2					 v0.0.0-20180821212333-d2e6202438be \
	golang.org/x/oauth2					 v0.0.0-20190226205417-e64efc72b421 \
	golang.org/x/oauth2					 v0.0.0-20190604053449-0f29369cfe45 \
	golang.org/x/oauth2					 v0.0.0-20191202225959-858c2ad4c8b6 \
	golang.org/x/oauth2					 v0.0.0-20200107190931-bf48bf16ab8d \
	golang.org/x/sync					 v0.0.0-20180314180146-1d60e4601c6f \
	golang.org/x/sync					 v0.0.0-20181108010431-42b317875d0f \
	golang.org/x/sync					 v0.0.0-20181221193216-37e7f081c4d4 \
	golang.org/x/sync					 v0.0.0-20190227155943-e225da77a7e6 \
	golang.org/x/sync					 v0.0.0-20190423024810-112230192c58 \
	golang.org/x/sync					 v0.0.0-20190911185100-cd5d95a43a6e \
	golang.org/x/sync					 v0.0.0-20200317015054-43a5402ce75a \
	golang.org/x/sync					 v0.0.0-20200625203802-6e8e738ad208 \
	golang.org/x/sync					 v0.0.0-20201020160332-67f06af15bc9 \
	golang.org/x/sync					 v0.0.0-20201207232520-09787c993a3a \
	golang.org/x/sys					 v0.0.0-20180830151530-49385e6e1522 \
	golang.org/x/sys					 v0.0.0-20180905080454-ebe1bf3edb33 \
	golang.org/x/sys					 v0.0.0-20180926160741-c2ed4eda69e7 \
	golang.org/x/sys					 v0.0.0-20181116152217-5ac8a444bdc5 \
	golang.org/x/sys					 v0.0.0-20190215142949-d0b11bdaac8a \
	golang.org/x/sys					 v0.0.0-20190222072716-a9d3bda3a223 \
	golang.org/x/sys					 v0.0.0-20190312061237-fead79001313 \
	golang.org/x/sys					 v0.0.0-20190412213103-97732733099d \
	golang.org/x/sys					 v0.0.0-20190422165155-953cdadca894 \
	golang.org/x/sys					 v0.0.0-20190502145724-3ef323f4f1fd \
	golang.org/x/sys					 v0.0.0-20190507160741-ecd444e8653b \
	golang.org/x/sys					 v0.0.0-20190606165138-5da285871e9c \
	golang.org/x/sys					 v0.0.0-20190624142023-c5567b49c5d0 \
	golang.org/x/sys					 v0.0.0-20190726091711-fc99dfbffb4e \
	golang.org/x/sys					 v0.0.0-20190916202348-b4ddaad3f8a3 \
	golang.org/x/sys					 v0.0.0-20191001151750-bb3f8db39f24 \
	golang.org/x/sys					 v0.0.0-20191026070338-33540a1f6037 \
	golang.org/x/sys					 v0.0.0-20191112214154-59a1497f0cea \
	golang.org/x/sys					 v0.0.0-20191204072324-ce4227a45e2e \
	golang.org/x/sys					 v0.0.0-20191228213918-04cbcbbfeed8 \
	golang.org/x/sys					 v0.0.0-20200106162015-b016eb3dc98e \
	golang.org/x/sys					 v0.0.0-20200113162924-86b910548bc1 \
	golang.org/x/sys					 v0.0.0-20200116001909-b77594299b42 \
	golang.org/x/sys					 v0.0.0-20200122134326-e047566fdf82 \
	golang.org/x/sys					 v0.0.0-20200202164722-d101bd2416d5 \
	golang.org/x/sys					 v0.0.0-20200212091648-12a6c2dcc1e4 \
	golang.org/x/sys					 v0.0.0-20200223170610-d5e6a3e2c0ae \
	golang.org/x/sys					 v0.0.0-20200302150141-5c8b2ff67527 \
	golang.org/x/sys					 v0.0.0-20200323222414-85ca7c5b95cd \
	golang.org/x/sys					 v0.0.0-20200331124033-c3d80250170d \
	golang.org/x/sys					 v0.0.0-20200501052902-10377860bb8e \
	golang.org/x/sys					 v0.0.0-20200511232937-7e40ca221e25 \
	golang.org/x/sys					 v0.0.0-20200515095857-1151b9dac4a9 \
	golang.org/x/sys					 v0.0.0-20200523222454-059865788121 \
	golang.org/x/sys					 v0.0.0-20200615200032-f1bc736245b1 \
	golang.org/x/sys					 v0.0.0-20200625212154-ddb9806d33ae \
	golang.org/x/sys					 v0.0.0-20200803210538-64077c9b5642 \
	golang.org/x/sys					 v0.0.0-20200930185726-fdedc70b468f \
	golang.org/x/sys					 v0.0.0-20201101102859-da207088b7d1 \
	golang.org/x/sys					 v0.0.0-20201119102817-f84b799fce68 \
	golang.org/x/sys					 v0.0.0-20210124154548-22da62e12c0c \
	golang.org/x/sys					 v0.0.0-20210217105451-b926d437f341 \
	golang.org/x/sys					 v0.0.0-20210316164454-77fc1eacc6aa \
	golang.org/x/sys					 v0.0.0-20210330210617-4fbd30eecc44 \
	golang.org/x/sys					 v0.0.0-20210403161142-5e06dd20ab57 \
	golang.org/x/sys					 v0.0.0-20210420072515-93ed5bcd2bfe \
	golang.org/x/sys					 v0.0.0-20210423082822-04245dca01da \
	golang.org/x/sys					 v0.0.0-20210510120138-977fb7262007 \
	golang.org/x/sys					 v0.0.0-20210603081109-ebe580a85c40 \
	golang.org/x/sys					 v0.0.0-20210615035016-665e8c7367d1 \
	golang.org/x/sys					 v0.0.0-20210630005230-0f9fa26af87c \
	golang.org/x/sys					 v0.0.0-20210816074244-15123e1e1f71 \
	golang.org/x/term					 v0.0.0-20201117132131-f5c789dd3221 \
	golang.org/x/term					 v0.0.0-20201126162022-7de9c90e9dd1 \
	golang.org/x/text					 v0.0.0-20170915032832-14c0d48ead0c \
	golang.org/x/text					 v0.3.0 \
	golang.org/x/text					 v0.3.1-0.20180807135948-17ff2d5776d2 \
	golang.org/x/text					 v0.3.2 \
	golang.org/x/text					 v0.3.3 \
	golang.org/x/text					 v0.3.5 \
	golang.org/x/text					 v0.3.6 \
	golang.org/x/time					 v0.0.0-20181108054448-85acf8d2951c \
	golang.org/x/time					 v0.0.0-20190308202827-9d24e82272b4 \
	golang.org/x/tools					 v0.0.0-20180917221912-90fa682c2a6e \
	golang.org/x/tools					 v0.0.0-20190114222345-bf090417da8b \
	golang.org/x/tools					 v0.0.0-20190226205152-f727befe758c \
	golang.org/x/tools					 v0.0.0-20190311212946-11955173bddd \
	golang.org/x/tools					 v0.0.0-20190312151545-0bb0c0a6e846 \
	golang.org/x/tools					 v0.0.0-20190312170243-e65039ee4138 \
	golang.org/x/tools					 v0.0.0-20190328211700-ab21143f2384 \
	golang.org/x/tools					 v0.0.0-20190425150028-36563e24a262 \
	golang.org/x/tools					 v0.0.0-20190506145303-2d16b83fe98c \
	golang.org/x/tools					 v0.0.0-20190524140312-2c0ae7006135 \
	golang.org/x/tools					 v0.0.0-20190606124116-d0a3d012864b \
	golang.org/x/tools					 v0.0.0-20190621195816-6e04913cbbac \
	golang.org/x/tools					 v0.0.0-20190628153133-6cdbf07be9d0 \
	golang.org/x/tools					 v0.0.0-20190816200558-6889da9d5479 \
	golang.org/x/tools					 v0.0.0-20190911174233-4f2ddba30aff \
	golang.org/x/tools					 v0.0.0-20191012152004-8de300cfc20a \
	golang.org/x/tools					 v0.0.0-20191113191852-77e3bb0ad9e7 \
	golang.org/x/tools					 v0.0.0-20191115202509-3a792d9c32b2 \
	golang.org/x/tools					 v0.0.0-20191119224855-298f0cb1881e \
	golang.org/x/tools					 v0.0.0-20191125144606-a911d9008d1f \
	golang.org/x/tools					 v0.0.0-20191130070609-6e064ea0cf2d \
	golang.org/x/tools					 v0.0.0-20191216173652-a0e659d51361 \
	golang.org/x/tools					 v0.0.0-20191227053925-7b8e75db28f4 \
	golang.org/x/tools					 v0.0.0-20200117161641-43d50277825c \
	golang.org/x/tools					 v0.0.0-20200122220014-bf1340f18c4a \
	golang.org/x/tools					 v0.0.0-20200130002326-2f3ba24bd6e7 \
	golang.org/x/tools					 v0.0.0-20200204074204-1cc6d1ef6c74 \
	golang.org/x/tools					 v0.0.0-20200207183749-b753a1ba74fa \
	golang.org/x/tools					 v0.0.0-20200212150539-ea181f53ac56 \
	golang.org/x/tools					 v0.0.0-20200224181240-023911ca70b2 \
	golang.org/x/tools					 v0.0.0-20200227222343-706bc42d1f0d \
	golang.org/x/tools					 v0.0.0-20200304193943-95d2e580d8eb \
	golang.org/x/tools					 v0.0.0-20200312045724-11d5b4c81c7d \
	golang.org/x/tools					 v0.0.0-20200331025713-a30bf2db82d4 \
	golang.org/x/tools					 v0.0.0-20200501065659-ab2804fb9c9d \
	golang.org/x/tools					 v0.0.0-20200512131952-2bc93b1c0c88 \
	golang.org/x/tools					 v0.0.0-20200515010526-7d3b6ebf133d \
	golang.org/x/tools					 v0.0.0-20200618134242-20370b0cb4b2 \
	golang.org/x/tools					 v0.0.0-20200619180055-7c47624df98f \
	golang.org/x/tools					 v0.0.0-20200729194436-6467de6f59a7 \
	golang.org/x/tools					 v0.0.0-20200804011535-6c149bb5ef0d \
	golang.org/x/tools					 v0.0.0-20200825202427-b303f430e36d \
	golang.org/x/tools					 v0.0.0-20200918232735-d647fc253266 \
	golang.org/x/tools					 v0.0.0-20201022035929-9cf592e881e9 \
	golang.org/x/tools					 v0.0.0-20210106214847-113979e3529a \
	golang.org/x/tools					 v0.0.0-20210114065538-d78b04bdf963 \
	golang.org/x/tools					 v0.1.2 \
	golang.org/x/xerrors					 v0.0.0-20190717185122-a985d3407aa7 \
	golang.org/x/xerrors					 v0.0.0-20191011141410-1b5146add898 \
	golang.org/x/xerrors					 v0.0.0-20191204190536-9bdfabe68543 \
	google.golang.org/api					 v0.13.0 \
	google.golang.org/api					 v0.14.0 \
	google.golang.org/api					 v0.15.0 \
	google.golang.org/api					 v0.17.0 \
	google.golang.org/api					 v0.18.0 \
	google.golang.org/api					 v0.19.0 \
	google.golang.org/api					 v0.20.0 \
	google.golang.org/api					 v0.22.0 \
	google.golang.org/api					 v0.24.0 \
	google.golang.org/api					 v0.28.0 \
	google.golang.org/api					 v0.29.0 \
	google.golang.org/api					 v0.4.0 \
	google.golang.org/api					 v0.7.0 \
	google.golang.org/api					 v0.8.0 \
	google.golang.org/api					 v0.9.0 \
	google.golang.org/appengine				 v1.1.0 \
	google.golang.org/appengine				 v1.4.0 \
	google.golang.org/appengine				 v1.5.0 \
	google.golang.org/appengine				 v1.6.1 \
	google.golang.org/appengine				 v1.6.5 \
	google.golang.org/genproto				 v0.0.0-20180817151627-c66870c02cf8 \
	google.golang.org/genproto				 v0.0.0-20190307195333-5fe7a883aa19 \
	google.golang.org/genproto				 v0.0.0-20190418145605-e7d98fc518a7 \
	google.golang.org/genproto				 v0.0.0-20190425155659-357c62f0e4bb \
	google.golang.org/genproto				 v0.0.0-20190502173448-54afdca5d873 \
	google.golang.org/genproto				 v0.0.0-20190801165951-fa694d86fc64 \
	google.golang.org/genproto				 v0.0.0-20190819201941-24fa4b261c55 \
	google.golang.org/genproto				 v0.0.0-20190911173649-1774047e7e51 \
	google.golang.org/genproto				 v0.0.0-20191108220845-16a3f7862a1a \
	google.golang.org/genproto				 v0.0.0-20191115194625-c23dd37a84c9 \
	google.golang.org/genproto				 v0.0.0-20191216164720-4f79533eabd1 \
	google.golang.org/genproto				 v0.0.0-20191230161307-f3c370f40bfb \
	google.golang.org/genproto				 v0.0.0-20200115191322-ca5a22157cba \
	google.golang.org/genproto				 v0.0.0-20200122232147-0452cf42e150 \
	google.golang.org/genproto				 v0.0.0-20200204135345-fa8e72b47b90 \
	google.golang.org/genproto				 v0.0.0-20200212174721-66ed5ce911ce \
	google.golang.org/genproto				 v0.0.0-20200224152610-e50cd9704f63 \
	google.golang.org/genproto				 v0.0.0-20200228133532-8c2c7df3a383 \
	google.golang.org/genproto				 v0.0.0-20200305110556-506484158171 \
	google.golang.org/genproto				 v0.0.0-20200312145019-da6875a35672 \
	google.golang.org/genproto				 v0.0.0-20200331122359-1ee6d9798940 \
	google.golang.org/genproto				 v0.0.0-20200430143042-b979b6f78d84 \
	google.golang.org/genproto				 v0.0.0-20200511104702-f5ebc3bea380 \
	google.golang.org/genproto				 v0.0.0-20200513103714-09dca8ec2884 \
	google.golang.org/genproto				 v0.0.0-20200515170657-fc4c6c6a6587 \
	google.golang.org/genproto				 v0.0.0-20200526211855-cb27e3aa2013 \
	google.golang.org/genproto				 v0.0.0-20200618031413-b414f8b61790 \
	google.golang.org/genproto				 v0.0.0-20200729003335-053ba62fc06f \
	google.golang.org/genproto				 v0.0.0-20200804131852-c06518451d9c \
	google.golang.org/genproto				 v0.0.0-20200825200019-8632dd797987 \
	google.golang.org/genproto				 v0.0.0-20210602131652-f16073e35f0c \
	google.golang.org/grpc					 v1.19.0 \
	google.golang.org/grpc					 v1.20.1 \
	google.golang.org/grpc					 v1.21.1 \
	google.golang.org/grpc					 v1.23.0 \
	google.golang.org/grpc					 v1.25.1 \
	google.golang.org/grpc					 v1.26.0 \
	google.golang.org/grpc					 v1.27.0 \
	google.golang.org/grpc					 v1.27.1 \
	google.golang.org/grpc					 v1.28.0 \
	google.golang.org/grpc					 v1.29.1 \
	google.golang.org/grpc					 v1.30.0 \
	google.golang.org/grpc					 v1.31.0 \
	google.golang.org/grpc					 v1.33.1 \
	google.golang.org/grpc					 v1.36.0 \
	google.golang.org/grpc					 v1.37.0 \
	google.golang.org/grpc					 v1.38.0 \
	google.golang.org/grpc					 v1.40.0 \
	google.golang.org/protobuf				 v0.0.0-20200109180630-ec00e32a8dfd \
	google.golang.org/protobuf				 v0.0.0-20200221191635-4d8936d0db64 \
	google.golang.org/protobuf				 v0.0.0-20200228230310-ab0ca4ff8a60 \
	google.golang.org/protobuf				 v1.20.1-0.20200309200217-e05f789c0967 \
	google.golang.org/protobuf				 v1.21.0 \
	google.golang.org/protobuf				 v1.22.0 \
	google.golang.org/protobuf				 v1.23.0 \
	google.golang.org/protobuf				 v1.23.1-0.20200526195155-81db48ad09cc \
	google.golang.org/protobuf				 v1.24.0 \
	google.golang.org/protobuf				 v1.25.0 \
	google.golang.org/protobuf				 v1.26.0 \
	google.golang.org/protobuf				 v1.26.0-rc.1 \
	gopkg.in/check.v1					 v0.0.0-20161208181325-20d25e280405 \
	gopkg.in/check.v1					 v1.0.0-20180628173108-788fd7840127 \
	gopkg.in/check.v1					 v1.0.0-20190902080502-41f04d3bba15 \
	gopkg.in/ini.v1						 v1.57.0 \
	gopkg.in/yaml.v2					 v2.2.1 \
	gopkg.in/yaml.v2					 v2.2.2 \
	gopkg.in/yaml.v2					 v2.2.3 \
	gopkg.in/yaml.v2					 v2.2.4 \
	gopkg.in/yaml.v2					 v2.2.5 \
	gopkg.in/yaml.v2					 v2.2.8 \
	gopkg.in/yaml.v2					 v2.3.0 \
	gopkg.in/yaml.v3					 v3.0.0-20200313102051-9f266ea9e77c \
	gopkg.in/yaml.v3					 v3.0.0-20200615113413-eeeca48fe776 \
	honnef.co/go/tools					 v0.0.0-20190102054323-c2f93a96b099 \
	honnef.co/go/tools					 v0.0.0-20190106161140-3f1c8253044a \
	honnef.co/go/tools					 v0.0.0-20190418001031-e561f6794a2a \
	honnef.co/go/tools					 v0.0.0-20190523083050-ea95bdfd59fc \
	honnef.co/go/tools					 v0.0.1-2019.2.3 \
	honnef.co/go/tools					 v0.0.1-2020.1.3

