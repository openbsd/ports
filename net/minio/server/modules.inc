MODGO_MODULES =	\
	aead.dev/mem									 v0.2.0 \
	aead.dev/minisign								 v0.3.0 \
	cel.dev/expr									 v0.15.0 \
	cloud.google.com/go								 v0.115.1 \
	cloud.google.com/go/accessapproval						 v1.7.12 \
	cloud.google.com/go/accesscontextmanager					 v1.8.12 \
	cloud.google.com/go/aiplatform							 v1.68.0 \
	cloud.google.com/go/analytics							 v0.24.0 \
	cloud.google.com/go/apigateway							 v1.6.12 \
	cloud.google.com/go/apigeeconnect						 v1.6.12 \
	cloud.google.com/go/apigeeregistry						 v0.8.10 \
	cloud.google.com/go/appengine							 v1.8.12 \
	cloud.google.com/go/area120							 v0.8.12 \
	cloud.google.com/go/artifactregistry						 v1.14.14 \
	cloud.google.com/go/asset							 v1.19.6 \
	cloud.google.com/go/assuredworkloads						 v1.11.12 \
	cloud.google.com/go/auth							 v0.9.1 \
	cloud.google.com/go/auth/oauth2adapt						 v0.2.4 \
	cloud.google.com/go/automl							 v1.13.12 \
	cloud.google.com/go/baremetalsolution						 v1.2.11 \
	cloud.google.com/go/batch							 v1.9.4 \
	cloud.google.com/go/beyondcorp							 v1.0.11 \
	cloud.google.com/go/bigquery							 v1.62.0 \
	cloud.google.com/go/bigtable							 v1.29.0 \
	cloud.google.com/go/billing							 v1.18.10 \
	cloud.google.com/go/binaryauthorization						 v1.8.8 \
	cloud.google.com/go/certificatemanager						 v1.8.6 \
	cloud.google.com/go/channel							 v1.17.12 \
	cloud.google.com/go/cloudbuild							 v1.16.6 \
	cloud.google.com/go/clouddms							 v1.7.11 \
	cloud.google.com/go/cloudtasks							 v1.12.13 \
	cloud.google.com/go/compute							 v1.27.5 \
	cloud.google.com/go/compute/metadata						 v0.5.0 \
	cloud.google.com/go/contactcenterinsights					 v1.13.7 \
	cloud.google.com/go/container							 v1.38.1 \
	cloud.google.com/go/containeranalysis						 v0.12.2 \
	cloud.google.com/go/datacatalog							 v1.21.1 \
	cloud.google.com/go/dataflow							 v0.9.12 \
	cloud.google.com/go/dataform							 v0.9.9 \
	cloud.google.com/go/datafusion							 v1.7.12 \
	cloud.google.com/go/datalabeling						 v0.8.12 \
	cloud.google.com/go/dataplex							 v1.18.3 \
	cloud.google.com/go/dataproc/v2							 v2.5.4 \
	cloud.google.com/go/dataqna							 v0.8.12 \
	cloud.google.com/go/datastore							 v1.19.0 \
	cloud.google.com/go/datastream							 v1.10.11 \
	cloud.google.com/go/deploy							 v1.21.2 \
	cloud.google.com/go/dialogflow							 v1.56.0 \
	cloud.google.com/go/dlp								 v1.17.0 \
	cloud.google.com/go/documentai							 v1.32.0 \
	cloud.google.com/go/domains							 v0.9.12 \
	cloud.google.com/go/edgecontainer						 v1.2.6 \
	cloud.google.com/go/errorreporting						 v0.3.1 \
	cloud.google.com/go/essentialcontacts						 v1.6.13 \
	cloud.google.com/go/eventarc							 v1.13.11 \
	cloud.google.com/go/filestore							 v1.8.8 \
	cloud.google.com/go/firestore							 v1.16.0 \
	cloud.google.com/go/functions							 v1.18.0 \
	cloud.google.com/go/gkebackup							 v1.5.5 \
	cloud.google.com/go/gkeconnect							 v0.8.12 \
	cloud.google.com/go/gkehub							 v0.14.12 \
	cloud.google.com/go/gkemulticloud						 v1.2.5 \
	cloud.google.com/go/gsuiteaddons						 v1.6.12 \
	cloud.google.com/go/iam								 v1.2.0 \
	cloud.google.com/go/iap								 v1.9.11 \
	cloud.google.com/go/ids								 v1.4.12 \
	cloud.google.com/go/iot								 v1.7.12 \
	cloud.google.com/go/kms								 v1.18.5 \
	cloud.google.com/go/language							 v1.13.1 \
	cloud.google.com/go/lifesciences						 v0.9.12 \
	cloud.google.com/go/logging							 v1.11.0 \
	cloud.google.com/go/longrunning							 v0.5.12 \
	cloud.google.com/go/managedidentities						 v1.6.12 \
	cloud.google.com/go/maps							 v1.11.7 \
	cloud.google.com/go/mediatranslation						 v0.8.12 \
	cloud.google.com/go/memcache							 v1.10.12 \
	cloud.google.com/go/metastore							 v1.13.11 \
	cloud.google.com/go/monitoring							 v1.20.4 \
	cloud.google.com/go/networkconnectivity						 v1.14.11 \
	cloud.google.com/go/networkmanagement						 v1.13.7 \
	cloud.google.com/go/networksecurity						 v0.9.12 \
	cloud.google.com/go/notebooks							 v1.11.10 \
	cloud.google.com/go/optimization						 v1.6.10 \
	cloud.google.com/go/orchestration						 v1.9.7 \
	cloud.google.com/go/orgpolicy							 v1.12.8 \
	cloud.google.com/go/osconfig							 v1.13.3 \
	cloud.google.com/go/oslogin							 v1.13.8 \
	cloud.google.com/go/phishingprotection						 v0.8.12 \
	cloud.google.com/go/policytroubleshooter					 v1.10.10 \
	cloud.google.com/go/privatecatalog						 v0.9.12 \
	cloud.google.com/go/pubsub							 v1.42.0 \
	cloud.google.com/go/pubsublite							 v1.8.2 \
	cloud.google.com/go/recaptchaenterprise/v2					 v2.14.3 \
	cloud.google.com/go/recommendationengine					 v0.8.12 \
	cloud.google.com/go/recommender							 v1.12.8 \
	cloud.google.com/go/redis							 v1.16.5 \
	cloud.google.com/go/resourcemanager						 v1.9.12 \
	cloud.google.com/go/resourcesettings						 v1.7.5 \
	cloud.google.com/go/retail							 v1.17.5 \
	cloud.google.com/go/run								 v1.4.1 \
	cloud.google.com/go/scheduler							 v1.10.13 \
	cloud.google.com/go/secretmanager						 v1.13.6 \
	cloud.google.com/go/security							 v1.17.5 \
	cloud.google.com/go/securitycenter						 v1.34.0 \
	cloud.google.com/go/servicedirectory						 v1.11.12 \
	cloud.google.com/go/shell							 v1.7.12 \
	cloud.google.com/go/spanner							 v1.67.0 \
	cloud.google.com/go/speech							 v1.24.1 \
	cloud.google.com/go/storage							 v1.43.0 \
	cloud.google.com/go/storagetransfer						 v1.10.11 \
	cloud.google.com/go/talent							 v1.6.13 \
	cloud.google.com/go/texttospeech						 v1.7.12 \
	cloud.google.com/go/tpu								 v1.6.12 \
	cloud.google.com/go/trace							 v1.10.12 \
	cloud.google.com/go/translate							 v1.11.0 \
	cloud.google.com/go/video							 v1.22.1 \
	cloud.google.com/go/videointelligence						 v1.11.12 \
	cloud.google.com/go/vision/v2							 v2.8.7 \
	cloud.google.com/go/vmmigration							 v1.7.12 \
	cloud.google.com/go/vmwareengine						 v1.2.1 \
	cloud.google.com/go/vpcaccess							 v1.7.12 \
	cloud.google.com/go/webrisk							 v1.9.12 \
	cloud.google.com/go/websecurityscanner						 v1.6.12 \
	cloud.google.com/go/workflows							 v1.12.11 \
	filippo.io/edwards25519								 v1.1.0 \
	github.com/!azure!a!d/microsoft-authentication-library-for-go			 v1.2.2 \
	github.com/!azure/azure-sdk-for-go/sdk/azcore					 v1.14.0 \
	github.com/!azure/azure-sdk-for-go/sdk/azidentity				 v1.7.0 \
	github.com/!azure/azure-sdk-for-go/sdk/internal					 v1.10.0 \
	github.com/!azure/azure-sdk-for-go/sdk/resourcemanager/compute/armcompute/v5	 v5.7.0 \
	github.com/!azure/azure-sdk-for-go/sdk/resourcemanager/network/armnetwork/v4	 v4.3.0 \
	github.com/!azure/azure-sdk-for-go/sdk/resourcemanager/storage/armstorage	 v1.6.0 \
	github.com/!azure/azure-sdk-for-go/sdk/storage/azblob				 v1.4.0 \
	github.com/!azure/go-ntlmssp							 v0.0.0-20221128193559-754e69321358 \
	github.com/!burnt!sushi/toml							 v0.3.1 \
	github.com/!code-!hex/go-generics-cache						 v1.5.1 \
	github.com/!data!dog/datadog-go							 v2.2.0+incompatible \
	github.com/!i!b!m/sarama							 v1.43.3 \
	github.com/!kim!machine!gun/automemlimit					 v0.6.1 \
	github.com/!make!now!just/heredoc						 v1.0.0 \
	github.com/!microsoft/go-winio							 v0.6.1 \
	github.com/!vivid!cortex/ewma							 v1.2.0 \
	github.com/acarl005/stripansi							 v0.0.0-20180116102854-5a71ef0e047d \
	github.com/alecthomas/kingpin/v2						 v2.4.0 \
	github.com/alecthomas/participle						 v0.7.1 \
	github.com/alecthomas/repr							 v0.0.0-20181024024818-d37bc2a10ba1 \
	github.com/alecthomas/units							 v0.0.0-20240626203959-61d1e3462e30 \
	github.com/alexbrainman/sspi							 v0.0.0-20231016080023-1a75b4708caa \
	github.com/apache/thrift							 v0.20.0 \
	github.com/araddon/dateparse							 v0.0.0-20210429162001-6b43995a97de \
	github.com/armon/consul-api							 v0.0.0-20180202201655-eb2c6b5be1b6 \
	github.com/armon/go-metrics							 v0.4.1 \
	github.com/asaskevich/govalidator						 v0.0.0-20230301143203-a9d515a09cc2 \
	github.com/atotto/clipboard							 v0.1.4 \
	github.com/aws/aws-sdk-go							 v1.54.19 \
	github.com/aymanbagabas/go-osc52/v2						 v2.0.1 \
	github.com/aymanbagabas/go-udiff						 v0.2.0 \
	github.com/bboreham/go-loser							 v0.0.0-20230920113527-fcc2c21820a3 \
	github.com/beevik/ntp								 v1.4.3 \
	github.com/beorn7/perks								 v1.0.1 \
	github.com/blang/semver/v4							 v4.0.0 \
	github.com/buger/jsonparser							 v1.1.1 \
	github.com/cenkalti/backoff/v4							 v4.3.0 \
	github.com/census-instrumentation/opencensus-proto				 v0.4.1 \
	github.com/cespare/xxhash/v2							 v2.3.0 \
	github.com/charmbracelet/bubbles						 v0.19.0 \
	github.com/charmbracelet/bubbletea						 v0.27.1 \
	github.com/charmbracelet/harmonica						 v0.2.0 \
	github.com/charmbracelet/lipgloss						 v0.13.0 \
	github.com/charmbracelet/x/ansi							 v0.2.3 \
	github.com/charmbracelet/x/exp/golden						 v0.0.0-20240815200342-61de596daa2b \
	github.com/charmbracelet/x/input						 v0.1.3 \
	github.com/charmbracelet/x/term							 v0.2.0 \
	github.com/charmbracelet/x/windows						 v0.1.2 \
	github.com/cheggaaa/pb								 v1.0.29 \
	github.com/cheggaaa/pb/v3							 v3.1.5 \
	github.com/chromedp/cdproto							 v0.0.0-20230802225258-3cf4e6d46a89 \
	github.com/chromedp/chromedp							 v0.9.2 \
	github.com/chromedp/sysutil							 v1.0.0 \
	github.com/chzyer/logex								 v1.2.1 \
	github.com/chzyer/readline							 v1.5.1 \
	github.com/chzyer/test								 v1.0.0 \
	github.com/cilium/ebpf								 v0.11.0 \
	github.com/circonus-labs/circonus-gometrics					 v2.3.1+incompatible \
	github.com/circonus-labs/circonusllhist						 v0.1.3 \
	github.com/client9/misspell							 v0.3.4 \
	github.com/cncf/udpa/go								 v0.0.0-20191209042840-269d4d468f6f \
	github.com/cncf/xds/go								 v0.0.0-20240423153145-555b57ec207b \
	github.com/containerd/cgroups/v3						 v3.0.3 \
	github.com/containerd/log							 v0.1.0 \
	github.com/coreos/etcd								 v3.3.10+incompatible \
	github.com/coreos/go-etcd							 v2.0.0+incompatible \
	github.com/coreos/go-oidc/v3							 v3.11.0 \
	github.com/coreos/go-semver							 v0.3.1 \
	github.com/coreos/go-systemd/v22						 v22.5.0 \
	github.com/cosnicolaou/pbzip2							 v1.0.3 \
	github.com/cpuguy83/go-md2man							 v1.0.10 \
	github.com/davecgh/go-spew							 v1.1.2-0.20180830191138-d8f796af33cc \
	github.com/dchest/siphash							 v1.2.3 \
	github.com/decred/dcrd/crypto/blake256						 v1.0.1 \
	github.com/decred/dcrd/dcrec/secp256k1/v4					 v4.3.0 \
	github.com/dennwc/varint							 v1.0.0 \
	github.com/digitalocean/godo							 v1.118.0 \
	github.com/distribution/reference						 v0.5.0 \
	github.com/docker/docker							 v27.0.3+incompatible \
	github.com/docker/go-connections						 v0.4.0 \
	github.com/docker/go-units							 v0.5.0 \
	github.com/dustin/go-humanize							 v1.0.1 \
	github.com/eapache/go-resiliency						 v1.7.0 \
	github.com/eapache/go-xerial-snappy						 v0.0.0-20230731223053-c322873962e3 \
	github.com/eapache/queue							 v1.1.0 \
	github.com/eclipse/paho.mqtt.golang						 v1.5.0 \
	github.com/edsrzf/mmap-go							 v1.1.0 \
	github.com/elastic/go-elasticsearch/v7						 v7.17.10 \
	github.com/emicklei/go-restful/v3						 v3.11.0 \
	github.com/envoyproxy/go-control-plane						 v0.12.1-0.20240621013728-1eb8caab5155 \
	github.com/envoyproxy/protoc-gen-validate					 v1.0.4 \
	github.com/erikgeiser/coninput							 v0.0.0-20211004153227-1c3628e74d0f \
	github.com/evanphx/json-patch							 v5.6.0+incompatible \
	github.com/facette/natsort							 v0.0.0-20181210072756-2cd4dd1e2dcb \
	github.com/fatih/color								 v1.17.0 \
	github.com/fatih/structs							 v1.1.0 \
	github.com/felixge/fgprof							 v0.9.4 \
	github.com/felixge/httpsnoop							 v1.0.4 \
	github.com/fortytw2/leaktest							 v1.3.0 \
	github.com/fraugster/parquet-go							 v0.12.0 \
	github.com/fsnotify/fsnotify							 v1.7.0 \
	github.com/ghodss/yaml								 v1.0.0 \
	github.com/go-asn1-ber/asn1-ber							 v1.5.7 \
	github.com/go-ini/ini								 v1.67.0 \
	github.com/go-jose/go-jose/v4							 v4.0.4 \
	github.com/go-kit/kit								 v0.12.0 \
	github.com/go-kit/log								 v0.2.1 \
	github.com/go-ldap/ldap/v3							 v3.4.8 \
	github.com/go-logfmt/logfmt							 v0.6.0 \
	github.com/go-logr/logr								 v1.4.2 \
	github.com/go-logr/stdr								 v1.2.2 \
	github.com/go-ole/go-ole							 v1.3.0 \
	github.com/go-openapi/analysis							 v0.23.0 \
	github.com/go-openapi/errors							 v0.22.0 \
	github.com/go-openapi/jsonpointer						 v0.21.0 \
	github.com/go-openapi/jsonreference						 v0.21.0 \
	github.com/go-openapi/loads							 v0.22.0 \
	github.com/go-openapi/runtime							 v0.28.0 \
	github.com/go-openapi/spec							 v0.21.0 \
	github.com/go-openapi/strfmt							 v0.23.0 \
	github.com/go-openapi/swag							 v0.23.0 \
	github.com/go-openapi/validate							 v0.24.0 \
	github.com/go-resty/resty/v2							 v2.13.1 \
	github.com/go-sql-driver/mysql							 v1.8.1 \
	github.com/go-zookeeper/zk							 v1.0.3 \
	github.com/gobwas/httphead							 v0.1.0 \
	github.com/gobwas/pool								 v0.2.1 \
	github.com/gobwas/ws								 v1.4.0 \
	github.com/goccy/go-json							 v0.10.3 \
	github.com/godbus/dbus/v5							 v5.0.4 \
	github.com/gogo/protobuf							 v1.3.2 \
	github.com/golang-jwt/jwt/v4							 v4.5.1 \
	github.com/golang-jwt/jwt/v5							 v5.2.1 \
	github.com/golang/glog								 v1.2.1 \
	github.com/golang/groupcache							 v0.0.0-20210331224755-41bb18bfe9da \
	github.com/golang/mock								 v1.5.0 \
	github.com/golang/protobuf							 v1.5.4 \
	github.com/golang/snappy							 v0.0.4 \
	github.com/gomodule/redigo							 v1.9.2 \
	github.com/google/gnostic-models						 v0.6.8 \
	github.com/google/go-cmp							 v0.6.0 \
	github.com/google/go-pkcs11							 v0.2.1-0.20230907215043-c6f79328ddf9 \
	github.com/google/go-querystring						 v1.1.0 \
	github.com/google/gofuzz							 v1.2.0 \
	github.com/google/martian/v3							 v3.3.3 \
	github.com/google/pprof								 v0.0.0-20240727154555-813a5fbdbec8 \
	github.com/google/s2a-go							 v0.1.8 \
	github.com/google/shlex								 v0.0.0-20191202100458-e7afc7fbc510 \
	github.com/google/uuid								 v1.6.0 \
	github.com/googleapis/enterprise-certificate-proxy				 v0.3.2 \
	github.com/googleapis/gax-go/v2							 v2.13.0 \
	github.com/gophercloud/gophercloud						 v1.13.0 \
	github.com/gopherjs/gopherjs							 v0.0.0-20181017120253-0766667cb4d1 \
	github.com/gorilla/securecookie							 v1.1.1 \
	github.com/gorilla/sessions							 v1.2.1 \
	github.com/gorilla/websocket							 v1.5.3 \
	github.com/grafana/regexp							 v0.0.0-20240518133315-a468a5bfb3bc \
	github.com/grpc-ecosystem/go-grpc-prometheus					 v1.2.0 \
	github.com/grpc-ecosystem/grpc-gateway						 v1.16.0 \
	github.com/grpc-ecosystem/grpc-gateway/v2					 v2.20.0 \
	github.com/hashicorp/consul/api							 v1.29.2 \
	github.com/hashicorp/cronexpr							 v1.1.2 \
	github.com/hashicorp/errwrap							 v1.1.0 \
	github.com/hashicorp/go-cleanhttp						 v0.5.2 \
	github.com/hashicorp/go-hclog							 v1.6.3 \
	github.com/hashicorp/go-immutable-radix						 v1.3.1 \
	github.com/hashicorp/go-msgpack							 v1.1.5 \
	github.com/hashicorp/go-multierror						 v1.1.1 \
	github.com/hashicorp/go-retryablehttp						 v0.7.7 \
	github.com/hashicorp/go-rootcerts						 v1.0.2 \
	github.com/hashicorp/go-uuid							 v1.0.3 \
	github.com/hashicorp/golang-lru							 v1.0.2 \
	github.com/hashicorp/hcl							 v1.0.0 \
	github.com/hashicorp/nomad/api							 v0.0.0-20240717122358-3d93bd3778f3 \
	github.com/hashicorp/raft							 v1.3.9 \
	github.com/hashicorp/serf							 v0.10.1 \
	github.com/hetznercloud/hcloud-go/v2						 v2.10.2 \
	github.com/ianlancetaylor/demangle						 v0.0.0-20240312041847-bd984b5ce465 \
	github.com/imdario/mergo							 v0.3.16 \
	github.com/inconshreveable/mousetrap						 v1.1.0 \
	github.com/ionos-cloud/sdk-go/v6						 v6.1.11 \
	github.com/jcmturner/aescts/v2							 v2.0.0 \
	github.com/jcmturner/dnsutils/v2						 v2.0.0 \
	github.com/jcmturner/gofork							 v1.7.6 \
	github.com/jcmturner/goidentity/v6						 v6.0.1 \
	github.com/jcmturner/gokrb5/v8							 v8.4.4 \
	github.com/jcmturner/rpc/v2							 v2.0.3 \
	github.com/jedib0t/go-pretty/v6							 v6.5.9 \
	github.com/jessevdk/go-flags							 v1.6.1 \
	github.com/jlaffaye/ftp								 v0.0.0-20190624084859-c1312a7102bf \
	github.com/jmespath/go-jmespath							 v0.4.0 \
	github.com/josharian/intern							 v1.0.0 \
	github.com/jpillora/backoff							 v1.0.0 \
	github.com/json-iterator/go							 v1.1.12 \
	github.com/jtolds/gls								 v4.20.0+incompatible \
	github.com/juju/ratelimit							 v1.0.2 \
	github.com/julienschmidt/httprouter						 v1.3.0 \
	github.com/kisielk/errcheck							 v1.5.0 \
	github.com/kisielk/gotool							 v1.0.0 \
	github.com/klauspost/compress							 v1.17.10 \
	github.com/klauspost/cpuid/v2							 v2.2.8 \
	github.com/klauspost/filepathx							 v1.1.1 \
	github.com/klauspost/pgzip							 v1.2.6 \
	github.com/klauspost/readahead							 v1.4.0 \
	github.com/klauspost/reedsolomon						 v1.12.4 \
	github.com/kolo/xmlrpc								 v0.0.0-20220921171641-a4b6fa1dd06b \
	github.com/konsorten/go-windows-terminal-sequences				 v1.0.1 \
	github.com/kr/fs								 v0.1.0 \
	github.com/kr/pretty								 v0.3.1 \
	github.com/kr/pty								 v1.1.1 \
	github.com/kr/text								 v0.2.0 \
	github.com/kylelemons/godebug							 v1.1.0 \
	github.com/ledongthuc/pdf							 v0.0.0-20220302134840-0c2507a12d80 \
	github.com/lestrrat-go/backoff/v2						 v2.0.8 \
	github.com/lestrrat-go/blackmagic						 v1.0.2 \
	github.com/lestrrat-go/httpcc							 v1.0.1 \
	github.com/lestrrat-go/iter							 v1.0.2 \
	github.com/lestrrat-go/jwx							 v1.2.30 \
	github.com/lestrrat-go/option							 v1.0.1 \
	github.com/lib/pq								 v1.10.9 \
	github.com/linode/linodego							 v1.37.0 \
	github.com/lithammer/shortuuid/v4						 v4.0.0 \
	github.com/lucasb-eyer/go-colorful						 v1.2.0 \
	github.com/lufia/plan9stats							 v0.0.0-20240909124753-873cd0166683 \
	github.com/magiconair/properties						 v1.8.7 \
	github.com/mailru/easyjson							 v0.7.7 \
	github.com/mattn/go-colorable							 v0.1.13 \
	github.com/mattn/go-ieproxy							 v0.0.12 \
	github.com/mattn/go-isatty							 v0.0.20 \
	github.com/mattn/go-localereader						 v0.0.1 \
	github.com/mattn/go-runewidth							 v0.0.16 \
	github.com/matttproud/golang_protobuf_extensions				 v1.0.4 \
	github.com/miekg/dns								 v1.1.62 \
	github.com/minio/cli								 v1.24.2 \
	github.com/minio/colorjson							 v1.0.8 \
	github.com/minio/console							 v1.7.3 \
	github.com/minio/csvparser							 v1.0.0 \
	github.com/minio/dnscache							 v0.1.1 \
	github.com/minio/dperf								 v0.6.0 \
	github.com/minio/filepath							 v1.0.0 \
	github.com/minio/highwayhash							 v1.0.3 \
	github.com/minio/kes								 v0.23.0 \
	github.com/minio/kes-go								 v0.2.1 \
	github.com/minio/kms-go/kes							 v0.3.0 \
	github.com/minio/kms-go/kms							 v0.4.0 \
	github.com/minio/madmin-go/v3							 v3.0.70 \
	github.com/minio/mc								 v0.0.0-20240909075310-04c5116c9bdf \
	github.com/minio/md5-simd							 v1.1.2 \
	github.com/minio/minio-go/v6							 v6.0.46 \
	github.com/minio/minio-go/v7							 v7.0.77 \
	github.com/minio/mux								 v1.9.0 \
	github.com/minio/pkg/v3								 v3.0.22 \
	github.com/minio/selfupdate							 v0.6.0 \
	github.com/minio/sha256-simd							 v0.1.1 \
	github.com/minio/simdjson-go							 v0.4.5 \
	github.com/minio/sio								 v0.4.1 \
	github.com/minio/websocket							 v1.6.0 \
	github.com/minio/xxml								 v0.0.3 \
	github.com/minio/zipindex							 v0.3.1 \
	github.com/mitchellh/go-homedir							 v1.1.0 \
	github.com/mitchellh/mapstructure						 v1.5.0 \
	github.com/moby/docker-image-spec						 v1.3.1 \
	github.com/moby/term								 v0.0.0-20210619224110-3f7ff695adc6 \
	github.com/modern-go/concurrent							 v0.0.0-20180306012644-bacd9c7ef1dd \
	github.com/modern-go/reflect2							 v1.0.2 \
	github.com/montanaflynn/stats							 v0.7.1 \
	github.com/morikuni/aec								 v1.0.0 \
	github.com/muesli/ansi								 v0.0.0-20230316100256-276c6243b2f6 \
	github.com/muesli/cancelreader							 v0.2.2 \
	github.com/muesli/reflow							 v0.3.0 \
	github.com/muesli/termenv							 v0.15.2 \
	github.com/munnerz/goautoneg							 v0.0.0-20191010083416-a7dc8b61c822 \
	github.com/mwitkow/go-conntrack							 v0.0.0-20190716064945-2f068394615f \
	github.com/nats-io/jwt/v2							 v2.5.0 \
	github.com/nats-io/nats-server/v2						 v2.9.23 \
	github.com/nats-io/nats-streaming-server					 v0.24.6 \
	github.com/nats-io/nats.go							 v1.37.0 \
	github.com/nats-io/nkeys							 v0.4.7 \
	github.com/nats-io/nuid								 v1.0.1 \
	github.com/nats-io/stan.go							 v0.10.4 \
	github.com/ncw/directio								 v1.0.5 \
	github.com/niemeyer/pretty							 v0.0.0-20200227124842-a10e7caefd8e \
	github.com/nsf/jsondiff								 v0.0.0-20230430225905-43f6cf3098c1 \
	github.com/nsqio/go-nsq								 v1.1.0 \
	github.com/oklog/run								 v1.1.0 \
	github.com/oklog/ulid								 v1.3.1 \
	github.com/olekukonko/tablewriter						 v0.0.5 \
	github.com/opencontainers/go-digest						 v1.0.0 \
	github.com/opencontainers/image-spec						 v1.0.2 \
	github.com/opencontainers/runtime-spec						 v1.0.2 \
	github.com/opentracing/opentracing-go						 v1.2.0 \
	github.com/orisano/pixelmatch							 v0.0.0-20220722002657-fb0b55479cde \
	github.com/ovh/go-ovh								 v1.6.0 \
	github.com/pascaldekloe/goe							 v0.1.0 \
	github.com/pbnjay/memory							 v0.0.0-20210728143218-7b4eea64cf58 \
	github.com/pelletier/go-toml							 v1.2.0 \
	github.com/pelletier/go-toml/v2							 v2.2.3 \
	github.com/philhofer/fwd							 v1.1.3-0.20240916144458-20a13a1f6b7c \
	github.com/pierrec/lz4/v4							 v4.1.21 \
	github.com/pkg/browser								 v0.0.0-20240102092130-5ac0b6a4141c \
	github.com/pkg/errors								 v0.9.1 \
	github.com/pkg/profile								 v1.7.0 \
	github.com/pkg/sftp								 v1.13.6 \
	github.com/pkg/xattr								 v0.4.10 \
	github.com/planetscale/vtprotobuf						 v0.6.1-0.20240319094008-0393e58bdf10 \
	github.com/pmezard/go-difflib							 v1.0.1-0.20181226105442-5d4384ee4fb2 \
	github.com/posener/complete							 v1.2.3 \
	github.com/power-devops/perfstat						 v0.0.0-20240221224432-82ca36839d55 \
	github.com/prometheus/alertmanager						 v0.27.0 \
	github.com/prometheus/client_golang						 v1.20.2 \
	github.com/prometheus/client_model						 v0.6.1 \
	github.com/prometheus/common							 v0.59.1 \
	github.com/prometheus/common/assets						 v0.2.0 \
	github.com/prometheus/common/sigv4						 v0.1.0 \
	github.com/prometheus/exporter-toolkit						 v0.11.0 \
	github.com/prometheus/procfs							 v0.15.1 \
	github.com/prometheus/prom2json							 v1.4.0 \
	github.com/prometheus/prometheus						 v0.54.1 \
	github.com/puzpuzpuz/xsync/v3							 v3.4.0 \
	github.com/rabbitmq/amqp091-go							 v1.10.0 \
	github.com/rcrowley/go-metrics							 v0.0.0-20201227073835-cf1acfcdf475 \
	github.com/rivo/uniseg								 v0.4.7 \
	github.com/rjeczalik/notify							 v0.9.3 \
	github.com/rogpeppe/go-internal							 v1.12.0 \
	github.com/rs/cors								 v1.11.1 \
	github.com/rs/xid								 v1.6.0 \
	github.com/russross/blackfriday							 v1.5.2 \
	github.com/safchain/ethtool							 v0.4.1 \
	github.com/sagikazarmark/locafero						 v0.6.0 \
	github.com/sagikazarmark/slog-shim						 v0.1.0 \
	github.com/sahilm/fuzzy								 v0.1.1 \
	github.com/scaleway/scaleway-sdk-go						 v1.0.0-beta.29 \
	github.com/scylladb/termtables							 v0.0.0-20191203121021-c4c0b6d42ff4 \
	github.com/secure-io/sio-go							 v0.3.1 \
	github.com/shirou/gopsutil/v3							 v3.24.5 \
	github.com/shoenig/go-m1cpu							 v0.1.6 \
	github.com/shoenig/test								 v0.6.4 \
	github.com/shurcoo!l/httpfs							 v0.0.0-20230704072500-f1e31cf0ba5c \
	github.com/sirupsen/logrus							 v1.9.3 \
	github.com/smartystreets/assertions						 v0.0.0-20180927180507-b2de0cb4f26d \
	github.com/smartystreets/goconvey						 v0.0.0-20190330032615-68dc04aab96a \
	github.com/sourcegraph/conc							 v0.3.0 \
	github.com/spf13/afero								 v1.11.0 \
	github.com/spf13/cast								 v1.7.0 \
	github.com/spf13/cobra								 v1.8.1 \
	github.com/spf13/jwalterweatherman						 v1.0.0 \
	github.com/spf13/pflag								 v1.0.5 \
	github.com/spf13/viper								 v1.19.0 \
	github.com/stretchr/objx							 v0.5.2 \
	github.com/stretchr/testify							 v1.9.0 \
	github.com/subosito/gotenv							 v1.6.0 \
	github.com/tidwall/gjson							 v1.17.3 \
	github.com/tidwall/match							 v1.1.1 \
	github.com/tidwall/pretty							 v1.2.1 \
	github.com/tinylib/msgp								 v1.2.3-0.20241022140105-4558fbf3a223 \
	github.com/tklauser/go-sysconf							 v0.3.14 \
	github.com/tklauser/numcpus							 v0.8.0 \
	github.com/tv42/httpunix							 v0.0.0-20150427012821-b75d8614f926 \
	github.com/ugorji/go/codec							 v0.0.0-20181204163529-d75b2dcb6bc8 \
	github.com/unrolled/secure							 v1.15.0 \
	github.com/valyala/bytebufferpool						 v1.0.0 \
	github.com/vbauerster/mpb/v8							 v8.8.2 \
	github.com/vultr/govultr/v2							 v2.17.2 \
	github.com/xdg-go/pbkdf2							 v1.0.0 \
	github.com/xdg-go/scram								 v1.1.2 \
	github.com/xdg-go/stringprep							 v1.0.4 \
	github.com/xdg/scram								 v1.0.5 \
	github.com/xdg/stringprep							 v1.0.3 \
	github.com/xhit/go-str2duration/v2						 v2.1.0 \
	github.com/xo/terminfo								 v0.0.0-20220910002029-abceb7e1c41e \
	github.com/xordataexchange/crypt						 v0.0.3-0.20170626215501-b2862e3d0a77 \
	github.com/youmark/pkcs8							 v0.0.0-20181117223130-1be2e3e5546d \
	github.com/yuin/goldmark							 v1.4.13 \
	github.com/yusufpapurcu/wmi							 v1.2.4 \
	github.com/zeebo/assert								 v1.3.0 \
	github.com/zeebo/xxh3								 v1.0.2 \
	go.etcd.io/bbolt								 v1.3.6 \
	go.etcd.io/etcd/api/v3								 v3.5.16 \
	go.etcd.io/etcd/client/pkg/v3							 v3.5.16 \
	go.etcd.io/etcd/client/v3							 v3.5.16 \
	go.mongodb.org/mongo-driver							 v1.16.1 \
	go.opencensus.io								 v0.24.0 \
	go.opentelemetry.io/collector/pdata						 v1.12.0 \
	go.opentelemetry.io/collector/semconv						 v0.105.0 \
	go.opentelemetry.io/contrib/instrumentation/google.golang.org/grpc/otelgrpc	 v0.54.0 \
	go.opentelemetry.io/contrib/instrumentation/net/http/otelhttp			 v0.54.0 \
	go.opentelemetry.io/otel							 v1.29.0 \
	go.opentelemetry.io/otel/exporters/otlp/otlptrace				 v1.28.0 \
	go.opentelemetry.io/otel/exporters/otlp/otlptrace/otlptracegrpc			 v1.28.0 \
	go.opentelemetry.io/otel/exporters/otlp/otlptrace/otlptracehttp			 v1.28.0 \
	go.opentelemetry.io/otel/metric							 v1.29.0 \
	go.opentelemetry.io/otel/sdk							 v1.28.0 \
	go.opentelemetry.io/otel/trace							 v1.29.0 \
	go.opentelemetry.io/proto/otlp							 v1.3.1 \
	go.uber.org/atomic								 v1.11.0 \
	go.uber.org/automaxprocs							 v1.5.3 \
	go.uber.org/goleak								 v1.3.0 \
	go.uber.org/multierr								 v1.11.0 \
	go.uber.org/zap									 v1.27.0 \
	goftp.io/server/v2								 v2.0.1 \
	golang.org/x/crypto								 v0.27.0 \
	golang.org/x/exp								 v0.0.0-20240823005443-9b4947da3948 \
	golang.org/x/lint								 v0.0.0-20190313153728-d0100b6bd8b3 \
	golang.org/x/mod								 v0.20.0 \
	golang.org/x/net								 v0.29.0 \
	golang.org/x/oauth2								 v0.22.0 \
	golang.org/x/sync								 v0.8.0 \
	golang.org/x/sys								 v0.25.0 \
	golang.org/x/telemetry								 v0.0.0-20240521205824-bda55230c457 \
	golang.org/x/term								 v0.24.0 \
	golang.org/x/text								 v0.18.0 \
	golang.org/x/time								 v0.6.0 \
	golang.org/x/tools								 v0.24.0 \
	golang.org/x/xerrors								 v0.0.0-20200804184101-5ec99f83aff1 \
	google.golang.org/api								 v0.194.0 \
	google.golang.org/appengine							 v1.6.8 \
	google.golang.org/genproto							 v0.0.0-20240823204242-4ba0660f739c \
	google.golang.org/genproto/googleapis/api					 v0.0.0-20240903143218-8af14fe29dc1 \
	google.golang.org/genproto/googleapis/bytestream				 v0.0.0-20240814211410-ddb44dafa142 \
	google.golang.org/genproto/googleapis/rpc					 v0.0.0-20240903143218-8af14fe29dc1 \
	google.golang.org/grpc								 v1.66.2 \
	google.golang.org/protobuf							 v1.34.2 \
	gopkg.in/check.v1								 v1.0.0-20201130134442-10cb98267c6c \
	gopkg.in/inf.v0									 v0.9.1 \
	gopkg.in/ini.v1									 v1.67.0 \
	gopkg.in/urfave/cli.v1								 v1.20.0 \
	gopkg.in/yaml.v2								 v2.4.0 \
	gopkg.in/yaml.v3								 v3.0.1 \
	gotest.tools/v3									 v3.0.3 \
	honnef.co/go/tools								 v0.0.0-20190523083050-ea95bdfd59fc \
	k8s.io/api									 v0.29.3 \
	k8s.io/apimachinery								 v0.29.3 \
	k8s.io/client-go								 v0.29.3 \
	k8s.io/klog									 v1.0.0 \
	k8s.io/klog/v2									 v2.130.1 \
	k8s.io/kube-openapi								 v0.0.0-20240228011516-70dd3763d340 \
	k8s.io/utils									 v0.0.0-20230726121419-3b25d923346b \
	sigs.k8s.io/json								 v0.0.0-20221116044647-bc3834ca7abd \
	sigs.k8s.io/structured-merge-diff/v4						 v4.4.1 \
	sigs.k8s.io/yaml								 v1.3.0

MODGO_MODFILES =	\
	aead.dev/minisign								 v0.2.0 \
	cloud.google.com/go								 v0.112.2 \
	cloud.google.com/go								 v0.115.0 \
	cloud.google.com/go								 v0.26.0 \
	cloud.google.com/go/auth							 v0.3.0 \
	cloud.google.com/go/auth							 v0.6.1 \
	cloud.google.com/go/auth							 v0.7.0 \
	cloud.google.com/go/auth							 v0.7.2 \
	cloud.google.com/go/auth							 v0.8.0 \
	cloud.google.com/go/auth							 v0.9.0 \
	cloud.google.com/go/auth/oauth2adapt						 v0.2.2 \
	cloud.google.com/go/auth/oauth2adapt						 v0.2.3 \
	cloud.google.com/go/compute/metadata						 v0.3.0 \
	cloud.google.com/go/compute/metadata						 v0.4.0 \
	cloud.google.com/go/iam								 v1.1.12 \
	cloud.google.com/go/iam								 v1.1.13 \
	cloud.google.com/go/iam								 v1.1.8 \
	cloud.google.com/go/longrunning							 v0.5.6 \
	cloud.google.com/go/longrunning							 v0.5.7 \
	cloud.google.com/go/translate							 v1.10.3 \
	github.com/!azure/azure-sdk-for-go/sdk/azcore					 v1.11.1 \
	github.com/!azure/azure-sdk-for-go/sdk/azcore					 v1.12.0 \
	github.com/!azure/azure-sdk-for-go/sdk/azcore					 v1.13.0 \
	github.com/!azure/azure-sdk-for-go/sdk/internal					 v1.8.0 \
	github.com/alecthomas/units							 v0.0.0-20211218093645-b94a6e3cc137 \
	github.com/apache/thrift							 v0.16.0 \
	github.com/armon/go-metrics							 v0.0.0-20190430140413-ec5e00d3c878 \
	github.com/beorn7/perks								 v0.0.0-20180321164747-3a771d992973 \
	github.com/census-instrumentation/opencensus-proto				 v0.2.1 \
	github.com/cespare/xxhash/v2							 v2.2.0 \
	github.com/charmbracelet/bubbles						 v0.18.0 \
	github.com/charmbracelet/bubbletea						 v0.26.6 \
	github.com/charmbracelet/bubbletea						 v0.27.0 \
	github.com/charmbracelet/lipgloss						 v0.12.1 \
	github.com/charmbracelet/x/ansi							 v0.1.4 \
	github.com/charmbracelet/x/exp/golden						 v0.0.0-20240806155701-69247e0abc2a \
	github.com/charmbracelet/x/input						 v0.1.0 \
	github.com/charmbracelet/x/term							 v0.1.1 \
	github.com/charmbracelet/x/windows						 v0.1.0 \
	github.com/coreos/go-semver							 v0.2.0 \
	github.com/coreos/go-semver							 v0.3.0 \
	github.com/coreos/go-systemd/v22						 v22.3.2 \
	github.com/davecgh/go-spew							 v1.1.0 \
	github.com/davecgh/go-spew							 v1.1.1 \
	github.com/dustin/go-humanize							 v1.0.0 \
	github.com/envoyproxy/go-control-plane						 v0.12.0 \
	github.com/envoyproxy/go-control-plane						 v0.9.0 \
	github.com/envoyproxy/go-control-plane						 v0.9.1-0.20191026205805-5f8ba28d4473 \
	github.com/envoyproxy/go-control-plane						 v0.9.4 \
	github.com/envoyproxy/protoc-gen-validate					 v0.1.0 \
	github.com/fatih/color								 v1.16.0 \
	github.com/fatih/color								 v1.7.0 \
	github.com/fatih/color								 v1.9.0 \
	github.com/felixge/fgprof							 v0.9.3 \
	github.com/fsnotify/fsnotify							 v1.4.7 \
	github.com/go-asn1-ber/asn1-ber							 v1.5.5 \
	github.com/go-jose/go-jose/v4							 v4.0.2 \
	github.com/go-logfmt/logfmt							 v0.5.1 \
	github.com/go-logr/logr								 v1.2.2 \
	github.com/go-logr/logr								 v1.4.1 \
	github.com/go-ole/go-ole							 v1.2.6 \
	github.com/go-openapi/analysis							 v0.22.2 \
	github.com/go-openapi/jsonpointer						 v0.20.2 \
	github.com/go-openapi/jsonreference						 v0.20.4 \
	github.com/go-openapi/loads							 v0.21.5 \
	github.com/go-openapi/spec							 v0.20.14 \
	github.com/go-openapi/swag							 v0.22.9 \
	github.com/go-openapi/validate							 v0.23.0 \
	github.com/go-sql-driver/mysql							 v1.6.0 \
	github.com/gobwas/ws								 v1.2.1 \
	github.com/golang-jwt/jwt/v4							 v4.5.0 \
	github.com/golang-jwt/jwt/v5							 v5.0.0 \
	github.com/golang/glog								 v0.0.0-20160126235308-23def4e6c14b \
	github.com/golang/groupcache							 v0.0.0-20200121045136-8c9f03a8e57e \
	github.com/golang/mock								 v1.1.1 \
	github.com/golang/protobuf							 v1.2.0 \
	github.com/golang/protobuf							 v1.3.2 \
	github.com/golang/protobuf							 v1.4.0 \
	github.com/golang/protobuf							 v1.4.0-rc.1 \
	github.com/golang/protobuf							 v1.4.0-rc.1.0.20200221234624-67d41d38c208 \
	github.com/golang/protobuf							 v1.4.0-rc.2 \
	github.com/golang/protobuf							 v1.4.0-rc.4.0.20200313231945-b860323f09d0 \
	github.com/golang/protobuf							 v1.4.1 \
	github.com/golang/protobuf							 v1.4.2 \
	github.com/golang/protobuf							 v1.4.3 \
	github.com/golang/protobuf							 v1.5.0 \
	github.com/golang/protobuf							 v1.5.2 \
	github.com/golang/snappy							 v0.0.1 \
	github.com/google/go-cmp							 v0.2.0 \
	github.com/google/go-cmp							 v0.3.0 \
	github.com/google/go-cmp							 v0.3.1 \
	github.com/google/go-cmp							 v0.4.0 \
	github.com/google/go-cmp							 v0.5.0 \
	github.com/google/go-cmp							 v0.5.3 \
	github.com/google/go-cmp							 v0.5.4 \
	github.com/google/go-cmp							 v0.5.5 \
	github.com/google/go-cmp							 v0.5.9 \
	github.com/google/gofuzz							 v1.0.0 \
	github.com/google/pprof								 v0.0.0-20211214055906-6f57359322fd \
	github.com/google/pprof								 v0.0.0-20240227163752-401108e1b7e7 \
	github.com/google/pprof								 v0.0.0-20240711041743-f6c9dda6c6da \
	github.com/google/s2a-go							 v0.1.7 \
	github.com/google/uuid								 v1.1.2 \
	github.com/google/uuid								 v1.3.0 \
	github.com/googleapis/gax-go/v2							 v2.12.3 \
	github.com/googleapis/gax-go/v2							 v2.12.5 \
	github.com/gorilla/websocket							 v1.5.0 \
	github.com/hashicorp/errwrap							 v1.0.0 \
	github.com/hashicorp/go-cleanhttp						 v0.5.0 \
	github.com/hashicorp/go-hclog							 v0.9.1 \
	github.com/hashicorp/go-hclog							 v1.1.0 \
	github.com/hashicorp/go-immutable-radix						 v1.0.0 \
	github.com/hashicorp/go-msgpack							 v0.5.5 \
	github.com/hashicorp/go-multierror						 v1.0.0 \
	github.com/hashicorp/go-retryablehttp						 v0.5.3 \
	github.com/hashicorp/go-uuid							 v1.0.0 \
	github.com/hashicorp/go-uuid							 v1.0.2 \
	github.com/hashicorp/golang-lru							 v0.5.0 \
	github.com/hashicorp/golang-lru							 v0.6.0 \
	github.com/ianlancetaylor/demangle						 v0.0.0-20230524184225-eabc099b10ab \
	github.com/inconshreveable/mousetrap						 v1.0.0 \
	github.com/klauspost/compress							 v1.13.6 \
	github.com/klauspost/compress							 v1.14.4 \
	github.com/klauspost/compress							 v1.15.15 \
	github.com/klauspost/compress							 v1.16.7 \
	github.com/klauspost/compress							 v1.17.2 \
	github.com/klauspost/compress							 v1.17.8 \
	github.com/klauspost/compress							 v1.17.9 \
	github.com/klauspost/cpuid/v2							 v2.0.1 \
	github.com/klauspost/cpuid/v2							 v2.0.9 \
	github.com/klauspost/cpuid/v2							 v2.2.3 \
	github.com/kr/pretty								 v0.1.0 \
	github.com/kr/pretty								 v0.2.1 \
	github.com/kr/pretty								 v0.3.0 \
	github.com/kr/text								 v0.1.0 \
	github.com/lestrrat-go/option							 v1.0.0 \
	github.com/lib/pq								 v1.10.4 \
	github.com/lufia/plan9stats							 v0.0.0-20211012122336-39d0f177ccd0 \
	github.com/lufia/plan9stats							 v0.0.0-20240819163618-b1d8f4d146e7 \
	github.com/magiconair/properties						 v1.8.0 \
	github.com/mattn/go-colorable							 v0.1.4 \
	github.com/mattn/go-isatty							 v0.0.10 \
	github.com/mattn/go-isatty							 v0.0.11 \
	github.com/mattn/go-isatty							 v0.0.16 \
	github.com/mattn/go-isatty							 v0.0.18 \
	github.com/mattn/go-isatty							 v0.0.8 \
	github.com/mattn/go-runewidth							 v0.0.10 \
	github.com/mattn/go-runewidth							 v0.0.12 \
	github.com/mattn/go-runewidth							 v0.0.14 \
	github.com/mattn/go-runewidth							 v0.0.15 \
	github.com/mattn/go-runewidth							 v0.0.4 \
	github.com/mattn/go-runewidth							 v0.0.9 \
	github.com/matttproud/golang_protobuf_extensions				 v1.0.1 \
	github.com/miekg/dns								 v1.1.61 \
	github.com/minio/highwayhash							 v1.0.2 \
	github.com/minio/madmin-go/v3							 v3.0.66 \
	github.com/minio/madmin-go/v3							 v3.0.68 \
	github.com/minio/mc								 v0.0.0-20240815155011-479171e7be9c \
	github.com/minio/minio-go/v7							 v7.0.76 \
	github.com/minio/mux								 v1.8.2 \
	github.com/minio/pkg/v3								 v3.0.1 \
	github.com/minio/pkg/v3								 v3.0.13 \
	github.com/minio/pkg/v3								 v3.0.15 \
	github.com/mitchellh/mapstructure						 v1.1.2 \
	github.com/modern-go/concurrent							 v0.0.0-20180228061459-e0a39a4cb421 \
	github.com/montanaflynn/stats							 v0.7.0 \
	github.com/nats-io/jwt/v2							 v2.2.1-0.20220330180145-442af02fd36a \
	github.com/nats-io/nats-server/v2						 v2.8.2 \
	github.com/nats-io/nats.go							 v1.13.0 \
	github.com/nats-io/nats.go							 v1.14.0 \
	github.com/nats-io/nats.go							 v1.15.0 \
	github.com/nats-io/nats.go							 v1.22.1 \
	github.com/nats-io/nats.go							 v1.28.0 \
	github.com/nats-io/nkeys							 v0.3.0 \
	github.com/nats-io/nkeys							 v0.4.4 \
	github.com/nats-io/stan.go							 v0.10.2 \
	github.com/philhofer/fwd							 v1.1.2 \
	github.com/philhofer/fwd							 v1.1.3-0.20240612014219-fbbf4953d986 \
	github.com/pkg/browser								 v0.0.0-20210911075715-681adbf594b8 \
	github.com/pkg/errors								 v0.8.1 \
	github.com/pmezard/go-difflib							 v1.0.0 \
	github.com/power-devops/perfstat						 v0.0.0-20210106213030-5aafc221ea8c \
	github.com/prometheus/client_golang						 v0.9.2 \
	github.com/prometheus/client_golang						 v1.11.1 \
	github.com/prometheus/client_golang						 v1.19.1 \
	github.com/prometheus/client_golang						 v1.20.0 \
	github.com/prometheus/client_model						 v0.0.0-20180712105110-5c3871d89910 \
	github.com/prometheus/client_model						 v0.0.0-20190812154241-14fe0d1b01d4 \
	github.com/prometheus/client_model						 v0.2.0 \
	github.com/prometheus/client_model						 v0.3.0 \
	github.com/prometheus/common							 v0.0.0-20181126121408-4724e9255275 \
	github.com/prometheus/common							 v0.26.0 \
	github.com/prometheus/common							 v0.39.0 \
	github.com/prometheus/common							 v0.55.0 \
	github.com/prometheus/procfs							 v0.0.0-20181204211112-1dc9a6cbc91a \
	github.com/prometheus/procfs							 v0.6.0 \
	github.com/prometheus/procfs							 v0.7.3 \
	github.com/prometheus/prometheus						 v0.53.1 \
	github.com/prometheus/prometheus						 v0.54.0 \
	github.com/rivo/uniseg								 v0.1.0 \
	github.com/rivo/uniseg								 v0.2.0 \
	github.com/rogpeppe/go-internal							 v1.10.0 \
	github.com/rogpeppe/go-internal							 v1.11.0 \
	github.com/rogpeppe/go-internal							 v1.9.1-0.20221123163938-fef05454be76 \
	github.com/sirupsen/logrus							 v1.4.2 \
	github.com/spf13/afero								 v1.1.2 \
	github.com/spf13/cast								 v1.3.0 \
	github.com/spf13/cobra								 v0.0.5 \
	github.com/spf13/pflag								 v1.0.3 \
	github.com/spf13/viper								 v1.3.2 \
	github.com/stretchr/objx							 v0.1.0 \
	github.com/stretchr/objx							 v0.1.1 \
	github.com/stretchr/objx							 v0.4.0 \
	github.com/stretchr/objx							 v0.5.0 \
	github.com/stretchr/testify							 v1.2.2 \
	github.com/stretchr/testify							 v1.3.0 \
	github.com/stretchr/testify							 v1.4.0 \
	github.com/stretchr/testify							 v1.6.1 \
	github.com/stretchr/testify							 v1.7.0 \
	github.com/stretchr/testify							 v1.7.1 \
	github.com/stretchr/testify							 v1.8.0 \
	github.com/stretchr/testify							 v1.8.1 \
	github.com/stretchr/testify							 v1.8.4 \
	github.com/tidwall/pretty							 v1.2.0 \
	github.com/tinylib/msgp								 v1.1.9 \
	github.com/tinylib/msgp								 v1.2.0 \
	github.com/tinylib/msgp								 v1.2.1 \
	github.com/tklauser/go-sysconf							 v0.3.12 \
	github.com/tklauser/numcpus							 v0.6.1 \
	github.com/vbauerster/mpb/v8							 v8.7.5 \
	github.com/yuin/goldmark							 v1.1.27 \
	github.com/yuin/goldmark							 v1.2.1 \
	go.etcd.io/etcd/api/v3								 v3.5.15 \
	go.etcd.io/etcd/client/pkg/v3							 v3.5.15 \
	go.etcd.io/etcd/client/v3							 v3.5.15 \
	go.mongodb.org/mongo-driver							 v1.14.0 \
	go.opentelemetry.io/contrib/instrumentation/google.golang.org/grpc/otelgrpc	 v0.49.0 \
	go.opentelemetry.io/contrib/instrumentation/google.golang.org/grpc/otelgrpc	 v0.52.0 \
	go.opentelemetry.io/contrib/instrumentation/net/http/otelhttp			 v0.49.0 \
	go.opentelemetry.io/contrib/instrumentation/net/http/otelhttp			 v0.53.0 \
	go.opentelemetry.io/otel							 v1.24.0 \
	go.opentelemetry.io/otel							 v1.28.0 \
	go.opentelemetry.io/otel/metric							 v1.24.0 \
	go.opentelemetry.io/otel/metric							 v1.28.0 \
	go.opentelemetry.io/otel/sdk							 v1.24.0 \
	go.opentelemetry.io/otel/trace							 v1.24.0 \
	go.opentelemetry.io/otel/trace							 v1.28.0 \
	go.uber.org/atomic								 v1.7.0 \
	go.uber.org/multierr								 v1.10.0 \
	go.uber.org/multierr								 v1.6.0 \
	go.uber.org/zap									 v1.17.0 \
	golang.org/x/crypto								 v0.0.0-20181203042331-505ab145d0a9 \
	golang.org/x/crypto								 v0.0.0-20190308221718-c2843e01d9a2 \
	golang.org/x/crypto								 v0.0.0-20190513172903-22d7a77e9e5f \
	golang.org/x/crypto								 v0.0.0-20190701094942-4def268fd1a4 \
	golang.org/x/crypto								 v0.0.0-20191011191535-87dc89f01550 \
	golang.org/x/crypto								 v0.0.0-20200302210943-78000ba7a073 \
	golang.org/x/crypto								 v0.0.0-20200622213623-75b288015ac9 \
	golang.org/x/crypto								 v0.0.0-20210220033148-5ea612d1eb83 \
	golang.org/x/crypto								 v0.0.0-20210314154223-e6e6c4f2bb5b \
	golang.org/x/crypto								 v0.0.0-20210921155107-089bfa567519 \
	golang.org/x/crypto								 v0.0.0-20211209193657-4570a0811e8b \
	golang.org/x/crypto								 v0.0.0-20220315160706-3147a52a75dd \
	golang.org/x/crypto								 v0.1.0 \
	golang.org/x/crypto								 v0.12.0 \
	golang.org/x/crypto								 v0.13.0 \
	golang.org/x/crypto								 v0.17.0 \
	golang.org/x/crypto								 v0.18.0 \
	golang.org/x/crypto								 v0.19.0 \
	golang.org/x/crypto								 v0.21.0 \
	golang.org/x/crypto								 v0.22.0 \
	golang.org/x/crypto								 v0.23.0 \
	golang.org/x/crypto								 v0.24.0 \
	golang.org/x/crypto								 v0.25.0 \
	golang.org/x/crypto								 v0.26.0 \
	golang.org/x/crypto								 v0.5.0 \
	golang.org/x/crypto								 v0.6.0 \
	golang.org/x/crypto								 v0.7.0 \
	golang.org/x/exp								 v0.0.0-20190121172915-509febef88a4 \
	golang.org/x/exp								 v0.0.0-20230905200255-921286631fa9 \
	golang.org/x/exp								 v0.0.0-20240119083558-1b970713d09a \
	golang.org/x/lint								 v0.0.0-20181026193005-c67002cb31c3 \
	golang.org/x/lint								 v0.0.0-20190227174305-5b3e6a55c961 \
	golang.org/x/mod								 v0.17.0 \
	golang.org/x/mod								 v0.18.0 \
	golang.org/x/mod								 v0.19.0 \
	golang.org/x/mod								 v0.2.0 \
	golang.org/x/mod								 v0.3.0 \
	golang.org/x/mod								 v0.6.0-dev.0.20220419223038-86c51ed26bb4 \
	golang.org/x/mod								 v0.8.0 \
	golang.org/x/net								 v0.0.0-20180724234803-3673e40ba225 \
	golang.org/x/net								 v0.0.0-20180826012351-8a410e7b638d \
	golang.org/x/net								 v0.0.0-20181201002055-351d144fa1fc \
	golang.org/x/net								 v0.0.0-20190213061140-3a22650c66bd \
	golang.org/x/net								 v0.0.0-20190311183353-d8887717615a \
	golang.org/x/net								 v0.0.0-20190404232315-eb5bcb51f2a3 \
	golang.org/x/net								 v0.0.0-20190522155817-f3200d17e092 \
	golang.org/x/net								 v0.0.0-20190620200207-3b0461eec859 \
	golang.org/x/net								 v0.0.0-20190724013045-ca1201d0de80 \
	golang.org/x/net								 v0.0.0-20200114155413-6afb5195e5aa \
	golang.org/x/net								 v0.0.0-20200226121028-0de0cce0169b \
	golang.org/x/net								 v0.0.0-20201021035429-f5854403a974 \
	golang.org/x/net								 v0.0.0-20201110031124-69a78807bb2b \
	golang.org/x/net								 v0.0.0-20210226172049-e18ecbb05110 \
	golang.org/x/net								 v0.0.0-20211112202133-69e39bad7dc2 \
	golang.org/x/net								 v0.0.0-20220722155237-a158d28d115b \
	golang.org/x/net								 v0.1.0 \
	golang.org/x/net								 v0.10.0 \
	golang.org/x/net								 v0.21.0 \
	golang.org/x/net								 v0.22.0 \
	golang.org/x/net								 v0.23.0 \
	golang.org/x/net								 v0.24.0 \
	golang.org/x/net								 v0.25.0 \
	golang.org/x/net								 v0.26.0 \
	golang.org/x/net								 v0.27.0 \
	golang.org/x/net								 v0.28.0 \
	golang.org/x/net								 v0.5.0 \
	golang.org/x/net								 v0.6.0 \
	golang.org/x/net								 v0.7.0 \
	golang.org/x/oauth2								 v0.0.0-20180821212333-d2e6202438be \
	golang.org/x/oauth2								 v0.19.0 \
	golang.org/x/oauth2								 v0.21.0 \
	golang.org/x/sync								 v0.0.0-20180314180146-1d60e4601c6f \
	golang.org/x/sync								 v0.0.0-20181108010431-42b317875d0f \
	golang.org/x/sync								 v0.0.0-20181221193216-37e7f081c4d4 \
	golang.org/x/sync								 v0.0.0-20190423024810-112230192c58 \
	golang.org/x/sync								 v0.0.0-20190911185100-cd5d95a43a6e \
	golang.org/x/sync								 v0.0.0-20201020160332-67f06af15bc9 \
	golang.org/x/sync								 v0.0.0-20201207232520-09787c993a3a \
	golang.org/x/sync								 v0.0.0-20220722155255-886fb9371eb4 \
	golang.org/x/sync								 v0.1.0 \
	golang.org/x/sync								 v0.6.0 \
	golang.org/x/sync								 v0.7.0 \
	golang.org/x/sys								 v0.0.0-20180830151530-49385e6e1522 \
	golang.org/x/sys								 v0.0.0-20180926160741-c2ed4eda69e7 \
	golang.org/x/sys								 v0.0.0-20181205085412-a5c9d58dba9a \
	golang.org/x/sys								 v0.0.0-20190130150945-aca44879d564 \
	golang.org/x/sys								 v0.0.0-20190215142949-d0b11bdaac8a \
	golang.org/x/sys								 v0.0.0-20190222072716-a9d3bda3a223 \
	golang.org/x/sys								 v0.0.0-20190412213103-97732733099d \
	golang.org/x/sys								 v0.0.0-20190422165155-953cdadca894 \
	golang.org/x/sys								 v0.0.0-20190726091711-fc99dfbffb4e \
	golang.org/x/sys								 v0.0.0-20190916202348-b4ddaad3f8a3 \
	golang.org/x/sys								 v0.0.0-20191008105621-543471e840be \
	golang.org/x/sys								 v0.0.0-20191026070338-33540a1f6037 \
	golang.org/x/sys								 v0.0.0-20200302150141-5c8b2ff67527 \
	golang.org/x/sys								 v0.0.0-20200923182605-d9f96fdee20d \
	golang.org/x/sys								 v0.0.0-20200930185726-fdedc70b468f \
	golang.org/x/sys								 v0.0.0-20201119102817-f84b799fce68 \
	golang.org/x/sys								 v0.0.0-20201204225414-ed752295db88 \
	golang.org/x/sys								 v0.0.0-20210124154548-22da62e12c0c \
	golang.org/x/sys								 v0.0.0-20210228012217-479acdf4ea46 \
	golang.org/x/sys								 v0.0.0-20210423082822-04245dca01da \
	golang.org/x/sys								 v0.0.0-20210615035016-665e8c7367d1 \
	golang.org/x/sys								 v0.0.0-20210809222454-d867a43fc93e \
	golang.org/x/sys								 v0.0.0-20220111092808-5a964db01320 \
	golang.org/x/sys								 v0.0.0-20220204135822-1c1b9b1eba6a \
	golang.org/x/sys								 v0.0.0-20220310020820-b874c991c1a5 \
	golang.org/x/sys								 v0.0.0-20220408201424-a24fb2fb8a0f \
	golang.org/x/sys								 v0.0.0-20220412211240-33da011f77ad \
	golang.org/x/sys								 v0.0.0-20220520151302-bc2c85ada10a \
	golang.org/x/sys								 v0.0.0-20220704084225-05e143d24a9e \
	golang.org/x/sys								 v0.0.0-20220722155257-8c9f86f7a55f \
	golang.org/x/sys								 v0.0.0-20220811171246-fbc7d0a398ab \
	golang.org/x/sys								 v0.1.0 \
	golang.org/x/sys								 v0.11.0 \
	golang.org/x/sys								 v0.12.0 \
	golang.org/x/sys								 v0.15.0 \
	golang.org/x/sys								 v0.16.0 \
	golang.org/x/sys								 v0.17.0 \
	golang.org/x/sys								 v0.18.0 \
	golang.org/x/sys								 v0.19.0 \
	golang.org/x/sys								 v0.20.0 \
	golang.org/x/sys								 v0.21.0 \
	golang.org/x/sys								 v0.22.0 \
	golang.org/x/sys								 v0.23.0 \
	golang.org/x/sys								 v0.24.0 \
	golang.org/x/sys								 v0.4.0 \
	golang.org/x/sys								 v0.5.0 \
	golang.org/x/sys								 v0.6.0 \
	golang.org/x/sys								 v0.7.0 \
	golang.org/x/sys								 v0.8.0 \
	golang.org/x/term								 v0.0.0-20201117132131-f5c789dd3221 \
	golang.org/x/term								 v0.0.0-20201126162022-7de9c90e9dd1 \
	golang.org/x/term								 v0.0.0-20210927222741-03fcf44c2211 \
	golang.org/x/term								 v0.1.0 \
	golang.org/x/term								 v0.12.0 \
	golang.org/x/term								 v0.17.0 \
	golang.org/x/term								 v0.18.0 \
	golang.org/x/term								 v0.20.0 \
	golang.org/x/term								 v0.22.0 \
	golang.org/x/term								 v0.23.0 \
	golang.org/x/term								 v0.4.0 \
	golang.org/x/term								 v0.5.0 \
	golang.org/x/term								 v0.8.0 \
	golang.org/x/text								 v0.14.0 \
	golang.org/x/text								 v0.15.0 \
	golang.org/x/text								 v0.16.0 \
	golang.org/x/text								 v0.17.0 \
	golang.org/x/text								 v0.3.0 \
	golang.org/x/text								 v0.3.2 \
	golang.org/x/text								 v0.3.3 \
	golang.org/x/text								 v0.3.6 \
	golang.org/x/text								 v0.3.7 \
	golang.org/x/text								 v0.3.8 \
	golang.org/x/text								 v0.4.0 \
	golang.org/x/text								 v0.6.0 \
	golang.org/x/text								 v0.7.0 \
	golang.org/x/text								 v0.9.0 \
	golang.org/x/time								 v0.0.0-20211116232009-f0f3c7e86c11 \
	golang.org/x/time								 v0.3.0 \
	golang.org/x/time								 v0.5.0 \
	golang.org/x/tools								 v0.0.0-20180917221912-90fa682c2a6e \
	golang.org/x/tools								 v0.0.0-20190114222345-bf090417da8b \
	golang.org/x/tools								 v0.0.0-20190226205152-f727befe758c \
	golang.org/x/tools								 v0.0.0-20190311212946-11955173bddd \
	golang.org/x/tools								 v0.0.0-20190328211700-ab21143f2384 \
	golang.org/x/tools								 v0.0.0-20190424220101-1e8e1cfdf96b \
	golang.org/x/tools								 v0.0.0-20190524140312-2c0ae7006135 \
	golang.org/x/tools								 v0.0.0-20191119224855-298f0cb1881e \
	golang.org/x/tools								 v0.0.0-20200619180055-7c47624df98f \
	golang.org/x/tools								 v0.0.0-20210106214847-113979e3529a \
	golang.org/x/tools								 v0.1.12 \
	golang.org/x/tools								 v0.13.0 \
	golang.org/x/tools								 v0.21.1-0.20240508182429-e35e4ccd0d2d \
	golang.org/x/tools								 v0.22.0 \
	golang.org/x/tools								 v0.23.0 \
	golang.org/x/tools								 v0.6.0 \
	golang.org/x/xerrors								 v0.0.0-20190717185122-a985d3407aa7 \
	golang.org/x/xerrors								 v0.0.0-20191011141410-1b5146add898 \
	golang.org/x/xerrors								 v0.0.0-20191204190536-9bdfabe68543 \
	google.golang.org/api								 v0.177.0 \
	google.golang.org/api								 v0.187.0 \
	google.golang.org/api								 v0.188.0 \
	google.golang.org/api								 v0.191.0 \
	google.golang.org/api								 v0.193.0 \
	google.golang.org/appengine							 v1.1.0 \
	google.golang.org/appengine							 v1.4.0 \
	google.golang.org/genproto							 v0.0.0-20180817151627-c66870c02cf8 \
	google.golang.org/genproto							 v0.0.0-20190819201941-24fa4b261c55 \
	google.golang.org/genproto							 v0.0.0-20200526211855-cb27e3aa2013 \
	google.golang.org/genproto							 v0.0.0-20230822172742-b8732ec3820d \
	google.golang.org/genproto							 v0.0.0-20240624140628-dc46fd24d27d \
	google.golang.org/genproto							 v0.0.0-20240730163845-b1a4ccb954bf \
	google.golang.org/genproto							 v0.0.0-20240814211410-ddb44dafa142 \
	google.golang.org/genproto/googleapis/api					 v0.0.0-20230822172742-b8732ec3820d \
	google.golang.org/genproto/googleapis/api					 v0.0.0-20240429193739-8cf5692501f6 \
	google.golang.org/genproto/googleapis/api					 v0.0.0-20240604185151-ef581f913117 \
	google.golang.org/genproto/googleapis/api					 v0.0.0-20240617180043-68d350f18fd4 \
	google.golang.org/genproto/googleapis/api					 v0.0.0-20240711142825-46eb208f015d \
	google.golang.org/genproto/googleapis/api					 v0.0.0-20240725223205-93522f1f2a9f \
	google.golang.org/genproto/googleapis/api					 v0.0.0-20240814211410-ddb44dafa142 \
	google.golang.org/genproto/googleapis/api					 v0.0.0-20240823204242-4ba0660f739c \
	google.golang.org/genproto/googleapis/rpc					 v0.0.0-20230822172742-b8732ec3820d \
	google.golang.org/genproto/googleapis/rpc					 v0.0.0-20240429193739-8cf5692501f6 \
	google.golang.org/genproto/googleapis/rpc					 v0.0.0-20240604185151-ef581f913117 \
	google.golang.org/genproto/googleapis/rpc					 v0.0.0-20240624140628-dc46fd24d27d \
	google.golang.org/genproto/googleapis/rpc					 v0.0.0-20240708141625-4ad9e859172b \
	google.golang.org/genproto/googleapis/rpc					 v0.0.0-20240711142825-46eb208f015d \
	google.golang.org/genproto/googleapis/rpc					 v0.0.0-20240722135656-d784300faade \
	google.golang.org/genproto/googleapis/rpc					 v0.0.0-20240730163845-b1a4ccb954bf \
	google.golang.org/genproto/googleapis/rpc					 v0.0.0-20240814211410-ddb44dafa142 \
	google.golang.org/genproto/googleapis/rpc					 v0.0.0-20240822170219-fc7c04adadcd \
	google.golang.org/genproto/googleapis/rpc					 v0.0.0-20240823204242-4ba0660f739c \
	google.golang.org/genproto/googleapis/rpc					 v0.0.0-20240827150818-7e3bb234dfed \
	google.golang.org/grpc								 v1.19.0 \
	google.golang.org/grpc								 v1.23.0 \
	google.golang.org/grpc								 v1.25.1 \
	google.golang.org/grpc								 v1.27.0 \
	google.golang.org/grpc								 v1.33.2 \
	google.golang.org/grpc								 v1.59.0 \
	google.golang.org/grpc								 v1.63.2 \
	google.golang.org/grpc								 v1.64.0 \
	google.golang.org/grpc								 v1.64.1 \
	google.golang.org/grpc								 v1.65.0 \
	google.golang.org/grpc								 v1.66.0 \
	google.golang.org/protobuf							 v0.0.0-20200109180630-ec00e32a8dfd \
	google.golang.org/protobuf							 v0.0.0-20200221191635-4d8936d0db64 \
	google.golang.org/protobuf							 v0.0.0-20200228230310-ab0ca4ff8a60 \
	google.golang.org/protobuf							 v1.20.1-0.20200309200217-e05f789c0967 \
	google.golang.org/protobuf							 v1.21.0 \
	google.golang.org/protobuf							 v1.22.0 \
	google.golang.org/protobuf							 v1.23.0 \
	google.golang.org/protobuf							 v1.23.1-0.20200526195155-81db48ad09cc \
	google.golang.org/protobuf							 v1.25.0 \
	google.golang.org/protobuf							 v1.28.1 \
	google.golang.org/protobuf							 v1.31.0 \
	google.golang.org/protobuf							 v1.33.0 \
	google.golang.org/protobuf							 v1.34.1 \
	gopkg.in/check.v1								 v0.0.0-20161208181325-20d25e280405 \
	gopkg.in/check.v1								 v1.0.0-20190902080502-41f04d3bba15 \
	gopkg.in/check.v1								 v1.0.0-20200227125254-8fa46927fb4f \
	gopkg.in/ini.v1									 v1.42.0 \
	gopkg.in/yaml.v2								 v2.2.2 \
	gopkg.in/yaml.v3								 v3.0.0-20200313102051-9f266ea9e77c \
	honnef.co/go/tools								 v0.0.0-20190102054323-c2f93a96b099 \
	sigs.k8s.io/yaml								 v1.2.0

