MODCARGO_CRATES +=	aead	0.5.2
MODCARGO_CRATES +=	aes	0.8.4
MODCARGO_CRATES +=	aes-gcm	0.10.3
MODCARGO_CRATES +=	aho-corasick	1.1.4
MODCARGO_CRATES +=	alloca	0.4.0
MODCARGO_CRATES +=	allocator-api2	0.2.21
MODCARGO_CRATES +=	android_system_properties	0.1.5
MODCARGO_CRATES +=	anes	0.1.6
MODCARGO_CRATES +=	anstyle	1.0.14
MODCARGO_CRATES +=	anyhow	1.0.102
MODCARGO_CRATES +=	arc-swap	1.9.0
MODCARGO_CRATES +=	arrayref	0.3.9
MODCARGO_CRATES +=	arrayvec	0.7.6
MODCARGO_CRATES +=	asn1-rs	0.7.1
MODCARGO_CRATES +=	asn1-rs-derive	0.6.0
MODCARGO_CRATES +=	asn1-rs-impl	0.2.0
MODCARGO_CRATES +=	async-trait	0.1.89
MODCARGO_CRATES +=	atomic-waker	1.1.2
MODCARGO_CRATES +=	autocfg	1.5.0
MODCARGO_CRATES +=	aws-lc-rs	1.16.2
MODCARGO_CRATES +=	aws-lc-sys	0.39.0
MODCARGO_CRATES +=	base64	0.22.1
MODCARGO_CRATES +=	base64ct	1.8.3
MODCARGO_CRATES +=	bit-set	0.8.0
MODCARGO_CRATES +=	bit-vec	0.8.0
MODCARGO_CRATES +=	bitflags	1.3.2
MODCARGO_CRATES +=	bitflags	2.11.0
MODCARGO_CRATES +=	blake3	1.8.3
MODCARGO_CRATES +=	block-buffer	0.10.4
MODCARGO_CRATES +=	block-padding	0.3.3
MODCARGO_CRATES +=	bumpalo	3.20.2
MODCARGO_CRATES +=	byte_string	1.0.0
MODCARGO_CRATES +=	bytes	1.11.1
MODCARGO_CRATES +=	cast	0.3.0
MODCARGO_CRATES +=	cbc	0.1.2
MODCARGO_CRATES +=	cc	1.2.57
MODCARGO_CRATES +=	cesu8	1.1.0
MODCARGO_CRATES +=	cfg-if	1.0.4
MODCARGO_CRATES +=	cfg_aliases	0.2.1
MODCARGO_CRATES +=	chacha20	0.9.1
MODCARGO_CRATES +=	chacha20	0.10.0
MODCARGO_CRATES +=	chacha20poly1305	0.10.1
MODCARGO_CRATES +=	chrono	0.4.44
MODCARGO_CRATES +=	ciborium	0.2.2
MODCARGO_CRATES +=	ciborium-io	0.2.2
MODCARGO_CRATES +=	ciborium-ll	0.2.2
MODCARGO_CRATES +=	cipher	0.4.4
MODCARGO_CRATES +=	clap	4.6.0
MODCARGO_CRATES +=	clap_builder	4.6.0
MODCARGO_CRATES +=	clap_lex	1.1.0
MODCARGO_CRATES +=	cmake	0.1.57
MODCARGO_CRATES +=	combine	4.6.7
MODCARGO_CRATES +=	const-oid	0.9.6
MODCARGO_CRATES +=	constant_time_eq	0.4.2
MODCARGO_CRATES +=	core-foundation	0.10.1
MODCARGO_CRATES +=	core-foundation-sys	0.8.7
MODCARGO_CRATES +=	cpufeatures	0.2.17
MODCARGO_CRATES +=	cpufeatures	0.3.0
MODCARGO_CRATES +=	crc32c	0.6.8
MODCARGO_CRATES +=	crc32fast	1.5.0
MODCARGO_CRATES +=	criterion	0.8.2
MODCARGO_CRATES +=	criterion-plot	0.8.2
MODCARGO_CRATES +=	critical-section	1.2.0
MODCARGO_CRATES +=	crossbeam-channel	0.5.15
MODCARGO_CRATES +=	crossbeam-deque	0.8.6
MODCARGO_CRATES +=	crossbeam-epoch	0.9.18
MODCARGO_CRATES +=	crossbeam-queue	0.3.12
MODCARGO_CRATES +=	crossbeam-utils	0.8.21
MODCARGO_CRATES +=	crunchy	0.2.4
MODCARGO_CRATES +=	crypto-common	0.1.7
MODCARGO_CRATES +=	ctr	0.9.2
MODCARGO_CRATES +=	curve25519-dalek	4.1.3
MODCARGO_CRATES +=	curve25519-dalek-derive	0.1.1
MODCARGO_CRATES +=	dashmap	6.1.0
MODCARGO_CRATES +=	data-encoding	2.10.0
MODCARGO_CRATES +=	der	0.7.10
MODCARGO_CRATES +=	der-parser	10.0.0
MODCARGO_CRATES +=	deranged	0.5.8
MODCARGO_CRATES +=	digest	0.10.7
MODCARGO_CRATES +=	displaydoc	0.2.5
MODCARGO_CRATES +=	dunce	1.0.5
MODCARGO_CRATES +=	dynosaur	0.3.0
MODCARGO_CRATES +=	dynosaur_derive	0.3.0
MODCARGO_CRATES +=	ed25519	2.2.3
MODCARGO_CRATES +=	either	1.15.0
MODCARGO_CRATES +=	enum-as-inner	0.6.1
MODCARGO_CRATES +=	equivalent	1.0.2
MODCARGO_CRATES +=	errno	0.3.14
MODCARGO_CRATES +=	fastrand	2.3.0
MODCARGO_CRATES +=	fiat-crypto	0.2.9
MODCARGO_CRATES +=	find-msvc-tools	0.1.9
MODCARGO_CRATES +=	fnv	1.0.7
MODCARGO_CRATES +=	foldhash	0.1.5
MODCARGO_CRATES +=	foldhash	0.2.0
MODCARGO_CRATES +=	form_urlencoded	1.2.2
MODCARGO_CRATES +=	fs_extra	1.3.0
MODCARGO_CRATES +=	fsevent-sys	4.1.0
MODCARGO_CRATES +=	futures	0.3.32
MODCARGO_CRATES +=	futures-channel	0.3.32
MODCARGO_CRATES +=	futures-core	0.3.32
MODCARGO_CRATES +=	futures-executor	0.3.32
MODCARGO_CRATES +=	futures-io	0.3.32
MODCARGO_CRATES +=	futures-macro	0.3.32
MODCARGO_CRATES +=	futures-sink	0.3.32
MODCARGO_CRATES +=	futures-task	0.3.32
MODCARGO_CRATES +=	futures-util	0.3.32
MODCARGO_CRATES +=	generic-array	0.14.7
MODCARGO_CRATES +=	getrandom	0.2.17
MODCARGO_CRATES +=	getrandom	0.3.4
MODCARGO_CRATES +=	getrandom	0.4.2
MODCARGO_CRATES +=	ghash	0.5.1
MODCARGO_CRATES +=	h2	0.4.13
MODCARGO_CRATES +=	half	2.7.1
MODCARGO_CRATES +=	hashbrown	0.14.5
MODCARGO_CRATES +=	hashbrown	0.15.5
MODCARGO_CRATES +=	hashbrown	0.16.1
MODCARGO_CRATES +=	heck	0.5.0
MODCARGO_CRATES +=	hex	0.4.3
MODCARGO_CRATES +=	hickory-proto	0.25.2
MODCARGO_CRATES +=	hickory-resolver	0.25.2
MODCARGO_CRATES +=	hkdf	0.12.4
MODCARGO_CRATES +=	hmac	0.12.1
MODCARGO_CRATES +=	http	1.4.0
MODCARGO_CRATES +=	http-body	1.0.1
MODCARGO_CRATES +=	http-body-util	0.1.3
MODCARGO_CRATES +=	httparse	1.10.1
MODCARGO_CRATES +=	httpdate	1.0.3
MODCARGO_CRATES +=	hyper	1.8.1
MODCARGO_CRATES +=	hyper-rustls	0.27.7
MODCARGO_CRATES +=	hyper-util	0.1.20
MODCARGO_CRATES +=	iana-time-zone	0.1.65
MODCARGO_CRATES +=	iana-time-zone-haiku	0.1.2
MODCARGO_CRATES +=	icu_collections	2.1.1
MODCARGO_CRATES +=	icu_locale_core	2.1.1
MODCARGO_CRATES +=	icu_normalizer	2.1.1
MODCARGO_CRATES +=	icu_normalizer_data	2.1.1
MODCARGO_CRATES +=	icu_properties	2.1.2
MODCARGO_CRATES +=	icu_properties_data	2.1.2
MODCARGO_CRATES +=	icu_provider	2.1.1
MODCARGO_CRATES +=	id-arena	2.3.0
MODCARGO_CRATES +=	idna	1.1.0
MODCARGO_CRATES +=	idna_adapter	1.2.1
MODCARGO_CRATES +=	indexmap	2.13.0
MODCARGO_CRATES +=	inotify	0.11.1
MODCARGO_CRATES +=	inotify-sys	0.1.5
MODCARGO_CRATES +=	inout	0.1.4
MODCARGO_CRATES +=	ipconfig	0.3.2
MODCARGO_CRATES +=	ipnet	2.12.0
MODCARGO_CRATES +=	ipnetwork	0.21.1
MODCARGO_CRATES +=	iri-string	0.7.11
MODCARGO_CRATES +=	itertools	0.13.0
MODCARGO_CRATES +=	itoa	1.0.18
MODCARGO_CRATES +=	jni	0.21.1
MODCARGO_CRATES +=	jni-sys	0.3.1
MODCARGO_CRATES +=	jni-sys	0.4.1
MODCARGO_CRATES +=	jni-sys-macros	0.4.1
MODCARGO_CRATES +=	jobserver	0.1.34
MODCARGO_CRATES +=	js-sys	0.3.91
MODCARGO_CRATES +=	kqueue	1.1.1
MODCARGO_CRATES +=	kqueue-sys	1.0.4
MODCARGO_CRATES +=	lazy_static	1.5.0
MODCARGO_CRATES +=	leb128fmt	0.1.0
MODCARGO_CRATES +=	libc	0.2.183
MODCARGO_CRATES +=	linux-raw-sys	0.12.1
MODCARGO_CRATES +=	litemap	0.8.1
MODCARGO_CRATES +=	lock_api	0.4.14
MODCARGO_CRATES +=	log	0.4.29
MODCARGO_CRATES +=	lru	0.16.3
MODCARGO_CRATES +=	lru-slab	0.1.2
MODCARGO_CRATES +=	lru_time_cache	0.11.11
MODCARGO_CRATES +=	matchers	0.2.0
MODCARGO_CRATES +=	md-5	0.10.6
MODCARGO_CRATES +=	memchr	2.8.0
MODCARGO_CRATES +=	memoffset	0.9.1
MODCARGO_CRATES +=	minimal-lexical	0.2.1
MODCARGO_CRATES +=	mio	1.1.1
MODCARGO_CRATES +=	moka	0.12.15
MODCARGO_CRATES +=	nix	0.31.2
MODCARGO_CRATES +=	nom	7.1.3
MODCARGO_CRATES +=	notify	8.2.0
MODCARGO_CRATES +=	notify-types	2.1.0
MODCARGO_CRATES +=	nu-ansi-term	0.50.3
MODCARGO_CRATES +=	num-bigint	0.4.6
MODCARGO_CRATES +=	num-conv	0.2.0
MODCARGO_CRATES +=	num-integer	0.1.46
MODCARGO_CRATES +=	num-traits	0.2.19
MODCARGO_CRATES +=	oid-registry	0.8.1
MODCARGO_CRATES +=	once_cell	1.21.4
MODCARGO_CRATES +=	oorandom	11.1.5
MODCARGO_CRATES +=	opaque-debug	0.3.1
MODCARGO_CRATES +=	openssl-probe	0.2.1
MODCARGO_CRATES +=	page_size	0.6.0
MODCARGO_CRATES +=	parking_lot	0.12.5
MODCARGO_CRATES +=	parking_lot_core	0.9.12
MODCARGO_CRATES +=	percent-encoding	2.3.2
MODCARGO_CRATES +=	pin-project	1.1.11
MODCARGO_CRATES +=	pin-project-internal	1.1.11
MODCARGO_CRATES +=	pin-project-lite	0.2.17
MODCARGO_CRATES +=	pin-utils	0.1.0
MODCARGO_CRATES +=	pkcs8	0.10.2
MODCARGO_CRATES +=	plotters	0.3.7
MODCARGO_CRATES +=	plotters-backend	0.3.7
MODCARGO_CRATES +=	plotters-svg	0.3.7
MODCARGO_CRATES +=	poly1305	0.8.0
MODCARGO_CRATES +=	polyval	0.6.2
MODCARGO_CRATES +=	portable-atomic	1.13.1
MODCARGO_CRATES +=	potential_utf	0.1.4
MODCARGO_CRATES +=	powerfmt	0.2.0
MODCARGO_CRATES +=	ppv-lite86	0.2.21
MODCARGO_CRATES +=	prettyplease	0.2.37
MODCARGO_CRATES +=	proc-macro2	1.0.106
MODCARGO_CRATES +=	proptest	1.10.0
MODCARGO_CRATES +=	quick-error	1.2.3
MODCARGO_CRATES +=	quinn	0.11.9
MODCARGO_CRATES +=	quinn-proto	0.11.14
MODCARGO_CRATES +=	quinn-udp	0.5.14
MODCARGO_CRATES +=	quote	1.0.45
MODCARGO_CRATES +=	r-efi	5.3.0
MODCARGO_CRATES +=	r-efi	6.0.0
MODCARGO_CRATES +=	rand	0.9.2
MODCARGO_CRATES +=	rand	0.10.0
MODCARGO_CRATES +=	rand_chacha	0.9.0
MODCARGO_CRATES +=	rand_core	0.6.4
MODCARGO_CRATES +=	rand_core	0.9.5
MODCARGO_CRATES +=	rand_core	0.10.0
MODCARGO_CRATES +=	rand_xorshift	0.4.0
MODCARGO_CRATES +=	rayon	1.11.0
MODCARGO_CRATES +=	rayon-core	1.13.0
MODCARGO_CRATES +=	redox_syscall	0.5.18
MODCARGO_CRATES +=	regex	1.12.3
MODCARGO_CRATES +=	regex-automata	0.4.14
MODCARGO_CRATES +=	regex-syntax	0.8.10
MODCARGO_CRATES +=	reqwest	0.13.2
MODCARGO_CRATES +=	resolv-conf	0.7.6
MODCARGO_CRATES +=	ring	0.17.14
MODCARGO_CRATES +=	ring-compat	0.8.0
MODCARGO_CRATES +=	rustc-hash	2.1.1
MODCARGO_CRATES +=	rustc_version	0.4.1
MODCARGO_CRATES +=	rusticata-macros	4.1.0
MODCARGO_CRATES +=	rustix	1.1.4
MODCARGO_CRATES +=	rustls	0.23.37
MODCARGO_CRATES +=	rustls-native-certs	0.8.3
MODCARGO_CRATES +=	rustls-pki-types	1.14.0
MODCARGO_CRATES +=	rustls-platform-verifier	0.6.2
MODCARGO_CRATES +=	rustls-platform-verifier-android	0.1.1
MODCARGO_CRATES +=	rustls-webpki	0.103.10
MODCARGO_CRATES +=	rustversion	1.0.22
MODCARGO_CRATES +=	rusty-fork	0.3.1
MODCARGO_CRATES +=	ryu	1.0.23
MODCARGO_CRATES +=	same-file	1.0.6
MODCARGO_CRATES +=	schannel	0.1.29
MODCARGO_CRATES +=	scopeguard	1.2.0
MODCARGO_CRATES +=	sealed	0.6.0
MODCARGO_CRATES +=	security-framework	3.7.0
MODCARGO_CRATES +=	security-framework-sys	2.17.0
MODCARGO_CRATES +=	semver	1.0.27
MODCARGO_CRATES +=	sendfd	0.4.4
MODCARGO_CRATES +=	serde	1.0.228
MODCARGO_CRATES +=	serde_core	1.0.228
MODCARGO_CRATES +=	serde_derive	1.0.228
MODCARGO_CRATES +=	serde_json	1.0.149
MODCARGO_CRATES +=	serde_spanned	1.0.4
MODCARGO_CRATES +=	serde_urlencoded	0.7.1
MODCARGO_CRATES +=	sha1	0.10.6
MODCARGO_CRATES +=	sha2	0.10.9
MODCARGO_CRATES +=	shadowsocks	1.24.0
MODCARGO_CRATES +=	shadowsocks-crypto	0.6.2
MODCARGO_CRATES +=	sharded-slab	0.1.7
MODCARGO_CRATES +=	shlex	1.3.0
MODCARGO_CRATES +=	signal-hook-registry	1.4.8
MODCARGO_CRATES +=	signature	2.2.0
MODCARGO_CRATES +=	slab	0.4.12
MODCARGO_CRATES +=	smallvec	1.15.1
MODCARGO_CRATES +=	socket2	0.5.10
MODCARGO_CRATES +=	socket2	0.6.3
MODCARGO_CRATES +=	spin	0.10.0
MODCARGO_CRATES +=	spki	0.7.3
MODCARGO_CRATES +=	stable_deref_trait	1.2.1
MODCARGO_CRATES +=	static_assertions	1.1.0
MODCARGO_CRATES +=	subtle	2.6.1
MODCARGO_CRATES +=	syn	2.0.117
MODCARGO_CRATES +=	sync_wrapper	1.0.2
MODCARGO_CRATES +=	synstructure	0.13.2
MODCARGO_CRATES +=	tagptr	0.2.0
MODCARGO_CRATES +=	tempfile	3.27.0
MODCARGO_CRATES +=	thiserror	1.0.69
MODCARGO_CRATES +=	thiserror	2.0.18
MODCARGO_CRATES +=	thiserror-impl	1.0.69
MODCARGO_CRATES +=	thiserror-impl	2.0.18
MODCARGO_CRATES +=	thread_local	1.1.9
MODCARGO_CRATES +=	time	0.3.47
MODCARGO_CRATES +=	time-core	0.1.8
MODCARGO_CRATES +=	time-macros	0.2.27
MODCARGO_CRATES +=	tinystr	0.8.2
MODCARGO_CRATES +=	tinytemplate	1.2.1
MODCARGO_CRATES +=	tinyvec	1.11.0
MODCARGO_CRATES +=	tinyvec_macros	0.1.1
MODCARGO_CRATES +=	tokio	1.50.0
MODCARGO_CRATES +=	tokio-macros	2.6.1
MODCARGO_CRATES +=	tokio-rustls	0.26.4
MODCARGO_CRATES +=	tokio-stream	0.1.18
MODCARGO_CRATES +=	tokio-test	0.4.5
MODCARGO_CRATES +=	tokio-tfo	0.4.3
MODCARGO_CRATES +=	tokio-util	0.7.18
MODCARGO_CRATES +=	toml	1.0.7+spec-1.1.0
MODCARGO_CRATES +=	toml_datetime	1.0.1+spec-1.1.0
MODCARGO_CRATES +=	toml_parser	1.0.10+spec-1.1.0
MODCARGO_CRATES +=	toml_writer	1.0.7+spec-1.1.0
MODCARGO_CRATES +=	tower	0.5.3
MODCARGO_CRATES +=	tower-http	0.6.8
MODCARGO_CRATES +=	tower-layer	0.3.3
MODCARGO_CRATES +=	tower-service	0.3.3
MODCARGO_CRATES +=	tracing	0.1.44
MODCARGO_CRATES +=	tracing-appender	0.2.4
MODCARGO_CRATES +=	tracing-attributes	0.1.31
MODCARGO_CRATES +=	tracing-core	0.1.36
MODCARGO_CRATES +=	tracing-log	0.2.0
MODCARGO_CRATES +=	tracing-subscriber	0.3.23
MODCARGO_CRATES +=	trait-variant	0.1.2
MODCARGO_CRATES +=	try-lock	0.2.5
MODCARGO_CRATES +=	typenum	1.19.0
MODCARGO_CRATES +=	unarray	0.1.4
MODCARGO_CRATES +=	unicode-ident	1.0.24
MODCARGO_CRATES +=	unicode-xid	0.2.6
MODCARGO_CRATES +=	universal-hash	0.5.1
MODCARGO_CRATES +=	untrusted	0.9.0
MODCARGO_CRATES +=	url	2.5.8
MODCARGO_CRATES +=	utf8_iter	1.0.4
MODCARGO_CRATES +=	uuid	1.22.0
MODCARGO_CRATES +=	valuable	0.1.1
MODCARGO_CRATES +=	version_check	0.9.5
MODCARGO_CRATES +=	wait-timeout	0.2.1
MODCARGO_CRATES +=	walkdir	2.5.0
MODCARGO_CRATES +=	want	0.3.1
MODCARGO_CRATES +=	wasi	0.11.1+wasi-snapshot-preview1
MODCARGO_CRATES +=	wasip2	1.0.2+wasi-0.2.9
MODCARGO_CRATES +=	wasip3	0.4.0+wasi-0.3.0-rc-2026-01-06
MODCARGO_CRATES +=	wasm-bindgen	0.2.114
MODCARGO_CRATES +=	wasm-bindgen-futures	0.4.64
MODCARGO_CRATES +=	wasm-bindgen-macro	0.2.114
MODCARGO_CRATES +=	wasm-bindgen-macro-support	0.2.114
MODCARGO_CRATES +=	wasm-bindgen-shared	0.2.114
MODCARGO_CRATES +=	wasm-encoder	0.244.0
MODCARGO_CRATES +=	wasm-metadata	0.244.0
MODCARGO_CRATES +=	wasmparser	0.244.0
MODCARGO_CRATES +=	web-sys	0.3.91
MODCARGO_CRATES +=	web-time	1.1.0
MODCARGO_CRATES +=	webpki-root-certs	1.0.6
MODCARGO_CRATES +=	webpki-roots	1.0.6
MODCARGO_CRATES +=	widestring	1.2.1
MODCARGO_CRATES +=	winapi	0.3.9
MODCARGO_CRATES +=	winapi-i686-pc-windows-gnu	0.4.0
MODCARGO_CRATES +=	winapi-util	0.1.11
MODCARGO_CRATES +=	winapi-x86_64-pc-windows-gnu	0.4.0
MODCARGO_CRATES +=	windows-core	0.62.2
MODCARGO_CRATES +=	windows-implement	0.60.2
MODCARGO_CRATES +=	windows-interface	0.59.3
MODCARGO_CRATES +=	windows-link	0.2.1
MODCARGO_CRATES +=	windows-result	0.4.1
MODCARGO_CRATES +=	windows-strings	0.5.1
MODCARGO_CRATES +=	windows-sys	0.45.0
MODCARGO_CRATES +=	windows-sys	0.48.0
MODCARGO_CRATES +=	windows-sys	0.52.0
MODCARGO_CRATES +=	windows-sys	0.60.2
MODCARGO_CRATES +=	windows-sys	0.61.2
MODCARGO_CRATES +=	windows-targets	0.42.2
MODCARGO_CRATES +=	windows-targets	0.48.5
MODCARGO_CRATES +=	windows-targets	0.52.6
MODCARGO_CRATES +=	windows-targets	0.53.5
MODCARGO_CRATES +=	windows_aarch64_gnullvm	0.42.2
MODCARGO_CRATES +=	windows_aarch64_gnullvm	0.48.5
MODCARGO_CRATES +=	windows_aarch64_gnullvm	0.52.6
MODCARGO_CRATES +=	windows_aarch64_gnullvm	0.53.1
MODCARGO_CRATES +=	windows_aarch64_msvc	0.42.2
MODCARGO_CRATES +=	windows_aarch64_msvc	0.48.5
MODCARGO_CRATES +=	windows_aarch64_msvc	0.52.6
MODCARGO_CRATES +=	windows_aarch64_msvc	0.53.1
MODCARGO_CRATES +=	windows_i686_gnu	0.42.2
MODCARGO_CRATES +=	windows_i686_gnu	0.48.5
MODCARGO_CRATES +=	windows_i686_gnu	0.52.6
MODCARGO_CRATES +=	windows_i686_gnu	0.53.1
MODCARGO_CRATES +=	windows_i686_gnullvm	0.52.6
MODCARGO_CRATES +=	windows_i686_gnullvm	0.53.1
MODCARGO_CRATES +=	windows_i686_msvc	0.42.2
MODCARGO_CRATES +=	windows_i686_msvc	0.48.5
MODCARGO_CRATES +=	windows_i686_msvc	0.52.6
MODCARGO_CRATES +=	windows_i686_msvc	0.53.1
MODCARGO_CRATES +=	windows_x86_64_gnu	0.42.2
MODCARGO_CRATES +=	windows_x86_64_gnu	0.48.5
MODCARGO_CRATES +=	windows_x86_64_gnu	0.52.6
MODCARGO_CRATES +=	windows_x86_64_gnu	0.53.1
MODCARGO_CRATES +=	windows_x86_64_gnullvm	0.42.2
MODCARGO_CRATES +=	windows_x86_64_gnullvm	0.48.5
MODCARGO_CRATES +=	windows_x86_64_gnullvm	0.52.6
MODCARGO_CRATES +=	windows_x86_64_gnullvm	0.53.1
MODCARGO_CRATES +=	windows_x86_64_msvc	0.42.2
MODCARGO_CRATES +=	windows_x86_64_msvc	0.48.5
MODCARGO_CRATES +=	windows_x86_64_msvc	0.52.6
MODCARGO_CRATES +=	windows_x86_64_msvc	0.53.1
MODCARGO_CRATES +=	winnow	1.0.0
MODCARGO_CRATES +=	winreg	0.50.0
MODCARGO_CRATES +=	wit-bindgen	0.51.0
MODCARGO_CRATES +=	wit-bindgen-core	0.51.0
MODCARGO_CRATES +=	wit-bindgen-rust	0.51.0
MODCARGO_CRATES +=	wit-bindgen-rust-macro	0.51.0
MODCARGO_CRATES +=	wit-component	0.244.0
MODCARGO_CRATES +=	wit-parser	0.244.0
MODCARGO_CRATES +=	writeable	0.6.2
MODCARGO_CRATES +=	x25519-dalek	2.0.1
MODCARGO_CRATES +=	x509-parser	0.18.1
MODCARGO_CRATES +=	yoke	0.8.1
MODCARGO_CRATES +=	yoke-derive	0.8.1
MODCARGO_CRATES +=	zerocopy	0.8.47
MODCARGO_CRATES +=	zerocopy-derive	0.8.47
MODCARGO_CRATES +=	zerofrom	0.1.6
MODCARGO_CRATES +=	zerofrom-derive	0.1.6
MODCARGO_CRATES +=	zeroize	1.8.2
MODCARGO_CRATES +=	zeroize_derive	1.4.3
MODCARGO_CRATES +=	zerotrie	0.2.3
MODCARGO_CRATES +=	zerovec	0.11.5
MODCARGO_CRATES +=	zerovec-derive	0.11.2
MODCARGO_CRATES +=	zmij	1.0.21
