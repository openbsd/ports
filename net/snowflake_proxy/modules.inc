MODGO_MODULES =	\
	cloud.google.com/go							 v0.26.0 \
	github.com/!burnt!sushi/toml						 v0.3.1 \
	github.com/alecthomas/kingpin/v2					 v2.4.0 \
	github.com/alecthomas/units						 v0.0.0-20211218093645-b94a6e3cc137 \
	github.com/andybalholm/brotli						 v1.0.6 \
	github.com/aws/aws-sdk-go-v2						 v1.25.3 \
	github.com/aws/aws-sdk-go-v2/config					 v1.27.7 \
	github.com/aws/aws-sdk-go-v2/credentials				 v1.17.7 \
	github.com/aws/aws-sdk-go-v2/feature/ec2/imds				 v1.15.3 \
	github.com/aws/aws-sdk-go-v2/internal/configsources			 v1.3.3 \
	github.com/aws/aws-sdk-go-v2/internal/endpoints/v2			 v2.6.3 \
	github.com/aws/aws-sdk-go-v2/internal/ini				 v1.8.0 \
	github.com/aws/aws-sdk-go-v2/service/internal/accept-encoding		 v1.11.1 \
	github.com/aws/aws-sdk-go-v2/service/internal/presigned-url		 v1.11.5 \
	github.com/aws/aws-sdk-go-v2/service/sqs				 v1.31.2 \
	github.com/aws/aws-sdk-go-v2/service/sso				 v1.20.2 \
	github.com/aws/aws-sdk-go-v2/service/ssooidc				 v1.23.2 \
	github.com/aws/aws-sdk-go-v2/service/sts				 v1.28.4 \
	github.com/aws/smithy-go						 v1.20.1 \
	github.com/beorn7/perks							 v1.0.1 \
	github.com/bwesterb/go-ristretto					 v1.2.3 \
	github.com/census-instrumentation/opencensus-proto			 v0.2.1 \
	github.com/cespare/xxhash/v2						 v2.2.0 \
	github.com/client9/misspell						 v0.3.4 \
	github.com/cloudflare/circl						 v1.3.7 \
	github.com/cncf/udpa/go							 v0.0.0-20191209042840-269d4d468f6f \
	github.com/creack/pty							 v1.1.9 \
	github.com/davecgh/go-spew						 v1.1.1 \
	github.com/envoyproxy/go-control-plane					 v0.9.4 \
	github.com/envoyproxy/protoc-gen-validate				 v0.1.0 \
	github.com/francoispqt/gojay						 v1.2.13 \
	github.com/fsnotify/fsnotify						 v1.4.9 \
	github.com/go-kit/log							 v0.2.1 \
	github.com/go-logfmt/logfmt						 v0.5.1 \
	github.com/go-logr/logr							 v1.2.4 \
	github.com/go-task/slim-sprig						 v0.0.0-20230315185526-52ccab3ef572 \
	github.com/golang/glog							 v0.0.0-20160126235308-23def4e6c14b \
	github.com/golang/mock							 v1.6.0 \
	github.com/golang/protobuf						 v1.5.3 \
	github.com/google/go-cmp						 v0.6.0 \
	github.com/google/pprof							 v0.0.0-20210407192527-94a9f03dee38 \
	github.com/google/uuid							 v1.3.1 \
	github.com/gopherjs/gopherjs						 v1.17.2 \
	github.com/gorilla/websocket						 v1.5.1 \
	github.com/hpcloud/tail							 v1.0.0 \
	github.com/inconshreveable/mousetrap					 v1.0.0 \
	github.com/jmespath/go-jmespath						 v0.4.0 \
	github.com/jpillora/backoff						 v1.0.0 \
	github.com/json-iterator/go						 v1.1.12 \
	github.com/jtolds/gls							 v4.20.0+incompatible \
	github.com/julienschmidt/httprouter					 v1.3.0 \
	github.com/klauspost/compress						 v1.17.4 \
	github.com/klauspost/cpuid/v2						 v2.2.6 \
	github.com/klauspost/reedsolomon					 v1.12.0 \
	github.com/kr/pretty							 v0.3.1 \
	github.com/kr/pty							 v1.1.1 \
	github.com/kr/text							 v0.2.0 \
	github.com/miekg/dns							 v1.1.58 \
	github.com/modern-go/concurrent						 v0.0.0-20180306012644-bacd9c7ef1dd \
	github.com/modern-go/reflect2						 v1.0.2 \
	github.com/mwitkow/go-conntrack						 v0.0.0-20190716064945-2f068394615f \
	github.com/neelance/astrewrite						 v0.0.0-20160511093645-99348263ae86 \
	github.com/neelance/sourcemap						 v0.0.0-20200213170602-2833bce08e4c \
	github.com/nxadm/tail							 v1.4.8 \
	github.com/onsi/ginkgo							 v1.16.5 \
	github.com/onsi/ginkgo/v2						 v2.9.5 \
	github.com/onsi/gomega							 v1.27.6 \
	github.com/patrickmn/go-cache						 v2.1.0+incompatible \
	github.com/pion/datachannel						 v1.5.5 \
	github.com/pion/dtls/v2							 v2.2.7 \
	github.com/pion/ice/v2							 v2.3.13 \
	github.com/pion/interceptor						 v0.1.25 \
	github.com/pion/logging							 v0.2.2 \
	github.com/pion/mdns							 v0.0.12 \
	github.com/pion/randutil						 v0.1.0 \
	github.com/pion/rtcp							 v1.2.12 \
	github.com/pion/rtp							 v1.8.3 \
	github.com/pion/sctp							 v1.8.12 \
	github.com/pion/sdp/v3							 v3.0.8 \
	github.com/pion/srtp/v2							 v2.0.18 \
	github.com/pion/stun							 v0.6.1 \
	github.com/pion/transport						 v0.14.1 \
	github.com/pion/transport/v2						 v2.2.4 \
	github.com/pion/transport/v3						 v3.0.1 \
	github.com/pion/turn/v2							 v2.1.4 \
	github.com/pion/webrtc/v3						 v3.2.29 \
	github.com/pkg/errors							 v0.9.1 \
	github.com/pmezard/go-difflib						 v1.0.0 \
	github.com/prometheus/client_golang					 v1.19.0 \
	github.com/prometheus/client_model					 v0.6.0 \
	github.com/prometheus/common						 v0.48.0 \
	github.com/prometheus/procfs						 v0.12.0 \
	github.com/quic-go/qpack						 v0.4.0 \
	github.com/quic-go/qtls-go1-20						 v0.4.1 \
	github.com/quic-go/quic-go						 v0.40.1 \
	github.com/realclientip/realclientip-go					 v1.0.0 \
	github.com/refraction-networking/utls					 v1.6.3 \
	github.com/rogpeppe/go-internal						 v1.10.0 \
	github.com/sclevine/agouti						 v3.0.0+incompatible \
	github.com/shurcoo!l/go							 v0.0.0-20200502201357-93f07166e636 \
	github.com/shurcoo!l/httpfs						 v0.0.0-20190707220628-8d4bc4ba7749 \
	github.com/shurcoo!l/vfsgen						 v0.0.0-20200824052919-0d455de96546 \
	github.com/sirupsen/logrus						 v1.8.1 \
	github.com/smarty/assertions						 v1.15.0 \
	github.com/smartystreets/assertions					 v0.0.0-20180927180507-b2de0cb4f26d \
	github.com/smartystreets/goconvey					 v1.8.1 \
	github.com/spf13/cobra							 v1.2.1 \
	github.com/spf13/pflag							 v1.0.5 \
	github.com/stretchr/objx						 v0.5.2 \
	github.com/stretchr/testify						 v1.9.0 \
	github.com/templexxx/cpu						 v0.1.0 \
	github.com/templexxx/xorsimd						 v0.4.2 \
	github.com/tjfoc/gmsm							 v1.4.1 \
	github.com/txthinking/runnergroup					 v0.0.0-20210608031112-152c7c4432bf \
	github.com/txthinking/socks5						 v0.0.0-20230325130024-4230056ae301 \
	github.com/xhit/go-str2duration/v2					 v2.1.0 \
	github.com/xtaci/kcp-go/v5						 v5.6.8 \
	github.com/xtaci/lossyconn						 v0.0.0-20190602105132-8df528c0c9ae \
	github.com/xtaci/smux							 v1.5.24 \
	github.com/yuin/goldmark						 v1.4.13 \
	gitlab.torproject.org/tpo/anti-censorship/geoip				 v0.0.0-20210928150955-7ce4b3d98d01 \
	gitlab.torproject.org/tpo/anti-censorship/pluggable-transports/goptlib	 v1.5.0 \
	go.uber.org/mock							 v0.3.0 \
	golang.org/x/crypto							 v0.21.0 \
	golang.org/x/exp							 v0.0.0-20221205204356-47842c84f3db \
	golang.org/x/lint							 v0.0.0-20190313153728-d0100b6bd8b3 \
	golang.org/x/mod							 v0.14.0 \
	golang.org/x/net							 v0.22.0 \
	golang.org/x/oauth2							 v0.16.0 \
	golang.org/x/sync							 v0.6.0 \
	golang.org/x/sys							 v0.18.0 \
	golang.org/x/term							 v0.18.0 \
	golang.org/x/text							 v0.14.0 \
	golang.org/x/tools							 v0.17.0 \
	golang.org/x/xerrors							 v0.0.0-20200804184101-5ec99f83aff1 \
	google.golang.org/appengine						 v1.6.7 \
	google.golang.org/genproto						 v0.0.0-20190819201941-24fa4b261c55 \
	google.golang.org/grpc							 v1.31.0 \
	google.golang.org/protobuf						 v1.33.0 \
	gopkg.in/check.v1							 v1.0.0-20201130134442-10cb98267c6c \
	gopkg.in/fsnotify.v1							 v1.4.7 \
	gopkg.in/tomb.v1							 v1.0.0-20141024135613-dd632973f1e7 \
	gopkg.in/yaml.v2							 v2.4.0 \
	gopkg.in/yaml.v3							 v3.0.1 \
	honnef.co/go/tools							 v0.0.0-20190523083050-ea95bdfd59fc

MODGO_MODFILES =	\
	github.com/davecgh/go-spew		 v1.1.0 \
	github.com/envoyproxy/go-control-plane	 v0.9.0 \
	github.com/fsnotify/fsnotify		 v1.4.7 \
	github.com/go-task/slim-sprig		 v0.0.0-20210107165309-348f09dbbbc0 \
	github.com/golang/mock			 v1.1.1 \
	github.com/golang/protobuf		 v1.2.0 \
	github.com/golang/protobuf		 v1.3.2 \
	github.com/golang/protobuf		 v1.3.3 \
	github.com/golang/protobuf		 v1.4.0 \
	github.com/golang/protobuf		 v1.4.0-rc.1 \
	github.com/golang/protobuf		 v1.4.0-rc.1.0.20200221234624-67d41d38c208 \
	github.com/golang/protobuf		 v1.4.0-rc.2 \
	github.com/golang/protobuf		 v1.4.0-rc.4.0.20200313231945-b860323f09d0 \
	github.com/golang/protobuf		 v1.4.2 \
	github.com/golang/protobuf		 v1.5.0 \
	github.com/golang/protobuf		 v1.5.2 \
	github.com/google/go-cmp		 v0.2.0 \
	github.com/google/go-cmp		 v0.3.0 \
	github.com/google/go-cmp		 v0.3.1 \
	github.com/google/go-cmp		 v0.4.0 \
	github.com/google/go-cmp		 v0.5.5 \
	github.com/google/go-cmp		 v0.5.6 \
	github.com/google/go-cmp		 v0.5.9 \
	github.com/gopherjs/gopherjs		 v0.0.0-20181017120253-0766667cb4d1 \
	github.com/klauspost/cpuid/v2		 v2.1.1 \
	github.com/kr/pretty			 v0.1.0 \
	github.com/kr/text			 v0.1.0 \
	github.com/miekg/dns			 v1.1.51 \
	github.com/nxadm/tail			 v1.4.4 \
	github.com/onsi/ginkgo			 v1.12.1 \
	github.com/onsi/ginkgo			 v1.16.4 \
	github.com/onsi/ginkgo			 v1.6.0 \
	github.com/onsi/gomega			 v1.10.1 \
	github.com/onsi/gomega			 v1.17.0 \
	github.com/onsi/gomega			 v1.7.1 \
	github.com/pion/rtcp			 v1.2.10 \
	github.com/pion/rtp			 v1.8.2 \
	github.com/pion/sctp			 v1.8.5 \
	github.com/pion/transport/v2		 v2.2.1 \
	github.com/pion/transport/v2		 v2.2.2 \
	github.com/pion/transport/v2		 v2.2.3 \
	github.com/pion/turn/v2			 v2.1.3 \
	github.com/prometheus/client_golang	 v1.18.0 \
	github.com/prometheus/client_model	 v0.0.0-20190812154241-14fe0d1b01d4 \
	github.com/prometheus/client_model	 v0.5.0 \
	github.com/smartystreets/goconvey	 v1.6.4 \
	github.com/stretchr/objx		 v0.1.0 \
	github.com/stretchr/objx		 v0.4.0 \
	github.com/stretchr/objx		 v0.5.0 \
	github.com/stretchr/testify		 v1.5.1 \
	github.com/stretchr/testify		 v1.6.1 \
	github.com/stretchr/testify		 v1.7.1 \
	github.com/stretchr/testify		 v1.8.0 \
	github.com/stretchr/testify		 v1.8.1 \
	github.com/stretchr/testify		 v1.8.3 \
	github.com/stretchr/testify		 v1.8.4 \
	github.com/yuin/goldmark		 v1.2.1 \
	github.com/yuin/goldmark		 v1.3.5 \
	golang.org/x/crypto			 v0.0.0-20190308221718-c2843e01d9a2 \
	golang.org/x/crypto			 v0.0.0-20191011191535-87dc89f01550 \
	golang.org/x/crypto			 v0.0.0-20200622213623-75b288015ac9 \
	golang.org/x/crypto			 v0.0.0-20201012173705-84dcc777aaee \
	golang.org/x/crypto			 v0.0.0-20210711020723-a769d52b0f97 \
	golang.org/x/crypto			 v0.0.0-20210921155107-089bfa567519 \
	golang.org/x/crypto			 v0.11.0 \
	golang.org/x/crypto			 v0.12.0 \
	golang.org/x/crypto			 v0.17.0 \
	golang.org/x/crypto			 v0.18.0 \
	golang.org/x/crypto			 v0.4.0 \
	golang.org/x/crypto			 v0.8.0 \
	golang.org/x/exp			 v0.0.0-20190121172915-509febef88a4 \
	golang.org/x/lint			 v0.0.0-20181026193005-c67002cb31c3 \
	golang.org/x/lint			 v0.0.0-20190227174305-5b3e6a55c961 \
	golang.org/x/mod			 v0.11.0 \
	golang.org/x/mod			 v0.3.0 \
	golang.org/x/mod			 v0.4.2 \
	golang.org/x/mod			 v0.6.0-dev.0.20220419223038-86c51ed26bb4 \
	golang.org/x/mod			 v0.7.0 \
	golang.org/x/mod			 v0.8.0 \
	golang.org/x/mod			 v0.9.0 \
	golang.org/x/net			 v0.0.0-20180724234803-3673e40ba225 \
	golang.org/x/net			 v0.0.0-20180826012351-8a410e7b638d \
	golang.org/x/net			 v0.0.0-20180906233101-161cd47e91fd \
	golang.org/x/net			 v0.0.0-20190213061140-3a22650c66bd \
	golang.org/x/net			 v0.0.0-20190311183353-d8887717615a \
	golang.org/x/net			 v0.0.0-20190404232315-eb5bcb51f2a3 \
	golang.org/x/net			 v0.0.0-20190620200207-3b0461eec859 \
	golang.org/x/net			 v0.0.0-20200520004742-59133d7f0dd7 \
	golang.org/x/net			 v0.0.0-20201010224723-4f7140c49acb \
	golang.org/x/net			 v0.0.0-20201021035429-f5854403a974 \
	golang.org/x/net			 v0.0.0-20210226172049-e18ecbb05110 \
	golang.org/x/net			 v0.0.0-20210405180319-a5a99cb37ef4 \
	golang.org/x/net			 v0.0.0-20210428140749-89ef3d95e781 \
	golang.org/x/net			 v0.0.0-20220722155237-a158d28d115b \
	golang.org/x/net			 v0.1.0 \
	golang.org/x/net			 v0.10.0 \
	golang.org/x/net			 v0.13.0 \
	golang.org/x/net			 v0.14.0 \
	golang.org/x/net			 v0.17.0 \
	golang.org/x/net			 v0.19.0 \
	golang.org/x/net			 v0.2.0 \
	golang.org/x/net			 v0.20.0 \
	golang.org/x/net			 v0.21.0 \
	golang.org/x/net			 v0.6.0 \
	golang.org/x/net			 v0.9.0 \
	golang.org/x/oauth2			 v0.0.0-20180821212333-d2e6202438be \
	golang.org/x/sync			 v0.0.0-20180314180146-1d60e4601c6f \
	golang.org/x/sync			 v0.0.0-20181108010431-42b317875d0f \
	golang.org/x/sync			 v0.0.0-20190423024810-112230192c58 \
	golang.org/x/sync			 v0.0.0-20201020160332-67f06af15bc9 \
	golang.org/x/sync			 v0.0.0-20210220032951-036812b2e83c \
	golang.org/x/sync			 v0.0.0-20220722155255-886fb9371eb4 \
	golang.org/x/sync			 v0.1.0 \
	golang.org/x/sync			 v0.2.0 \
	golang.org/x/sync			 v0.3.0 \
	golang.org/x/sys			 v0.0.0-20180830151530-49385e6e1522 \
	golang.org/x/sys			 v0.0.0-20180909124046-d0be0721c37e \
	golang.org/x/sys			 v0.0.0-20190215142949-d0b11bdaac8a \
	golang.org/x/sys			 v0.0.0-20190412213103-97732733099d \
	golang.org/x/sys			 v0.0.0-20190904154756-749cb33beabd \
	golang.org/x/sys			 v0.0.0-20191005200804-aed5e4c7ecf9 \
	golang.org/x/sys			 v0.0.0-20191120155948-bd437916bb0e \
	golang.org/x/sys			 v0.0.0-20200323222414-85ca7c5b95cd \
	golang.org/x/sys			 v0.0.0-20200930185726-fdedc70b468f \
	golang.org/x/sys			 v0.0.0-20201119102817-f84b799fce68 \
	golang.org/x/sys			 v0.0.0-20210112080510-489259a85091 \
	golang.org/x/sys			 v0.0.0-20210330210617-4fbd30eecc44 \
	golang.org/x/sys			 v0.0.0-20210423082822-04245dca01da \
	golang.org/x/sys			 v0.0.0-20210510120138-977fb7262007 \
	golang.org/x/sys			 v0.0.0-20210615035016-665e8c7367d1 \
	golang.org/x/sys			 v0.0.0-20210630005230-0f9fa26af87c \
	golang.org/x/sys			 v0.0.0-20220520151302-bc2c85ada10a \
	golang.org/x/sys			 v0.0.0-20220704084225-05e143d24a9e \
	golang.org/x/sys			 v0.0.0-20220722155257-8c9f86f7a55f \
	golang.org/x/sys			 v0.1.0 \
	golang.org/x/sys			 v0.10.0 \
	golang.org/x/sys			 v0.11.0 \
	golang.org/x/sys			 v0.12.0 \
	golang.org/x/sys			 v0.15.0 \
	golang.org/x/sys			 v0.16.0 \
	golang.org/x/sys			 v0.2.0 \
	golang.org/x/sys			 v0.5.0 \
	golang.org/x/sys			 v0.6.0 \
	golang.org/x/sys			 v0.7.0 \
	golang.org/x/sys			 v0.8.0 \
	golang.org/x/sys			 v0.9.0 \
	golang.org/x/term			 v0.0.0-20201126162022-7de9c90e9dd1 \
	golang.org/x/term			 v0.0.0-20210927222741-03fcf44c2211 \
	golang.org/x/term			 v0.1.0 \
	golang.org/x/term			 v0.10.0 \
	golang.org/x/term			 v0.11.0 \
	golang.org/x/term			 v0.16.0 \
	golang.org/x/term			 v0.2.0 \
	golang.org/x/term			 v0.5.0 \
	golang.org/x/term			 v0.7.0 \
	golang.org/x/term			 v0.8.0 \
	golang.org/x/text			 v0.11.0 \
	golang.org/x/text			 v0.12.0 \
	golang.org/x/text			 v0.3.0 \
	golang.org/x/text			 v0.3.3 \
	golang.org/x/text			 v0.3.6 \
	golang.org/x/text			 v0.3.7 \
	golang.org/x/text			 v0.4.0 \
	golang.org/x/text			 v0.7.0 \
	golang.org/x/text			 v0.9.0 \
	golang.org/x/tools			 v0.0.0-20180917221912-90fa682c2a6e \
	golang.org/x/tools			 v0.0.0-20190114222345-bf090417da8b \
	golang.org/x/tools			 v0.0.0-20190226205152-f727befe758c \
	golang.org/x/tools			 v0.0.0-20190311212946-11955173bddd \
	golang.org/x/tools			 v0.0.0-20190328211700-ab21143f2384 \
	golang.org/x/tools			 v0.0.0-20190524140312-2c0ae7006135 \
	golang.org/x/tools			 v0.0.0-20191119224855-298f0cb1881e \
	golang.org/x/tools			 v0.0.0-20201224043029-2b0845dc783e \
	golang.org/x/tools			 v0.1.1 \
	golang.org/x/tools			 v0.1.12 \
	golang.org/x/tools			 v0.1.5 \
	golang.org/x/tools			 v0.13.0 \
	golang.org/x/tools			 v0.3.0 \
	golang.org/x/tools			 v0.6.0 \
	golang.org/x/tools			 v0.7.0 \
	golang.org/x/tools			 v0.9.1 \
	golang.org/x/xerrors			 v0.0.0-20190717185122-a985d3407aa7 \
	golang.org/x/xerrors			 v0.0.0-20191011141410-1b5146add898 \
	golang.org/x/xerrors			 v0.0.0-20191204190536-9bdfabe68543 \
	google.golang.org/appengine		 v1.1.0 \
	google.golang.org/appengine		 v1.4.0 \
	google.golang.org/genproto		 v0.0.0-20180817151627-c66870c02cf8 \
	google.golang.org/grpc			 v1.19.0 \
	google.golang.org/grpc			 v1.23.0 \
	google.golang.org/grpc			 v1.25.1 \
	google.golang.org/protobuf		 v0.0.0-20200109180630-ec00e32a8dfd \
	google.golang.org/protobuf		 v0.0.0-20200221191635-4d8936d0db64 \
	google.golang.org/protobuf		 v0.0.0-20200228230310-ab0ca4ff8a60 \
	google.golang.org/protobuf		 v1.20.1-0.20200309200217-e05f789c0967 \
	google.golang.org/protobuf		 v1.21.0 \
	google.golang.org/protobuf		 v1.23.0 \
	google.golang.org/protobuf		 v1.26.0 \
	google.golang.org/protobuf		 v1.26.0-rc.1 \
	google.golang.org/protobuf		 v1.32.0 \
	gopkg.in/check.v1			 v0.0.0-20161208181325-20d25e280405 \
	gopkg.in/check.v1			 v1.0.0-20180628173108-788fd7840127 \
	gopkg.in/check.v1			 v1.0.0-20190902080502-41f04d3bba15 \
	gopkg.in/yaml.v2			 v2.2.2 \
	gopkg.in/yaml.v2			 v2.2.4 \
	gopkg.in/yaml.v2			 v2.3.0 \
	gopkg.in/yaml.v3			 v3.0.0 \
	gopkg.in/yaml.v3			 v3.0.0-20200313102051-9f266ea9e77c \
	honnef.co/go/tools			 v0.0.0-20190102054323-c2f93a96b099
