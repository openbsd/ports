MODCARGO_CRATES +=	accessory	1.3.0
MODCARGO_CRATES +=	addr2line	0.21.0
MODCARGO_CRATES +=	adler	1.0.2
MODCARGO_CRATES +=	aead	0.5.2
MODCARGO_CRATES +=	aes	0.8.4
MODCARGO_CRATES +=	ahash	0.8.11
MODCARGO_CRATES +=	aho-corasick	1.1.3
MODCARGO_CRATES +=	allocator-api2	0.2.18
MODCARGO_CRATES +=	android-tzdata	0.1.1
MODCARGO_CRATES +=	android_system_properties	0.1.5
MODCARGO_CRATES +=	anstream	0.3.2
MODCARGO_CRATES +=	anstyle	1.0.6
MODCARGO_CRATES +=	anstyle-parse	0.2.3
MODCARGO_CRATES +=	anstyle-query	1.0.2
MODCARGO_CRATES +=	anstyle-wincon	1.0.2
MODCARGO_CRATES +=	anyhow	1.0.82
MODCARGO_CRATES +=	anymap2	0.13.0
MODCARGO_CRATES +=	aquamarine	0.5.0
MODCARGO_CRATES +=	arboard	3.3.2
MODCARGO_CRATES +=	arrayref	0.3.7
MODCARGO_CRATES +=	arrayvec	0.7.4
MODCARGO_CRATES +=	as_variant	1.2.0
MODCARGO_CRATES +=	assign	1.1.1
MODCARGO_CRATES +=	async-broadcast	0.5.1
MODCARGO_CRATES +=	async-channel	2.2.1
MODCARGO_CRATES +=	async-executor	1.8.0
MODCARGO_CRATES +=	async-fs	1.6.0
MODCARGO_CRATES +=	async-io	1.13.0
MODCARGO_CRATES +=	async-io	2.3.2
MODCARGO_CRATES +=	async-lock	2.8.0
MODCARGO_CRATES +=	async-lock	3.3.0
MODCARGO_CRATES +=	async-process	1.8.1
MODCARGO_CRATES +=	async-recursion	1.1.0
MODCARGO_CRATES +=	async-signal	0.2.5
MODCARGO_CRATES +=	async-stream	0.3.5
MODCARGO_CRATES +=	async-stream-impl	0.3.5
MODCARGO_CRATES +=	async-task	4.7.0
MODCARGO_CRATES +=	async-trait	0.1.80
MODCARGO_CRATES +=	atomic-waker	1.1.2
MODCARGO_CRATES +=	autocfg	1.2.0
MODCARGO_CRATES +=	backoff	0.4.0
MODCARGO_CRATES +=	backtrace	0.3.71
MODCARGO_CRATES +=	base64	0.21.7
MODCARGO_CRATES +=	base64ct	1.6.0
MODCARGO_CRATES +=	bit_field	0.10.2
MODCARGO_CRATES +=	bitflags	1.3.2
MODCARGO_CRATES +=	bitflags	2.5.0
MODCARGO_CRATES +=	bitmaps	3.2.1
MODCARGO_CRATES +=	blake3	1.5.1
MODCARGO_CRATES +=	block	0.1.6
MODCARGO_CRATES +=	block-buffer	0.10.4
MODCARGO_CRATES +=	block-padding	0.3.3
MODCARGO_CRATES +=	blocking	1.5.1
MODCARGO_CRATES +=	bs58	0.5.1
MODCARGO_CRATES +=	bumpalo	3.16.0
MODCARGO_CRATES +=	bytemuck	1.15.0
MODCARGO_CRATES +=	byteorder	1.5.0
MODCARGO_CRATES +=	bytes	1.6.0
MODCARGO_CRATES +=	bytesize	1.3.0
MODCARGO_CRATES +=	cassowary	0.3.0
MODCARGO_CRATES +=	castaway	0.2.2
MODCARGO_CRATES +=	cbc	0.1.2
MODCARGO_CRATES +=	cc	1.0.94
MODCARGO_CRATES +=	cfg-if	1.0.0
MODCARGO_CRATES +=	cfg-vis	0.3.0
MODCARGO_CRATES +=	cfg_aliases	0.1.1
MODCARGO_CRATES +=	chacha20	0.9.1
MODCARGO_CRATES +=	chacha20poly1305	0.10.1
MODCARGO_CRATES +=	chrono	0.4.31
MODCARGO_CRATES +=	cipher	0.4.4
MODCARGO_CRATES +=	clap	4.3.24
MODCARGO_CRATES +=	clap_builder	4.3.24
MODCARGO_CRATES +=	clap_derive	4.3.12
MODCARGO_CRATES +=	clap_lex	0.5.1
MODCARGO_CRATES +=	clipboard-win	5.3.1
MODCARGO_CRATES +=	color_quant	1.1.0
MODCARGO_CRATES +=	colorchoice	1.0.0
MODCARGO_CRATES +=	compact_str	0.7.1
MODCARGO_CRATES +=	comrak	0.22.0
MODCARGO_CRATES +=	concurrent-queue	2.4.0
MODCARGO_CRATES +=	const-oid	0.9.6
MODCARGO_CRATES +=	const_panic	0.2.8
MODCARGO_CRATES +=	constant_time_eq	0.3.0
MODCARGO_CRATES +=	convert_case	0.4.0
MODCARGO_CRATES +=	core-foundation	0.9.4
MODCARGO_CRATES +=	core-foundation-sys	0.8.6
MODCARGO_CRATES +=	core-graphics	0.23.2
MODCARGO_CRATES +=	core-graphics-types	0.1.3
MODCARGO_CRATES +=	cpufeatures	0.2.12
MODCARGO_CRATES +=	crc32fast	1.4.0
MODCARGO_CRATES +=	crossbeam-channel	0.5.12
MODCARGO_CRATES +=	crossbeam-deque	0.8.5
MODCARGO_CRATES +=	crossbeam-epoch	0.9.18
MODCARGO_CRATES +=	crossbeam-utils	0.8.19
MODCARGO_CRATES +=	crossterm	0.27.0
MODCARGO_CRATES +=	crossterm_winapi	0.9.1
MODCARGO_CRATES +=	crunchy	0.2.2
MODCARGO_CRATES +=	crypto-common	0.1.6
MODCARGO_CRATES +=	css-color-parser	0.1.2
MODCARGO_CRATES +=	ctr	0.9.2
MODCARGO_CRATES +=	curve25519-dalek	4.1.2
MODCARGO_CRATES +=	curve25519-dalek-derive	0.1.1
MODCARGO_CRATES +=	darling	0.14.4
MODCARGO_CRATES +=	darling_core	0.14.4
MODCARGO_CRATES +=	darling_macro	0.14.4
MODCARGO_CRATES +=	deadpool	0.10.0
MODCARGO_CRATES +=	deadpool-runtime	0.1.3
MODCARGO_CRATES +=	deadpool-sqlite	0.7.0
MODCARGO_CRATES +=	deadpool-sync	0.1.2
MODCARGO_CRATES +=	delegate-display	2.1.1
MODCARGO_CRATES +=	der	0.7.9
MODCARGO_CRATES +=	der_derive	0.7.2
MODCARGO_CRATES +=	deranged	0.3.11
MODCARGO_CRATES +=	derivative	2.2.0
MODCARGO_CRATES +=	derive-new	0.6.0
MODCARGO_CRATES +=	derive_builder	0.12.0
MODCARGO_CRATES +=	derive_builder_core	0.12.0
MODCARGO_CRATES +=	derive_builder_macro	0.12.0
MODCARGO_CRATES +=	derive_more	0.99.17
MODCARGO_CRATES +=	deunicode	1.4.4
MODCARGO_CRATES +=	diff	0.1.13
MODCARGO_CRATES +=	digest	0.10.7
MODCARGO_CRATES +=	dirs	4.0.0
MODCARGO_CRATES +=	dirs-next	2.0.0
MODCARGO_CRATES +=	dirs-sys	0.3.7
MODCARGO_CRATES +=	dirs-sys-next	0.1.2
MODCARGO_CRATES +=	displaydoc	0.2.4
MODCARGO_CRATES +=	dlib	0.5.2
MODCARGO_CRATES +=	downcast-rs	1.2.1
MODCARGO_CRATES +=	dyn-clone	1.0.14
MODCARGO_CRATES +=	ed25519	2.2.3
MODCARGO_CRATES +=	ed25519-dalek	2.1.1
MODCARGO_CRATES +=	edit	0.1.4
MODCARGO_CRATES +=	either	1.11.0
MODCARGO_CRATES +=	emojis	0.5.3
MODCARGO_CRATES +=	encoding_rs	0.8.34
MODCARGO_CRATES +=	endian-type	0.1.2
MODCARGO_CRATES +=	entities	1.0.1
MODCARGO_CRATES +=	enumflags2	0.7.9
MODCARGO_CRATES +=	enumflags2_derive	0.7.9
MODCARGO_CRATES +=	equivalent	1.0.1
MODCARGO_CRATES +=	errno	0.3.8
MODCARGO_CRATES +=	error-code	3.2.0
MODCARGO_CRATES +=	event-listener	2.5.3
MODCARGO_CRATES +=	event-listener	3.1.0
MODCARGO_CRATES +=	event-listener	4.0.3
MODCARGO_CRATES +=	event-listener	5.3.0
MODCARGO_CRATES +=	event-listener-strategy	0.4.0
MODCARGO_CRATES +=	event-listener-strategy	0.5.1
MODCARGO_CRATES +=	exr	1.72.0
MODCARGO_CRATES +=	eyeball	0.8.7
MODCARGO_CRATES +=	eyeball-im	0.4.2
MODCARGO_CRATES +=	fallible-iterator	0.3.0
MODCARGO_CRATES +=	fallible-streaming-iterator	0.1.9
MODCARGO_CRATES +=	fancy_constructor	1.2.2
MODCARGO_CRATES +=	fastrand	1.9.0
MODCARGO_CRATES +=	fastrand	2.0.2
MODCARGO_CRATES +=	fdeflate	0.3.4
MODCARGO_CRATES +=	fiat-crypto	0.2.7
MODCARGO_CRATES +=	fixedbitset	0.4.2
MODCARGO_CRATES +=	flagset	0.4.5
MODCARGO_CRATES +=	flate2	1.0.28
MODCARGO_CRATES +=	flume	0.11.0
MODCARGO_CRATES +=	fnv	1.0.7
MODCARGO_CRATES +=	foreign-types	0.3.2
MODCARGO_CRATES +=	foreign-types	0.5.0
MODCARGO_CRATES +=	foreign-types-macros	0.2.3
MODCARGO_CRATES +=	foreign-types-shared	0.1.1
MODCARGO_CRATES +=	foreign-types-shared	0.3.1
MODCARGO_CRATES +=	form_urlencoded	1.2.1
MODCARGO_CRATES +=	fs2	0.4.3
MODCARGO_CRATES +=	futf	0.1.5
MODCARGO_CRATES +=	futures	0.3.30
MODCARGO_CRATES +=	futures-channel	0.3.30
MODCARGO_CRATES +=	futures-core	0.3.30
MODCARGO_CRATES +=	futures-executor	0.3.30
MODCARGO_CRATES +=	futures-io	0.3.30
MODCARGO_CRATES +=	futures-lite	1.13.0
MODCARGO_CRATES +=	futures-lite	2.3.0
MODCARGO_CRATES +=	futures-macro	0.3.30
MODCARGO_CRATES +=	futures-sink	0.3.30
MODCARGO_CRATES +=	futures-task	0.3.30
MODCARGO_CRATES +=	futures-util	0.3.30
MODCARGO_CRATES +=	fxhash	0.2.1
MODCARGO_CRATES +=	generic-array	0.14.7
MODCARGO_CRATES +=	gethostname	0.4.3
MODCARGO_CRATES +=	getrandom	0.2.14
MODCARGO_CRATES +=	gif	0.13.1
MODCARGO_CRATES +=	gimli	0.28.1
MODCARGO_CRATES +=	gloo-timers	0.3.0
MODCARGO_CRATES +=	gloo-utils	0.2.0
MODCARGO_CRATES +=	h2	0.3.26
MODCARGO_CRATES +=	half	2.4.1
MODCARGO_CRATES +=	hashbrown	0.14.3
MODCARGO_CRATES +=	hashlink	0.8.4
MODCARGO_CRATES +=	heck	0.4.1
MODCARGO_CRATES +=	hermit-abi	0.3.9
MODCARGO_CRATES +=	hex	0.4.3
MODCARGO_CRATES +=	hkdf	0.12.4
MODCARGO_CRATES +=	hmac	0.12.1
MODCARGO_CRATES +=	home	0.5.5
MODCARGO_CRATES +=	html5ever	0.26.0
MODCARGO_CRATES +=	http	0.2.12
MODCARGO_CRATES +=	http-body	0.4.6
MODCARGO_CRATES +=	httparse	1.8.0
MODCARGO_CRATES +=	httpdate	1.0.3
MODCARGO_CRATES +=	humansize	2.1.3
MODCARGO_CRATES +=	hyper	0.14.28
MODCARGO_CRATES +=	hyper-rustls	0.24.2
MODCARGO_CRATES +=	hyper-tls	0.5.0
MODCARGO_CRATES +=	iana-time-zone	0.1.57
MODCARGO_CRATES +=	iana-time-zone-haiku	0.1.2
MODCARGO_CRATES +=	icy_sixel	0.1.1
MODCARGO_CRATES +=	ident_case	1.0.1
MODCARGO_CRATES +=	idna	0.5.0
MODCARGO_CRATES +=	image	0.24.9
MODCARGO_CRATES +=	imbl	2.0.3
MODCARGO_CRATES +=	imbl-sized-chunks	0.1.2
MODCARGO_CRATES +=	include_dir	0.7.3
MODCARGO_CRATES +=	include_dir_macros	0.7.3
MODCARGO_CRATES +=	indexed_db_futures	0.4.1
MODCARGO_CRATES +=	indexmap	2.2.6
MODCARGO_CRATES +=	indoc	2.0.4
MODCARGO_CRATES +=	inout	0.1.3
MODCARGO_CRATES +=	instant	0.1.12
MODCARGO_CRATES +=	intervaltree	0.2.7
MODCARGO_CRATES +=	io-lifetimes	1.0.11
MODCARGO_CRATES +=	ipnet	2.9.0
MODCARGO_CRATES +=	is-terminal	0.4.12
MODCARGO_CRATES +=	itertools	0.10.5
MODCARGO_CRATES +=	itertools	0.12.1
MODCARGO_CRATES +=	itoa	1.0.11
MODCARGO_CRATES +=	jpeg-decoder	0.3.1
MODCARGO_CRATES +=	js-sys	0.3.69
MODCARGO_CRATES +=	js_int	0.2.2
MODCARGO_CRATES +=	js_option	0.1.1
MODCARGO_CRATES +=	keybindings	0.0.1
MODCARGO_CRATES +=	konst	0.3.8
MODCARGO_CRATES +=	konst_kernel	0.3.8
MODCARGO_CRATES +=	lazy_static	0.1.16
MODCARGO_CRATES +=	lazy_static	1.4.0
MODCARGO_CRATES +=	lebe	0.5.2
MODCARGO_CRATES +=	libc	0.2.153
MODCARGO_CRATES +=	libloading	0.8.3
MODCARGO_CRATES +=	libm	0.2.8
MODCARGO_CRATES +=	libredox	0.1.3
MODCARGO_CRATES +=	libsqlite3-sys	0.27.0
MODCARGO_CRATES +=	linux-raw-sys	0.3.8
MODCARGO_CRATES +=	linux-raw-sys	0.4.13
MODCARGO_CRATES +=	lock_api	0.4.11
MODCARGO_CRATES +=	log	0.4.21
MODCARGO_CRATES +=	lru	0.12.3
MODCARGO_CRATES +=	mac	0.1.1
MODCARGO_CRATES +=	mac-notification-sys	0.6.1
MODCARGO_CRATES +=	macroific	1.3.1
MODCARGO_CRATES +=	macroific_attr_parse	1.3.0
MODCARGO_CRATES +=	macroific_core	1.0.2
MODCARGO_CRATES +=	macroific_macro	1.1.0
MODCARGO_CRATES +=	malloc_buf	0.0.6
MODCARGO_CRATES +=	maplit	1.0.2
MODCARGO_CRATES +=	markup5ever	0.11.0
MODCARGO_CRATES +=	markup5ever_rcdom	0.2.0
MODCARGO_CRATES +=	matrix-pickle	0.1.1
MODCARGO_CRATES +=	matrix-pickle-derive	0.1.1
MODCARGO_CRATES +=	matrix-sdk	0.7.1
MODCARGO_CRATES +=	matrix-sdk-base	0.7.0
MODCARGO_CRATES +=	matrix-sdk-common	0.7.0
MODCARGO_CRATES +=	matrix-sdk-crypto	0.7.0
MODCARGO_CRATES +=	matrix-sdk-indexeddb	0.7.0
MODCARGO_CRATES +=	matrix-sdk-sqlite	0.7.0
MODCARGO_CRATES +=	matrix-sdk-store-encryption	0.7.0
MODCARGO_CRATES +=	memchr	2.7.2
MODCARGO_CRATES +=	memoffset	0.7.1
MODCARGO_CRATES +=	memoffset	0.9.1
MODCARGO_CRATES +=	mime	0.3.17
MODCARGO_CRATES +=	mime2ext	0.1.52
MODCARGO_CRATES +=	mime_guess	2.0.4
MODCARGO_CRATES +=	minimal-lexical	0.2.1
MODCARGO_CRATES +=	miniz_oxide	0.7.2
MODCARGO_CRATES +=	mio	0.8.11
MODCARGO_CRATES +=	modalkit	0.0.20
MODCARGO_CRATES +=	modalkit-ratatui	0.0.20
MODCARGO_CRATES +=	native-tls	0.2.11
MODCARGO_CRATES +=	new_debug_unreachable	1.0.4
MODCARGO_CRATES +=	nibble_vec	0.1.0
MODCARGO_CRATES +=	nix	0.26.4
MODCARGO_CRATES +=	nix	0.28.0
MODCARGO_CRATES +=	nom	7.1.3
MODCARGO_CRATES +=	notify-rust	4.10.0
MODCARGO_CRATES +=	nu-ansi-term	0.46.0
MODCARGO_CRATES +=	num-conv	0.1.0
MODCARGO_CRATES +=	num-traits	0.2.18
MODCARGO_CRATES +=	num_cpus	1.16.0
MODCARGO_CRATES +=	num_threads	0.1.7
MODCARGO_CRATES +=	objc	0.2.7
MODCARGO_CRATES +=	objc-foundation	0.1.1
MODCARGO_CRATES +=	objc_id	0.1.1
MODCARGO_CRATES +=	object	0.32.2
MODCARGO_CRATES +=	once_cell	1.19.0
MODCARGO_CRATES +=	opaque-debug	0.3.1
MODCARGO_CRATES +=	open	3.2.0
MODCARGO_CRATES +=	openssl	0.10.64
MODCARGO_CRATES +=	openssl-macros	0.1.1
MODCARGO_CRATES +=	openssl-probe	0.1.5
MODCARGO_CRATES +=	openssl-sys	0.9.102
MODCARGO_CRATES +=	ordered-stream	0.2.0
MODCARGO_CRATES +=	os_pipe	1.1.5
MODCARGO_CRATES +=	overload	0.1.1
MODCARGO_CRATES +=	parking	2.2.0
MODCARGO_CRATES +=	parking_lot	0.11.2
MODCARGO_CRATES +=	parking_lot	0.12.1
MODCARGO_CRATES +=	parking_lot_core	0.8.6
MODCARGO_CRATES +=	parking_lot_core	0.9.9
MODCARGO_CRATES +=	paste	1.0.14
MODCARGO_CRATES +=	pathdiff	0.2.1
MODCARGO_CRATES +=	pbkdf2	0.12.2
MODCARGO_CRATES +=	percent-encoding	2.3.1
MODCARGO_CRATES +=	petgraph	0.6.4
MODCARGO_CRATES +=	phf	0.10.1
MODCARGO_CRATES +=	phf	0.11.2
MODCARGO_CRATES +=	phf_codegen	0.10.0
MODCARGO_CRATES +=	phf_generator	0.10.0
MODCARGO_CRATES +=	phf_shared	0.10.0
MODCARGO_CRATES +=	phf_shared	0.11.2
MODCARGO_CRATES +=	pin-project-lite	0.2.14
MODCARGO_CRATES +=	pin-utils	0.1.0
MODCARGO_CRATES +=	piper	0.2.1
MODCARGO_CRATES +=	pkcs7	0.4.1
MODCARGO_CRATES +=	pkcs8	0.10.2
MODCARGO_CRATES +=	pkg-config	0.3.30
MODCARGO_CRATES +=	platforms	3.4.0
MODCARGO_CRATES +=	png	0.17.13
MODCARGO_CRATES +=	polling	2.8.0
MODCARGO_CRATES +=	polling	3.5.0
MODCARGO_CRATES +=	poly1305	0.8.0
MODCARGO_CRATES +=	powerfmt	0.2.0
MODCARGO_CRATES +=	ppv-lite86	0.2.17
MODCARGO_CRATES +=	precomputed-hash	0.1.1
MODCARGO_CRATES +=	pretty_assertions	1.4.0
MODCARGO_CRATES +=	proc-macro-crate	1.3.1
MODCARGO_CRATES +=	proc-macro-crate	2.0.0
MODCARGO_CRATES +=	proc-macro-error	1.0.4
MODCARGO_CRATES +=	proc-macro-error-attr	1.0.4
MODCARGO_CRATES +=	proc-macro2	1.0.81
MODCARGO_CRATES +=	prost	0.12.4
MODCARGO_CRATES +=	prost-derive	0.12.4
MODCARGO_CRATES +=	qoi	0.4.1
MODCARGO_CRATES +=	quick-xml	0.30.0
MODCARGO_CRATES +=	quick-xml	0.31.0
MODCARGO_CRATES +=	quote	1.0.36
MODCARGO_CRATES +=	radix_trie	0.2.1
MODCARGO_CRATES +=	rand	0.8.5
MODCARGO_CRATES +=	rand_chacha	0.3.1
MODCARGO_CRATES +=	rand_core	0.6.4
MODCARGO_CRATES +=	rand_xoshiro	0.6.0
MODCARGO_CRATES +=	ratatui	0.26.1
MODCARGO_CRATES +=	ratatui-image	1.0.0
MODCARGO_CRATES +=	rayon	1.10.0
MODCARGO_CRATES +=	rayon-core	1.12.1
MODCARGO_CRATES +=	readlock	0.1.7
MODCARGO_CRATES +=	redox_syscall	0.2.16
MODCARGO_CRATES +=	redox_syscall	0.4.1
MODCARGO_CRATES +=	redox_users	0.4.5
MODCARGO_CRATES +=	regex	1.10.4
MODCARGO_CRATES +=	regex-automata	0.4.6
MODCARGO_CRATES +=	regex-syntax	0.8.3
MODCARGO_CRATES +=	reqwest	0.11.27
MODCARGO_CRATES +=	ring	0.17.8
MODCARGO_CRATES +=	rmp	0.8.13
MODCARGO_CRATES +=	rmp-serde	1.2.0
MODCARGO_CRATES +=	ropey	1.6.1
MODCARGO_CRATES +=	rpassword	7.2.0
MODCARGO_CRATES +=	rtoolbox	0.0.1
MODCARGO_CRATES +=	ruma	0.9.4
MODCARGO_CRATES +=	ruma-client-api	0.17.4
MODCARGO_CRATES +=	ruma-common	0.12.1
MODCARGO_CRATES +=	ruma-events	0.27.11
MODCARGO_CRATES +=	ruma-federation-api	0.8.0
MODCARGO_CRATES +=	ruma-identifiers-validation	0.9.3
MODCARGO_CRATES +=	ruma-macros	0.12.0
MODCARGO_CRATES +=	rusqlite	0.30.0
MODCARGO_CRATES +=	rustc-demangle	0.1.23
MODCARGO_CRATES +=	rustc_version	0.4.0
MODCARGO_CRATES +=	rustix	0.37.27
MODCARGO_CRATES +=	rustix	0.38.32
MODCARGO_CRATES +=	rustls	0.21.10
MODCARGO_CRATES +=	rustls-pemfile	1.0.4
MODCARGO_CRATES +=	rustls-webpki	0.101.7
MODCARGO_CRATES +=	rustversion	1.0.14
MODCARGO_CRATES +=	ryu	1.0.17
MODCARGO_CRATES +=	schannel	0.1.23
MODCARGO_CRATES +=	scoped-tls	1.0.1
MODCARGO_CRATES +=	scopeguard	1.2.0
MODCARGO_CRATES +=	sct	0.7.1
MODCARGO_CRATES +=	security-framework	2.10.0
MODCARGO_CRATES +=	security-framework-sys	2.10.0
MODCARGO_CRATES +=	semver	1.0.22
MODCARGO_CRATES +=	serde	1.0.198
MODCARGO_CRATES +=	serde-wasm-bindgen	0.6.5
MODCARGO_CRATES +=	serde_bytes	0.11.14
MODCARGO_CRATES +=	serde_derive	1.0.198
MODCARGO_CRATES +=	serde_html_form	0.2.6
MODCARGO_CRATES +=	serde_json	1.0.116
MODCARGO_CRATES +=	serde_repr	0.1.18
MODCARGO_CRATES +=	serde_spanned	0.6.5
MODCARGO_CRATES +=	serde_urlencoded	0.7.1
MODCARGO_CRATES +=	sha1	0.10.6
MODCARGO_CRATES +=	sha2	0.10.8
MODCARGO_CRATES +=	sharded-slab	0.1.7
MODCARGO_CRATES +=	signal-hook	0.3.17
MODCARGO_CRATES +=	signal-hook-mio	0.2.3
MODCARGO_CRATES +=	signal-hook-registry	1.4.1
MODCARGO_CRATES +=	signature	2.2.0
MODCARGO_CRATES +=	simd-adler32	0.3.7
MODCARGO_CRATES +=	siphasher	0.3.11
MODCARGO_CRATES +=	slab	0.4.9
MODCARGO_CRATES +=	sled	0.34.7
MODCARGO_CRATES +=	slug	0.1.5
MODCARGO_CRATES +=	smallvec	1.13.2
MODCARGO_CRATES +=	smawk	0.3.2
MODCARGO_CRATES +=	socket2	0.4.10
MODCARGO_CRATES +=	socket2	0.5.6
MODCARGO_CRATES +=	spin	0.9.8
MODCARGO_CRATES +=	spki	0.7.3
MODCARGO_CRATES +=	stability	0.1.1
MODCARGO_CRATES +=	static_assertions	1.1.0
MODCARGO_CRATES +=	str_indices	0.4.3
MODCARGO_CRATES +=	string_cache	0.8.7
MODCARGO_CRATES +=	string_cache_codegen	0.5.2
MODCARGO_CRATES +=	strsim	0.10.0
MODCARGO_CRATES +=	strum	0.26.2
MODCARGO_CRATES +=	strum_macros	0.26.2
MODCARGO_CRATES +=	subtle	2.5.0
MODCARGO_CRATES +=	syn	1.0.109
MODCARGO_CRATES +=	syn	2.0.59
MODCARGO_CRATES +=	sync_wrapper	0.1.2
MODCARGO_CRATES +=	system-configuration	0.5.1
MODCARGO_CRATES +=	system-configuration-sys	0.5.0
MODCARGO_CRATES +=	tauri-winrt-notification	0.1.3
MODCARGO_CRATES +=	temp-dir	0.1.12
MODCARGO_CRATES +=	tempfile	3.10.1
MODCARGO_CRATES +=	tendril	0.4.3
MODCARGO_CRATES +=	textwrap	0.16.1
MODCARGO_CRATES +=	thiserror	1.0.58
MODCARGO_CRATES +=	thiserror-impl	1.0.58
MODCARGO_CRATES +=	thread_local	1.1.8
MODCARGO_CRATES +=	tiff	0.9.1
MODCARGO_CRATES +=	time	0.3.36
MODCARGO_CRATES +=	time-core	0.1.2
MODCARGO_CRATES +=	time-macros	0.2.18
MODCARGO_CRATES +=	tinyvec	1.6.0
MODCARGO_CRATES +=	tinyvec_macros	0.1.1
MODCARGO_CRATES +=	tokio	1.37.0
MODCARGO_CRATES +=	tokio-macros	2.2.0
MODCARGO_CRATES +=	tokio-native-tls	0.3.1
MODCARGO_CRATES +=	tokio-rustls	0.24.1
MODCARGO_CRATES +=	tokio-stream	0.1.15
MODCARGO_CRATES +=	tokio-util	0.7.10
MODCARGO_CRATES +=	toml	0.8.12
MODCARGO_CRATES +=	toml_datetime	0.6.5
MODCARGO_CRATES +=	toml_edit	0.19.15
MODCARGO_CRATES +=	toml_edit	0.20.7
MODCARGO_CRATES +=	toml_edit	0.22.9
MODCARGO_CRATES +=	tower	0.4.13
MODCARGO_CRATES +=	tower-layer	0.3.2
MODCARGO_CRATES +=	tower-service	0.3.2
MODCARGO_CRATES +=	tracing	0.1.40
MODCARGO_CRATES +=	tracing-appender	0.2.3
MODCARGO_CRATES +=	tracing-attributes	0.1.27
MODCARGO_CRATES +=	tracing-core	0.1.32
MODCARGO_CRATES +=	tracing-log	0.2.0
MODCARGO_CRATES +=	tracing-subscriber	0.3.18
MODCARGO_CRATES +=	tree_magic_mini	3.1.4
MODCARGO_CRATES +=	try-lock	0.2.5
MODCARGO_CRATES +=	typed-arena	2.0.2
MODCARGO_CRATES +=	typenum	1.17.0
MODCARGO_CRATES +=	typewit	1.9.0
MODCARGO_CRATES +=	typewit_proc_macros	1.8.1
MODCARGO_CRATES +=	uds_windows	1.1.0
MODCARGO_CRATES +=	ulid	1.1.2
MODCARGO_CRATES +=	unicase	2.7.0
MODCARGO_CRATES +=	unicode-bidi	0.3.15
MODCARGO_CRATES +=	unicode-ident	1.0.12
MODCARGO_CRATES +=	unicode-linebreak	0.1.5
MODCARGO_CRATES +=	unicode-normalization	0.1.23
MODCARGO_CRATES +=	unicode-segmentation	1.11.0
MODCARGO_CRATES +=	unicode-width	0.1.11
MODCARGO_CRATES +=	unicode_categories	0.1.1
MODCARGO_CRATES +=	universal-hash	0.5.1
MODCARGO_CRATES +=	untrusted	0.9.0
MODCARGO_CRATES +=	url	2.5.0
MODCARGO_CRATES +=	urlencoding	2.1.3
MODCARGO_CRATES +=	utf-8	0.7.6
MODCARGO_CRATES +=	utf8parse	0.2.1
MODCARGO_CRATES +=	uuid	1.6.1
MODCARGO_CRATES +=	valuable	0.1.0
MODCARGO_CRATES +=	vcpkg	0.2.15
MODCARGO_CRATES +=	vergen	8.2.5
MODCARGO_CRATES +=	version_check	0.9.4
MODCARGO_CRATES +=	vodozemac	0.5.1
MODCARGO_CRATES +=	waker-fn	1.1.1
MODCARGO_CRATES +=	want	0.3.1
MODCARGO_CRATES +=	wasi	0.11.0+wasi-snapshot-preview1
MODCARGO_CRATES +=	wasm-bindgen	0.2.92
MODCARGO_CRATES +=	wasm-bindgen-backend	0.2.92
MODCARGO_CRATES +=	wasm-bindgen-futures	0.4.42
MODCARGO_CRATES +=	wasm-bindgen-macro	0.2.92
MODCARGO_CRATES +=	wasm-bindgen-macro-support	0.2.92
MODCARGO_CRATES +=	wasm-bindgen-shared	0.2.92
MODCARGO_CRATES +=	wasm-streams	0.4.0
MODCARGO_CRATES +=	wayland-backend	0.3.3
MODCARGO_CRATES +=	wayland-client	0.31.2
MODCARGO_CRATES +=	wayland-protocols	0.31.2
MODCARGO_CRATES +=	wayland-protocols-wlr	0.2.0
MODCARGO_CRATES +=	wayland-scanner	0.31.1
MODCARGO_CRATES +=	wayland-sys	0.31.1
MODCARGO_CRATES +=	web-sys	0.3.69
MODCARGO_CRATES +=	web-time	1.1.0
MODCARGO_CRATES +=	webpki-roots	0.25.4
MODCARGO_CRATES +=	weezl	0.1.8
MODCARGO_CRATES +=	which	4.4.2
MODCARGO_CRATES +=	wildmatch	2.3.3
MODCARGO_CRATES +=	winapi	0.3.9
MODCARGO_CRATES +=	winapi-i686-pc-windows-gnu	0.4.0
MODCARGO_CRATES +=	winapi-x86_64-pc-windows-gnu	0.4.0
MODCARGO_CRATES +=	windows	0.48.0
MODCARGO_CRATES +=	windows	0.51.1
MODCARGO_CRATES +=	windows-core	0.51.1
MODCARGO_CRATES +=	windows-sys	0.42.0
MODCARGO_CRATES +=	windows-sys	0.48.0
MODCARGO_CRATES +=	windows-sys	0.52.0
MODCARGO_CRATES +=	windows-targets	0.48.5
MODCARGO_CRATES +=	windows-targets	0.52.5
MODCARGO_CRATES +=	windows_aarch64_gnullvm	0.42.2
MODCARGO_CRATES +=	windows_aarch64_gnullvm	0.48.5
MODCARGO_CRATES +=	windows_aarch64_gnullvm	0.52.5
MODCARGO_CRATES +=	windows_aarch64_msvc	0.42.2
MODCARGO_CRATES +=	windows_aarch64_msvc	0.48.5
MODCARGO_CRATES +=	windows_aarch64_msvc	0.52.5
MODCARGO_CRATES +=	windows_i686_gnu	0.42.2
MODCARGO_CRATES +=	windows_i686_gnu	0.48.5
MODCARGO_CRATES +=	windows_i686_gnu	0.52.5
MODCARGO_CRATES +=	windows_i686_gnullvm	0.52.5
MODCARGO_CRATES +=	windows_i686_msvc	0.42.2
MODCARGO_CRATES +=	windows_i686_msvc	0.48.5
MODCARGO_CRATES +=	windows_i686_msvc	0.52.5
MODCARGO_CRATES +=	windows_x86_64_gnu	0.42.2
MODCARGO_CRATES +=	windows_x86_64_gnu	0.48.5
MODCARGO_CRATES +=	windows_x86_64_gnu	0.52.5
MODCARGO_CRATES +=	windows_x86_64_gnullvm	0.42.2
MODCARGO_CRATES +=	windows_x86_64_gnullvm	0.48.5
MODCARGO_CRATES +=	windows_x86_64_gnullvm	0.52.5
MODCARGO_CRATES +=	windows_x86_64_msvc	0.42.2
MODCARGO_CRATES +=	windows_x86_64_msvc	0.48.5
MODCARGO_CRATES +=	windows_x86_64_msvc	0.52.5
MODCARGO_CRATES +=	winnow	0.5.40
MODCARGO_CRATES +=	winnow	0.6.6
MODCARGO_CRATES +=	winreg	0.50.0
MODCARGO_CRATES +=	wl-clipboard-rs	0.8.1
MODCARGO_CRATES +=	x11rb	0.13.0
MODCARGO_CRATES +=	x11rb-protocol	0.13.0
MODCARGO_CRATES +=	x25519-dalek	2.0.1
MODCARGO_CRATES +=	x509-cert	0.2.5
MODCARGO_CRATES +=	xdg-home	1.1.0
MODCARGO_CRATES +=	xml5ever	0.17.0
MODCARGO_CRATES +=	yansi	0.5.1
MODCARGO_CRATES +=	zbus	3.15.2
MODCARGO_CRATES +=	zbus_macros	3.15.2
MODCARGO_CRATES +=	zbus_names	2.6.1
MODCARGO_CRATES +=	zerocopy	0.7.32
MODCARGO_CRATES +=	zerocopy-derive	0.7.32
MODCARGO_CRATES +=	zeroize	1.7.0
MODCARGO_CRATES +=	zeroize_derive	1.4.2
MODCARGO_CRATES +=	zune-inflate	0.2.54
MODCARGO_CRATES +=	zvariant	3.15.2
MODCARGO_CRATES +=	zvariant_derive	3.15.2
MODCARGO_CRATES +=	zvariant_utils	1.0.1
