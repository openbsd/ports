MODCARGO_CRATES +=	accessory	2.1.1	# MIT OR Apache-2.0
MODCARGO_CRATES +=	adler2	2.0.1	# 0BSD OR MIT OR Apache-2.0
MODCARGO_CRATES +=	aead	0.5.2	# MIT OR Apache-2.0
MODCARGO_CRATES +=	aes	0.8.4	# MIT OR Apache-2.0
MODCARGO_CRATES +=	aho-corasick	1.1.5	# Unlicense OR MIT
MODCARGO_CRATES +=	aligned	0.4.3	# MIT OR Apache-2.0
MODCARGO_CRATES +=	aligned-vec	0.6.4	# MIT
MODCARGO_CRATES +=	allocator-api2	0.2.21	# MIT OR Apache-2.0
MODCARGO_CRATES +=	android_system_properties	0.1.6	# MIT OR Apache-2.0
MODCARGO_CRATES +=	anstream	1.0.0	# MIT OR Apache-2.0
MODCARGO_CRATES +=	anstyle	1.0.14	# MIT OR Apache-2.0
MODCARGO_CRATES +=	anstyle-parse	1.0.0	# MIT OR Apache-2.0
MODCARGO_CRATES +=	anstyle-query	1.1.5	# MIT OR Apache-2.0
MODCARGO_CRATES +=	anstyle-wincon	3.0.11	# MIT OR Apache-2.0
MODCARGO_CRATES +=	anyhow	1.0.104	# MIT OR Apache-2.0
MODCARGO_CRATES +=	anymap2	0.13.0	# MIT/Apache-2.0
MODCARGO_CRATES +=	approx	0.5.1	# Apache-2.0
MODCARGO_CRATES +=	aquamarine	0.6.0	# MIT
MODCARGO_CRATES +=	arbitrary	1.4.2	# MIT OR Apache-2.0
MODCARGO_CRATES +=	arboard	3.6.1	# MIT OR Apache-2.0
MODCARGO_CRATES +=	archery	1.2.3	# MIT
MODCARGO_CRATES +=	arg_enum_proc_macro	0.3.4	# MIT
MODCARGO_CRATES +=	arrayvec	0.7.8	# MIT OR Apache-2.0
MODCARGO_CRATES +=	as-slice	0.2.1	# MIT OR Apache-2.0
MODCARGO_CRATES +=	as_variant	1.3.0	# MPL-2.0
MODCARGO_CRATES +=	assign	1.1.1	# MIT
MODCARGO_CRATES +=	async-broadcast	0.7.2	# MIT OR Apache-2.0
MODCARGO_CRATES +=	async-channel	2.5.0	# Apache-2.0 OR MIT
MODCARGO_CRATES +=	async-compression	0.4.48	# MIT OR Apache-2.0
MODCARGO_CRATES +=	async-executor	1.14.0	# Apache-2.0 OR MIT
MODCARGO_CRATES +=	async-io	2.6.0	# Apache-2.0 OR MIT
MODCARGO_CRATES +=	async-lock	3.4.2	# Apache-2.0 OR MIT
MODCARGO_CRATES +=	async-once-cell	0.5.4	# MIT OR Apache-2.0
MODCARGO_CRATES +=	async-process	2.5.0	# Apache-2.0 OR MIT
MODCARGO_CRATES +=	async-recursion	1.1.1	# MIT OR Apache-2.0
MODCARGO_CRATES +=	async-signal	0.2.14	# Apache-2.0 OR MIT
MODCARGO_CRATES +=	async-stream	0.3.6	# MIT
MODCARGO_CRATES +=	async-stream-impl	0.3.6	# MIT
MODCARGO_CRATES +=	async-task	4.7.1	# Apache-2.0 OR MIT
MODCARGO_CRATES +=	async-trait	0.1.92	# MIT OR Apache-2.0
MODCARGO_CRATES +=	atomic	0.6.1	# Apache-2.0/MIT
MODCARGO_CRATES +=	atomic-polyfill	1.0.3	# MIT OR Apache-2.0
MODCARGO_CRATES +=	atomic-waker	1.1.2	# Apache-2.0 OR MIT
MODCARGO_CRATES +=	autocfg	1.5.1	# Apache-2.0 OR MIT
MODCARGO_CRATES +=	av-scenechange	0.14.1	# MIT
MODCARGO_CRATES +=	av1-grain	0.2.5	# BSD-2-Clause
MODCARGO_CRATES +=	avif-serialize	0.8.9	# BSD-3-Clause
MODCARGO_CRATES +=	aws-lc-rs	1.18.1	# ISC AND (Apache-2.0 OR ISC)
MODCARGO_CRATES +=	aws-lc-sys	0.45.0	# ISC AND (Apache-2.0 OR ISC) AND Apache-2.0 AND MIT AND BSD-3-Clause AND (Apache-2.0 OR ISC OR MIT) AND (Apache-2.0 OR ISC OR MIT-0)
MODCARGO_CRATES +=	axum	0.8.9	# MIT
MODCARGO_CRATES +=	axum-core	0.5.6	# MIT
MODCARGO_CRATES +=	backon	1.6.0	# Apache-2.0
MODCARGO_CRATES +=	base64	0.22.1	# MIT OR Apache-2.0
MODCARGO_CRATES +=	base64	0.23.1	# MIT OR Apache-2.0
MODCARGO_CRATES +=	base64-simd	0.8.0	# MIT
MODCARGO_CRATES +=	base64ct	1.8.3	# Apache-2.0 OR MIT
MODCARGO_CRATES +=	bit-set	0.5.3	# MIT/Apache-2.0
MODCARGO_CRATES +=	bit-vec	0.6.3	# MIT/Apache-2.0
MODCARGO_CRATES +=	bit_field	0.10.3	# Apache-2.0/MIT
MODCARGO_CRATES +=	bitflags	1.3.2	# MIT/Apache-2.0
MODCARGO_CRATES +=	bitflags	2.13.2	# MIT OR Apache-2.0
MODCARGO_CRATES +=	bitmaps	3.2.1	# MPL-2.0+
MODCARGO_CRATES +=	bitstream-io	4.10.0	# MIT/Apache-2.0
MODCARGO_CRATES +=	bitvec	1.1.1	# MIT
MODCARGO_CRATES +=	blake3	1.8.7	# CC0-1.0 OR Apache-2.0 OR Apache-2.0 WITH LLVM-exception
MODCARGO_CRATES +=	block-buffer	0.10.4	# MIT OR Apache-2.0
MODCARGO_CRATES +=	block-padding	0.3.3	# MIT OR Apache-2.0
MODCARGO_CRATES +=	block2	0.6.2	# MIT
MODCARGO_CRATES +=	blocking	1.7.0	# Apache-2.0 OR MIT
MODCARGO_CRATES +=	bs58	0.5.1	# MIT/Apache-2.0
MODCARGO_CRATES +=	bstr	1.13.1	# MIT OR Apache-2.0
MODCARGO_CRATES +=	built	0.8.1	# MIT
MODCARGO_CRATES +=	bumpalo	3.20.3	# MIT OR Apache-2.0
MODCARGO_CRATES +=	by_address	1.2.1	# MIT OR Apache-2.0
MODCARGO_CRATES +=	bytemuck	1.25.2	# Zlib OR Apache-2.0 OR MIT
MODCARGO_CRATES +=	bytemuck_derive	1.12.1	# Zlib OR Apache-2.0 OR MIT
MODCARGO_CRATES +=	byteorder	1.5.0	# Unlicense OR MIT
MODCARGO_CRATES +=	byteorder-lite	0.1.0	# Unlicense OR MIT
MODCARGO_CRATES +=	bytes	1.12.1	# MIT
MODCARGO_CRATES +=	bytesize	2.7.0	# Apache-2.0
MODCARGO_CRATES +=	caseless	0.2.2	# MIT
MODCARGO_CRATES +=	castaway	0.2.4	# MIT
MODCARGO_CRATES +=	cbc	0.1.2	# MIT OR Apache-2.0
MODCARGO_CRATES +=	cc	1.4.7	# MIT OR Apache-2.0
MODCARGO_CRATES +=	cfg-if	1.0.5	# MIT OR Apache-2.0
MODCARGO_CRATES +=	cfg_aliases	0.2.2	# MIT
MODCARGO_CRATES +=	chacha20	0.9.1	# Apache-2.0 OR MIT
MODCARGO_CRATES +=	chacha20	0.10.2	# MIT OR Apache-2.0
MODCARGO_CRATES +=	chacha20poly1305	0.10.1	# Apache-2.0 OR MIT
MODCARGO_CRATES +=	chrono	0.4.45	# MIT OR Apache-2.0
MODCARGO_CRATES +=	cipher	0.4.4	# MIT OR Apache-2.0
MODCARGO_CRATES +=	clap	4.6.7	# MIT OR Apache-2.0
MODCARGO_CRATES +=	clap_builder	4.6.7	# MIT OR Apache-2.0
MODCARGO_CRATES +=	clap_complete	4.6.11	# MIT OR Apache-2.0
MODCARGO_CRATES +=	clap_derive	4.6.7	# MIT OR Apache-2.0
MODCARGO_CRATES +=	clap_lex	1.1.1	# MIT OR Apache-2.0
MODCARGO_CRATES +=	clipboard-win	5.4.1	# BSL-1.0
MODCARGO_CRATES +=	cmake	0.1.58	# MIT OR Apache-2.0
MODCARGO_CRATES +=	cobs	0.3.0	# MIT OR Apache-2.0
MODCARGO_CRATES +=	color_quant	1.1.0	# MIT
MODCARGO_CRATES +=	colorchoice	1.0.5	# MIT OR Apache-2.0
MODCARGO_CRATES +=	combine	4.6.8	# MIT
MODCARGO_CRATES +=	compact_str	0.9.1	# MIT
MODCARGO_CRATES +=	compression-codecs	0.4.43	# MIT OR Apache-2.0
MODCARGO_CRATES +=	compression-core	0.4.33	# MIT OR Apache-2.0
MODCARGO_CRATES +=	comrak	0.55.0	# BSD-2-Clause
MODCARGO_CRATES +=	concurrent-queue	2.5.0	# Apache-2.0 OR MIT
MODCARGO_CRATES +=	const-oid	0.9.6	# Apache-2.0 OR MIT
MODCARGO_CRATES +=	const_panic	0.2.17	# Zlib
MODCARGO_CRATES +=	constant_time_eq	0.4.2	# CC0-1.0 OR MIT-0 OR Apache-2.0
MODCARGO_CRATES +=	convert_case	0.10.0	# MIT
MODCARGO_CRATES +=	core-foundation	0.10.1	# MIT OR Apache-2.0
MODCARGO_CRATES +=	core-foundation-sys	0.8.7	# MIT OR Apache-2.0
MODCARGO_CRATES +=	cpufeatures	0.2.17	# MIT OR Apache-2.0
MODCARGO_CRATES +=	cpufeatures	0.3.1	# MIT OR Apache-2.0
MODCARGO_CRATES +=	crc32fast	1.5.2	# MIT OR Apache-2.0
MODCARGO_CRATES +=	critical-section	1.2.0	# MIT OR Apache-2.0
MODCARGO_CRATES +=	crossbeam-channel	0.5.17	# MIT OR Apache-2.0
MODCARGO_CRATES +=	crossbeam-deque	0.8.8	# MIT OR Apache-2.0
MODCARGO_CRATES +=	crossbeam-epoch	0.9.21	# MIT OR Apache-2.0
MODCARGO_CRATES +=	crossbeam-utils	0.8.23	# MIT OR Apache-2.0
MODCARGO_CRATES +=	crossterm	0.28.1	# MIT
MODCARGO_CRATES +=	crossterm	0.29.0	# MIT
MODCARGO_CRATES +=	crossterm_winapi	0.9.1	# MIT
MODCARGO_CRATES +=	crunchy	0.2.4	# MIT
MODCARGO_CRATES +=	crypto-common	0.1.7	# MIT OR Apache-2.0
MODCARGO_CRATES +=	css-color-parser	0.1.2	# MIT
MODCARGO_CRATES +=	csscolorparser	0.6.2	# MIT OR Apache-2.0
MODCARGO_CRATES +=	ctr	0.9.2	# MIT OR Apache-2.0
MODCARGO_CRATES +=	curve25519-dalek	4.1.3	# BSD-3-Clause
MODCARGO_CRATES +=	curve25519-dalek-derive	0.1.1	# MIT/Apache-2.0
MODCARGO_CRATES +=	darling	0.20.11	# MIT
MODCARGO_CRATES +=	darling	0.24.1	# MIT
MODCARGO_CRATES +=	darling_core	0.20.11	# MIT
MODCARGO_CRATES +=	darling_core	0.24.1	# MIT
MODCARGO_CRATES +=	darling_macro	0.20.11	# MIT
MODCARGO_CRATES +=	darling_macro	0.24.1	# MIT
MODCARGO_CRATES +=	date_header	1.0.5	# MIT/Apache-2.0
MODCARGO_CRATES +=	deadpool	0.13.1	# MIT OR Apache-2.0
MODCARGO_CRATES +=	deadpool-runtime	0.3.1	# MIT OR Apache-2.0
MODCARGO_CRATES +=	deadpool-sync	0.2.0	# MIT OR Apache-2.0
MODCARGO_CRATES +=	decancer	3.3.3	# MIT
MODCARGO_CRATES +=	delegate-display	3.0.1	# MIT
MODCARGO_CRATES +=	deltae	0.3.2	# MIT
MODCARGO_CRATES +=	der	0.7.10	# Apache-2.0 OR MIT
MODCARGO_CRATES +=	deranged	0.5.8	# MIT OR Apache-2.0
MODCARGO_CRATES +=	derivative	2.2.0	# MIT/Apache-2.0
MODCARGO_CRATES +=	derive_builder	0.20.2	# MIT OR Apache-2.0
MODCARGO_CRATES +=	derive_builder_core	0.20.2	# MIT OR Apache-2.0
MODCARGO_CRATES +=	derive_builder_macro	0.20.2	# MIT OR Apache-2.0
MODCARGO_CRATES +=	derive_more	1.0.0	# MIT
MODCARGO_CRATES +=	derive_more	2.1.1	# MIT
MODCARGO_CRATES +=	derive_more-impl	1.0.0	# MIT
MODCARGO_CRATES +=	derive_more-impl	2.1.1	# MIT
MODCARGO_CRATES +=	diff	0.1.13	# MIT OR Apache-2.0
MODCARGO_CRATES +=	digest	0.10.7	# MIT OR Apache-2.0
MODCARGO_CRATES +=	dirs	6.0.0	# MIT OR Apache-2.0
MODCARGO_CRATES +=	dirs	7.0.0	# MIT OR Apache-2.0
MODCARGO_CRATES +=	dirs-sys	0.5.0	# MIT OR Apache-2.0
MODCARGO_CRATES +=	dispatch2	0.3.1	# Zlib OR Apache-2.0 OR MIT
MODCARGO_CRATES +=	displaydoc	0.2.7	# MIT OR Apache-2.0
MODCARGO_CRATES +=	document-features	0.2.12	# MIT OR Apache-2.0
MODCARGO_CRATES +=	downcast-rs	1.2.1	# MIT/Apache-2.0
MODCARGO_CRATES +=	dunce	1.0.5	# CC0-1.0 OR MIT-0 OR Apache-2.0
MODCARGO_CRATES +=	ed25519	2.2.3	# Apache-2.0 OR MIT
MODCARGO_CRATES +=	ed25519-dalek	2.2.0	# BSD-3-Clause
MODCARGO_CRATES +=	edit	0.1.5	# CC0-1.0
MODCARGO_CRATES +=	editor-types	0.0.4	# Apache-2.0
MODCARGO_CRATES +=	editor-types-macros	0.0.4	# Apache-2.0
MODCARGO_CRATES +=	editor-types-parser	0.0.4	# Apache-2.0
MODCARGO_CRATES +=	either	1.18.0	# MIT OR Apache-2.0
MODCARGO_CRATES +=	emojis	0.8.2	# (MIT OR Apache-2.0) AND Unicode-3.0
MODCARGO_CRATES +=	emojis	0.9.0	# (MIT OR Apache-2.0) AND Unicode-3.0
MODCARGO_CRATES +=	endi	1.1.1	# MIT
MODCARGO_CRATES +=	endian-type	0.2.0	# MIT
MODCARGO_CRATES +=	entities	1.0.1	# MIT
MODCARGO_CRATES +=	enumflags2	0.7.12	# MIT OR Apache-2.0
MODCARGO_CRATES +=	enumflags2_derive	0.7.12	# MIT OR Apache-2.0
MODCARGO_CRATES +=	equator	0.4.2	# MIT
MODCARGO_CRATES +=	equator-macro	0.4.2	# MIT
MODCARGO_CRATES +=	equivalent	1.0.2	# Apache-2.0 OR MIT
MODCARGO_CRATES +=	errno	0.3.14	# MIT OR Apache-2.0
MODCARGO_CRATES +=	error-code	3.4.0	# BSL-1.0
MODCARGO_CRATES +=	euclid	0.22.14	# MIT OR Apache-2.0
MODCARGO_CRATES +=	event-listener	5.4.2	# Apache-2.0 OR MIT
MODCARGO_CRATES +=	event-listener-strategy	0.5.4	# Apache-2.0 OR MIT
MODCARGO_CRATES +=	exr	1.74.2	# BSD-3-Clause
MODCARGO_CRATES +=	eyeball	0.8.8	# MPL-2.0
MODCARGO_CRATES +=	eyeball-im	0.8.0	# MPL-2.0
MODCARGO_CRATES +=	fallible-iterator	0.3.0	# MIT/Apache-2.0
MODCARGO_CRATES +=	fallible-streaming-iterator	0.1.9	# MIT/Apache-2.0
MODCARGO_CRATES +=	fancy-regex	0.11.0	# MIT
MODCARGO_CRATES +=	fancy_constructor	2.1.1	# MIT OR Apache-2.0
MODCARGO_CRATES +=	fastrand	2.5.0	# Apache-2.0 OR MIT
MODCARGO_CRATES +=	fax	0.2.7	# MIT
MODCARGO_CRATES +=	fdeflate	0.3.7	# MIT OR Apache-2.0
MODCARGO_CRATES +=	feruca	0.12.0	# MIT
MODCARGO_CRATES +=	fiat-crypto	0.2.9	# MIT OR Apache-2.0 OR BSD-1-Clause
MODCARGO_CRATES +=	filedescriptor	0.8.3	# MIT
MODCARGO_CRATES +=	find-msvc-tools	0.1.13	# MIT OR Apache-2.0
MODCARGO_CRATES +=	finl_unicode	1.5.0	# (MIT OR Apache-2.0) AND Unicode-DFS-2016
MODCARGO_CRATES +=	fixedbitset	0.4.2	# MIT/Apache-2.0
MODCARGO_CRATES +=	fixedbitset	0.5.7	# MIT OR Apache-2.0
MODCARGO_CRATES +=	flate2	1.1.10	# MIT OR Apache-2.0
MODCARGO_CRATES +=	fnv	1.0.7	# Apache-2.0 / MIT
MODCARGO_CRATES +=	foldhash	0.1.5	# Zlib
MODCARGO_CRATES +=	foldhash	0.2.0	# Zlib
MODCARGO_CRATES +=	form_urlencoded	1.2.2	# MIT OR Apache-2.0
MODCARGO_CRATES +=	fs2	0.4.3	# MIT/Apache-2.0
MODCARGO_CRATES +=	fs_extra	1.3.0	# MIT
MODCARGO_CRATES +=	funty	2.0.0	# MIT
MODCARGO_CRATES +=	futures	0.3.34	# MIT OR Apache-2.0
MODCARGO_CRATES +=	futures-channel	0.3.34	# MIT OR Apache-2.0
MODCARGO_CRATES +=	futures-core	0.3.34	# MIT OR Apache-2.0
MODCARGO_CRATES +=	futures-executor	0.3.34	# MIT OR Apache-2.0
MODCARGO_CRATES +=	futures-io	0.3.34	# MIT OR Apache-2.0
MODCARGO_CRATES +=	futures-lite	2.6.1	# Apache-2.0 OR MIT
MODCARGO_CRATES +=	futures-macro	0.3.34	# MIT OR Apache-2.0
MODCARGO_CRATES +=	futures-sink	0.3.34	# MIT OR Apache-2.0
MODCARGO_CRATES +=	futures-task	0.3.34	# MIT OR Apache-2.0
MODCARGO_CRATES +=	futures-util	0.3.34	# MIT OR Apache-2.0
MODCARGO_CRATES +=	fxhash	0.2.1	# Apache-2.0/MIT
MODCARGO_CRATES +=	generic-array	0.14.7	# MIT
MODCARGO_CRATES +=	gethostname	1.1.0	# Apache-2.0
MODCARGO_CRATES +=	getrandom	0.2.17	# MIT OR Apache-2.0
MODCARGO_CRATES +=	getrandom	0.3.4	# MIT OR Apache-2.0
MODCARGO_CRATES +=	getrandom	0.4.3	# MIT OR Apache-2.0
MODCARGO_CRATES +=	gif	0.14.2	# MIT OR Apache-2.0
MODCARGO_CRATES +=	gloo-timers	0.3.0	# MIT OR Apache-2.0
MODCARGO_CRATES +=	gloo-utils	0.2.0	# MIT OR Apache-2.0
MODCARGO_CRATES +=	growable-bloom-filter	2.1.1	# MIT
MODCARGO_CRATES +=	h2	0.4.19	# MIT
MODCARGO_CRATES +=	half	2.7.1	# MIT OR Apache-2.0
MODCARGO_CRATES +=	hash32	0.2.1	# MIT OR Apache-2.0
MODCARGO_CRATES +=	hashbrown	0.15.5	# MIT OR Apache-2.0
MODCARGO_CRATES +=	hashbrown	0.16.1	# MIT OR Apache-2.0
MODCARGO_CRATES +=	hashbrown	0.17.1	# MIT OR Apache-2.0
MODCARGO_CRATES +=	hashlink	0.10.0	# MIT OR Apache-2.0
MODCARGO_CRATES +=	heapless	0.7.17	# MIT OR Apache-2.0
MODCARGO_CRATES +=	heck	0.5.0	# MIT OR Apache-2.0
MODCARGO_CRATES +=	hermit-abi	0.5.3	# MIT OR Apache-2.0
MODCARGO_CRATES +=	hex	0.4.3	# MIT OR Apache-2.0
MODCARGO_CRATES +=	hkdf	0.12.4	# MIT OR Apache-2.0
MODCARGO_CRATES +=	hmac	0.12.1	# MIT OR Apache-2.0
MODCARGO_CRATES +=	home	0.5.12	# MIT OR Apache-2.0
MODCARGO_CRATES +=	html5ever	0.39.0	# MIT OR Apache-2.0
MODCARGO_CRATES +=	http	1.5.0	# MIT OR Apache-2.0
MODCARGO_CRATES +=	http-body	1.1.0	# MIT
MODCARGO_CRATES +=	http-body-util	0.1.5	# MIT
MODCARGO_CRATES +=	http-serde	2.1.1	# Apache-2.0 OR MIT
MODCARGO_CRATES +=	httparse	1.10.1	# MIT OR Apache-2.0
MODCARGO_CRATES +=	httpdate	1.0.3	# MIT OR Apache-2.0
MODCARGO_CRATES +=	humansize	2.1.3	# MIT/Apache-2.0
MODCARGO_CRATES +=	hyper	1.11.1	# MIT
MODCARGO_CRATES +=	hyper-rustls	0.27.9	# Apache-2.0 OR ISC OR MIT
MODCARGO_CRATES +=	hyper-util	0.1.20	# MIT
MODCARGO_CRATES +=	iana-time-zone	0.1.65	# MIT OR Apache-2.0
MODCARGO_CRATES +=	iana-time-zone-haiku	0.1.2	# MIT OR Apache-2.0
MODCARGO_CRATES +=	icu_collections	2.3.0	# Unicode-3.0
MODCARGO_CRATES +=	icu_locale_core	2.3.0	# Unicode-3.0
MODCARGO_CRATES +=	icu_locale_fallback	2.3.0	# Unicode-3.0
MODCARGO_CRATES +=	icu_locale_fallback_data	2.3.0	# Unicode-3.0
MODCARGO_CRATES +=	icu_normalizer	2.3.0	# Unicode-3.0
MODCARGO_CRATES +=	icu_normalizer_data	2.3.0	# Unicode-3.0
MODCARGO_CRATES +=	icu_properties	2.3.0	# Unicode-3.0
MODCARGO_CRATES +=	icu_properties_data	2.3.0	# Unicode-3.0
MODCARGO_CRATES +=	icu_provider	2.3.1	# Unicode-3.0
MODCARGO_CRATES +=	icu_segmenter	2.3.0	# Unicode-3.0
MODCARGO_CRATES +=	icu_segmenter_data	2.3.0	# Unicode-3.0
MODCARGO_CRATES +=	icy_sixel	0.5.1	# MIT OR Apache-2.0
MODCARGO_CRATES +=	ident_case	1.0.1	# MIT/Apache-2.0
MODCARGO_CRATES +=	idna	1.1.0	# MIT OR Apache-2.0
MODCARGO_CRATES +=	idna_adapter	1.2.2	# Apache-2.0 OR MIT
MODCARGO_CRATES +=	image	0.25.10	# MIT OR Apache-2.0
MODCARGO_CRATES +=	image-webp	0.2.4	# MIT OR Apache-2.0
MODCARGO_CRATES +=	imbl	6.1.0	# MPL-2.0+
MODCARGO_CRATES +=	imbl-sized-chunks	0.1.3	# MPL-2.0+
MODCARGO_CRATES +=	imgref	1.12.3	# CC0-1.0 OR Apache-2.0
MODCARGO_CRATES +=	impartial-ord	2.0.0	# MIT
MODCARGO_CRATES +=	include_dir	0.7.4	# MIT
MODCARGO_CRATES +=	include_dir_macros	0.7.4	# MIT
MODCARGO_CRATES +=	indexmap	2.14.2	# Apache-2.0 OR MIT
MODCARGO_CRATES +=	indoc	2.0.7	# MIT OR Apache-2.0
MODCARGO_CRATES +=	inout	0.1.4	# MIT OR Apache-2.0
MODCARGO_CRATES +=	instability	0.3.13	# MIT
MODCARGO_CRATES +=	instant	0.1.13	# BSD-3-Clause
MODCARGO_CRATES +=	interpolate_name	0.2.4	# MIT
MODCARGO_CRATES +=	intervaltree	0.2.7	# MIT
MODCARGO_CRATES +=	ipnet	2.12.2	# MIT OR Apache-2.0
MODCARGO_CRATES +=	is-docker	0.2.0	# MIT
MODCARGO_CRATES +=	is-wsl	0.4.0	# MIT
MODCARGO_CRATES +=	is_terminal_polyfill	1.70.2	# MIT OR Apache-2.0
MODCARGO_CRATES +=	itertools	0.10.5	# MIT/Apache-2.0
MODCARGO_CRATES +=	itertools	0.14.0	# MIT OR Apache-2.0
MODCARGO_CRATES +=	itoa	1.0.18	# MIT OR Apache-2.0
MODCARGO_CRATES +=	jetscii	0.5.3	# MIT OR Apache-2.0
MODCARGO_CRATES +=	jni	0.22.4	# MIT OR Apache-2.0
MODCARGO_CRATES +=	jni-macros	0.22.4	# MIT OR Apache-2.0
MODCARGO_CRATES +=	jni-sys	0.4.1	# MIT OR Apache-2.0
MODCARGO_CRATES +=	jni-sys-macros	0.4.1	# MIT OR Apache-2.0
MODCARGO_CRATES +=	jobserver	0.1.35	# MIT OR Apache-2.0
MODCARGO_CRATES +=	js-sys	0.3.105	# MIT OR Apache-2.0
MODCARGO_CRATES +=	js_int	0.2.2	# MIT
MODCARGO_CRATES +=	js_option	0.2.0	# MIT
MODCARGO_CRATES +=	kasuari	0.4.12	# MIT OR Apache-2.0
MODCARGO_CRATES +=	keybindings	0.0.4	# Apache-2.0
MODCARGO_CRATES +=	konst	0.4.3	# Zlib
MODCARGO_CRATES +=	lab	0.11.0	# MIT
MODCARGO_CRATES +=	language-tags	0.3.2	# MIT/Apache-2.0
MODCARGO_CRATES +=	lazy_static	0.1.16	# MIT
MODCARGO_CRATES +=	lazy_static	1.5.0	# MIT OR Apache-2.0
MODCARGO_CRATES +=	lebe	0.5.3	# BSD-3-Clause
MODCARGO_CRATES +=	libc	0.2.189	# MIT OR Apache-2.0
MODCARGO_CRATES +=	libfuzzer-sys	0.4.13	# (MIT OR Apache-2.0) AND NCSA
MODCARGO_CRATES +=	libm	0.2.16	# MIT
MODCARGO_CRATES +=	libredox	0.1.24	# MIT
MODCARGO_CRATES +=	libsqlite3-sys	0.35.0	# MIT
MODCARGO_CRATES +=	line-clipping	0.3.8	# MIT OR Apache-2.0
MODCARGO_CRATES +=	linkify	0.11.0	# MIT OR Apache-2.0
MODCARGO_CRATES +=	linux-raw-sys	0.4.15	# Apache-2.0 WITH LLVM-exception OR Apache-2.0 OR MIT
MODCARGO_CRATES +=	linux-raw-sys	0.12.1	# Apache-2.0 WITH LLVM-exception OR Apache-2.0 OR MIT
MODCARGO_CRATES +=	litemap	0.8.3	# Unicode-3.0
MODCARGO_CRATES +=	litrs	1.0.0	# MIT OR Apache-2.0
MODCARGO_CRATES +=	lock_api	0.4.14	# MIT OR Apache-2.0
MODCARGO_CRATES +=	log	0.4.34	# MIT OR Apache-2.0
MODCARGO_CRATES +=	loop9	0.1.5	# MIT
MODCARGO_CRATES +=	lru	0.18.4	# MIT
MODCARGO_CRATES +=	lru-slab	0.1.3	# MIT OR Apache-2.0 OR Zlib
MODCARGO_CRATES +=	mac-notification-sys	0.6.15	# MIT/Apache-2.0
MODCARGO_CRATES +=	mac_address	1.1.8	# MIT OR Apache-2.0
MODCARGO_CRATES +=	macroific	2.0.0	# Apache-2.0
MODCARGO_CRATES +=	macroific	3.1.0	# Apache-2.0
MODCARGO_CRATES +=	macroific_attr_parse	2.0.0	# Apache-2.0
MODCARGO_CRATES +=	macroific_attr_parse	3.1.0	# Apache-2.0
MODCARGO_CRATES +=	macroific_core	2.0.0	# Apache-2.0
MODCARGO_CRATES +=	macroific_core	3.1.0	# Apache-2.0
MODCARGO_CRATES +=	macroific_macro	2.0.0	# Apache-2.0
MODCARGO_CRATES +=	macroific_macro	3.1.0	# Apache-2.0
MODCARGO_CRATES +=	maplit	1.0.2	# MIT/Apache-2.0
MODCARGO_CRATES +=	markup5ever	0.39.0	# MIT OR Apache-2.0
MODCARGO_CRATES +=	markup5ever_rcdom	0.39.0+unofficial	# MIT OR Apache-2.0
MODCARGO_CRATES +=	matchers	0.2.0	# MIT
MODCARGO_CRATES +=	matchit	0.8.4	# MIT AND BSD-3-Clause
MODCARGO_CRATES +=	matrix-pickle	0.2.3	# Apache-2.0
MODCARGO_CRATES +=	matrix-pickle-derive	0.2.3	# Apache-2.0
MODCARGO_CRATES +=	matrix-sdk	0.18.0	# Apache-2.0
MODCARGO_CRATES +=	matrix-sdk-base	0.18.0	# Apache-2.0
MODCARGO_CRATES +=	matrix-sdk-common	0.18.0	# Apache-2.0
MODCARGO_CRATES +=	matrix-sdk-crypto	0.18.0	# Apache-2.0
MODCARGO_CRATES +=	matrix-sdk-indexeddb	0.18.0	# Apache-2.0
MODCARGO_CRATES +=	matrix-sdk-qrcode	0.18.0	# Apache-2.0
MODCARGO_CRATES +=	matrix-sdk-sqlite	0.18.0	# Apache-2.0
MODCARGO_CRATES +=	matrix-sdk-store-encryption	0.18.0	# Apache-2.0
MODCARGO_CRATES +=	matrix_indexed_db_futures	0.7.0	# MIT
MODCARGO_CRATES +=	matrix_indexed_db_futures_macros_internal	1.0.0	# MIT
MODCARGO_CRATES +=	maybe-rayon	0.1.1	# MIT
MODCARGO_CRATES +=	memchr	2.8.3	# Unlicense OR MIT
MODCARGO_CRATES +=	memmem	0.1.1	# MIT/Apache-2.0
MODCARGO_CRATES +=	memoffset	0.9.1	# MIT
MODCARGO_CRATES +=	mime	0.3.17	# MIT OR Apache-2.0
MODCARGO_CRATES +=	mime2ext	0.1.54	# MIT
MODCARGO_CRATES +=	mime_guess	2.0.5	# MIT
MODCARGO_CRATES +=	minimal-lexical	0.2.1	# MIT/Apache-2.0
MODCARGO_CRATES +=	miniz_oxide	0.8.9	# MIT OR Zlib OR Apache-2.0
MODCARGO_CRATES +=	miniz_oxide	0.9.1	# MIT OR Zlib OR Apache-2.0
MODCARGO_CRATES +=	mio	1.2.3	# MIT
MODCARGO_CRATES +=	modalkit	0.0.28	# Apache-2.0
MODCARGO_CRATES +=	modalkit-ratatui	0.0.28	# Apache-2.0
MODCARGO_CRATES +=	moxcms	0.8.1	# BSD-3-Clause OR Apache-2.0
MODCARGO_CRATES +=	new_debug_unreachable	1.0.6	# MIT
MODCARGO_CRATES +=	nibble_vec	0.1.0	# MIT
MODCARGO_CRATES +=	nix	0.29.0	# MIT
MODCARGO_CRATES +=	no_std_io2	0.9.4	# Apache-2.0 OR MIT
MODCARGO_CRATES +=	nom	7.1.3	# MIT
MODCARGO_CRATES +=	nom	8.0.0	# MIT
MODCARGO_CRATES +=	noop_proc_macro	0.3.0	# MIT
MODCARGO_CRATES +=	notify-rust	4.18.0	# MIT OR Apache-2.0
MODCARGO_CRATES +=	nu-ansi-term	0.50.3	# MIT
MODCARGO_CRATES +=	num-bigint	0.4.8	# MIT OR Apache-2.0
MODCARGO_CRATES +=	num-complex	0.4.6	# MIT OR Apache-2.0
MODCARGO_CRATES +=	num-conv	0.2.2	# MIT OR Apache-2.0
MODCARGO_CRATES +=	num-derive	0.4.2	# MIT OR Apache-2.0
MODCARGO_CRATES +=	num-integer	0.1.47	# MIT OR Apache-2.0
MODCARGO_CRATES +=	num-rational	0.4.2	# MIT OR Apache-2.0
MODCARGO_CRATES +=	num-traits	0.2.19	# MIT OR Apache-2.0
MODCARGO_CRATES +=	num_cpus	1.17.0	# MIT OR Apache-2.0
MODCARGO_CRATES +=	num_threads	0.1.7	# MIT OR Apache-2.0
MODCARGO_CRATES +=	numtoa	0.2.4	# MIT OR Apache-2.0
MODCARGO_CRATES +=	oauth2	5.0.0	# MIT OR Apache-2.0
MODCARGO_CRATES +=	oauth2-reqwest	0.1.0-alpha.3	# MIT
MODCARGO_CRATES +=	objc2	0.6.4	# MIT
MODCARGO_CRATES +=	objc2-app-kit	0.3.2	# Zlib OR Apache-2.0 OR MIT
MODCARGO_CRATES +=	objc2-core-foundation	0.3.2	# Zlib OR Apache-2.0 OR MIT
MODCARGO_CRATES +=	objc2-core-graphics	0.3.2	# Zlib OR Apache-2.0 OR MIT
MODCARGO_CRATES +=	objc2-encode	4.1.0	# MIT
MODCARGO_CRATES +=	objc2-foundation	0.3.2	# MIT
MODCARGO_CRATES +=	objc2-io-surface	0.3.2	# Zlib OR Apache-2.0 OR MIT
MODCARGO_CRATES +=	once_cell	1.21.4	# MIT OR Apache-2.0
MODCARGO_CRATES +=	once_cell_polyfill	1.70.2	# MIT OR Apache-2.0
MODCARGO_CRATES +=	opaque-debug	0.3.1	# MIT OR Apache-2.0
MODCARGO_CRATES +=	open	5.4.4	# MIT
MODCARGO_CRATES +=	openssl-probe	0.2.1	# MIT OR Apache-2.0
MODCARGO_CRATES +=	option-ext	0.2.0	# MPL-2.0
MODCARGO_CRATES +=	ordered-float	4.6.0	# MIT
MODCARGO_CRATES +=	ordered-float	5.5.0	# MIT
MODCARGO_CRATES +=	ordered-stream	0.2.0	# MIT OR Apache-2.0
MODCARGO_CRATES +=	os_pipe	1.2.3	# MIT
MODCARGO_CRATES +=	outref	0.5.2	# MIT
MODCARGO_CRATES +=	palette	0.7.7	# MIT OR Apache-2.0
MODCARGO_CRATES +=	palette_derive	0.7.7	# MIT OR Apache-2.0
MODCARGO_CRATES +=	palette_math	0.7.7	# MIT OR Apache-2.0
MODCARGO_CRATES +=	parking	2.2.1	# Apache-2.0 OR MIT
MODCARGO_CRATES +=	parking_lot	0.11.2	# Apache-2.0/MIT
MODCARGO_CRATES +=	parking_lot	0.12.5	# MIT OR Apache-2.0
MODCARGO_CRATES +=	parking_lot_core	0.8.6	# Apache-2.0/MIT
MODCARGO_CRATES +=	parking_lot_core	0.9.12	# MIT OR Apache-2.0
MODCARGO_CRATES +=	paste	1.0.15	# MIT OR Apache-2.0
MODCARGO_CRATES +=	pastey	0.1.1	# MIT OR Apache-2.0
MODCARGO_CRATES +=	pbkdf2	0.12.2	# MIT OR Apache-2.0
MODCARGO_CRATES +=	percent-encoding	2.3.2	# MIT OR Apache-2.0
MODCARGO_CRATES +=	pest	2.9.1	# MIT OR Apache-2.0
MODCARGO_CRATES +=	pest_derive	2.9.1	# MIT OR Apache-2.0
MODCARGO_CRATES +=	pest_generator	2.9.1	# MIT OR Apache-2.0
MODCARGO_CRATES +=	pest_meta	2.9.1	# MIT OR Apache-2.0
MODCARGO_CRATES +=	petgraph	0.8.3	# MIT OR Apache-2.0
MODCARGO_CRATES +=	phf	0.11.3	# MIT
MODCARGO_CRATES +=	phf	0.13.1	# MIT
MODCARGO_CRATES +=	phf_codegen	0.11.3	# MIT
MODCARGO_CRATES +=	phf_codegen	0.13.1	# MIT
MODCARGO_CRATES +=	phf_generator	0.11.3	# MIT
MODCARGO_CRATES +=	phf_generator	0.13.1	# MIT
MODCARGO_CRATES +=	phf_macros	0.11.3	# MIT
MODCARGO_CRATES +=	phf_shared	0.11.3	# MIT
MODCARGO_CRATES +=	phf_shared	0.13.1	# MIT
MODCARGO_CRATES +=	pin-project-lite	0.2.17	# Apache-2.0 OR MIT
MODCARGO_CRATES +=	piper	0.2.5	# MIT OR Apache-2.0
MODCARGO_CRATES +=	pkcs8	0.10.2	# Apache-2.0 OR MIT
MODCARGO_CRATES +=	pkg-config	0.3.34	# MIT OR Apache-2.0
MODCARGO_CRATES +=	png	0.18.1	# MIT OR Apache-2.0
MODCARGO_CRATES +=	polling	3.11.0	# Apache-2.0 OR MIT
MODCARGO_CRATES +=	poly1305	0.8.0	# Apache-2.0 OR MIT
MODCARGO_CRATES +=	portable-atomic	1.15.0	# Apache-2.0 OR MIT
MODCARGO_CRATES +=	postcard	1.1.3	# MIT OR Apache-2.0
MODCARGO_CRATES +=	potential_utf	0.1.6	# Unicode-3.0
MODCARGO_CRATES +=	powerfmt	0.2.0	# MIT OR Apache-2.0
MODCARGO_CRATES +=	ppv-lite86	0.2.21	# MIT OR Apache-2.0
MODCARGO_CRATES +=	precomputed-hash	0.1.1	# MIT
MODCARGO_CRATES +=	pretty_assertions	1.4.1	# MIT OR Apache-2.0
MODCARGO_CRATES +=	proc-macro-crate	3.5.0	# MIT OR Apache-2.0
MODCARGO_CRATES +=	proc-macro-error-attr2	2.0.0	# MIT OR Apache-2.0
MODCARGO_CRATES +=	proc-macro-error2	2.0.1	# MIT OR Apache-2.0
MODCARGO_CRATES +=	proc-macro2	1.0.107	# MIT OR Apache-2.0
MODCARGO_CRATES +=	profiling	1.0.18	# MIT OR Apache-2.0
MODCARGO_CRATES +=	profiling-procmacros	1.0.18	# MIT OR Apache-2.0
MODCARGO_CRATES +=	prost	0.14.4	# Apache-2.0
MODCARGO_CRATES +=	prost-derive	0.14.4	# Apache-2.0
MODCARGO_CRATES +=	pulp	0.22.3	# MIT
MODCARGO_CRATES +=	pulp-wasm-simd-flag	0.1.1	# MIT
MODCARGO_CRATES +=	pxfm	0.1.30	# BSD-3-Clause OR Apache-2.0
MODCARGO_CRATES +=	qoi	0.4.1	# MIT/Apache-2.0
MODCARGO_CRATES +=	qrcode	0.14.1	# MIT OR Apache-2.0
MODCARGO_CRATES +=	quantette	0.6.0	# MIT OR Apache-2.0
MODCARGO_CRATES +=	quick-error	2.0.1	# MIT/Apache-2.0
MODCARGO_CRATES +=	quick-xml	0.41.0	# MIT
MODCARGO_CRATES +=	quinn	0.11.12	# MIT OR Apache-2.0
MODCARGO_CRATES +=	quinn-proto	0.11.18	# MIT OR Apache-2.0
MODCARGO_CRATES +=	quinn-udp	0.5.15	# MIT OR Apache-2.0
MODCARGO_CRATES +=	quote	1.0.47	# MIT OR Apache-2.0
MODCARGO_CRATES +=	r-efi	5.3.0	# MIT OR Apache-2.0 OR LGPL-2.1-or-later
MODCARGO_CRATES +=	r-efi	6.0.0	# MIT OR Apache-2.0 OR LGPL-2.1-or-later
MODCARGO_CRATES +=	radium	0.7.0	# MIT
MODCARGO_CRATES +=	radix_trie	0.3.0	# MIT
MODCARGO_CRATES +=	rand	0.8.8	# MIT OR Apache-2.0
MODCARGO_CRATES +=	rand	0.9.5	# MIT OR Apache-2.0
MODCARGO_CRATES +=	rand	0.10.2	# MIT OR Apache-2.0
MODCARGO_CRATES +=	rand_chacha	0.3.1	# MIT OR Apache-2.0
MODCARGO_CRATES +=	rand_chacha	0.9.0	# MIT OR Apache-2.0
MODCARGO_CRATES +=	rand_core	0.6.4	# MIT OR Apache-2.0
MODCARGO_CRATES +=	rand_core	0.9.5	# MIT OR Apache-2.0
MODCARGO_CRATES +=	rand_core	0.10.1	# MIT OR Apache-2.0
MODCARGO_CRATES +=	rand_pcg	0.10.2	# MIT OR Apache-2.0
MODCARGO_CRATES +=	rand_xoshiro	0.7.0	# MIT OR Apache-2.0
MODCARGO_CRATES +=	rand_xoshiro	0.8.1	# MIT OR Apache-2.0
MODCARGO_CRATES +=	ratatui	0.30.2	# MIT
MODCARGO_CRATES +=	ratatui-core	0.1.2	# MIT
MODCARGO_CRATES +=	ratatui-crossterm	0.1.2	# MIT
MODCARGO_CRATES +=	ratatui-image	11.1.0	# MIT
MODCARGO_CRATES +=	ratatui-macros	0.7.2	# MIT
MODCARGO_CRATES +=	ratatui-termina	0.1.0	# MIT
MODCARGO_CRATES +=	ratatui-termion	0.1.2	# MIT
MODCARGO_CRATES +=	ratatui-termwiz	0.1.2	# MIT
MODCARGO_CRATES +=	ratatui-widgets	0.3.2	# MIT
MODCARGO_CRATES +=	rav1e	0.8.1	# BSD-2-Clause
MODCARGO_CRATES +=	ravif	0.13.0	# BSD-3-Clause
MODCARGO_CRATES +=	raw-cpuid	11.6.0	# MIT
MODCARGO_CRATES +=	rayon	1.12.0	# MIT OR Apache-2.0
MODCARGO_CRATES +=	rayon-core	1.13.0	# MIT OR Apache-2.0
MODCARGO_CRATES +=	readlock	0.1.11	# MPL-2.0
MODCARGO_CRATES +=	readlock-tokio	0.1.6	# MPL-2.0
MODCARGO_CRATES +=	reborrow	0.5.5	# MIT
MODCARGO_CRATES +=	redox_syscall	0.2.16	# MIT
MODCARGO_CRATES +=	redox_syscall	0.5.18	# MIT
MODCARGO_CRATES +=	redox_users	0.5.3	# MIT
MODCARGO_CRATES +=	ref-cast	1.0.27	# MIT OR Apache-2.0
MODCARGO_CRATES +=	ref-cast-impl	1.0.27	# MIT OR Apache-2.0
MODCARGO_CRATES +=	regex	1.13.1	# MIT OR Apache-2.0
MODCARGO_CRATES +=	regex-automata	0.4.18	# MIT OR Apache-2.0
MODCARGO_CRATES +=	regex-syntax	0.8.11	# MIT OR Apache-2.0
MODCARGO_CRATES +=	reqwest	0.13.5	# MIT OR Apache-2.0
MODCARGO_CRATES +=	rgb	0.8.53	# MIT
MODCARGO_CRATES +=	ring	0.17.14	# Apache-2.0 AND ISC
MODCARGO_CRATES +=	rmp	0.8.15	# MIT
MODCARGO_CRATES +=	rmp-serde	1.3.1	# MIT
MODCARGO_CRATES +=	ropey	1.6.1	# MIT
MODCARGO_CRATES +=	rpassword	7.5.4	# Apache-2.0
MODCARGO_CRATES +=	rtoolbox	0.0.6	# Apache-2.0
MODCARGO_CRATES +=	ruma	0.16.0	# MIT
MODCARGO_CRATES +=	ruma-client-api	0.24.0	# MIT
MODCARGO_CRATES +=	ruma-common	0.19.0	# MIT
MODCARGO_CRATES +=	ruma-events	0.34.0	# MIT
MODCARGO_CRATES +=	ruma-html	0.8.0	# MIT
MODCARGO_CRATES +=	ruma-identifiers-validation	0.12.1	# MIT
MODCARGO_CRATES +=	ruma-macros	0.19.0	# MIT
MODCARGO_CRATES +=	rusqlite	0.37.0	# MIT
MODCARGO_CRATES +=	rustc-hash	2.1.3	# Apache-2.0 OR MIT
MODCARGO_CRATES +=	rustc_version	0.4.1	# MIT OR Apache-2.0
MODCARGO_CRATES +=	rustix	0.38.44	# Apache-2.0 WITH LLVM-exception OR Apache-2.0 OR MIT
MODCARGO_CRATES +=	rustix	1.1.5	# Apache-2.0 WITH LLVM-exception OR Apache-2.0 OR MIT
MODCARGO_CRATES +=	rustls	0.23.45	# Apache-2.0 OR ISC OR MIT
MODCARGO_CRATES +=	rustls-native-certs	0.8.4	# Apache-2.0 OR ISC OR MIT
MODCARGO_CRATES +=	rustls-pki-types	1.15.1	# MIT OR Apache-2.0
MODCARGO_CRATES +=	rustls-platform-verifier	0.7.0	# MIT OR Apache-2.0
MODCARGO_CRATES +=	rustls-platform-verifier-android	0.1.1	# MIT OR Apache-2.0
MODCARGO_CRATES +=	rustls-webpki	0.103.15	# ISC
MODCARGO_CRATES +=	rustversion	1.0.23	# MIT OR Apache-2.0
MODCARGO_CRATES +=	ryu	1.0.23	# Apache-2.0 OR BSL-1.0
MODCARGO_CRATES +=	safe_arch	1.2.0	# Zlib OR Apache-2.0 OR MIT
MODCARGO_CRATES +=	same-file	1.0.6	# Unlicense/MIT
MODCARGO_CRATES +=	schannel	0.1.29	# MIT
MODCARGO_CRATES +=	scopeguard	1.2.0	# MIT OR Apache-2.0
MODCARGO_CRATES +=	sealed	0.6.0	# MIT OR Apache-2.0
MODCARGO_CRATES +=	sealed	0.7.0	# MIT OR Apache-2.0
MODCARGO_CRATES +=	security-framework	3.7.0	# MIT OR Apache-2.0
MODCARGO_CRATES +=	security-framework-sys	2.17.0	# MIT OR Apache-2.0
MODCARGO_CRATES +=	self_cell	1.3.0	# Apache-2.0 OR GPL-2.0-only
MODCARGO_CRATES +=	semver	1.0.28	# MIT OR Apache-2.0
MODCARGO_CRATES +=	serde	1.0.229	# MIT OR Apache-2.0
MODCARGO_CRATES +=	serde-wasm-bindgen	0.6.5	# MIT
MODCARGO_CRATES +=	serde_bytes	0.11.19	# MIT OR Apache-2.0
MODCARGO_CRATES +=	serde_core	1.0.229	# MIT OR Apache-2.0
MODCARGO_CRATES +=	serde_derive	1.0.229	# MIT OR Apache-2.0
MODCARGO_CRATES +=	serde_html_form	0.4.1	# MIT
MODCARGO_CRATES +=	serde_json	1.0.151	# MIT OR Apache-2.0
MODCARGO_CRATES +=	serde_path_to_error	0.1.20	# MIT OR Apache-2.0
MODCARGO_CRATES +=	serde_repr	0.1.21	# MIT OR Apache-2.0
MODCARGO_CRATES +=	serde_spanned	1.1.1	# MIT OR Apache-2.0
MODCARGO_CRATES +=	serde_urlencoded	0.7.1	# MIT/Apache-2.0
MODCARGO_CRATES +=	sha2	0.10.9	# MIT OR Apache-2.0
MODCARGO_CRATES +=	sharded-slab	0.1.7	# MIT
MODCARGO_CRATES +=	shellexpand	3.1.2	# MIT/Apache-2.0
MODCARGO_CRATES +=	shlex	2.0.1	# MIT OR Apache-2.0
MODCARGO_CRATES +=	signal-hook	0.3.18	# Apache-2.0/MIT
MODCARGO_CRATES +=	signal-hook-mio	0.2.5	# MIT OR Apache-2.0
MODCARGO_CRATES +=	signal-hook-registry	1.4.8	# MIT OR Apache-2.0
MODCARGO_CRATES +=	signature	2.2.0	# Apache-2.0 OR MIT
MODCARGO_CRATES +=	simd-adler32	0.3.10	# MIT
MODCARGO_CRATES +=	simd_cesu8	1.2.0	# Apache-2.0 OR MIT
MODCARGO_CRATES +=	simd_helpers	0.1.0	# MIT
MODCARGO_CRATES +=	simdutf8	0.1.5	# MIT OR Apache-2.0
MODCARGO_CRATES +=	siphasher	1.0.3	# MIT/Apache-2.0
MODCARGO_CRATES +=	slab	0.4.12	# MIT
MODCARGO_CRATES +=	sled	0.34.7	# MIT/Apache-2.0
MODCARGO_CRATES +=	smallvec	1.16.1	# MIT OR Apache-2.0
MODCARGO_CRATES +=	smawk	0.3.3	# MIT
MODCARGO_CRATES +=	socket2	0.6.5	# MIT OR Apache-2.0
MODCARGO_CRATES +=	spin	0.9.9	# MIT
MODCARGO_CRATES +=	spki	0.7.3	# Apache-2.0 OR MIT
MODCARGO_CRATES +=	stable_deref_trait	1.2.1	# MIT OR Apache-2.0
MODCARGO_CRATES +=	static_assertions	1.1.0	# MIT OR Apache-2.0
MODCARGO_CRATES +=	str_indices	0.4.4	# MIT OR Apache-2.0
MODCARGO_CRATES +=	string_cache	0.9.0	# MIT OR Apache-2.0
MODCARGO_CRATES +=	string_cache_codegen	0.6.1	# MIT OR Apache-2.0
MODCARGO_CRATES +=	strsim	0.11.1	# MIT
MODCARGO_CRATES +=	strum	0.28.0	# MIT
MODCARGO_CRATES +=	strum_macros	0.28.0	# MIT
MODCARGO_CRATES +=	subtle	2.6.1	# BSD-3-Clause
MODCARGO_CRATES +=	symlink	0.1.0	# MIT/Apache-2.0
MODCARGO_CRATES +=	syn	1.0.109	# MIT OR Apache-2.0
MODCARGO_CRATES +=	syn	2.0.119	# MIT OR Apache-2.0
MODCARGO_CRATES +=	syn	3.0.6	# MIT OR Apache-2.0
MODCARGO_CRATES +=	sync_wrapper	1.0.2	# Apache-2.0
MODCARGO_CRATES +=	synstructure	0.14.0	# MIT
MODCARGO_CRATES +=	tap	1.0.1	# MIT
MODCARGO_CRATES +=	tauri-winrt-notification	0.7.3	# MIT OR Apache-2.0
MODCARGO_CRATES +=	temp-dir	0.2.0	# Apache-2.0
MODCARGO_CRATES +=	tempfile	3.27.0	# MIT OR Apache-2.0
MODCARGO_CRATES +=	tendril	0.5.1	# MIT OR Apache-2.0
MODCARGO_CRATES +=	termina	0.3.3	# MIT OR MPL-2.0
MODCARGO_CRATES +=	terminfo	0.9.0	# WTFPL
MODCARGO_CRATES +=	termion	4.0.6	# MIT
MODCARGO_CRATES +=	termios	0.3.3	# MIT
MODCARGO_CRATES +=	termwiz	0.23.3	# MIT
MODCARGO_CRATES +=	textwrap	0.16.4	# MIT
MODCARGO_CRATES +=	thiserror	1.0.69	# MIT OR Apache-2.0
MODCARGO_CRATES +=	thiserror	2.0.20	# MIT OR Apache-2.0
MODCARGO_CRATES +=	thiserror-impl	1.0.69	# MIT OR Apache-2.0
MODCARGO_CRATES +=	thiserror-impl	2.0.20	# MIT OR Apache-2.0
MODCARGO_CRATES +=	thread_local	1.1.10	# MIT OR Apache-2.0
MODCARGO_CRATES +=	tiff	0.11.3	# MIT
MODCARGO_CRATES +=	time	0.3.55	# MIT OR Apache-2.0
MODCARGO_CRATES +=	time-core	0.1.9	# MIT OR Apache-2.0
MODCARGO_CRATES +=	time-macros	0.2.32	# MIT OR Apache-2.0
MODCARGO_CRATES +=	tinystr	0.8.4	# Unicode-3.0
MODCARGO_CRATES +=	tinyvec	1.13.3	# Zlib OR Apache-2.0 OR MIT
MODCARGO_CRATES +=	tokio	1.53.1	# MIT
MODCARGO_CRATES +=	tokio-macros	2.7.2	# MIT
MODCARGO_CRATES +=	tokio-rustls	0.26.5	# MIT OR Apache-2.0
MODCARGO_CRATES +=	tokio-stream	0.1.19	# MIT
MODCARGO_CRATES +=	tokio-util	0.7.19	# MIT
MODCARGO_CRATES +=	toml	1.1.6+spec-1.1.0	# MIT OR Apache-2.0
MODCARGO_CRATES +=	toml_datetime	1.1.1+spec-1.1.0	# MIT OR Apache-2.0
MODCARGO_CRATES +=	toml_edit	0.25.15+spec-1.1.0	# MIT OR Apache-2.0
MODCARGO_CRATES +=	toml_parser	1.1.3+spec-1.1.0	# MIT OR Apache-2.0
MODCARGO_CRATES +=	toml_writer	1.1.2+spec-1.1.0	# MIT OR Apache-2.0
MODCARGO_CRATES +=	tower	0.5.3	# MIT
MODCARGO_CRATES +=	tower-http	0.6.11	# MIT
MODCARGO_CRATES +=	tower-layer	0.3.3	# MIT
MODCARGO_CRATES +=	tower-service	0.3.3	# MIT
MODCARGO_CRATES +=	tracing	0.1.44	# MIT
MODCARGO_CRATES +=	tracing-appender	0.2.5	# MIT
MODCARGO_CRATES +=	tracing-attributes	0.1.31	# MIT
MODCARGO_CRATES +=	tracing-core	0.1.36	# MIT
MODCARGO_CRATES +=	tracing-log	0.2.0	# MIT
MODCARGO_CRATES +=	tracing-subscriber	0.3.23	# MIT
MODCARGO_CRATES +=	tree_magic_mini	3.2.2	# MIT
MODCARGO_CRATES +=	try-lock	0.2.5	# MIT
MODCARGO_CRATES +=	typed-arena	2.0.2	# MIT
MODCARGO_CRATES +=	typenum	1.20.1	# MIT OR Apache-2.0
MODCARGO_CRATES +=	typewit	1.15.2	# Zlib
MODCARGO_CRATES +=	ucd-trie	0.1.7	# MIT OR Apache-2.0
MODCARGO_CRATES +=	uds_windows	1.2.1	# MIT
MODCARGO_CRATES +=	ulid	1.2.1	# MIT
MODCARGO_CRATES +=	unicase	2.9.0	# MIT OR Apache-2.0
MODCARGO_CRATES +=	unicode-canonical-combining-class	1.0.0	# Apache-2.0
MODCARGO_CRATES +=	unicode-ident	1.0.26	# (MIT OR Apache-2.0) AND Unicode-3.0
MODCARGO_CRATES +=	unicode-normalization	0.1.25	# MIT OR Apache-2.0
MODCARGO_CRATES +=	unicode-segmentation	1.13.3	# MIT OR Apache-2.0
MODCARGO_CRATES +=	unicode-truncate	2.0.1	# MIT OR Apache-2.0
MODCARGO_CRATES +=	unicode-width	0.2.2	# MIT OR Apache-2.0
MODCARGO_CRATES +=	unicode-xid	0.2.6	# MIT OR Apache-2.0
MODCARGO_CRATES +=	universal-hash	0.5.1	# MIT OR Apache-2.0
MODCARGO_CRATES +=	untrusted	0.9.0	# ISC
MODCARGO_CRATES +=	url	2.5.8	# MIT OR Apache-2.0
MODCARGO_CRATES +=	urlencoding	2.1.3	# MIT
MODCARGO_CRATES +=	utf8_iter	1.0.4	# Apache-2.0 OR MIT
MODCARGO_CRATES +=	utf8parse	0.2.2	# Apache-2.0 OR MIT
MODCARGO_CRATES +=	uuid	1.26.1	# Apache-2.0 OR MIT
MODCARGO_CRATES +=	v_frame	0.3.9	# BSD-2-Clause
MODCARGO_CRATES +=	valuable	0.1.1	# MIT
MODCARGO_CRATES +=	vcpkg	0.2.15	# MIT/Apache-2.0
MODCARGO_CRATES +=	vergen	9.1.0	# MIT OR Apache-2.0
MODCARGO_CRATES +=	vergen-gitcl	9.1.0	# MIT OR Apache-2.0
MODCARGO_CRATES +=	vergen-lib	9.1.0	# MIT OR Apache-2.0
MODCARGO_CRATES +=	version_check	0.9.5	# MIT/Apache-2.0
MODCARGO_CRATES +=	vodozemac	0.10.0	# Apache-2.0
MODCARGO_CRATES +=	vsimd	0.8.0	# MIT
MODCARGO_CRATES +=	vtparse	0.6.2	# MIT
MODCARGO_CRATES +=	walkdir	2.5.0	# Unlicense/MIT
MODCARGO_CRATES +=	want	0.3.1	# MIT
MODCARGO_CRATES +=	wasi	0.11.1+wasi-snapshot-preview1	# Apache-2.0 WITH LLVM-exception OR Apache-2.0 OR MIT
MODCARGO_CRATES +=	wasip2	1.0.4+wasi-0.2.12	# Apache-2.0 WITH LLVM-exception OR Apache-2.0 OR MIT
MODCARGO_CRATES +=	wasm-bindgen	0.2.128	# MIT OR Apache-2.0
MODCARGO_CRATES +=	wasm-bindgen-futures	0.4.78	# MIT OR Apache-2.0
MODCARGO_CRATES +=	wasm-bindgen-macro	0.2.128	# MIT OR Apache-2.0
MODCARGO_CRATES +=	wasm-bindgen-macro-support	0.2.128	# MIT OR Apache-2.0
MODCARGO_CRATES +=	wasm-bindgen-shared	0.2.128	# MIT OR Apache-2.0
MODCARGO_CRATES +=	wasm-streams	0.5.0	# MIT OR Apache-2.0
MODCARGO_CRATES +=	wasm_evt_listener	0.1.0	# MIT
MODCARGO_CRATES +=	wayland-backend	0.3.17	# MIT
MODCARGO_CRATES +=	wayland-client	0.31.15	# MIT
MODCARGO_CRATES +=	wayland-protocols	0.32.13	# MIT
MODCARGO_CRATES +=	wayland-protocols-wlr	0.3.12	# MIT
MODCARGO_CRATES +=	wayland-scanner	0.31.11	# MIT
MODCARGO_CRATES +=	wayland-sys	0.31.11	# MIT
MODCARGO_CRATES +=	web-sys	0.3.105	# MIT OR Apache-2.0
MODCARGO_CRATES +=	web-time	1.1.0	# MIT OR Apache-2.0
MODCARGO_CRATES +=	web_atoms	0.2.6	# MIT OR Apache-2.0
MODCARGO_CRATES +=	webpki-root-certs	1.0.9	# CDLA-Permissive-2.0
MODCARGO_CRATES +=	webpki-roots	1.0.9	# CDLA-Permissive-2.0
MODCARGO_CRATES +=	weezl	0.1.12	# MIT OR Apache-2.0
MODCARGO_CRATES +=	wezterm-bidi	0.2.3	# MIT AND Unicode-DFS-2016
MODCARGO_CRATES +=	wezterm-blob-leases	0.1.1	# MIT
MODCARGO_CRATES +=	wezterm-color-types	0.3.0	# MIT
MODCARGO_CRATES +=	wezterm-dynamic	0.2.1	# MIT
MODCARGO_CRATES +=	wezterm-dynamic-derive	0.1.1	# MIT
MODCARGO_CRATES +=	wezterm-input-types	0.1.0	# MIT
MODCARGO_CRATES +=	which	4.4.2	# MIT
MODCARGO_CRATES +=	wide	1.7.1	# Zlib OR Apache-2.0 OR MIT
MODCARGO_CRATES +=	wildmatch	2.6.1	# MIT
MODCARGO_CRATES +=	winapi	0.3.9	# MIT/Apache-2.0
MODCARGO_CRATES +=	winapi-i686-pc-windows-gnu	0.4.0	# MIT/Apache-2.0
MODCARGO_CRATES +=	winapi-util	0.1.11	# Unlicense OR MIT
MODCARGO_CRATES +=	winapi-x86_64-pc-windows-gnu	0.4.0	# MIT/Apache-2.0
MODCARGO_CRATES +=	windows	0.58.0	# MIT OR Apache-2.0
MODCARGO_CRATES +=	windows	0.61.3	# MIT OR Apache-2.0
MODCARGO_CRATES +=	windows-collections	0.2.0	# MIT OR Apache-2.0
MODCARGO_CRATES +=	windows-core	0.58.0	# MIT OR Apache-2.0
MODCARGO_CRATES +=	windows-core	0.61.2	# MIT OR Apache-2.0
MODCARGO_CRATES +=	windows-core	0.62.2	# MIT OR Apache-2.0
MODCARGO_CRATES +=	windows-future	0.2.1	# MIT OR Apache-2.0
MODCARGO_CRATES +=	windows-implement	0.58.0	# MIT OR Apache-2.0
MODCARGO_CRATES +=	windows-implement	0.60.2	# MIT OR Apache-2.0
MODCARGO_CRATES +=	windows-interface	0.58.0	# MIT OR Apache-2.0
MODCARGO_CRATES +=	windows-interface	0.59.3	# MIT OR Apache-2.0
MODCARGO_CRATES +=	windows-link	0.1.3	# MIT OR Apache-2.0
MODCARGO_CRATES +=	windows-link	0.2.1	# MIT OR Apache-2.0
MODCARGO_CRATES +=	windows-numerics	0.2.0	# MIT OR Apache-2.0
MODCARGO_CRATES +=	windows-result	0.2.0	# MIT OR Apache-2.0
MODCARGO_CRATES +=	windows-result	0.3.4	# MIT OR Apache-2.0
MODCARGO_CRATES +=	windows-result	0.4.1	# MIT OR Apache-2.0
MODCARGO_CRATES +=	windows-strings	0.1.0	# MIT OR Apache-2.0
MODCARGO_CRATES +=	windows-strings	0.4.2	# MIT OR Apache-2.0
MODCARGO_CRATES +=	windows-strings	0.5.1	# MIT OR Apache-2.0
MODCARGO_CRATES +=	windows-sys	0.52.0	# MIT OR Apache-2.0
MODCARGO_CRATES +=	windows-sys	0.59.0	# MIT OR Apache-2.0
MODCARGO_CRATES +=	windows-sys	0.60.2	# MIT OR Apache-2.0
MODCARGO_CRATES +=	windows-sys	0.61.2	# MIT OR Apache-2.0
MODCARGO_CRATES +=	windows-targets	0.52.6	# MIT OR Apache-2.0
MODCARGO_CRATES +=	windows-targets	0.53.5	# MIT OR Apache-2.0
MODCARGO_CRATES +=	windows-threading	0.1.0	# MIT OR Apache-2.0
MODCARGO_CRATES +=	windows-version	0.1.7	# MIT OR Apache-2.0
MODCARGO_CRATES +=	windows_aarch64_gnullvm	0.52.6	# MIT OR Apache-2.0
MODCARGO_CRATES +=	windows_aarch64_gnullvm	0.53.1	# MIT OR Apache-2.0
MODCARGO_CRATES +=	windows_aarch64_msvc	0.52.6	# MIT OR Apache-2.0
MODCARGO_CRATES +=	windows_aarch64_msvc	0.53.1	# MIT OR Apache-2.0
MODCARGO_CRATES +=	windows_i686_gnu	0.52.6	# MIT OR Apache-2.0
MODCARGO_CRATES +=	windows_i686_gnu	0.53.1	# MIT OR Apache-2.0
MODCARGO_CRATES +=	windows_i686_gnullvm	0.52.6	# MIT OR Apache-2.0
MODCARGO_CRATES +=	windows_i686_gnullvm	0.53.1	# MIT OR Apache-2.0
MODCARGO_CRATES +=	windows_i686_msvc	0.52.6	# MIT OR Apache-2.0
MODCARGO_CRATES +=	windows_i686_msvc	0.53.1	# MIT OR Apache-2.0
MODCARGO_CRATES +=	windows_x86_64_gnu	0.52.6	# MIT OR Apache-2.0
MODCARGO_CRATES +=	windows_x86_64_gnu	0.53.1	# MIT OR Apache-2.0
MODCARGO_CRATES +=	windows_x86_64_gnullvm	0.52.6	# MIT OR Apache-2.0
MODCARGO_CRATES +=	windows_x86_64_gnullvm	0.53.1	# MIT OR Apache-2.0
MODCARGO_CRATES +=	windows_x86_64_msvc	0.52.6	# MIT OR Apache-2.0
MODCARGO_CRATES +=	windows_x86_64_msvc	0.53.1	# MIT OR Apache-2.0
MODCARGO_CRATES +=	winnow	1.0.4	# MIT
MODCARGO_CRATES +=	wit-bindgen	0.57.1	# Apache-2.0 WITH LLVM-exception OR Apache-2.0 OR MIT
MODCARGO_CRATES +=	wl-clipboard-rs	0.9.3	# MIT/Apache-2.0
MODCARGO_CRATES +=	writeable	0.6.4	# Unicode-3.0
MODCARGO_CRATES +=	wyz	0.5.1	# MIT
MODCARGO_CRATES +=	x11rb	0.13.2	# MIT OR Apache-2.0
MODCARGO_CRATES +=	x11rb-protocol	0.13.2	# MIT OR Apache-2.0
MODCARGO_CRATES +=	x25519-dalek	2.0.1	# BSD-3-Clause
MODCARGO_CRATES +=	xml5ever	0.39.0	# MIT OR Apache-2.0
MODCARGO_CRATES +=	xxhash-rust	0.8.18	# BSL-1.0
MODCARGO_CRATES +=	y4m	0.8.0	# MIT
MODCARGO_CRATES +=	yansi	1.0.1	# MIT OR Apache-2.0
MODCARGO_CRATES +=	yoke	0.8.3	# Unicode-3.0
MODCARGO_CRATES +=	yoke-derive	0.8.3	# Unicode-3.0
MODCARGO_CRATES +=	zbus	5.19.0	# MIT
MODCARGO_CRATES +=	zbus_macros	5.19.0	# MIT
MODCARGO_CRATES +=	zbus_names	4.3.4	# MIT
MODCARGO_CRATES +=	zcheapstr	1.1.0	# MIT
MODCARGO_CRATES +=	zerocopy	0.8.57	# BSD-2-Clause OR Apache-2.0 OR MIT
MODCARGO_CRATES +=	zerocopy-derive	0.8.57	# BSD-2-Clause OR Apache-2.0 OR MIT
MODCARGO_CRATES +=	zerofrom	0.1.8	# Unicode-3.0
MODCARGO_CRATES +=	zerofrom-derive	0.1.8	# Unicode-3.0
MODCARGO_CRATES +=	zeroize	1.9.0	# Apache-2.0 OR MIT
MODCARGO_CRATES +=	zeroize_derive	1.5.0	# Apache-2.0 OR MIT
MODCARGO_CRATES +=	zerotrie	0.2.5	# Unicode-3.0
MODCARGO_CRATES +=	zerovec	0.11.8	# Unicode-3.0
MODCARGO_CRATES +=	zerovec-derive	0.11.6	# Unicode-3.0
MODCARGO_CRATES +=	zlib-rs	0.6.8	# Zlib
MODCARGO_CRATES +=	zmij	1.0.23	# MIT
MODCARGO_CRATES +=	zune-core	0.5.3	# MIT OR Apache-2.0 OR Zlib
MODCARGO_CRATES +=	zune-inflate	0.2.54	# MIT OR Apache-2.0 OR Zlib
MODCARGO_CRATES +=	zune-jpeg	0.5.15	# MIT OR Apache-2.0 OR Zlib
MODCARGO_CRATES +=	zvariant	5.15.0	# MIT
MODCARGO_CRATES +=	zvariant_derive	5.15.0	# MIT
MODCARGO_CRATES +=	zvariant_utils	4.2.0	# MIT
