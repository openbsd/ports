MODGO_MODULES =	\
	github.com/!proton!mail/go-crypto	 v1.0.0 \
	github.com/!proton!mail/go-mime		 v0.0.0-20230322103455-7d82a3887f2f \
	github.com/!proton!mail/gopenpgp/v2	 v2.7.5 \
	github.com/beevik/etree			 v1.3.0 \
	github.com/bwesterb/go-ristretto	 v1.2.3 \
	github.com/cloudflare/circl		 v1.3.7 \
	github.com/davecgh/go-spew		 v1.1.1 \
	github.com/gabriel-vasile/mimetype	 v1.4.3 \
	github.com/google/uuid			 v1.6.0 \
	github.com/pborman/getopt/v2		 v2.1.0 \
	github.com/pkg/errors			 v0.9.1 \
	github.com/pmezard/go-difflib		 v1.0.0 \
	github.com/stretchr/objx		 v0.1.0 \
	github.com/stretchr/testify		 v1.7.0 \
	github.com/xmppo/go-xmpp		 v0.2.0 \
	github.com/yuin/goldmark		 v1.4.13 \
	golang.org/x/crypto			 v0.22.0 \
	golang.org/x/mod			 v0.8.0 \
	golang.org/x/net			 v0.24.0 \
	golang.org/x/sync			 v0.1.0 \
	golang.org/x/sys			 v0.19.0 \
	golang.org/x/term			 v0.19.0 \
	golang.org/x/text			 v0.14.0 \
	golang.org/x/tools			 v0.6.0 \
	golang.org/x/xerrors			 v0.0.0-20190717185122-a985d3407aa7 \
	gopkg.in/check.v1			 v0.0.0-20161208181325-20d25e280405 \
	gopkg.in/yaml.v3			 v3.0.0-20200313102051-9f266ea9e77c \
	salsa.debian.org/mdosch/xmppsrv		 v0.2.6

MODGO_MODFILES =	\
	github.com/!proton!mail/go-crypto	 v0.0.0-20230717121422-5aa5874ade95 \
	github.com/cloudflare/circl		 v1.3.3 \
	github.com/davecgh/go-spew		 v1.1.0 \
	golang.org/x/crypto			 v0.0.0-20190308221718-c2843e01d9a2 \
	golang.org/x/crypto			 v0.0.0-20210921155107-089bfa567519 \
	golang.org/x/crypto			 v0.17.0 \
	golang.org/x/crypto			 v0.3.1-0.20221117191849-2c476679df9a \
	golang.org/x/crypto			 v0.7.0 \
	golang.org/x/mod			 v0.6.0-dev.0.20220419223038-86c51ed26bb4 \
	golang.org/x/net			 v0.0.0-20190620200207-3b0461eec859 \
	golang.org/x/net			 v0.0.0-20210226172049-e18ecbb05110 \
	golang.org/x/net			 v0.0.0-20220722155237-a158d28d115b \
	golang.org/x/net			 v0.17.0 \
	golang.org/x/net			 v0.2.0 \
	golang.org/x/net			 v0.21.0 \
	golang.org/x/net			 v0.6.0 \
	golang.org/x/net			 v0.8.0 \
	golang.org/x/sync			 v0.0.0-20190423024810-112230192c58 \
	golang.org/x/sync			 v0.0.0-20220722155255-886fb9371eb4 \
	golang.org/x/sys			 v0.0.0-20190215142949-d0b11bdaac8a \
	golang.org/x/sys			 v0.0.0-20201119102817-f84b799fce68 \
	golang.org/x/sys			 v0.0.0-20210615035016-665e8c7367d1 \
	golang.org/x/sys			 v0.0.0-20220520151302-bc2c85ada10a \
	golang.org/x/sys			 v0.0.0-20220722155257-8c9f86f7a55f \
	golang.org/x/sys			 v0.15.0 \
	golang.org/x/sys			 v0.2.0 \
	golang.org/x/sys			 v0.3.0 \
	golang.org/x/sys			 v0.5.0 \
	golang.org/x/sys			 v0.6.0 \
	golang.org/x/term			 v0.0.0-20201126162022-7de9c90e9dd1 \
	golang.org/x/term			 v0.0.0-20210927222741-03fcf44c2211 \
	golang.org/x/term			 v0.2.0 \
	golang.org/x/term			 v0.5.0 \
	golang.org/x/term			 v0.6.0 \
	golang.org/x/text			 v0.3.0 \
	golang.org/x/text			 v0.3.3 \
	golang.org/x/text			 v0.3.7 \
	golang.org/x/text			 v0.4.0 \
	golang.org/x/text			 v0.7.0 \
	golang.org/x/text			 v0.8.0 \
	golang.org/x/tools			 v0.0.0-20180917221912-90fa682c2a6e \
	golang.org/x/tools			 v0.0.0-20191119224855-298f0cb1881e \
	golang.org/x/tools			 v0.1.12

