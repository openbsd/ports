MODGO_MODULES =	\
	github.com/ammario/ipisp	 v1.0.0 \
	github.com/briandowns/spinner	 v1.18.1 \
	github.com/davecgh/go-spew	 v1.1.1 \
	github.com/dustin/go-humanize	 v1.0.0 \
	github.com/fatih/color		 v1.13.0 \
	github.com/mattn/go-colorable	 v0.1.12 \
	github.com/mattn/go-isatty	 v0.0.14 \
	github.com/miekg/dns		 v1.1.50 \
	github.com/pkg/errors		 v0.9.1 \
	github.com/pmezard/go-difflib	 v1.0.0 \
	github.com/sirupsen/logrus	 v1.8.1 \
	github.com/stretchr/objx	 v0.1.0 \
	github.com/stretchr/testify	 v1.4.0 \
	github.com/yuin/goldmark	 v1.4.1 \
	golang.org/x/crypto		 v0.0.0-20191011191535-87dc89f01550 \
	golang.org/x/mod		 v0.5.1 \
	golang.org/x/net		 v0.0.0-20220225172249-27dd8689420f \
	golang.org/x/sync		 v0.0.0-20210220032951-036812b2e83c \
	golang.org/x/sys		 v0.0.0-20220227234510-4e6760a101f9 \
	golang.org/x/term		 v0.0.0-20210927222741-03fcf44c2211 \
	golang.org/x/text		 v0.3.7 \
	golang.org/x/tools		 v0.1.9 \
	golang.org/x/xerrors		 v0.0.0-20200804184101-5ec99f83aff1 \
	gopkg.in/check.v1		 v0.0.0-20161208181325-20d25e280405 \
	gopkg.in/yaml.v2		 v2.2.2
MODGO_MODFILES =	\
	github.com/davecgh/go-spew	 v1.1.0 \
	github.com/fatih/color		 v1.7.0 \
	github.com/mattn/go-colorable	 v0.1.2 \
	github.com/mattn/go-colorable	 v0.1.9 \
	github.com/mattn/go-isatty	 v0.0.12 \
	github.com/mattn/go-isatty	 v0.0.8 \
	github.com/pkg/errors		 v0.8.0 \
	github.com/stretchr/testify	 v1.2.1 \
	github.com/stretchr/testify	 v1.2.2 \
	github.com/yuin/goldmark	 v1.3.5 \
	golang.org/x/crypto		 v0.0.0-20190308221718-c2843e01d9a2 \
	golang.org/x/mod		 v0.4.2 \
	golang.org/x/net		 v0.0.0-20190404232315-eb5bcb51f2a3 \
	golang.org/x/net		 v0.0.0-20190620200207-3b0461eec859 \
	golang.org/x/net		 v0.0.0-20210405180319-a5a99cb37ef4 \
	golang.org/x/net		 v0.0.0-20210726213435-c6fcb2dbf985 \
	golang.org/x/net		 v0.0.0-20211015210444-4f30a5c0130f \
	golang.org/x/sync		 v0.0.0-20190423024810-112230192c58 \
	golang.org/x/sys		 v0.0.0-20190215142949-d0b11bdaac8a \
	golang.org/x/sys		 v0.0.0-20190222072716-a9d3bda3a223 \
	golang.org/x/sys		 v0.0.0-20190412213103-97732733099d \
	golang.org/x/sys		 v0.0.0-20191026070338-33540a1f6037 \
	golang.org/x/sys		 v0.0.0-20200116001909-b77594299b42 \
	golang.org/x/sys		 v0.0.0-20200223170610-d5e6a3e2c0ae \
	golang.org/x/sys		 v0.0.0-20201119102817-f84b799fce68 \
	golang.org/x/sys		 v0.0.0-20210330210617-4fbd30eecc44 \
	golang.org/x/sys		 v0.0.0-20210423082822-04245dca01da \
	golang.org/x/sys		 v0.0.0-20210510120138-977fb7262007 \
	golang.org/x/sys		 v0.0.0-20210630005230-0f9fa26af87c \
	golang.org/x/sys		 v0.0.0-20210927094055-39ccf1dd6fa6 \
	golang.org/x/sys		 v0.0.0-20211019181941-9d821ace8654 \
	golang.org/x/sys		 v0.0.0-20211216021012-1d35b9e2eb4e \
	golang.org/x/term		 v0.0.0-20201126162022-7de9c90e9dd1 \
	golang.org/x/text		 v0.3.0 \
	golang.org/x/text		 v0.3.3 \
	golang.org/x/text		 v0.3.6 \
	golang.org/x/tools		 v0.0.0-20180917221912-90fa682c2a6e \
	golang.org/x/tools		 v0.0.0-20191119224855-298f0cb1881e \
	golang.org/x/tools		 v0.1.6-0.20210726203631-07bc1bf47fb2 \
	golang.org/x/xerrors		 v0.0.0-20190717185122-a985d3407aa7 \
	golang.org/x/xerrors		 v0.0.0-20191011141410-1b5146add898
