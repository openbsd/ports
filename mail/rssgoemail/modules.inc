MODGO_MODULES =	\
	github.com/!burnt!sushi/toml			 v0.3.1 \
	github.com/!puerkito!bio/goquery		 v1.8.1 \
	github.com/andybalholm/cascadia			 v1.3.2 \
	github.com/cpuguy83/go-md2man/v2		 v2.0.0-20190314233015-f79a8a8ca69d \
	github.com/davecgh/go-spew			 v1.1.1 \
	github.com/google/go-cmp			 v0.3.1 \
	github.com/google/gofuzz			 v1.0.0 \
	github.com/json-iterator/go			 v1.1.12 \
	github.com/makeworld-the-better-one/go-gemini	 v0.13.1 \
	github.com/mmcdole/gofeed			 v1.2.1 \
	github.com/mmcdole/goxpp			 v1.1.0 \
	github.com/modern-go/concurrent			 v0.0.0-20180306012644-bacd9c7ef1dd \
	github.com/modern-go/reflect2			 v1.0.2 \
	github.com/pmezard/go-difflib			 v1.0.0 \
	github.com/russross/blackfriday/v2		 v2.0.1 \
	github.com/shurcoo!l/sanitized_anchor_name	 v1.0.0 \
	github.com/stretchr/objx			 v0.5.0 \
	github.com/stretchr/testify			 v1.8.1 \
	github.com/urfave/cli				 v1.22.3 \
	github.com/yuin/goldmark			 v1.4.13 \
	golang.org/x/crypto				 v0.14.0 \
	golang.org/x/mod				 v0.8.0 \
	golang.org/x/net				 v0.17.0 \
	golang.org/x/sync				 v0.1.0 \
	golang.org/x/sys				 v0.13.0 \
	golang.org/x/term				 v0.13.0 \
	golang.org/x/text				 v0.13.0 \
	golang.org/x/tools				 v0.6.0 \
	golang.org/x/xerrors				 v0.0.0-20190717185122-a985d3407aa7 \
	gopkg.in/check.v1				 v0.0.0-20161208181325-20d25e280405 \
	gopkg.in/yaml.v2				 v2.2.2 \
	gopkg.in/yaml.v3				 v3.0.1

MODGO_MODFILES =	\
	github.com/!puerkito!bio/goquery	 v1.8.0 \
	github.com/andybalholm/cascadia		 v1.3.1 \
	github.com/davecgh/go-spew		 v1.1.0 \
	github.com/modern-go/concurrent		 v0.0.0-20180228061459-e0a39a4cb421 \
	github.com/stretchr/objx		 v0.1.0 \
	github.com/stretchr/objx		 v0.4.0 \
	github.com/stretchr/testify		 v1.3.0 \
	github.com/stretchr/testify		 v1.7.1 \
	github.com/stretchr/testify		 v1.8.0 \
	golang.org/x/crypto			 v0.0.0-20190308221718-c2843e01d9a2 \
	golang.org/x/crypto			 v0.0.0-20210921155107-089bfa567519 \
	golang.org/x/mod			 v0.6.0-dev.0.20220419223038-86c51ed26bb4 \
	golang.org/x/net			 v0.0.0-20190620200207-3b0461eec859 \
	golang.org/x/net			 v0.0.0-20210226172049-e18ecbb05110 \
	golang.org/x/net			 v0.0.0-20210916014120-12bc252f5db8 \
	golang.org/x/net			 v0.0.0-20220722155237-a158d28d115b \
	golang.org/x/net			 v0.10.0 \
	golang.org/x/net			 v0.4.0 \
	golang.org/x/net			 v0.6.0 \
	golang.org/x/net			 v0.7.0 \
	golang.org/x/net			 v0.9.0 \
	golang.org/x/sync			 v0.0.0-20190423024810-112230192c58 \
	golang.org/x/sync			 v0.0.0-20220722155255-886fb9371eb4 \
	golang.org/x/sys			 v0.0.0-20190215142949-d0b11bdaac8a \
	golang.org/x/sys			 v0.0.0-20201119102817-f84b799fce68 \
	golang.org/x/sys			 v0.0.0-20210423082822-04245dca01da \
	golang.org/x/sys			 v0.0.0-20210615035016-665e8c7367d1 \
	golang.org/x/sys			 v0.0.0-20220520151302-bc2c85ada10a \
	golang.org/x/sys			 v0.0.0-20220722155257-8c9f86f7a55f \
	golang.org/x/sys			 v0.3.0 \
	golang.org/x/sys			 v0.5.0 \
	golang.org/x/sys			 v0.7.0 \
	golang.org/x/sys			 v0.8.0 \
	golang.org/x/term			 v0.0.0-20201126162022-7de9c90e9dd1 \
	golang.org/x/term			 v0.0.0-20210927222741-03fcf44c2211 \
	golang.org/x/term			 v0.3.0 \
	golang.org/x/term			 v0.5.0 \
	golang.org/x/term			 v0.7.0 \
	golang.org/x/term			 v0.8.0 \
	golang.org/x/text			 v0.3.0 \
	golang.org/x/text			 v0.3.3 \
	golang.org/x/text			 v0.3.6 \
	golang.org/x/text			 v0.3.7 \
	golang.org/x/text			 v0.5.0 \
	golang.org/x/text			 v0.7.0 \
	golang.org/x/text			 v0.9.0 \
	golang.org/x/tools			 v0.0.0-20180917221912-90fa682c2a6e \
	golang.org/x/tools			 v0.0.0-20191119224855-298f0cb1881e \
	golang.org/x/tools			 v0.1.12 \
	gopkg.in/yaml.v3			 v3.0.0-20200313102051-9f266ea9e77c

