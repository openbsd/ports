MODCARGO_CRATES +=	ahash	0.8.0	# MIT OR Apache-2.0
MODCARGO_CRATES +=	android_system_properties	0.1.5	# MIT/Apache-2.0
MODCARGO_CRATES +=	async-stream	0.3.3	# MIT
MODCARGO_CRATES +=	async-stream-impl	0.3.3	# MIT
MODCARGO_CRATES +=	autocfg	1.1.0	# Apache-2.0 OR MIT
MODCARGO_CRATES +=	base64	0.13.1	# MIT/Apache-2.0
MODCARGO_CRATES +=	bitflags	1.3.2	# MIT/Apache-2.0
MODCARGO_CRATES +=	block-buffer	0.10.3	# MIT OR Apache-2.0
MODCARGO_CRATES +=	bumpalo	3.11.1	# MIT/Apache-2.0
MODCARGO_CRATES +=	byteorder	1.4.3	# Unlicense OR MIT
MODCARGO_CRATES +=	bytes	1.2.1	# MIT
MODCARGO_CRATES +=	cc	1.0.74	# MIT OR Apache-2.0
MODCARGO_CRATES +=	cfg-if	1.0.0	# MIT/Apache-2.0
MODCARGO_CRATES +=	chrono	0.4.22	# MIT/Apache-2.0
MODCARGO_CRATES +=	codespan-reporting	0.11.1	# Apache-2.0
MODCARGO_CRATES +=	core-foundation-sys	0.8.3	# MIT / Apache-2.0
MODCARGO_CRATES +=	cpufeatures	0.2.5	# MIT OR Apache-2.0
MODCARGO_CRATES +=	crc32fast	1.3.2	# MIT OR Apache-2.0
MODCARGO_CRATES +=	crossbeam-channel	0.5.6	# MIT OR Apache-2.0
MODCARGO_CRATES +=	crossbeam-deque	0.8.2	# MIT OR Apache-2.0
MODCARGO_CRATES +=	crossbeam-epoch	0.9.11	# MIT OR Apache-2.0
MODCARGO_CRATES +=	crossbeam-utils	0.8.12	# MIT OR Apache-2.0
MODCARGO_CRATES +=	crypto-common	0.1.6	# MIT OR Apache-2.0
MODCARGO_CRATES +=	cxx	1.0.80	# MIT OR Apache-2.0
MODCARGO_CRATES +=	cxx-build	1.0.80	# MIT OR Apache-2.0
MODCARGO_CRATES +=	cxxbridge-flags	1.0.80	# MIT OR Apache-2.0
MODCARGO_CRATES +=	cxxbridge-macro	1.0.80	# MIT OR Apache-2.0
MODCARGO_CRATES +=	digest	0.10.5	# MIT OR Apache-2.0
MODCARGO_CRATES +=	either	1.8.0	# MIT/Apache-2.0
MODCARGO_CRATES +=	encoding_rs	0.8.31	# (Apache-2.0 OR MIT) AND BSD-3-Clause
MODCARGO_CRATES +=	fnv	1.0.7	# Apache-2.0 / MIT
MODCARGO_CRATES +=	form_urlencoded	1.1.0	# MIT OR Apache-2.0
MODCARGO_CRATES +=	fs2	0.4.3	# MIT/Apache-2.0
MODCARGO_CRATES +=	futures	0.3.25	# MIT OR Apache-2.0
MODCARGO_CRATES +=	futures-channel	0.3.25	# MIT OR Apache-2.0
MODCARGO_CRATES +=	futures-core	0.3.25	# MIT OR Apache-2.0
MODCARGO_CRATES +=	futures-executor	0.3.25	# MIT OR Apache-2.0
MODCARGO_CRATES +=	futures-io	0.3.25	# MIT OR Apache-2.0
MODCARGO_CRATES +=	futures-macro	0.3.25	# MIT OR Apache-2.0
MODCARGO_CRATES +=	futures-sink	0.3.25	# MIT OR Apache-2.0
MODCARGO_CRATES +=	futures-task	0.3.25	# MIT OR Apache-2.0
MODCARGO_CRATES +=	futures-util	0.3.25	# MIT OR Apache-2.0
MODCARGO_CRATES +=	fxhash	0.2.1	# Apache-2.0/MIT
MODCARGO_CRATES +=	generic-array	0.14.6	# MIT
MODCARGO_CRATES +=	getrandom	0.2.8	# MIT OR Apache-2.0
MODCARGO_CRATES +=	h2	0.3.15	# MIT
MODCARGO_CRATES +=	hashbrown	0.12.3	# MIT OR Apache-2.0
MODCARGO_CRATES +=	hermit-abi	0.1.19	# MIT/Apache-2.0
MODCARGO_CRATES +=	http	0.2.8	# MIT OR Apache-2.0
MODCARGO_CRATES +=	http-body	0.4.5	# MIT
MODCARGO_CRATES +=	httparse	1.8.0	# MIT/Apache-2.0
MODCARGO_CRATES +=	httpdate	1.0.2	# MIT/Apache-2.0
MODCARGO_CRATES +=	hyper	0.14.20	# MIT
MODCARGO_CRATES +=	hyper-rustls	0.23.0	# Apache-2.0/ISC/MIT
MODCARGO_CRATES +=	iana-time-zone	0.1.53	# MIT OR Apache-2.0
MODCARGO_CRATES +=	iana-time-zone-haiku	0.1.1	# MIT OR Apache-2.0
MODCARGO_CRATES +=	idna	0.3.0	# MIT OR Apache-2.0
MODCARGO_CRATES +=	indexmap	1.9.1	# Apache-2.0 OR MIT
MODCARGO_CRATES +=	instant	0.1.12	# BSD-3-Clause
MODCARGO_CRATES +=	ipnet	2.5.0	# MIT OR Apache-2.0
MODCARGO_CRATES +=	itoa	1.0.4	# MIT OR Apache-2.0
MODCARGO_CRATES +=	js-sys	0.3.60	# MIT/Apache-2.0
MODCARGO_CRATES +=	lazy_static	1.4.0	# MIT/Apache-2.0
MODCARGO_CRATES +=	libc	0.2.137	# MIT OR Apache-2.0
MODCARGO_CRATES +=	link-cplusplus	1.0.7	# MIT OR Apache-2.0
MODCARGO_CRATES +=	lock_api	0.4.9	# MIT OR Apache-2.0
MODCARGO_CRATES +=	log	0.4.17	# MIT OR Apache-2.0
MODCARGO_CRATES +=	md5	0.7.0	# Apache-2.0/MIT
MODCARGO_CRATES +=	memchr	2.5.0	# Unlicense/MIT
MODCARGO_CRATES +=	memoffset	0.6.5	# MIT
MODCARGO_CRATES +=	mime	0.3.16	# MIT/Apache-2.0
MODCARGO_CRATES +=	mio	0.8.5	# MIT
MODCARGO_CRATES +=	nu-ansi-term	0.46.0	# MIT
MODCARGO_CRATES +=	num-integer	0.1.45	# MIT OR Apache-2.0
MODCARGO_CRATES +=	num-traits	0.2.15	# MIT OR Apache-2.0
MODCARGO_CRATES +=	num_cpus	1.13.1	# MIT OR Apache-2.0
MODCARGO_CRATES +=	once_cell	1.16.0	# MIT OR Apache-2.0
MODCARGO_CRATES +=	overload	0.1.1	# MIT
MODCARGO_CRATES +=	parking_lot	0.11.2	# Apache-2.0/MIT
MODCARGO_CRATES +=	parking_lot	0.12.1	# MIT OR Apache-2.0
MODCARGO_CRATES +=	parking_lot_core	0.8.5	# Apache-2.0/MIT
MODCARGO_CRATES +=	parking_lot_core	0.9.4	# MIT OR Apache-2.0
MODCARGO_CRATES +=	percent-encoding	2.2.0	# MIT OR Apache-2.0
MODCARGO_CRATES +=	pin-project-lite	0.2.9	# Apache-2.0 OR MIT
MODCARGO_CRATES +=	pin-utils	0.1.0	# MIT OR Apache-2.0
MODCARGO_CRATES +=	ppv-lite86	0.2.16	# MIT/Apache-2.0
MODCARGO_CRATES +=	proc-macro2	1.0.47	# MIT OR Apache-2.0
MODCARGO_CRATES +=	quote	1.0.21	# MIT OR Apache-2.0
MODCARGO_CRATES +=	rand	0.8.5	# MIT OR Apache-2.0
MODCARGO_CRATES +=	rand_chacha	0.3.1	# MIT OR Apache-2.0
MODCARGO_CRATES +=	rand_core	0.6.4	# MIT OR Apache-2.0
MODCARGO_CRATES +=	rayon	1.5.3	# MIT OR Apache-2.0
MODCARGO_CRATES +=	rayon-core	1.9.3	# MIT OR Apache-2.0
MODCARGO_CRATES +=	redox_syscall	0.2.16	# MIT
MODCARGO_CRATES +=	ring	0.16.20	# LICENSE
MODCARGO_CRATES +=	rustls	0.20.7	# Apache-2.0/ISC/MIT
MODCARGO_CRATES +=	rustls-pemfile	1.0.1	# Apache-2.0 OR ISC OR MIT
MODCARGO_CRATES +=	ryu	1.0.11	# Apache-2.0 OR BSL-1.0
MODCARGO_CRATES +=	scopeguard	1.1.0	# MIT/Apache-2.0
MODCARGO_CRATES +=	scratch	1.0.2	# MIT OR Apache-2.0
MODCARGO_CRATES +=	sct	0.7.0	# Apache-2.0/ISC/MIT
MODCARGO_CRATES +=	serde	1.0.147	# MIT OR Apache-2.0
MODCARGO_CRATES +=	serde_derive	1.0.147	# MIT OR Apache-2.0
MODCARGO_CRATES +=	serde_json	1.0.87	# MIT OR Apache-2.0
MODCARGO_CRATES +=	serde_urlencoded	0.7.1	# MIT/Apache-2.0
MODCARGO_CRATES +=	sha-1	0.10.0	# MIT OR Apache-2.0
MODCARGO_CRATES +=	sharded-slab	0.1.4	# MIT
MODCARGO_CRATES +=	signal-hook-registry	1.4.0	# Apache-2.0/MIT
MODCARGO_CRATES +=	slab	0.4.7	# MIT
MODCARGO_CRATES +=	sled	0.34.7	# MIT/Apache-2.0
MODCARGO_CRATES +=	smallvec	1.10.0	# MIT OR Apache-2.0
MODCARGO_CRATES +=	socket2	0.4.7	# MIT OR Apache-2.0
MODCARGO_CRATES +=	spin	0.5.2	# MIT
MODCARGO_CRATES +=	syn	1.0.103	# MIT OR Apache-2.0
MODCARGO_CRATES +=	termcolor	1.1.3	# Unlicense OR MIT
MODCARGO_CRATES +=	thiserror	1.0.37	# MIT OR Apache-2.0
MODCARGO_CRATES +=	thiserror-impl	1.0.37	# MIT OR Apache-2.0
MODCARGO_CRATES +=	thread_local	1.1.4	# Apache-2.0/MIT
MODCARGO_CRATES +=	time	0.1.44	# MIT/Apache-2.0
MODCARGO_CRATES +=	tinyvec	1.6.0	# Zlib OR Apache-2.0 OR MIT
MODCARGO_CRATES +=	tinyvec_macros	0.1.0	# MIT OR Apache-2.0 OR Zlib
MODCARGO_CRATES +=	tokio	1.21.2	# MIT
MODCARGO_CRATES +=	tokio-macros	1.8.0	# MIT
MODCARGO_CRATES +=	tokio-rustls	0.23.4	# MIT/Apache-2.0
MODCARGO_CRATES +=	tokio-tungstenite	0.17.2	# MIT
MODCARGO_CRATES +=	tokio-util	0.7.4	# MIT
MODCARGO_CRATES +=	tower-service	0.3.2	# MIT
MODCARGO_CRATES +=	tracing	0.1.37	# MIT
MODCARGO_CRATES +=	tracing-attributes	0.1.23	# MIT
MODCARGO_CRATES +=	tracing-core	0.1.30	# MIT
MODCARGO_CRATES +=	tracing-log	0.1.3	# MIT
MODCARGO_CRATES +=	tracing-subscriber	0.3.16	# MIT
MODCARGO_CRATES +=	try-lock	0.2.3	# MIT
MODCARGO_CRATES +=	tungstenite	0.17.3	# MIT/Apache-2.0
MODCARGO_CRATES +=	typenum	1.15.0	# MIT OR Apache-2.0
MODCARGO_CRATES +=	unicode-bidi	0.3.8	# MIT OR Apache-2.0
MODCARGO_CRATES +=	unicode-ident	1.0.5	# (MIT OR Apache-2.0) AND Unicode-DFS-2016
MODCARGO_CRATES +=	unicode-normalization	0.1.22	# MIT/Apache-2.0
MODCARGO_CRATES +=	unicode-width	0.1.10	# MIT/Apache-2.0
MODCARGO_CRATES +=	untrusted	0.7.1	# ISC
MODCARGO_CRATES +=	url	2.3.1	# MIT OR Apache-2.0
MODCARGO_CRATES +=	utf-8	0.7.6	# MIT OR Apache-2.0
MODCARGO_CRATES +=	valuable	0.1.0	# MIT
MODCARGO_CRATES +=	version_check	0.9.4	# MIT/Apache-2.0
MODCARGO_CRATES +=	want	0.3.0	# MIT
MODCARGO_CRATES +=	wasi	0.10.0+wasi-snapshot-preview1	# Apache-2.0 WITH LLVM-exception OR Apache-2.0 OR MIT
MODCARGO_CRATES +=	wasi	0.11.0+wasi-snapshot-preview1	# Apache-2.0 WITH LLVM-exception OR Apache-2.0 OR MIT
MODCARGO_CRATES +=	wasm-bindgen	0.2.83	# MIT/Apache-2.0
MODCARGO_CRATES +=	wasm-bindgen-backend	0.2.83	# MIT/Apache-2.0
MODCARGO_CRATES +=	wasm-bindgen-futures	0.4.33	# MIT/Apache-2.0
MODCARGO_CRATES +=	wasm-bindgen-macro	0.2.83	# MIT/Apache-2.0
MODCARGO_CRATES +=	wasm-bindgen-macro-support	0.2.83	# MIT/Apache-2.0
MODCARGO_CRATES +=	wasm-bindgen-shared	0.2.83	# MIT/Apache-2.0
MODCARGO_CRATES +=	web-sys	0.3.60	# MIT/Apache-2.0
MODCARGO_CRATES +=	webpki	0.22.0	# LICENSE
MODCARGO_CRATES +=	webpki-roots	0.22.5	# MPL-2.0
MODCARGO_CRATES +=	winapi	0.3.9	# MIT/Apache-2.0
MODCARGO_CRATES +=	winapi-i686-pc-windows-gnu	0.4.0	# MIT/Apache-2.0
MODCARGO_CRATES +=	winapi-util	0.1.5	# Unlicense/MIT
MODCARGO_CRATES +=	winapi-x86_64-pc-windows-gnu	0.4.0	# MIT/Apache-2.0
MODCARGO_CRATES +=	windows-sys	0.42.0	# MIT OR Apache-2.0
MODCARGO_CRATES +=	windows_aarch64_gnullvm	0.42.0	# MIT OR Apache-2.0
MODCARGO_CRATES +=	windows_aarch64_msvc	0.42.0	# MIT OR Apache-2.0
MODCARGO_CRATES +=	windows_i686_gnu	0.42.0	# MIT OR Apache-2.0
MODCARGO_CRATES +=	windows_i686_msvc	0.42.0	# MIT OR Apache-2.0
MODCARGO_CRATES +=	windows_x86_64_gnu	0.42.0	# MIT OR Apache-2.0
MODCARGO_CRATES +=	windows_x86_64_gnullvm	0.42.0	# MIT OR Apache-2.0
MODCARGO_CRATES +=	windows_x86_64_msvc	0.42.0	# MIT OR Apache-2.0
MODCARGO_CRATES +=	winreg	0.10.1	# MIT
