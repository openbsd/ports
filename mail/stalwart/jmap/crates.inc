MODCARGO_CRATES +=	actix	0.13.0	# MIT OR Apache-2.0
MODCARGO_CRATES +=	actix-codec	0.5.0	# MIT OR Apache-2.0
MODCARGO_CRATES +=	actix-cors	0.6.3	# MIT OR Apache-2.0
MODCARGO_CRATES +=	actix-http	3.2.2	# MIT OR Apache-2.0
MODCARGO_CRATES +=	actix-macros	0.2.3	# MIT OR Apache-2.0
MODCARGO_CRATES +=	actix-router	0.5.1	# MIT OR Apache-2.0
MODCARGO_CRATES +=	actix-rt	2.7.0	# MIT OR Apache-2.0
MODCARGO_CRATES +=	actix-server	2.1.1	# MIT OR Apache-2.0
MODCARGO_CRATES +=	actix-service	2.0.2	# MIT OR Apache-2.0
MODCARGO_CRATES +=	actix-tls	3.0.3	# MIT OR Apache-2.0
MODCARGO_CRATES +=	actix-utils	3.0.1	# MIT OR Apache-2.0
MODCARGO_CRATES +=	actix-web	4.2.1	# MIT OR Apache-2.0
MODCARGO_CRATES +=	actix-web-actors	4.1.0	# MIT OR Apache-2.0
MODCARGO_CRATES +=	actix-web-codegen	4.1.0	# MIT OR Apache-2.0
MODCARGO_CRATES +=	actix_derive	0.6.0	# MIT OR Apache-2.0
MODCARGO_CRATES +=	adler	1.0.2	# 0BSD OR MIT OR Apache-2.0
MODCARGO_CRATES +=	adler32	1.2.0	# Zlib
MODCARGO_CRATES +=	adobe-cmap-parser	0.3.3	# MIT
MODCARGO_CRATES +=	aead	0.5.1	# MIT OR Apache-2.0
MODCARGO_CRATES +=	aes	0.8.2	# MIT OR Apache-2.0
MODCARGO_CRATES +=	aes-gcm	0.10.1	# Apache-2.0 OR MIT
MODCARGO_CRATES +=	aes-gcm-siv	0.11.1	# MIT OR Apache-2.0
MODCARGO_CRATES +=	ahash	0.7.6	# MIT OR Apache-2.0
MODCARGO_CRATES +=	ahash	0.8.0	# MIT OR Apache-2.0
MODCARGO_CRATES +=	aho-corasick	0.7.19	# Unlicense/MIT
MODCARGO_CRATES +=	alloc-no-stdlib	2.0.4	# BSD-3-Clause
MODCARGO_CRATES +=	alloc-stdlib	0.2.2	# BSD-3-Clause
MODCARGO_CRATES +=	android_system_properties	0.1.5	# MIT/Apache-2.0
MODCARGO_CRATES +=	ar	0.9.0	# MIT
MODCARGO_CRATES +=	arrayref	0.3.6	# BSD-2-Clause
MODCARGO_CRATES +=	arrayvec	0.7.2	# MIT OR Apache-2.0
MODCARGO_CRATES +=	async-io	1.9.0	# Apache-2.0 OR MIT
MODCARGO_CRATES +=	async-lock	2.6.0	# Apache-2.0 OR MIT
MODCARGO_CRATES +=	async-stream	0.3.3	# MIT
MODCARGO_CRATES +=	async-stream-impl	0.3.3	# MIT
MODCARGO_CRATES +=	atty	0.2.14	# MIT
MODCARGO_CRATES +=	autocfg	1.1.0	# Apache-2.0 OR MIT
MODCARGO_CRATES +=	base-x	0.2.11	# MIT
MODCARGO_CRATES +=	base16ct	0.1.1	# Apache-2.0 OR MIT
MODCARGO_CRATES +=	base64	0.13.1	# MIT/Apache-2.0
MODCARGO_CRATES +=	base64ct	1.5.3	# Apache-2.0 OR MIT
MODCARGO_CRATES +=	bincode	1.3.3	# MIT
MODCARGO_CRATES +=	bindgen	0.60.1	# BSD-3-Clause
MODCARGO_CRATES +=	bitflags	1.3.2	# MIT/Apache-2.0
MODCARGO_CRATES +=	bitpacking	0.8.4	# MIT
MODCARGO_CRATES +=	blake2b_simd	1.0.0	# MIT
MODCARGO_CRATES +=	blake3	1.3.1	# CC0-1.0 OR Apache-2.0
MODCARGO_CRATES +=	block-buffer	0.10.3	# MIT OR Apache-2.0
MODCARGO_CRATES +=	brotli	3.3.4	# BSD-3-Clause/MIT
MODCARGO_CRATES +=	brotli-decompressor	2.3.2	# BSD-3-Clause/MIT
MODCARGO_CRATES +=	bstr	0.2.17	# MIT OR Apache-2.0
MODCARGO_CRATES +=	bumpalo	3.11.1	# MIT/Apache-2.0
MODCARGO_CRATES +=	bytecount	0.6.3	# Apache-2.0/MIT
MODCARGO_CRATES +=	bytemuck	1.12.1	# Zlib OR Apache-2.0 OR MIT
MODCARGO_CRATES +=	byteorder	1.4.3	# Unlicense OR MIT
MODCARGO_CRATES +=	bytes	1.2.1	# MIT
MODCARGO_CRATES +=	bytestring	1.1.0	# MIT OR Apache-2.0
MODCARGO_CRATES +=	bzip2-sys	0.1.11+1.0.8	# MIT/Apache-2.0
MODCARGO_CRATES +=	cache-padded	1.2.0	# Apache-2.0 OR MIT
MODCARGO_CRATES +=	camino	1.1.1	# MIT OR Apache-2.0
MODCARGO_CRATES +=	cargo-deb	1.40.5	# MIT
MODCARGO_CRATES +=	cargo-platform	0.1.2	# MIT OR Apache-2.0
MODCARGO_CRATES +=	cargo_metadata	0.14.2	# MIT
MODCARGO_CRATES +=	cargo_toml	0.13.0	# Apache-2.0 OR MIT
MODCARGO_CRATES +=	cc	1.0.73	# MIT/Apache-2.0
MODCARGO_CRATES +=	cedarwood	0.4.6	# BSD-2-Clause
MODCARGO_CRATES +=	cexpr	0.6.0	# Apache-2.0/MIT
MODCARGO_CRATES +=	cfg-if	1.0.0	# MIT/Apache-2.0
MODCARGO_CRATES +=	chrono	0.4.22	# MIT/Apache-2.0
MODCARGO_CRATES +=	cipher	0.4.3	# MIT OR Apache-2.0
MODCARGO_CRATES +=	clang-sys	1.4.0	# Apache-2.0
MODCARGO_CRATES +=	codespan-reporting	0.11.1	# Apache-2.0
MODCARGO_CRATES +=	concurrent-queue	1.2.4	# Apache-2.0 OR MIT
MODCARGO_CRATES +=	const-oid	0.7.1	# Apache-2.0 OR MIT
MODCARGO_CRATES +=	const-oid	0.9.0	# Apache-2.0 OR MIT
MODCARGO_CRATES +=	const_fn	0.4.9	# Apache-2.0 OR MIT
MODCARGO_CRATES +=	constant_time_eq	0.1.5	# CC0-1.0
MODCARGO_CRATES +=	convert_case	0.4.0	# MIT
MODCARGO_CRATES +=	cookie	0.16.1	# MIT OR Apache-2.0
MODCARGO_CRATES +=	core-foundation-sys	0.8.3	# MIT / Apache-2.0
MODCARGO_CRATES +=	cpufeatures	0.2.5	# MIT OR Apache-2.0
MODCARGO_CRATES +=	crc	3.0.0	# MIT OR Apache-2.0
MODCARGO_CRATES +=	crc-catalog	2.1.0	# MIT OR Apache-2.0
MODCARGO_CRATES +=	crc32fast	1.3.2	# MIT OR Apache-2.0
MODCARGO_CRATES +=	crossbeam-channel	0.5.6	# MIT OR Apache-2.0
MODCARGO_CRATES +=	crossbeam-deque	0.8.2	# MIT OR Apache-2.0
MODCARGO_CRATES +=	crossbeam-epoch	0.9.11	# MIT OR Apache-2.0
MODCARGO_CRATES +=	crossbeam-utils	0.8.12	# MIT OR Apache-2.0
MODCARGO_CRATES +=	crunchy	0.2.2	# MIT
MODCARGO_CRATES +=	crypto-bigint	0.3.2	# Apache-2.0 OR MIT
MODCARGO_CRATES +=	crypto-bigint	0.4.9	# Apache-2.0 OR MIT
MODCARGO_CRATES +=	crypto-common	0.1.6	# MIT OR Apache-2.0
MODCARGO_CRATES +=	csv	1.1.6	# Unlicense/MIT
MODCARGO_CRATES +=	csv-core	0.1.10	# Unlicense/MIT
MODCARGO_CRATES +=	ctr	0.9.2	# MIT OR Apache-2.0
MODCARGO_CRATES +=	cxx	1.0.80	# MIT OR Apache-2.0
MODCARGO_CRATES +=	cxx-build	1.0.80	# MIT OR Apache-2.0
MODCARGO_CRATES +=	cxxbridge-flags	1.0.80	# MIT OR Apache-2.0
MODCARGO_CRATES +=	cxxbridge-macro	1.0.80	# MIT OR Apache-2.0
MODCARGO_CRATES +=	der	0.5.1	# Apache-2.0 OR MIT
MODCARGO_CRATES +=	der	0.6.0	# Apache-2.0 OR MIT
MODCARGO_CRATES +=	derive_more	0.99.17	# MIT
MODCARGO_CRATES +=	digest	0.10.5	# MIT OR Apache-2.0
MODCARGO_CRATES +=	discard	1.0.4	# MIT
MODCARGO_CRATES +=	dtoa	0.4.8	# MIT OR Apache-2.0
MODCARGO_CRATES +=	ecdsa	0.14.8	# Apache-2.0 OR MIT
MODCARGO_CRATES +=	ece	2.2.0	# MPL-2.0
MODCARGO_CRATES +=	either	1.8.0	# MIT/Apache-2.0
MODCARGO_CRATES +=	elliptic-curve	0.12.3	# Apache-2.0 OR MIT
MODCARGO_CRATES +=	encoding	0.2.33	# MIT
MODCARGO_CRATES +=	encoding-index-japanese	1.20141219.5	# CC0-1.0
MODCARGO_CRATES +=	encoding-index-korean	1.20141219.5	# CC0-1.0
MODCARGO_CRATES +=	encoding-index-simpchinese	1.20141219.5	# CC0-1.0
MODCARGO_CRATES +=	encoding-index-singlebyte	1.20141219.5	# CC0-1.0
MODCARGO_CRATES +=	encoding-index-tradchinese	1.20141219.5	# CC0-1.0
MODCARGO_CRATES +=	encoding_index_tests	0.1.4	# CC0-1.0
MODCARGO_CRATES +=	encoding_rs	0.8.31	# (Apache-2.0 OR MIT) AND BSD-3-Clause
MODCARGO_CRATES +=	env_logger	0.9.1	# MIT OR Apache-2.0
MODCARGO_CRATES +=	error-chain	0.12.4	# MIT/Apache-2.0
MODCARGO_CRATES +=	euclid	0.20.14	# MIT / Apache-2.0
MODCARGO_CRATES +=	event-listener	2.5.3	# Apache-2.0 OR MIT
MODCARGO_CRATES +=	fastrand	1.8.0	# Apache-2.0 OR MIT
MODCARGO_CRATES +=	ff	0.12.0	# MIT/Apache-2.0
MODCARGO_CRATES +=	filetime	0.2.18	# MIT/Apache-2.0
MODCARGO_CRATES +=	flate2	1.0.24	# MIT OR Apache-2.0
MODCARGO_CRATES +=	fnv	1.0.7	# Apache-2.0 / MIT
MODCARGO_CRATES +=	foreign-types	0.3.2	# MIT/Apache-2.0
MODCARGO_CRATES +=	foreign-types-shared	0.1.1	# MIT/Apache-2.0
MODCARGO_CRATES +=	form_urlencoded	1.1.0	# MIT OR Apache-2.0
MODCARGO_CRATES +=	futures	0.3.25	# MIT OR Apache-2.0
MODCARGO_CRATES +=	futures-channel	0.3.25	# MIT OR Apache-2.0
MODCARGO_CRATES +=	futures-core	0.3.25	# MIT OR Apache-2.0
MODCARGO_CRATES +=	futures-executor	0.3.25	# MIT OR Apache-2.0
MODCARGO_CRATES +=	futures-io	0.3.25	# MIT OR Apache-2.0
MODCARGO_CRATES +=	futures-lite	1.12.0	# Apache-2.0 OR MIT
MODCARGO_CRATES +=	futures-macro	0.3.25	# MIT OR Apache-2.0
MODCARGO_CRATES +=	futures-sink	0.3.25	# MIT OR Apache-2.0
MODCARGO_CRATES +=	futures-task	0.3.25	# MIT OR Apache-2.0
MODCARGO_CRATES +=	futures-util	0.3.25	# MIT OR Apache-2.0
MODCARGO_CRATES +=	fxhash	0.2.1	# Apache-2.0/MIT
MODCARGO_CRATES +=	generic-array	0.14.6	# MIT
MODCARGO_CRATES +=	gethostname	0.2.3	# Apache-2.0
MODCARGO_CRATES +=	gethostname	0.3.0	# Apache-2.0
MODCARGO_CRATES +=	gethostname	0.4.0	# Apache-2.0
MODCARGO_CRATES +=	getopts	0.2.21	# MIT/Apache-2.0
MODCARGO_CRATES +=	getrandom	0.2.8	# MIT OR Apache-2.0
MODCARGO_CRATES +=	ghash	0.5.0	# Apache-2.0 OR MIT
MODCARGO_CRATES +=	glob	0.3.0	# MIT/Apache-2.0
MODCARGO_CRATES +=	group	0.12.1	# MIT/Apache-2.0
MODCARGO_CRATES +=	h2	0.3.15	# MIT
MODCARGO_CRATES +=	hashbrown	0.12.3	# MIT OR Apache-2.0
MODCARGO_CRATES +=	hermit-abi	0.1.19	# MIT/Apache-2.0
MODCARGO_CRATES +=	hex	0.4.3	# MIT OR Apache-2.0
MODCARGO_CRATES +=	hkdf	0.12.3	# MIT OR Apache-2.0
MODCARGO_CRATES +=	hmac	0.12.1	# MIT OR Apache-2.0
MODCARGO_CRATES +=	http	0.2.8	# MIT OR Apache-2.0
MODCARGO_CRATES +=	http-body	0.4.5	# MIT
MODCARGO_CRATES +=	httparse	1.8.0	# MIT/Apache-2.0
MODCARGO_CRATES +=	httpdate	1.0.2	# MIT/Apache-2.0
MODCARGO_CRATES +=	humantime	2.1.0	# MIT/Apache-2.0
MODCARGO_CRATES +=	hyper	0.14.20	# MIT
MODCARGO_CRATES +=	hyper-rustls	0.23.0	# Apache-2.0/ISC/MIT
MODCARGO_CRATES +=	iana-time-zone	0.1.52	# MIT OR Apache-2.0
MODCARGO_CRATES +=	iana-time-zone-haiku	0.1.1	# MIT OR Apache-2.0
MODCARGO_CRATES +=	idna	0.3.0	# MIT OR Apache-2.0
MODCARGO_CRATES +=	indexmap	1.9.1	# Apache-2.0 OR MIT
MODCARGO_CRATES +=	inout	0.1.3	# MIT OR Apache-2.0
MODCARGO_CRATES +=	instant	0.1.12	# BSD-3-Clause
MODCARGO_CRATES +=	ipnet	2.5.0	# MIT OR Apache-2.0
MODCARGO_CRATES +=	iter-read	0.3.1	# MIT/Apache-2.0
MODCARGO_CRATES +=	itertools	0.10.5	# MIT/Apache-2.0
MODCARGO_CRATES +=	itoa	0.4.8	# MIT OR Apache-2.0
MODCARGO_CRATES +=	itoa	1.0.4	# MIT OR Apache-2.0
MODCARGO_CRATES +=	jieba-rs	0.6.7	# MIT
MODCARGO_CRATES +=	jobserver	0.1.25	# MIT/Apache-2.0
MODCARGO_CRATES +=	js-sys	0.3.60	# MIT/Apache-2.0
MODCARGO_CRATES +=	language-tags	0.3.2	# MIT/Apache-2.0
MODCARGO_CRATES +=	lazy_static	1.4.0	# MIT/Apache-2.0
MODCARGO_CRATES +=	lazycell	1.3.0	# MIT/Apache-2.0
MODCARGO_CRATES +=	libc	0.2.137	# MIT OR Apache-2.0
MODCARGO_CRATES +=	libloading	0.7.3	# ISC
MODCARGO_CRATES +=	libm	0.2.5	# MIT OR Apache-2.0
MODCARGO_CRATES +=	librocksdb-sys	0.8.0+7.4.4	# MIT/Apache-2.0/BSD-3-Clause
MODCARGO_CRATES +=	libz-sys	1.1.8	# MIT OR Apache-2.0
MODCARGO_CRATES +=	link-cplusplus	1.0.7	# MIT OR Apache-2.0
MODCARGO_CRATES +=	linked-hash-map	0.5.3	# MIT/Apache-2.0
MODCARGO_CRATES +=	local-channel	0.1.3	# MIT OR Apache-2.0
MODCARGO_CRATES +=	local-waker	0.1.3	# MIT OR Apache-2.0
MODCARGO_CRATES +=	lock_api	0.4.9	# MIT OR Apache-2.0
MODCARGO_CRATES +=	log	0.4.17	# MIT OR Apache-2.0
MODCARGO_CRATES +=	lopdf	0.26.0	# MIT
MODCARGO_CRATES +=	lz4_flex	0.9.5	# MIT
MODCARGO_CRATES +=	lzma-sys	0.1.19	# MIT/Apache-2.0
MODCARGO_CRATES +=	lzw	0.10.0	# MIT/Apache-2.0
MODCARGO_CRATES +=	mach	0.3.2	# BSD-2-Clause
MODCARGO_CRATES +=	mail-builder	0.2.3	# Apache-2.0 OR MIT
MODCARGO_CRATES +=	maplit	1.0.2	# MIT/Apache-2.0
MODCARGO_CRATES +=	md5	0.7.0	# Apache-2.0/MIT
MODCARGO_CRATES +=	memchr	2.5.0	# Unlicense/MIT
MODCARGO_CRATES +=	memoffset	0.6.5	# MIT
MODCARGO_CRATES +=	mime	0.3.16	# MIT/Apache-2.0
MODCARGO_CRATES +=	minimal-lexical	0.2.1	# MIT/Apache-2.0
MODCARGO_CRATES +=	miniz_oxide	0.5.4	# MIT OR Zlib OR Apache-2.0
MODCARGO_CRATES +=	mio	0.8.5	# MIT
MODCARGO_CRATES +=	moka	0.9.4	# MIT OR Apache-2.0
MODCARGO_CRATES +=	naive-cityhash	0.2.0	# MIT/Apache-2.0
MODCARGO_CRATES +=	nom	7.1.1	# MIT
MODCARGO_CRATES +=	nu-ansi-term	0.46.0	# MIT
MODCARGO_CRATES +=	num-bigint-dig	0.8.1	# MIT/Apache-2.0
MODCARGO_CRATES +=	num-integer	0.1.45	# MIT OR Apache-2.0
MODCARGO_CRATES +=	num-iter	0.1.43	# MIT OR Apache-2.0
MODCARGO_CRATES +=	num-traits	0.2.15	# MIT OR Apache-2.0
MODCARGO_CRATES +=	num_cpus	1.13.1	# MIT OR Apache-2.0
MODCARGO_CRATES +=	num_threads	0.1.6	# MIT OR Apache-2.0
MODCARGO_CRATES +=	once_cell	1.15.0	# MIT OR Apache-2.0
MODCARGO_CRATES +=	opaque-debug	0.3.0	# MIT OR Apache-2.0
MODCARGO_CRATES +=	openssl	0.10.42	# Apache-2.0
MODCARGO_CRATES +=	openssl-macros	0.1.0	# MIT/Apache-2.0
MODCARGO_CRATES +=	openssl-sys	0.9.77	# MIT
MODCARGO_CRATES +=	overload	0.1.1	# MIT
MODCARGO_CRATES +=	p256	0.11.1	# Apache-2.0 OR MIT
MODCARGO_CRATES +=	parking	2.0.0	# Apache-2.0 OR MIT
MODCARGO_CRATES +=	parking_lot	0.12.1	# MIT OR Apache-2.0
MODCARGO_CRATES +=	parking_lot_core	0.9.4	# MIT OR Apache-2.0
MODCARGO_CRATES +=	paste	1.0.9	# MIT OR Apache-2.0
MODCARGO_CRATES +=	pdf-extract	0.6.4	# MIT
MODCARGO_CRATES +=	peeking_take_while	0.1.2	# Apache-2.0/MIT
MODCARGO_CRATES +=	pem-rfc7468	0.3.1	# Apache-2.0 OR MIT
MODCARGO_CRATES +=	percent-encoding	2.2.0	# MIT OR Apache-2.0
MODCARGO_CRATES +=	phf	0.11.1	# MIT
MODCARGO_CRATES +=	phf_codegen	0.11.1	# MIT
MODCARGO_CRATES +=	phf_generator	0.11.1	# MIT
MODCARGO_CRATES +=	phf_macros	0.11.1	# MIT
MODCARGO_CRATES +=	phf_shared	0.11.1	# MIT
MODCARGO_CRATES +=	pin-project-lite	0.2.9	# Apache-2.0 OR MIT
MODCARGO_CRATES +=	pin-utils	0.1.0	# MIT OR Apache-2.0
MODCARGO_CRATES +=	pkcs1	0.3.3	# Apache-2.0 OR MIT
MODCARGO_CRATES +=	pkcs8	0.8.0	# Apache-2.0 OR MIT
MODCARGO_CRATES +=	pkcs8	0.9.0	# Apache-2.0 OR MIT
MODCARGO_CRATES +=	pkg-config	0.3.26	# MIT OR Apache-2.0
MODCARGO_CRATES +=	polling	2.4.0	# Apache-2.0 OR MIT
MODCARGO_CRATES +=	polyval	0.6.0	# Apache-2.0 OR MIT
MODCARGO_CRATES +=	pom	1.1.0	# MIT
MODCARGO_CRATES +=	pom	3.2.0	# MIT
MODCARGO_CRATES +=	postscript	0.14.0	# Apache-2.0/MIT
MODCARGO_CRATES +=	ppv-lite86	0.2.16	# MIT/Apache-2.0
MODCARGO_CRATES +=	proc-macro-hack	0.5.19	# MIT OR Apache-2.0
MODCARGO_CRATES +=	proc-macro2	1.0.47	# MIT OR Apache-2.0
MODCARGO_CRATES +=	pulldown-cmark	0.9.2	# MIT
MODCARGO_CRATES +=	quanta	0.10.1	# MIT
MODCARGO_CRATES +=	quick-error	2.0.1	# MIT/Apache-2.0
MODCARGO_CRATES +=	quote	1.0.21	# MIT OR Apache-2.0
MODCARGO_CRATES +=	rand	0.8.5	# MIT OR Apache-2.0
MODCARGO_CRATES +=	rand_chacha	0.3.1	# MIT OR Apache-2.0
MODCARGO_CRATES +=	rand_core	0.6.4	# MIT OR Apache-2.0
MODCARGO_CRATES +=	raw-cpuid	10.6.0	# MIT
MODCARGO_CRATES +=	rayon	1.5.3	# MIT OR Apache-2.0
MODCARGO_CRATES +=	rayon-core	1.9.3	# MIT OR Apache-2.0
MODCARGO_CRATES +=	redox_syscall	0.2.16	# MIT
MODCARGO_CRATES +=	regex	1.6.0	# MIT OR Apache-2.0
MODCARGO_CRATES +=	regex-automata	0.1.10	# Unlicense/MIT
MODCARGO_CRATES +=	regex-syntax	0.6.27	# MIT OR Apache-2.0
MODCARGO_CRATES +=	remove_dir_all	0.5.3	# MIT/Apache-2.0
MODCARGO_CRATES +=	reqwest	0.11.12	# MIT/Apache-2.0
MODCARGO_CRATES +=	retain_mut	0.1.7	# MIT
MODCARGO_CRATES +=	rfc6979	0.3.0	# Apache-2.0 OR MIT
MODCARGO_CRATES +=	ring	0.16.20	# LICENSE
MODCARGO_CRATES +=	roaring	0.10.1	# MIT OR Apache-2.0
MODCARGO_CRATES +=	rocksdb	0.19.0	# Apache-2.0
MODCARGO_CRATES +=	rsa	0.6.1	# MIT OR Apache-2.0
MODCARGO_CRATES +=	rust-argon2	1.0.0	# MIT/Apache-2.0
MODCARGO_CRATES +=	rust-stemmers	1.2.0	# MIT/BSD-3-Clause
MODCARGO_CRATES +=	rustc-hash	1.1.0	# Apache-2.0/MIT
MODCARGO_CRATES +=	rustc_version	0.2.3	# MIT/Apache-2.0
MODCARGO_CRATES +=	rustc_version	0.4.0	# MIT/Apache-2.0
MODCARGO_CRATES +=	rustls	0.20.7	# Apache-2.0/ISC/MIT
MODCARGO_CRATES +=	rustls-pemfile	1.0.1	# Apache-2.0 OR ISC OR MIT
MODCARGO_CRATES +=	ryu	1.0.11	# Apache-2.0 OR BSL-1.0
MODCARGO_CRATES +=	same-file	1.0.6	# Unlicense/MIT
MODCARGO_CRATES +=	scheduled-thread-pool	0.2.6	# MIT/Apache-2.0
MODCARGO_CRATES +=	scopeguard	1.1.0	# MIT/Apache-2.0
MODCARGO_CRATES +=	scratch	1.0.2	# MIT OR Apache-2.0
MODCARGO_CRATES +=	sct	0.7.0	# Apache-2.0/ISC/MIT
MODCARGO_CRATES +=	sec1	0.3.0	# Apache-2.0 OR MIT
MODCARGO_CRATES +=	semver	0.9.0	# MIT/Apache-2.0
MODCARGO_CRATES +=	semver	1.0.14	# MIT OR Apache-2.0
MODCARGO_CRATES +=	semver-parser	0.7.0	# MIT/Apache-2.0
MODCARGO_CRATES +=	serde	1.0.147	# MIT OR Apache-2.0
MODCARGO_CRATES +=	serde_derive	1.0.147	# MIT OR Apache-2.0
MODCARGO_CRATES +=	serde_json	1.0.87	# MIT OR Apache-2.0
MODCARGO_CRATES +=	serde_urlencoded	0.7.1	# MIT/Apache-2.0
MODCARGO_CRATES +=	serde_yaml	0.9.14	# MIT OR Apache-2.0
MODCARGO_CRATES +=	sha-1	0.10.0	# MIT OR Apache-2.0
MODCARGO_CRATES +=	sha1	0.6.1	# BSD-3-Clause
MODCARGO_CRATES +=	sha1	0.10.5	# MIT OR Apache-2.0
MODCARGO_CRATES +=	sha1_smol	1.0.0	# BSD-3-Clause
MODCARGO_CRATES +=	sha2	0.10.6	# MIT OR Apache-2.0
MODCARGO_CRATES +=	sharded-slab	0.1.4	# MIT
MODCARGO_CRATES +=	shlex	1.1.0	# MIT OR Apache-2.0
MODCARGO_CRATES +=	signal-hook-registry	1.4.0	# Apache-2.0/MIT
MODCARGO_CRATES +=	signature	1.6.4	# Apache-2.0 OR MIT
MODCARGO_CRATES +=	siphasher	0.3.10	# MIT/Apache-2.0
MODCARGO_CRATES +=	skeptic	0.13.7	# MIT/Apache-2.0
MODCARGO_CRATES +=	slab	0.4.7	# MIT
MODCARGO_CRATES +=	smallvec	1.10.0	# MIT OR Apache-2.0
MODCARGO_CRATES +=	socket2	0.4.7	# MIT OR Apache-2.0
MODCARGO_CRATES +=	spin	0.5.2	# MIT
MODCARGO_CRATES +=	spki	0.5.4	# Apache-2.0 OR MIT
MODCARGO_CRATES +=	spki	0.6.0	# Apache-2.0 OR MIT
MODCARGO_CRATES +=	standback	0.2.17	# MIT OR Apache-2.0
MODCARGO_CRATES +=	static_assertions	1.1.0	# MIT OR Apache-2.0
MODCARGO_CRATES +=	stdweb	0.4.20	# MIT/Apache-2.0
MODCARGO_CRATES +=	stdweb-derive	0.5.3	# MIT/Apache-2.0
MODCARGO_CRATES +=	stdweb-internal-macros	0.2.9	# MIT/Apache-2.0
MODCARGO_CRATES +=	stdweb-internal-runtime	0.1.5	# MIT/Apache-2.0
MODCARGO_CRATES +=	subtle	2.4.1	# BSD-3-Clause
MODCARGO_CRATES +=	syn	1.0.103	# MIT OR Apache-2.0
MODCARGO_CRATES +=	tagptr	0.2.0	# MIT/Apache-2.0
MODCARGO_CRATES +=	tar	0.4.38	# MIT/Apache-2.0
MODCARGO_CRATES +=	tempfile	3.3.0	# MIT OR Apache-2.0
MODCARGO_CRATES +=	termcolor	1.1.3	# Unlicense OR MIT
MODCARGO_CRATES +=	thiserror	1.0.37	# MIT OR Apache-2.0
MODCARGO_CRATES +=	thiserror-impl	1.0.37	# MIT OR Apache-2.0
MODCARGO_CRATES +=	thread_local	1.1.4	# Apache-2.0/MIT
MODCARGO_CRATES +=	time	0.1.43	# MIT/Apache-2.0
MODCARGO_CRATES +=	time	0.2.27	# MIT OR Apache-2.0
MODCARGO_CRATES +=	time	0.3.16	# MIT OR Apache-2.0
MODCARGO_CRATES +=	time-core	0.1.0	# MIT OR Apache-2.0
MODCARGO_CRATES +=	time-macros	0.1.1	# MIT OR Apache-2.0
MODCARGO_CRATES +=	time-macros	0.2.5	# MIT OR Apache-2.0
MODCARGO_CRATES +=	time-macros-impl	0.1.2	# MIT OR Apache-2.0
MODCARGO_CRATES +=	tinysegmenter	0.1.1	# MIT
MODCARGO_CRATES +=	tinyvec	1.6.0	# Zlib OR Apache-2.0 OR MIT
MODCARGO_CRATES +=	tinyvec_macros	0.1.0	# MIT OR Apache-2.0 OR Zlib
MODCARGO_CRATES +=	tokio	1.21.2	# MIT
MODCARGO_CRATES +=	tokio-macros	1.8.0	# MIT
MODCARGO_CRATES +=	tokio-rustls	0.23.4	# MIT/Apache-2.0
MODCARGO_CRATES +=	tokio-tungstenite	0.17.2	# MIT
MODCARGO_CRATES +=	tokio-util	0.7.4	# MIT
MODCARGO_CRATES +=	toml	0.5.9	# MIT/Apache-2.0
MODCARGO_CRATES +=	tower-service	0.3.2	# MIT
MODCARGO_CRATES +=	tracing	0.1.37	# MIT
MODCARGO_CRATES +=	tracing-attributes	0.1.23	# MIT
MODCARGO_CRATES +=	tracing-core	0.1.30	# MIT
MODCARGO_CRATES +=	tracing-log	0.1.3	# MIT
MODCARGO_CRATES +=	tracing-subscriber	0.3.16	# MIT
MODCARGO_CRATES +=	triomphe	0.1.8	# MIT OR Apache-2.0
MODCARGO_CRATES +=	try-lock	0.2.3	# MIT
MODCARGO_CRATES +=	tungstenite	0.17.3	# MIT/Apache-2.0
MODCARGO_CRATES +=	twox-hash	1.6.3	# MIT
MODCARGO_CRATES +=	type1-encoding-parser	0.1.0	# MIT
MODCARGO_CRATES +=	typed-arena	2.0.1	# MIT
MODCARGO_CRATES +=	typenum	1.15.0	# MIT OR Apache-2.0
MODCARGO_CRATES +=	unicase	2.6.0	# MIT/Apache-2.0
MODCARGO_CRATES +=	unicode-bidi	0.3.8	# MIT OR Apache-2.0
MODCARGO_CRATES +=	unicode-ident	1.0.5	# (MIT OR Apache-2.0) AND Unicode-DFS-2016
MODCARGO_CRATES +=	unicode-normalization	0.1.22	# MIT/Apache-2.0
MODCARGO_CRATES +=	unicode-width	0.1.10	# MIT/Apache-2.0
MODCARGO_CRATES +=	universal-hash	0.5.0	# MIT OR Apache-2.0
MODCARGO_CRATES +=	unsafe-libyaml	0.2.4	# MIT
MODCARGO_CRATES +=	untrusted	0.7.1	# ISC
MODCARGO_CRATES +=	url	2.3.1	# MIT OR Apache-2.0
MODCARGO_CRATES +=	utf-8	0.7.6	# MIT OR Apache-2.0
MODCARGO_CRATES +=	uuid	1.2.1	# Apache-2.0 OR MIT
MODCARGO_CRATES +=	valuable	0.1.0	# MIT
MODCARGO_CRATES +=	vcpkg	0.2.15	# MIT/Apache-2.0
MODCARGO_CRATES +=	version_check	0.9.4	# MIT/Apache-2.0
MODCARGO_CRATES +=	waker-fn	1.1.0	# Apache-2.0 OR MIT
MODCARGO_CRATES +=	walkdir	2.3.2	# Unlicense/MIT
MODCARGO_CRATES +=	want	0.3.0	# MIT
MODCARGO_CRATES +=	wasi	0.10.2+wasi-snapshot-preview1	# Apache-2.0 WITH LLVM-exception OR Apache-2.0 OR MIT
MODCARGO_CRATES +=	wasi	0.11.0+wasi-snapshot-preview1	# Apache-2.0 WITH LLVM-exception OR Apache-2.0 OR MIT
MODCARGO_CRATES +=	wasm-bindgen	0.2.83	# MIT/Apache-2.0
MODCARGO_CRATES +=	wasm-bindgen-backend	0.2.83	# MIT/Apache-2.0
MODCARGO_CRATES +=	wasm-bindgen-futures	0.4.33	# MIT/Apache-2.0
MODCARGO_CRATES +=	wasm-bindgen-macro	0.2.83	# MIT/Apache-2.0
MODCARGO_CRATES +=	wasm-bindgen-macro-support	0.2.83	# MIT/Apache-2.0
MODCARGO_CRATES +=	wasm-bindgen-shared	0.2.83	# MIT/Apache-2.0
MODCARGO_CRATES +=	web-sys	0.3.60	# MIT/Apache-2.0
MODCARGO_CRATES +=	webpki	0.22.0	# LICENSE
MODCARGO_CRATES +=	webpki-roots	0.22.5	# MPL-2.0
MODCARGO_CRATES +=	wepoll-ffi	0.1.2	# MIT OR Apache-2.0 OR BSD-2-Clause
MODCARGO_CRATES +=	whatlang	0.16.2	# MIT
MODCARGO_CRATES +=	winapi	0.3.9	# MIT/Apache-2.0
MODCARGO_CRATES +=	winapi-i686-pc-windows-gnu	0.4.0	# MIT/Apache-2.0
MODCARGO_CRATES +=	winapi-util	0.1.5	# Unlicense/MIT
MODCARGO_CRATES +=	winapi-x86_64-pc-windows-gnu	0.4.0	# MIT/Apache-2.0
MODCARGO_CRATES +=	windows	0.43.0	# MIT OR Apache-2.0
MODCARGO_CRATES +=	windows-sys	0.42.0	# MIT OR Apache-2.0
MODCARGO_CRATES +=	windows_aarch64_gnullvm	0.42.0	# MIT OR Apache-2.0
MODCARGO_CRATES +=	windows_aarch64_msvc	0.42.0	# MIT OR Apache-2.0
MODCARGO_CRATES +=	windows_i686_gnu	0.42.0	# MIT OR Apache-2.0
MODCARGO_CRATES +=	windows_i686_msvc	0.42.0	# MIT OR Apache-2.0
MODCARGO_CRATES +=	windows_x86_64_gnu	0.42.0	# MIT OR Apache-2.0
MODCARGO_CRATES +=	windows_x86_64_gnullvm	0.42.0	# MIT OR Apache-2.0
MODCARGO_CRATES +=	windows_x86_64_msvc	0.42.0	# MIT OR Apache-2.0
MODCARGO_CRATES +=	winreg	0.10.1	# MIT
MODCARGO_CRATES +=	xattr	0.2.3	# MIT/Apache-2.0
MODCARGO_CRATES +=	xxhash-rust	0.8.6	# BSL-1.0
MODCARGO_CRATES +=	xz2	0.1.7	# MIT/Apache-2.0
MODCARGO_CRATES +=	zeroize	1.5.7	# Apache-2.0 OR MIT
MODCARGO_CRATES +=	zopfli	0.7.1	# Apache-2.0
MODCARGO_CRATES +=	zstd	0.11.2+zstd.1.5.2	# MIT
MODCARGO_CRATES +=	zstd-safe	5.0.2+zstd.1.5.2	# MIT/Apache-2.0
MODCARGO_CRATES +=	zstd-sys	2.0.1+zstd.1.5.2	# MIT/Apache-2.0
