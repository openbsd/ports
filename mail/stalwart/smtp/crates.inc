MODCARGO_CRATES +=	adler	1.0.2	# 0BSD OR MIT OR Apache-2.0
MODCARGO_CRATES +=	aes	0.7.5	# MIT OR Apache-2.0
MODCARGO_CRATES +=	ahash	0.7.6	# MIT OR Apache-2.0
MODCARGO_CRATES +=	ahash	0.8.3	# MIT OR Apache-2.0
MODCARGO_CRATES +=	aho-corasick	0.7.20	# Unlicense OR MIT
MODCARGO_CRATES +=	anes	0.1.6	# MIT OR Apache-2.0
MODCARGO_CRATES +=	anyhow	1.0.69	# MIT OR Apache-2.0
MODCARGO_CRATES +=	arrayref	0.3.6	# BSD-2-Clause
MODCARGO_CRATES +=	arrayvec	0.7.2	# MIT OR Apache-2.0
MODCARGO_CRATES +=	asn1-rs	0.5.2	# MIT/Apache-2.0
MODCARGO_CRATES +=	asn1-rs-derive	0.4.0	# MIT/Apache-2.0
MODCARGO_CRATES +=	asn1-rs-impl	0.1.0	# MIT/Apache-2.0
MODCARGO_CRATES +=	async-stream	0.3.4	# MIT
MODCARGO_CRATES +=	async-stream-impl	0.3.4	# MIT
MODCARGO_CRATES +=	async-trait	0.1.66	# MIT OR Apache-2.0
MODCARGO_CRATES +=	atoi	1.0.0	# MIT
MODCARGO_CRATES +=	atty	0.2.14	# MIT
MODCARGO_CRATES +=	autocfg	1.1.0	# Apache-2.0 OR MIT
MODCARGO_CRATES +=	axum	0.6.7	# MIT
MODCARGO_CRATES +=	axum-core	0.3.3	# MIT
MODCARGO_CRATES +=	base64	0.13.1	# MIT/Apache-2.0
MODCARGO_CRATES +=	base64	0.20.0	# MIT OR Apache-2.0
MODCARGO_CRATES +=	base64	0.21.0	# MIT OR Apache-2.0
MODCARGO_CRATES +=	base64ct	1.6.0	# Apache-2.0 OR MIT
MODCARGO_CRATES +=	bincode	1.3.3	# MIT
MODCARGO_CRATES +=	bitflags	1.3.2	# MIT/Apache-2.0
MODCARGO_CRATES +=	blake3	1.3.3	# CC0-1.0 OR Apache-2.0
MODCARGO_CRATES +=	block-buffer	0.10.4	# MIT OR Apache-2.0
MODCARGO_CRATES +=	bumpalo	3.12.0	# MIT/Apache-2.0
MODCARGO_CRATES +=	byteorder	1.4.3	# Unlicense OR MIT
MODCARGO_CRATES +=	bytes	1.4.0	# MIT
MODCARGO_CRATES +=	bzip2	0.4.4	# MIT/Apache-2.0
MODCARGO_CRATES +=	bzip2-sys	0.1.11+1.0.8	# MIT/Apache-2.0
MODCARGO_CRATES +=	cast	0.3.0	# MIT OR Apache-2.0
MODCARGO_CRATES +=	cc	1.0.79	# MIT OR Apache-2.0
MODCARGO_CRATES +=	cfg-if	1.0.0	# MIT/Apache-2.0
MODCARGO_CRATES +=	ciborium	0.2.0	# Apache-2.0
MODCARGO_CRATES +=	ciborium-io	0.2.0	# Apache-2.0
MODCARGO_CRATES +=	ciborium-ll	0.2.0	# Apache-2.0
MODCARGO_CRATES +=	cipher	0.3.0	# MIT OR Apache-2.0
MODCARGO_CRATES +=	clap	3.2.23	# MIT OR Apache-2.0
MODCARGO_CRATES +=	clap_lex	0.2.4	# MIT OR Apache-2.0
MODCARGO_CRATES +=	const-oid	0.7.1	# Apache-2.0 OR MIT
MODCARGO_CRATES +=	constant_time_eq	0.1.5	# CC0-1.0
MODCARGO_CRATES +=	constant_time_eq	0.2.4	# CC0-1.0 OR MIT-0 OR Apache-2.0
MODCARGO_CRATES +=	core-foundation	0.9.3	# MIT / Apache-2.0
MODCARGO_CRATES +=	core-foundation-sys	0.8.3	# MIT / Apache-2.0
MODCARGO_CRATES +=	cpufeatures	0.2.5	# MIT OR Apache-2.0
MODCARGO_CRATES +=	crc	3.0.1	# MIT OR Apache-2.0
MODCARGO_CRATES +=	crc-catalog	2.2.0	# MIT OR Apache-2.0
MODCARGO_CRATES +=	crc32fast	1.3.2	# MIT OR Apache-2.0
MODCARGO_CRATES +=	criterion	0.4.0	# Apache-2.0/MIT
MODCARGO_CRATES +=	criterion-plot	0.5.0	# MIT/Apache-2.0
MODCARGO_CRATES +=	crossbeam-channel	0.5.7	# MIT OR Apache-2.0
MODCARGO_CRATES +=	crossbeam-deque	0.8.3	# MIT OR Apache-2.0
MODCARGO_CRATES +=	crossbeam-epoch	0.9.14	# MIT OR Apache-2.0
MODCARGO_CRATES +=	crossbeam-queue	0.3.8	# MIT OR Apache-2.0
MODCARGO_CRATES +=	crossbeam-utils	0.8.15	# MIT OR Apache-2.0
MODCARGO_CRATES +=	crypto-bigint	0.3.2	# Apache-2.0 OR MIT
MODCARGO_CRATES +=	crypto-common	0.1.6	# MIT OR Apache-2.0
MODCARGO_CRATES +=	dashmap	5.4.0	# MIT
MODCARGO_CRATES +=	data-encoding	2.3.3	# MIT
MODCARGO_CRATES +=	der	0.5.1	# Apache-2.0 OR MIT
MODCARGO_CRATES +=	der-parser	8.2.0	# MIT/Apache-2.0
MODCARGO_CRATES +=	digest	0.10.6	# MIT OR Apache-2.0
MODCARGO_CRATES +=	dirs	4.0.0	# MIT OR Apache-2.0
MODCARGO_CRATES +=	dirs-sys	0.3.7	# MIT OR Apache-2.0
MODCARGO_CRATES +=	displaydoc	0.2.3	# MIT OR Apache-2.0
MODCARGO_CRATES +=	dotenvy	0.15.6	# MIT
MODCARGO_CRATES +=	either	1.8.1	# MIT OR Apache-2.0
MODCARGO_CRATES +=	encoding_rs	0.8.32	# (Apache-2.0 OR MIT) AND BSD-3-Clause
MODCARGO_CRATES +=	enum-as-inner	0.5.1	# MIT/Apache-2.0
MODCARGO_CRATES +=	errno	0.2.8	# MIT/Apache-2.0
MODCARGO_CRATES +=	errno-dragonfly	0.1.2	# MIT
MODCARGO_CRATES +=	event-listener	2.5.3	# Apache-2.0 OR MIT
MODCARGO_CRATES +=	fastrand	1.9.0	# Apache-2.0 OR MIT
MODCARGO_CRATES +=	fixedbitset	0.4.2	# MIT/Apache-2.0
MODCARGO_CRATES +=	flate2	1.0.25	# MIT OR Apache-2.0
MODCARGO_CRATES +=	flume	0.10.14	# Apache-2.0/MIT
MODCARGO_CRATES +=	fnv	1.0.7	# Apache-2.0 / MIT
MODCARGO_CRATES +=	form_urlencoded	1.1.0	# MIT OR Apache-2.0
MODCARGO_CRATES +=	futures	0.3.26	# MIT OR Apache-2.0
MODCARGO_CRATES +=	futures-channel	0.3.26	# MIT OR Apache-2.0
MODCARGO_CRATES +=	futures-core	0.3.26	# MIT OR Apache-2.0
MODCARGO_CRATES +=	futures-executor	0.3.26	# MIT OR Apache-2.0
MODCARGO_CRATES +=	futures-intrusive	0.4.2	# MIT OR Apache-2.0
MODCARGO_CRATES +=	futures-io	0.3.26	# MIT OR Apache-2.0
MODCARGO_CRATES +=	futures-macro	0.3.26	# MIT OR Apache-2.0
MODCARGO_CRATES +=	futures-sink	0.3.26	# MIT OR Apache-2.0
MODCARGO_CRATES +=	futures-task	0.3.26	# MIT OR Apache-2.0
MODCARGO_CRATES +=	futures-util	0.3.26	# MIT OR Apache-2.0
MODCARGO_CRATES +=	generic-array	0.14.6	# MIT
MODCARGO_CRATES +=	gethostname	0.4.1	# Apache-2.0
MODCARGO_CRATES +=	getrandom	0.2.8	# MIT OR Apache-2.0
MODCARGO_CRATES +=	h2	0.3.16	# MIT
MODCARGO_CRATES +=	half	1.8.2	# MIT OR Apache-2.0
MODCARGO_CRATES +=	hashbrown	0.12.3	# MIT OR Apache-2.0
MODCARGO_CRATES +=	hashlink	0.8.1	# MIT OR Apache-2.0
MODCARGO_CRATES +=	heck	0.4.1	# MIT OR Apache-2.0
MODCARGO_CRATES +=	hermit-abi	0.1.19	# MIT/Apache-2.0
MODCARGO_CRATES +=	hermit-abi	0.2.6	# MIT/Apache-2.0
MODCARGO_CRATES +=	hex	0.4.3	# MIT OR Apache-2.0
MODCARGO_CRATES +=	hkdf	0.12.3	# MIT OR Apache-2.0
MODCARGO_CRATES +=	hmac	0.12.1	# MIT OR Apache-2.0
MODCARGO_CRATES +=	hostname	0.3.1	# MIT
MODCARGO_CRATES +=	http	0.2.9	# MIT OR Apache-2.0
MODCARGO_CRATES +=	http-body	0.4.5	# MIT
MODCARGO_CRATES +=	http-body	1.0.0-rc.2	# MIT
MODCARGO_CRATES +=	http-body-util	0.1.0-rc.2	# MIT
MODCARGO_CRATES +=	http-range-header	0.3.0	# MIT
MODCARGO_CRATES +=	httparse	1.8.0	# MIT/Apache-2.0
MODCARGO_CRATES +=	httpdate	1.0.2	# MIT/Apache-2.0
MODCARGO_CRATES +=	hyper	0.14.24	# MIT
MODCARGO_CRATES +=	hyper	1.0.0-rc.3	# MIT
MODCARGO_CRATES +=	hyper-rustls	0.23.2	# Apache-2.0/ISC/MIT
MODCARGO_CRATES +=	hyper-timeout	0.4.1	# MIT/Apache-2.0
MODCARGO_CRATES +=	idna	0.2.3	# MIT/Apache-2.0
MODCARGO_CRATES +=	idna	0.3.0	# MIT OR Apache-2.0
MODCARGO_CRATES +=	indexmap	1.9.2	# Apache-2.0 OR MIT
MODCARGO_CRATES +=	instant	0.1.12	# BSD-3-Clause
MODCARGO_CRATES +=	io-lifetimes	1.0.6	# Apache-2.0 WITH LLVM-exception OR Apache-2.0 OR MIT
MODCARGO_CRATES +=	ipconfig	0.3.1	# MIT/Apache-2.0
MODCARGO_CRATES +=	ipnet	2.7.1	# MIT OR Apache-2.0
MODCARGO_CRATES +=	itertools	0.10.5	# MIT/Apache-2.0
MODCARGO_CRATES +=	itoa	1.0.6	# MIT OR Apache-2.0
MODCARGO_CRATES +=	jobserver	0.1.26	# MIT/Apache-2.0
MODCARGO_CRATES +=	js-sys	0.3.61	# MIT/Apache-2.0
MODCARGO_CRATES +=	lazy_static	1.4.0	# MIT/Apache-2.0
MODCARGO_CRATES +=	libc	0.2.140	# MIT OR Apache-2.0
MODCARGO_CRATES +=	libm	0.2.6	# MIT OR Apache-2.0
MODCARGO_CRATES +=	libsqlite3-sys	0.24.2	# MIT
MODCARGO_CRATES +=	linked-hash-map	0.5.6	# MIT/Apache-2.0
MODCARGO_CRATES +=	linux-raw-sys	0.1.4	# Apache-2.0 WITH LLVM-exception OR Apache-2.0 OR MIT
MODCARGO_CRATES +=	lock_api	0.4.9	# MIT OR Apache-2.0
MODCARGO_CRATES +=	log	0.4.17	# MIT OR Apache-2.0
MODCARGO_CRATES +=	lru-cache	0.1.2	# MIT/Apache-2.0
MODCARGO_CRATES +=	match_cfg	0.1.0	# MIT/Apache-2.0
MODCARGO_CRATES +=	matchers	0.1.0	# MIT
MODCARGO_CRATES +=	matches	0.1.10	# MIT
MODCARGO_CRATES +=	matchit	0.7.0	# MIT
MODCARGO_CRATES +=	md-5	0.10.5	# MIT OR Apache-2.0
MODCARGO_CRATES +=	md5	0.7.0	# Apache-2.0/MIT
MODCARGO_CRATES +=	memchr	2.5.0	# Unlicense/MIT
MODCARGO_CRATES +=	memoffset	0.7.1	# MIT
MODCARGO_CRATES +=	memoffset	0.8.0	# MIT
MODCARGO_CRATES +=	mime	0.3.16	# MIT/Apache-2.0
MODCARGO_CRATES +=	minimal-lexical	0.2.1	# MIT/Apache-2.0
MODCARGO_CRATES +=	miniz_oxide	0.6.2	# MIT OR Zlib OR Apache-2.0
MODCARGO_CRATES +=	mio	0.8.6	# MIT
MODCARGO_CRATES +=	multimap	0.8.3	# MIT/Apache-2.0
MODCARGO_CRATES +=	nix	0.26.2	# MIT
MODCARGO_CRATES +=	nom	7.1.3	# MIT
MODCARGO_CRATES +=	nu-ansi-term	0.46.0	# MIT
MODCARGO_CRATES +=	num-bigint	0.4.3	# MIT OR Apache-2.0
MODCARGO_CRATES +=	num-bigint-dig	0.8.2	# MIT/Apache-2.0
MODCARGO_CRATES +=	num-integer	0.1.45	# MIT OR Apache-2.0
MODCARGO_CRATES +=	num-iter	0.1.43	# MIT OR Apache-2.0
MODCARGO_CRATES +=	num-traits	0.2.15	# MIT OR Apache-2.0
MODCARGO_CRATES +=	num_cpus	1.15.0	# MIT OR Apache-2.0
MODCARGO_CRATES +=	oid-registry	0.6.1	# MIT/Apache-2.0
MODCARGO_CRATES +=	once_cell	1.17.1	# MIT OR Apache-2.0
MODCARGO_CRATES +=	oorandom	11.1.3	# MIT
MODCARGO_CRATES +=	opaque-debug	0.3.0	# MIT OR Apache-2.0
MODCARGO_CRATES +=	openssl-probe	0.1.5	# MIT/Apache-2.0
MODCARGO_CRATES +=	opentelemetry	0.18.0	# Apache-2.0
MODCARGO_CRATES +=	opentelemetry-http	0.7.0	# Apache-2.0
MODCARGO_CRATES +=	opentelemetry-otlp	0.11.0	# Apache-2.0
MODCARGO_CRATES +=	opentelemetry-proto	0.1.0	# Apache-2.0
MODCARGO_CRATES +=	opentelemetry-semantic-conventions	0.10.0	# Apache-2.0
MODCARGO_CRATES +=	opentelemetry_api	0.18.0	# Apache-2.0
MODCARGO_CRATES +=	opentelemetry_sdk	0.18.0	# Apache-2.0
MODCARGO_CRATES +=	os_str_bytes	6.4.1	# MIT OR Apache-2.0
MODCARGO_CRATES +=	overload	0.1.1	# MIT
MODCARGO_CRATES +=	parking_lot	0.11.2	# Apache-2.0/MIT
MODCARGO_CRATES +=	parking_lot	0.12.1	# MIT OR Apache-2.0
MODCARGO_CRATES +=	parking_lot_core	0.8.6	# Apache-2.0/MIT
MODCARGO_CRATES +=	parking_lot_core	0.9.7	# MIT OR Apache-2.0
MODCARGO_CRATES +=	password-hash	0.4.2	# MIT OR Apache-2.0
MODCARGO_CRATES +=	paste	1.0.12	# MIT OR Apache-2.0
MODCARGO_CRATES +=	pbkdf2	0.11.0	# MIT OR Apache-2.0
MODCARGO_CRATES +=	pem-rfc7468	0.3.1	# Apache-2.0 OR MIT
MODCARGO_CRATES +=	percent-encoding	2.2.0	# MIT OR Apache-2.0
MODCARGO_CRATES +=	petgraph	0.6.3	# MIT OR Apache-2.0
MODCARGO_CRATES +=	phf	0.11.1	# MIT
MODCARGO_CRATES +=	phf_generator	0.11.1	# MIT
MODCARGO_CRATES +=	phf_macros	0.11.1	# MIT
MODCARGO_CRATES +=	phf_shared	0.11.1	# MIT
MODCARGO_CRATES +=	pin-project	1.0.12	# Apache-2.0 OR MIT
MODCARGO_CRATES +=	pin-project-internal	1.0.12	# Apache-2.0 OR MIT
MODCARGO_CRATES +=	pin-project-lite	0.2.9	# Apache-2.0 OR MIT
MODCARGO_CRATES +=	pin-utils	0.1.0	# MIT OR Apache-2.0
MODCARGO_CRATES +=	pkcs1	0.3.3	# Apache-2.0 OR MIT
MODCARGO_CRATES +=	pkcs8	0.8.0	# Apache-2.0 OR MIT
MODCARGO_CRATES +=	pkg-config	0.3.26	# MIT OR Apache-2.0
MODCARGO_CRATES +=	plotters	0.3.4	# MIT
MODCARGO_CRATES +=	plotters-backend	0.3.4	# MIT
MODCARGO_CRATES +=	plotters-svg	0.3.3	# MIT
MODCARGO_CRATES +=	ppv-lite86	0.2.17	# MIT/Apache-2.0
MODCARGO_CRATES +=	prettyplease	0.1.24	# MIT OR Apache-2.0
MODCARGO_CRATES +=	privdrop	0.5.3	# ISC
MODCARGO_CRATES +=	proc-macro2	1.0.51	# MIT OR Apache-2.0
MODCARGO_CRATES +=	prost	0.11.8	# Apache-2.0
MODCARGO_CRATES +=	prost-build	0.11.8	# Apache-2.0
MODCARGO_CRATES +=	prost-derive	0.11.8	# Apache-2.0
MODCARGO_CRATES +=	prost-types	0.11.8	# Apache-2.0
MODCARGO_CRATES +=	quick-error	1.2.3	# MIT/Apache-2.0
MODCARGO_CRATES +=	quick-xml	0.27.1	# MIT
MODCARGO_CRATES +=	quote	1.0.23	# MIT OR Apache-2.0
MODCARGO_CRATES +=	rand	0.8.5	# MIT OR Apache-2.0
MODCARGO_CRATES +=	rand_chacha	0.3.1	# MIT OR Apache-2.0
MODCARGO_CRATES +=	rand_core	0.6.4	# MIT OR Apache-2.0
MODCARGO_CRATES +=	rayon	1.7.0	# MIT OR Apache-2.0
MODCARGO_CRATES +=	rayon-core	1.11.0	# MIT OR Apache-2.0
MODCARGO_CRATES +=	redox_syscall	0.2.16	# MIT
MODCARGO_CRATES +=	redox_users	0.4.3	# MIT
MODCARGO_CRATES +=	regex	1.7.1	# MIT OR Apache-2.0
MODCARGO_CRATES +=	regex-automata	0.1.10	# Unlicense/MIT
MODCARGO_CRATES +=	regex-syntax	0.6.28	# MIT OR Apache-2.0
MODCARGO_CRATES +=	reqwest	0.11.14	# MIT OR Apache-2.0
MODCARGO_CRATES +=	resolv-conf	0.7.0	# MIT/Apache-2.0
MODCARGO_CRATES +=	ring	0.16.20	# LICENSE
MODCARGO_CRATES +=	rsa	0.6.1	# MIT OR Apache-2.0
MODCARGO_CRATES +=	rusticata-macros	4.1.0	# MIT/Apache-2.0
MODCARGO_CRATES +=	rustix	0.36.9	# Apache-2.0 WITH LLVM-exception OR Apache-2.0 OR MIT
MODCARGO_CRATES +=	rustls	0.20.8	# Apache-2.0/ISC/MIT
MODCARGO_CRATES +=	rustls-native-certs	0.6.2	# Apache-2.0/ISC/MIT
MODCARGO_CRATES +=	rustls-pemfile	1.0.2	# Apache-2.0 OR ISC OR MIT
MODCARGO_CRATES +=	rustversion	1.0.12	# MIT OR Apache-2.0
MODCARGO_CRATES +=	ryu	1.0.13	# Apache-2.0 OR BSL-1.0
MODCARGO_CRATES +=	same-file	1.0.6	# Unlicense/MIT
MODCARGO_CRATES +=	schannel	0.1.21	# MIT
MODCARGO_CRATES +=	scopeguard	1.1.0	# MIT/Apache-2.0
MODCARGO_CRATES +=	sct	0.7.0	# Apache-2.0/ISC/MIT
MODCARGO_CRATES +=	security-framework	2.8.2	# MIT OR Apache-2.0
MODCARGO_CRATES +=	security-framework-sys	2.8.0	# MIT OR Apache-2.0
MODCARGO_CRATES +=	serde	1.0.154	# MIT OR Apache-2.0
MODCARGO_CRATES +=	serde_derive	1.0.154	# MIT OR Apache-2.0
MODCARGO_CRATES +=	serde_json	1.0.94	# MIT OR Apache-2.0
MODCARGO_CRATES +=	serde_urlencoded	0.7.1	# MIT/Apache-2.0
MODCARGO_CRATES +=	serial_test	1.0.0	# MIT
MODCARGO_CRATES +=	serial_test_derive	1.0.0	# MIT
MODCARGO_CRATES +=	sha1	0.10.5	# MIT OR Apache-2.0
MODCARGO_CRATES +=	sha2	0.10.6	# MIT OR Apache-2.0
MODCARGO_CRATES +=	sharded-slab	0.1.4	# MIT
MODCARGO_CRATES +=	signal-hook-registry	1.4.1	# Apache-2.0/MIT
MODCARGO_CRATES +=	siphasher	0.3.10	# MIT/Apache-2.0
MODCARGO_CRATES +=	slab	0.4.8	# MIT
MODCARGO_CRATES +=	smallvec	1.10.0	# MIT OR Apache-2.0
MODCARGO_CRATES +=	socket2	0.4.9	# MIT OR Apache-2.0
MODCARGO_CRATES +=	spin	0.5.2	# MIT
MODCARGO_CRATES +=	spin	0.9.5	# MIT
MODCARGO_CRATES +=	spki	0.5.4	# Apache-2.0 OR MIT
MODCARGO_CRATES +=	sqlformat	0.2.1	# MIT OR Apache-2.0
MODCARGO_CRATES +=	sqlx	0.6.2	# MIT OR Apache-2.0
MODCARGO_CRATES +=	sqlx-core	0.6.2	# MIT OR Apache-2.0
MODCARGO_CRATES +=	sqlx-macros	0.6.2	# MIT OR Apache-2.0
MODCARGO_CRATES +=	sqlx-rt	0.6.2	# MIT OR Apache-2.0
MODCARGO_CRATES +=	static_assertions	1.1.0	# MIT OR Apache-2.0
MODCARGO_CRATES +=	stringprep	0.1.2	# MIT/Apache-2.0
MODCARGO_CRATES +=	subtle	2.4.1	# BSD-3-Clause
MODCARGO_CRATES +=	syn	1.0.109	# MIT OR Apache-2.0
MODCARGO_CRATES +=	sync_wrapper	0.1.2	# Apache-2.0
MODCARGO_CRATES +=	synstructure	0.12.6	# MIT
MODCARGO_CRATES +=	tempfile	3.4.0	# MIT OR Apache-2.0
MODCARGO_CRATES +=	textwrap	0.16.0	# MIT
MODCARGO_CRATES +=	thiserror	1.0.39	# MIT OR Apache-2.0
MODCARGO_CRATES +=	thiserror-impl	1.0.39	# MIT OR Apache-2.0
MODCARGO_CRATES +=	thread_local	1.1.7	# MIT OR Apache-2.0
MODCARGO_CRATES +=	time	0.3.20	# MIT OR Apache-2.0
MODCARGO_CRATES +=	time-core	0.1.0	# MIT OR Apache-2.0
MODCARGO_CRATES +=	time-macros	0.2.8	# MIT OR Apache-2.0
MODCARGO_CRATES +=	tinytemplate	1.2.1	# Apache-2.0 OR MIT
MODCARGO_CRATES +=	tinyvec	1.6.0	# Zlib OR Apache-2.0 OR MIT
MODCARGO_CRATES +=	tinyvec_macros	0.1.1	# MIT OR Apache-2.0 OR Zlib
MODCARGO_CRATES +=	tokio	1.26.0	# MIT
MODCARGO_CRATES +=	tokio-io-timeout	1.2.0	# MIT/Apache-2.0
MODCARGO_CRATES +=	tokio-macros	1.8.2	# MIT
MODCARGO_CRATES +=	tokio-rustls	0.23.4	# MIT/Apache-2.0
MODCARGO_CRATES +=	tokio-stream	0.1.12	# MIT
MODCARGO_CRATES +=	tokio-util	0.7.7	# MIT
MODCARGO_CRATES +=	tonic	0.8.3	# MIT
MODCARGO_CRATES +=	tonic-build	0.8.4	# MIT
MODCARGO_CRATES +=	tower	0.4.13	# MIT
MODCARGO_CRATES +=	tower-http	0.3.5	# MIT
MODCARGO_CRATES +=	tower-layer	0.3.2	# MIT
MODCARGO_CRATES +=	tower-service	0.3.2	# MIT
MODCARGO_CRATES +=	tracing	0.1.37	# MIT
MODCARGO_CRATES +=	tracing-appender	0.2.2	# MIT
MODCARGO_CRATES +=	tracing-attributes	0.1.23	# MIT
MODCARGO_CRATES +=	tracing-core	0.1.30	# MIT
MODCARGO_CRATES +=	tracing-futures	0.2.5	# MIT
MODCARGO_CRATES +=	tracing-log	0.1.3	# MIT
MODCARGO_CRATES +=	tracing-opentelemetry	0.18.0	# MIT
MODCARGO_CRATES +=	tracing-subscriber	0.3.16	# MIT
MODCARGO_CRATES +=	trust-dns-proto	0.22.0	# MIT/Apache-2.0
MODCARGO_CRATES +=	trust-dns-resolver	0.22.0	# MIT/Apache-2.0
MODCARGO_CRATES +=	try-lock	0.2.4	# MIT
MODCARGO_CRATES +=	typenum	1.16.0	# MIT OR Apache-2.0
MODCARGO_CRATES +=	unicode-bidi	0.3.11	# MIT OR Apache-2.0
MODCARGO_CRATES +=	unicode-ident	1.0.8	# (MIT OR Apache-2.0) AND Unicode-DFS-2016
MODCARGO_CRATES +=	unicode-normalization	0.1.22	# MIT/Apache-2.0
MODCARGO_CRATES +=	unicode-segmentation	1.10.1	# MIT/Apache-2.0
MODCARGO_CRATES +=	unicode-xid	0.2.4	# MIT OR Apache-2.0
MODCARGO_CRATES +=	unicode_categories	0.1.1	# MIT OR Apache-2.0
MODCARGO_CRATES +=	untrusted	0.7.1	# ISC
MODCARGO_CRATES +=	url	2.3.1	# MIT OR Apache-2.0
MODCARGO_CRATES +=	uuid	1.3.0	# Apache-2.0 OR MIT
MODCARGO_CRATES +=	valuable	0.1.0	# MIT
MODCARGO_CRATES +=	vcpkg	0.2.15	# MIT/Apache-2.0
MODCARGO_CRATES +=	version_check	0.9.4	# MIT/Apache-2.0
MODCARGO_CRATES +=	walkdir	2.3.2	# Unlicense/MIT
MODCARGO_CRATES +=	want	0.3.0	# MIT
MODCARGO_CRATES +=	wasi	0.11.0+wasi-snapshot-preview1	# Apache-2.0 WITH LLVM-exception OR Apache-2.0 OR MIT
MODCARGO_CRATES +=	wasm-bindgen	0.2.84	# MIT/Apache-2.0
MODCARGO_CRATES +=	wasm-bindgen-backend	0.2.84	# MIT/Apache-2.0
MODCARGO_CRATES +=	wasm-bindgen-futures	0.4.34	# MIT/Apache-2.0
MODCARGO_CRATES +=	wasm-bindgen-macro	0.2.84	# MIT/Apache-2.0
MODCARGO_CRATES +=	wasm-bindgen-macro-support	0.2.84	# MIT/Apache-2.0
MODCARGO_CRATES +=	wasm-bindgen-shared	0.2.84	# MIT/Apache-2.0
MODCARGO_CRATES +=	web-sys	0.3.61	# MIT/Apache-2.0
MODCARGO_CRATES +=	webpki	0.22.0	# LICENSE
MODCARGO_CRATES +=	webpki-roots	0.22.6	# MPL-2.0
MODCARGO_CRATES +=	which	4.4.0	# MIT
MODCARGO_CRATES +=	whoami	1.3.0	# Apache-2.0 OR BSL-1.0 OR MIT
MODCARGO_CRATES +=	widestring	0.5.1	# MIT OR Apache-2.0
MODCARGO_CRATES +=	winapi	0.3.9	# MIT/Apache-2.0
MODCARGO_CRATES +=	winapi-i686-pc-windows-gnu	0.4.0	# MIT/Apache-2.0
MODCARGO_CRATES +=	winapi-util	0.1.5	# Unlicense/MIT
MODCARGO_CRATES +=	winapi-x86_64-pc-windows-gnu	0.4.0	# MIT/Apache-2.0
MODCARGO_CRATES +=	windows	0.43.0	# MIT OR Apache-2.0
MODCARGO_CRATES +=	windows-sys	0.42.0	# MIT OR Apache-2.0
MODCARGO_CRATES +=	windows-sys	0.45.0	# MIT OR Apache-2.0
MODCARGO_CRATES +=	windows-targets	0.42.1	# MIT OR Apache-2.0
MODCARGO_CRATES +=	windows_aarch64_gnullvm	0.42.1	# MIT OR Apache-2.0
MODCARGO_CRATES +=	windows_aarch64_msvc	0.42.1	# MIT OR Apache-2.0
MODCARGO_CRATES +=	windows_i686_gnu	0.42.1	# MIT OR Apache-2.0
MODCARGO_CRATES +=	windows_i686_msvc	0.42.1	# MIT OR Apache-2.0
MODCARGO_CRATES +=	windows_x86_64_gnu	0.42.1	# MIT OR Apache-2.0
MODCARGO_CRATES +=	windows_x86_64_gnullvm	0.42.1	# MIT OR Apache-2.0
MODCARGO_CRATES +=	windows_x86_64_msvc	0.42.1	# MIT OR Apache-2.0
MODCARGO_CRATES +=	winreg	0.10.1	# MIT
MODCARGO_CRATES +=	x509-parser	0.14.0	# MIT/Apache-2.0
MODCARGO_CRATES +=	zeroize	1.5.7	# Apache-2.0 OR MIT
MODCARGO_CRATES +=	zip	0.6.4	# MIT
MODCARGO_CRATES +=	zstd	0.11.2+zstd.1.5.2	# MIT
MODCARGO_CRATES +=	zstd-safe	5.0.2+zstd.1.5.2	# MIT/Apache-2.0
MODCARGO_CRATES +=	zstd-sys	2.0.7+zstd.1.5.4	# MIT/Apache-2.0
