MODCARGO_CRATES +=	addr2line	0.21.0	# Apache-2.0 OR MIT
MODCARGO_CRATES +=	adler	1.0.2	# 0BSD OR MIT OR Apache-2.0
MODCARGO_CRATES +=	aead	0.5.2	# MIT OR Apache-2.0
MODCARGO_CRATES +=	aes	0.8.4	# MIT OR Apache-2.0
MODCARGO_CRATES +=	aes-gcm	0.10.3	# Apache-2.0 OR MIT
MODCARGO_CRATES +=	aes-gcm-siv	0.11.1	# MIT OR Apache-2.0
MODCARGO_CRATES +=	ahash	0.7.8	# MIT OR Apache-2.0
MODCARGO_CRATES +=	ahash	0.8.11	# MIT OR Apache-2.0
MODCARGO_CRATES +=	aho-corasick	1.1.3	# Unlicense OR MIT
MODCARGO_CRATES +=	allocator-api2	0.2.18	# MIT OR Apache-2.0
MODCARGO_CRATES +=	android-tzdata	0.1.1	# MIT OR Apache-2.0
MODCARGO_CRATES +=	android_system_properties	0.1.5	# MIT/Apache-2.0
MODCARGO_CRATES +=	anstream	0.6.13	# MIT OR Apache-2.0
MODCARGO_CRATES +=	anstyle	1.0.6	# MIT OR Apache-2.0
MODCARGO_CRATES +=	anstyle-parse	0.2.3	# MIT OR Apache-2.0
MODCARGO_CRATES +=	anstyle-query	1.0.2	# MIT OR Apache-2.0
MODCARGO_CRATES +=	anstyle-wincon	3.0.2	# MIT OR Apache-2.0
MODCARGO_CRATES +=	anyhow	1.0.82	# MIT OR Apache-2.0
MODCARGO_CRATES +=	arc-swap	1.7.1	# MIT OR Apache-2.0
MODCARGO_CRATES +=	argon2	0.5.3	# MIT OR Apache-2.0
MODCARGO_CRATES +=	arrayref	0.3.7	# BSD-2-Clause
MODCARGO_CRATES +=	arrayvec	0.7.4	# MIT OR Apache-2.0
MODCARGO_CRATES +=	ascii-canvas	3.0.0	# Apache-2.0/MIT
MODCARGO_CRATES +=	asn1-rs	0.5.2	# MIT/Apache-2.0
MODCARGO_CRATES +=	asn1-rs	0.6.1	# MIT/Apache-2.0
MODCARGO_CRATES +=	asn1-rs-derive	0.4.0	# MIT/Apache-2.0
MODCARGO_CRATES +=	asn1-rs-derive	0.5.0	# MIT/Apache-2.0
MODCARGO_CRATES +=	asn1-rs-impl	0.1.0	# MIT/Apache-2.0
MODCARGO_CRATES +=	asn1-rs-impl	0.2.0	# MIT/Apache-2.0
MODCARGO_CRATES +=	async-compression	0.4.8	# MIT OR Apache-2.0
MODCARGO_CRATES +=	async-recursion	1.1.0	# MIT OR Apache-2.0
MODCARGO_CRATES +=	async-stream	0.3.5	# MIT
MODCARGO_CRATES +=	async-stream-impl	0.3.5	# MIT
MODCARGO_CRATES +=	async-trait	0.1.80	# MIT OR Apache-2.0
MODCARGO_CRATES +=	attohttpc	0.22.0	# MPL-2.0
MODCARGO_CRATES +=	autocfg	1.2.0	# Apache-2.0 OR MIT
MODCARGO_CRATES +=	aws-creds	0.34.1	# MIT
MODCARGO_CRATES +=	aws-region	0.25.4	# MIT
MODCARGO_CRATES +=	axum	0.6.20	# MIT
MODCARGO_CRATES +=	axum-core	0.3.4	# MIT
MODCARGO_CRATES +=	backtrace	0.3.71	# MIT OR Apache-2.0
MODCARGO_CRATES +=	base16ct	0.2.0	# Apache-2.0 OR MIT
MODCARGO_CRATES +=	base64	0.11.0	# MIT/Apache-2.0
MODCARGO_CRATES +=	base64	0.13.1	# MIT/Apache-2.0
MODCARGO_CRATES +=	base64	0.21.7	# MIT OR Apache-2.0
MODCARGO_CRATES +=	base64	0.22.0	# MIT OR Apache-2.0
MODCARGO_CRATES +=	base64ct	1.6.0	# Apache-2.0 OR MIT
MODCARGO_CRATES +=	bigdecimal	0.4.3	# MIT/Apache-2.0
MODCARGO_CRATES +=	bincode	1.3.3	# MIT
MODCARGO_CRATES +=	bindgen	0.69.4	# BSD-3-Clause
MODCARGO_CRATES +=	bit-set	0.5.3	# MIT/Apache-2.0
MODCARGO_CRATES +=	bit-vec	0.6.3	# MIT/Apache-2.0
MODCARGO_CRATES +=	bitflags	1.3.2	# MIT/Apache-2.0
MODCARGO_CRATES +=	bitflags	2.5.0	# MIT OR Apache-2.0
MODCARGO_CRATES +=	bitvec	1.0.1	# MIT
MODCARGO_CRATES +=	bitvec-nom2	0.2.0	# MIT
MODCARGO_CRATES +=	blake2	0.10.6	# MIT OR Apache-2.0
MODCARGO_CRATES +=	blake3	1.5.1	# CC0-1.0 OR Apache-2.0
MODCARGO_CRATES +=	block-buffer	0.9.0	# MIT OR Apache-2.0
MODCARGO_CRATES +=	block-buffer	0.10.4	# MIT OR Apache-2.0
MODCARGO_CRATES +=	block-padding	0.3.3	# MIT OR Apache-2.0
MODCARGO_CRATES +=	blowfish	0.7.0	# MIT OR Apache-2.0
MODCARGO_CRATES +=	blowfish	0.9.1	# MIT OR Apache-2.0
MODCARGO_CRATES +=	borsh	1.4.0	# MIT OR Apache-2.0
MODCARGO_CRATES +=	borsh-derive	1.4.0	# Apache-2.0
MODCARGO_CRATES +=	btoi	0.4.3	# MIT OR Apache-2.0
MODCARGO_CRATES +=	buffered-reader	1.3.1	# LGPL-2.0-or-later
MODCARGO_CRATES +=	bumpalo	3.16.0	# MIT OR Apache-2.0
MODCARGO_CRATES +=	bytecheck	0.6.12	# MIT
MODCARGO_CRATES +=	bytecheck_derive	0.6.12	# MIT
MODCARGO_CRATES +=	bytemuck	1.15.0	# Zlib OR Apache-2.0 OR MIT
MODCARGO_CRATES +=	byteorder	1.5.0	# Unlicense OR MIT
MODCARGO_CRATES +=	bytes	1.6.0	# MIT
MODCARGO_CRATES +=	bzip2	0.4.4	# MIT/Apache-2.0
MODCARGO_CRATES +=	bzip2-sys	0.1.11+1.0.8	# MIT/Apache-2.0
MODCARGO_CRATES +=	camellia	0.1.0	# MIT OR Apache-2.0
MODCARGO_CRATES +=	cast5	0.11.1	# MIT OR Apache-2.0
MODCARGO_CRATES +=	cbc	0.1.2	# MIT OR Apache-2.0
MODCARGO_CRATES +=	cc	1.0.92	# MIT OR Apache-2.0
MODCARGO_CRATES +=	cedarwood	0.4.6	# BSD-2-Clause
MODCARGO_CRATES +=	cexpr	0.6.0	# Apache-2.0/MIT
MODCARGO_CRATES +=	cfb	0.7.3	# MIT
MODCARGO_CRATES +=	cfb-mode	0.8.2	# MIT OR Apache-2.0
MODCARGO_CRATES +=	cfg-if	1.0.0	# MIT/Apache-2.0
MODCARGO_CRATES +=	cfg_aliases	0.1.1	# MIT
MODCARGO_CRATES +=	chrono	0.4.37	# MIT OR Apache-2.0
MODCARGO_CRATES +=	cipher	0.2.5	# MIT OR Apache-2.0
MODCARGO_CRATES +=	cipher	0.4.4	# MIT OR Apache-2.0
MODCARGO_CRATES +=	clang-sys	1.7.0	# Apache-2.0
MODCARGO_CRATES +=	clap	4.5.4	# MIT OR Apache-2.0
MODCARGO_CRATES +=	clap_builder	4.5.2	# MIT OR Apache-2.0
MODCARGO_CRATES +=	clap_derive	4.5.4	# MIT OR Apache-2.0
MODCARGO_CRATES +=	clap_lex	0.7.0	# MIT OR Apache-2.0
MODCARGO_CRATES +=	cmac	0.7.2	# MIT OR Apache-2.0
MODCARGO_CRATES +=	cmake	0.1.50	# MIT OR Apache-2.0
MODCARGO_CRATES +=	colorchoice	1.0.0	# MIT OR Apache-2.0
MODCARGO_CRATES +=	combine	4.6.7	# MIT
MODCARGO_CRATES +=	console	0.15.8	# MIT
MODCARGO_CRATES +=	const-oid	0.9.6	# Apache-2.0 OR MIT
MODCARGO_CRATES +=	const_panic	0.2.8	# Zlib
MODCARGO_CRATES +=	constant_time_eq	0.1.5	# CC0-1.0
MODCARGO_CRATES +=	constant_time_eq	0.3.0	# CC0-1.0 OR MIT-0 OR Apache-2.0
MODCARGO_CRATES +=	core-foundation	0.9.4	# MIT OR Apache-2.0
MODCARGO_CRATES +=	core-foundation-sys	0.8.6	# MIT OR Apache-2.0
MODCARGO_CRATES +=	cpufeatures	0.2.12	# MIT OR Apache-2.0
MODCARGO_CRATES +=	crc16	0.4.0	# MIT
MODCARGO_CRATES +=	crc32fast	1.4.0	# MIT OR Apache-2.0
MODCARGO_CRATES +=	crossbeam	0.8.4	# MIT OR Apache-2.0
MODCARGO_CRATES +=	crossbeam-channel	0.5.12	# MIT OR Apache-2.0
MODCARGO_CRATES +=	crossbeam-deque	0.8.5	# MIT OR Apache-2.0
MODCARGO_CRATES +=	crossbeam-epoch	0.9.18	# MIT OR Apache-2.0
MODCARGO_CRATES +=	crossbeam-queue	0.3.11	# MIT OR Apache-2.0
MODCARGO_CRATES +=	crossbeam-utils	0.8.19	# MIT OR Apache-2.0
MODCARGO_CRATES +=	crunchy	0.2.2	# MIT
MODCARGO_CRATES +=	crypto-bigint	0.5.5	# Apache-2.0 OR MIT
MODCARGO_CRATES +=	crypto-common	0.1.6	# MIT OR Apache-2.0
MODCARGO_CRATES +=	crypto-mac	0.10.0	# MIT OR Apache-2.0
MODCARGO_CRATES +=	csv	1.3.0	# Unlicense/MIT
MODCARGO_CRATES +=	csv-core	0.1.11	# Unlicense/MIT
MODCARGO_CRATES +=	ctr	0.9.2	# MIT OR Apache-2.0
MODCARGO_CRATES +=	curve25519-dalek	4.1.2	# BSD-3-Clause
MODCARGO_CRATES +=	curve25519-dalek-derive	0.1.1	# MIT/Apache-2.0
MODCARGO_CRATES +=	darling	0.13.4	# MIT
MODCARGO_CRATES +=	darling	0.20.8	# MIT
MODCARGO_CRATES +=	darling_core	0.13.4	# MIT
MODCARGO_CRATES +=	darling_core	0.20.8	# MIT
MODCARGO_CRATES +=	darling_macro	0.13.4	# MIT
MODCARGO_CRATES +=	darling_macro	0.20.8	# MIT
MODCARGO_CRATES +=	dashmap	5.5.3	# MIT
MODCARGO_CRATES +=	data-encoding	2.5.0	# MIT
MODCARGO_CRATES +=	dbl	0.3.2	# MIT OR Apache-2.0
MODCARGO_CRATES +=	deadpool	0.10.0	# MIT OR Apache-2.0
MODCARGO_CRATES +=	deadpool-postgres	0.12.1	# MIT OR Apache-2.0
MODCARGO_CRATES +=	deadpool-runtime	0.1.3	# MIT OR Apache-2.0
MODCARGO_CRATES +=	decancer	3.1.2	# MIT
MODCARGO_CRATES +=	der	0.7.9	# Apache-2.0 OR MIT
MODCARGO_CRATES +=	der-parser	8.2.0	# MIT/Apache-2.0
MODCARGO_CRATES +=	der-parser	9.0.0	# MIT/Apache-2.0
MODCARGO_CRATES +=	deranged	0.3.11	# MIT OR Apache-2.0
MODCARGO_CRATES +=	des	0.8.1	# MIT OR Apache-2.0
MODCARGO_CRATES +=	digest	0.9.0	# MIT OR Apache-2.0
MODCARGO_CRATES +=	digest	0.10.7	# MIT OR Apache-2.0
MODCARGO_CRATES +=	dirs	4.0.0	# MIT OR Apache-2.0
MODCARGO_CRATES +=	dirs-next	2.0.0	# MIT OR Apache-2.0
MODCARGO_CRATES +=	dirs-sys	0.3.7	# MIT OR Apache-2.0
MODCARGO_CRATES +=	dirs-sys-next	0.1.2	# MIT OR Apache-2.0
MODCARGO_CRATES +=	displaydoc	0.2.4	# MIT OR Apache-2.0
MODCARGO_CRATES +=	dlv-list	0.3.0	# MIT
MODCARGO_CRATES +=	doc-comment	0.3.3	# MIT
MODCARGO_CRATES +=	dsa	0.6.3	# Apache-2.0 OR MIT
MODCARGO_CRATES +=	dyn-clone	1.0.17	# MIT OR Apache-2.0
MODCARGO_CRATES +=	eax	0.5.0	# Apache-2.0 OR MIT
MODCARGO_CRATES +=	ecb	0.1.2	# MIT
MODCARGO_CRATES +=	ecdsa	0.16.9	# Apache-2.0 OR MIT
MODCARGO_CRATES +=	ece	2.3.1	# MPL-2.0
MODCARGO_CRATES +=	ed25519	2.2.3	# Apache-2.0 OR MIT
MODCARGO_CRATES +=	ed25519-dalek	2.1.1	# BSD-3-Clause
MODCARGO_CRATES +=	either	1.10.0	# MIT OR Apache-2.0
MODCARGO_CRATES +=	elasticsearch	8.5.0-alpha.1	# Apache-2.0
MODCARGO_CRATES +=	elliptic-curve	0.13.8	# Apache-2.0 OR MIT
MODCARGO_CRATES +=	ena	0.14.2	# MIT OR Apache-2.0
MODCARGO_CRATES +=	encode_unicode	0.3.6	# MIT/Apache-2.0
MODCARGO_CRATES +=	encode_unicode	1.0.0	# Apache-2.0 OR MIT
MODCARGO_CRATES +=	encoding_rs	0.8.34	# (Apache-2.0 OR MIT) AND BSD-3-Clause
MODCARGO_CRATES +=	enum-as-inner	0.6.0	# MIT/Apache-2.0
MODCARGO_CRATES +=	equivalent	1.0.1	# Apache-2.0 OR MIT
MODCARGO_CRATES +=	errno	0.3.8	# MIT OR Apache-2.0
MODCARGO_CRATES +=	fallible-iterator	0.2.0	# MIT/Apache-2.0
MODCARGO_CRATES +=	fallible-iterator	0.3.0	# MIT/Apache-2.0
MODCARGO_CRATES +=	fallible-streaming-iterator	0.1.9	# MIT/Apache-2.0
MODCARGO_CRATES +=	fancy-regex	0.13.0	# MIT
MODCARGO_CRATES +=	farmhash	1.1.5	# MIT
MODCARGO_CRATES +=	fast-float	0.2.0	# MIT OR Apache-2.0
MODCARGO_CRATES +=	ff	0.13.0	# MIT/Apache-2.0
MODCARGO_CRATES +=	fiat-crypto	0.2.7	# MIT OR Apache-2.0 OR BSD-1-Clause
MODCARGO_CRATES +=	finl_unicode	1.2.0	# MIT OR Apache-2.0
MODCARGO_CRATES +=	fixedbitset	0.4.2	# MIT/Apache-2.0
MODCARGO_CRATES +=	flate2	1.0.28	# MIT OR Apache-2.0
MODCARGO_CRATES +=	fnv	1.0.7	# Apache-2.0 / MIT
MODCARGO_CRATES +=	foreign-types	0.3.2	# MIT/Apache-2.0
MODCARGO_CRATES +=	foreign-types-shared	0.1.1	# MIT/Apache-2.0
MODCARGO_CRATES +=	form-data	0.5.4	# MIT OR Apache-2.0
MODCARGO_CRATES +=	form_urlencoded	1.2.1	# MIT OR Apache-2.0
MODCARGO_CRATES +=	foundationdb	0.9.0	# MIT/Apache-2.0
MODCARGO_CRATES +=	foundationdb-gen	0.9.0	# MIT/Apache-2.0
MODCARGO_CRATES +=	foundationdb-macros	0.3.0	# MIT/Apache-2.0
MODCARGO_CRATES +=	foundationdb-sys	0.9.0	# MIT/Apache-2.0
MODCARGO_CRATES +=	frunk	0.4.2	# MIT
MODCARGO_CRATES +=	frunk_core	0.4.2	# MIT
MODCARGO_CRATES +=	frunk_derives	0.4.2	# MIT
MODCARGO_CRATES +=	frunk_proc_macro_helpers	0.1.2	# MIT
MODCARGO_CRATES +=	frunk_proc_macros	0.1.2	# MIT
MODCARGO_CRATES +=	funty	2.0.0	# MIT
MODCARGO_CRATES +=	futures	0.3.30	# MIT OR Apache-2.0
MODCARGO_CRATES +=	futures-channel	0.3.30	# MIT OR Apache-2.0
MODCARGO_CRATES +=	futures-core	0.3.30	# MIT OR Apache-2.0
MODCARGO_CRATES +=	futures-executor	0.3.30	# MIT OR Apache-2.0
MODCARGO_CRATES +=	futures-io	0.3.30	# MIT OR Apache-2.0
MODCARGO_CRATES +=	futures-macro	0.3.30	# MIT OR Apache-2.0
MODCARGO_CRATES +=	futures-sink	0.3.30	# MIT OR Apache-2.0
MODCARGO_CRATES +=	futures-task	0.3.30	# MIT OR Apache-2.0
MODCARGO_CRATES +=	futures-util	0.3.30	# MIT OR Apache-2.0
MODCARGO_CRATES +=	fxhash	0.2.1	# Apache-2.0/MIT
MODCARGO_CRATES +=	generic-array	0.14.7	# MIT
MODCARGO_CRATES +=	generic-array	1.0.0	# MIT
MODCARGO_CRATES +=	gethostname	0.4.3	# Apache-2.0
MODCARGO_CRATES +=	getrandom	0.2.14	# MIT OR Apache-2.0
MODCARGO_CRATES +=	ghash	0.5.1	# Apache-2.0 OR MIT
MODCARGO_CRATES +=	gimli	0.28.1	# MIT OR Apache-2.0
MODCARGO_CRATES +=	glob	0.3.1	# MIT OR Apache-2.0
MODCARGO_CRATES +=	group	0.13.0	# MIT/Apache-2.0
MODCARGO_CRATES +=	h2	0.3.26	# MIT
MODCARGO_CRATES +=	h2	0.4.4	# MIT
MODCARGO_CRATES +=	hashbrown	0.12.3	# MIT OR Apache-2.0
MODCARGO_CRATES +=	hashbrown	0.14.3	# MIT OR Apache-2.0
MODCARGO_CRATES +=	hashlink	0.9.0	# MIT OR Apache-2.0
MODCARGO_CRATES +=	heck	0.4.1	# MIT OR Apache-2.0
MODCARGO_CRATES +=	heck	0.5.0	# MIT OR Apache-2.0
MODCARGO_CRATES +=	hermit-abi	0.3.9	# MIT OR Apache-2.0
MODCARGO_CRATES +=	hex	0.4.3	# MIT OR Apache-2.0
MODCARGO_CRATES +=	hickory-proto	0.24.0	# MIT OR Apache-2.0
MODCARGO_CRATES +=	hickory-resolver	0.24.0	# MIT OR Apache-2.0
MODCARGO_CRATES +=	hkdf	0.12.4	# MIT OR Apache-2.0
MODCARGO_CRATES +=	hmac	0.10.1	# MIT OR Apache-2.0
MODCARGO_CRATES +=	hmac	0.12.1	# MIT OR Apache-2.0
MODCARGO_CRATES +=	home	0.5.9	# MIT OR Apache-2.0
MODCARGO_CRATES +=	hostname	0.3.1	# MIT
MODCARGO_CRATES +=	hostname	0.4.0	# MIT
MODCARGO_CRATES +=	http	0.2.12	# MIT OR Apache-2.0
MODCARGO_CRATES +=	http	1.1.0	# MIT OR Apache-2.0
MODCARGO_CRATES +=	http-body	0.4.6	# MIT
MODCARGO_CRATES +=	http-body	1.0.0	# MIT
MODCARGO_CRATES +=	http-body-util	0.1.1	# MIT
MODCARGO_CRATES +=	httparse	1.8.0	# MIT/Apache-2.0
MODCARGO_CRATES +=	httpdate	1.0.3	# MIT OR Apache-2.0
MODCARGO_CRATES +=	human-size	0.4.3	# MIT/Apache-2.0
MODCARGO_CRATES +=	hyper	0.14.28	# MIT
MODCARGO_CRATES +=	hyper	1.2.0	# MIT
MODCARGO_CRATES +=	hyper-rustls	0.24.2	# Apache-2.0 OR ISC OR MIT
MODCARGO_CRATES +=	hyper-rustls	0.26.0	# Apache-2.0 OR ISC OR MIT
MODCARGO_CRATES +=	hyper-timeout	0.4.1	# MIT/Apache-2.0
MODCARGO_CRATES +=	hyper-util	0.1.3	# MIT
MODCARGO_CRATES +=	iana-time-zone	0.1.60	# MIT OR Apache-2.0
MODCARGO_CRATES +=	iana-time-zone-haiku	0.1.2	# MIT OR Apache-2.0
MODCARGO_CRATES +=	idea	0.5.1	# MIT OR Apache-2.0
MODCARGO_CRATES +=	ident_case	1.0.1	# MIT/Apache-2.0
MODCARGO_CRATES +=	idna	0.4.0	# MIT OR Apache-2.0
MODCARGO_CRATES +=	idna	0.5.0	# MIT OR Apache-2.0
MODCARGO_CRATES +=	imagesize	0.12.0	# MIT
MODCARGO_CRATES +=	indexmap	1.9.3	# Apache-2.0 OR MIT
MODCARGO_CRATES +=	indexmap	2.2.6	# Apache-2.0 OR MIT
MODCARGO_CRATES +=	indicatif	0.17.8	# MIT
MODCARGO_CRATES +=	infer	0.15.0	# MIT
MODCARGO_CRATES +=	inout	0.1.3	# MIT OR Apache-2.0
MODCARGO_CRATES +=	instant	0.1.12	# BSD-3-Clause
MODCARGO_CRATES +=	ipconfig	0.3.2	# MIT/Apache-2.0
MODCARGO_CRATES +=	ipnet	2.9.0	# MIT OR Apache-2.0
MODCARGO_CRATES +=	is-terminal	0.4.12	# MIT
MODCARGO_CRATES +=	itertools	0.10.5	# MIT/Apache-2.0
MODCARGO_CRATES +=	itertools	0.11.0	# MIT OR Apache-2.0
MODCARGO_CRATES +=	itertools	0.12.1	# MIT OR Apache-2.0
MODCARGO_CRATES +=	itoa	1.0.11	# MIT OR Apache-2.0
MODCARGO_CRATES +=	jemalloc-sys	0.5.4+5.3.0-patched	# MIT/Apache-2.0
MODCARGO_CRATES +=	jemallocator	0.5.4	# MIT/Apache-2.0
MODCARGO_CRATES +=	jieba-rs	0.6.8	# MIT
MODCARGO_CRATES +=	jmap-client	0.3.2	# Apache-2.0 OR MIT
MODCARGO_CRATES +=	jobserver	0.1.29	# MIT OR Apache-2.0
MODCARGO_CRATES +=	js-sys	0.3.69	# MIT OR Apache-2.0
MODCARGO_CRATES +=	keyed_priority_queue	0.4.2	# MIT
MODCARGO_CRATES +=	konst	0.3.8	# Zlib
MODCARGO_CRATES +=	konst_kernel	0.3.8	# Zlib
MODCARGO_CRATES +=	lalrpop	0.20.2	# Apache-2.0 OR MIT
MODCARGO_CRATES +=	lalrpop-util	0.20.2	# Apache-2.0 OR MIT
MODCARGO_CRATES +=	lazy_static	1.4.0	# MIT/Apache-2.0
MODCARGO_CRATES +=	lazycell	1.3.0	# MIT/Apache-2.0
MODCARGO_CRATES +=	lber	0.4.2	# MIT
MODCARGO_CRATES +=	ldap3	0.11.3	# MIT/Apache-2.0
MODCARGO_CRATES +=	libc	0.2.153	# MIT OR Apache-2.0
MODCARGO_CRATES +=	libloading	0.8.3	# ISC
MODCARGO_CRATES +=	libm	0.2.8	# MIT OR Apache-2.0
MODCARGO_CRATES +=	libredox	0.1.3	# MIT
MODCARGO_CRATES +=	librocksdb-sys	0.16.0+8.10.0	# MIT/Apache-2.0/BSD-3-Clause
MODCARGO_CRATES +=	libsqlite3-sys	0.28.0	# MIT
MODCARGO_CRATES +=	libz-sys	1.1.16	# MIT OR Apache-2.0
MODCARGO_CRATES +=	linked-hash-map	0.5.6	# MIT/Apache-2.0
MODCARGO_CRATES +=	linux-raw-sys	0.4.13	# Apache-2.0 WITH LLVM-exception OR Apache-2.0 OR MIT
MODCARGO_CRATES +=	lock_api	0.4.11	# MIT OR Apache-2.0
MODCARGO_CRATES +=	log	0.4.21	# MIT OR Apache-2.0
MODCARGO_CRATES +=	lru	0.12.3	# MIT
MODCARGO_CRATES +=	lru-cache	0.1.2	# MIT/Apache-2.0
MODCARGO_CRATES +=	lz4-sys	1.9.4	# MIT
MODCARGO_CRATES +=	lz4_flex	0.11.3	# MIT
MODCARGO_CRATES +=	mail-auth	0.3.11	# Apache-2.0 OR MIT
MODCARGO_CRATES +=	mail-builder	0.3.1	# Apache-2.0 OR MIT
MODCARGO_CRATES +=	mail-parser	0.9.3	# Apache-2.0 OR MIT
MODCARGO_CRATES +=	mail-send	0.4.7	# Apache-2.0 OR MIT
MODCARGO_CRATES +=	maplit	1.0.2	# MIT/Apache-2.0
MODCARGO_CRATES +=	match_cfg	0.1.0	# MIT/Apache-2.0
MODCARGO_CRATES +=	matchers	0.1.0	# MIT
MODCARGO_CRATES +=	matchit	0.7.3	# MIT AND BSD-3-Clause
MODCARGO_CRATES +=	maybe-async	0.2.10	# MIT
MODCARGO_CRATES +=	md-5	0.9.1	# MIT OR Apache-2.0
MODCARGO_CRATES +=	md-5	0.10.6	# MIT OR Apache-2.0
MODCARGO_CRATES +=	md5	0.7.0	# Apache-2.0/MIT
MODCARGO_CRATES +=	memchr	2.7.2	# Unlicense OR MIT
MODCARGO_CRATES +=	memoffset	0.7.1	# MIT
MODCARGO_CRATES +=	memsec	0.6.3	# MIT
MODCARGO_CRATES +=	mime	0.3.17	# MIT OR Apache-2.0
MODCARGO_CRATES +=	mime_guess	2.0.4	# MIT
MODCARGO_CRATES +=	minimal-lexical	0.2.1	# MIT/Apache-2.0
MODCARGO_CRATES +=	miniz_oxide	0.7.2	# MIT OR Zlib OR Apache-2.0
MODCARGO_CRATES +=	mio	0.8.11	# MIT
MODCARGO_CRATES +=	mysql-common-derive	0.31.1	# MIT/Apache-2.0
MODCARGO_CRATES +=	mysql_async	0.34.1	# MIT/Apache-2.0
MODCARGO_CRATES +=	mysql_common	0.32.2	# MIT/Apache-2.0
MODCARGO_CRATES +=	new_debug_unreachable	1.0.6	# MIT
MODCARGO_CRATES +=	nix	0.26.4	# MIT
MODCARGO_CRATES +=	nohash	0.2.0	# Apache-2.0 OR MIT
MODCARGO_CRATES +=	nom	7.1.3	# MIT
MODCARGO_CRATES +=	nu-ansi-term	0.46.0	# MIT
MODCARGO_CRATES +=	num-bigint	0.4.4	# MIT OR Apache-2.0
MODCARGO_CRATES +=	num-bigint-dig	0.8.4	# MIT/Apache-2.0
MODCARGO_CRATES +=	num-conv	0.1.0	# MIT OR Apache-2.0
MODCARGO_CRATES +=	num-integer	0.1.46	# MIT OR Apache-2.0
MODCARGO_CRATES +=	num-iter	0.1.44	# MIT OR Apache-2.0
MODCARGO_CRATES +=	num-traits	0.2.18	# MIT OR Apache-2.0
MODCARGO_CRATES +=	num_cpus	1.16.0	# MIT OR Apache-2.0
MODCARGO_CRATES +=	number_prefix	0.4.0	# MIT
MODCARGO_CRATES +=	object	0.32.2	# Apache-2.0 OR MIT
MODCARGO_CRATES +=	oid-registry	0.6.1	# MIT/Apache-2.0
MODCARGO_CRATES +=	oid-registry	0.7.0	# MIT OR Apache-2.0
MODCARGO_CRATES +=	once_cell	1.19.0	# MIT OR Apache-2.0
MODCARGO_CRATES +=	opaque-debug	0.3.1	# MIT OR Apache-2.0
MODCARGO_CRATES +=	openssl	0.10.64	# Apache-2.0
MODCARGO_CRATES +=	openssl-macros	0.1.1	# MIT/Apache-2.0
MODCARGO_CRATES +=	openssl-probe	0.1.5	# MIT/Apache-2.0
MODCARGO_CRATES +=	openssl-sys	0.9.102	# MIT
MODCARGO_CRATES +=	opentelemetry	0.22.0	# Apache-2.0
MODCARGO_CRATES +=	opentelemetry-http	0.11.1	# Apache-2.0
MODCARGO_CRATES +=	opentelemetry-otlp	0.15.0	# Apache-2.0
MODCARGO_CRATES +=	opentelemetry-proto	0.5.0	# Apache-2.0
MODCARGO_CRATES +=	opentelemetry-semantic-conventions	0.14.0	# Apache-2.0
MODCARGO_CRATES +=	opentelemetry_sdk	0.22.1	# Apache-2.0
MODCARGO_CRATES +=	ordered-float	4.2.0	# MIT
MODCARGO_CRATES +=	ordered-multimap	0.4.3	# MIT
MODCARGO_CRATES +=	overload	0.1.1	# MIT
MODCARGO_CRATES +=	p256	0.13.2	# Apache-2.0 OR MIT
MODCARGO_CRATES +=	parking_lot	0.12.1	# MIT OR Apache-2.0
MODCARGO_CRATES +=	parking_lot_core	0.9.9	# MIT OR Apache-2.0
MODCARGO_CRATES +=	password-hash	0.4.2	# MIT OR Apache-2.0
MODCARGO_CRATES +=	password-hash	0.5.0	# MIT OR Apache-2.0
MODCARGO_CRATES +=	paste	1.0.14	# MIT OR Apache-2.0
MODCARGO_CRATES +=	pbkdf2	0.11.0	# MIT OR Apache-2.0
MODCARGO_CRATES +=	pbkdf2	0.12.2	# MIT OR Apache-2.0
MODCARGO_CRATES +=	pem	3.0.4	# MIT
MODCARGO_CRATES +=	pem-rfc7468	0.7.0	# Apache-2.0 OR MIT
MODCARGO_CRATES +=	percent-encoding	2.3.1	# MIT OR Apache-2.0
MODCARGO_CRATES +=	petgraph	0.6.4	# MIT OR Apache-2.0
MODCARGO_CRATES +=	phf	0.11.2	# MIT
MODCARGO_CRATES +=	phf_codegen	0.11.2	# MIT
MODCARGO_CRATES +=	phf_generator	0.11.2	# MIT
MODCARGO_CRATES +=	phf_macros	0.11.2	# MIT
MODCARGO_CRATES +=	phf_shared	0.10.0	# MIT
MODCARGO_CRATES +=	phf_shared	0.11.2	# MIT
MODCARGO_CRATES +=	pin-project	1.1.5	# Apache-2.0 OR MIT
MODCARGO_CRATES +=	pin-project-internal	1.1.5	# Apache-2.0 OR MIT
MODCARGO_CRATES +=	pin-project-lite	0.2.14	# Apache-2.0 OR MIT
MODCARGO_CRATES +=	pin-utils	0.1.0	# MIT OR Apache-2.0
MODCARGO_CRATES +=	pkcs1	0.7.5	# Apache-2.0 OR MIT
MODCARGO_CRATES +=	pkcs8	0.10.2	# Apache-2.0 OR MIT
MODCARGO_CRATES +=	pkg-config	0.3.30	# MIT OR Apache-2.0
MODCARGO_CRATES +=	platforms	3.4.0	# Apache-2.0 OR MIT
MODCARGO_CRATES +=	polyval	0.6.2	# Apache-2.0 OR MIT
MODCARGO_CRATES +=	portable-atomic	1.6.0	# Apache-2.0 OR MIT
MODCARGO_CRATES +=	postgres-protocol	0.6.6	# MIT/Apache-2.0
MODCARGO_CRATES +=	postgres-types	0.2.6	# MIT/Apache-2.0
MODCARGO_CRATES +=	powerfmt	0.2.0	# MIT OR Apache-2.0
MODCARGO_CRATES +=	ppv-lite86	0.2.17	# MIT/Apache-2.0
MODCARGO_CRATES +=	precomputed-hash	0.1.1	# MIT
MODCARGO_CRATES +=	prettyplease	0.2.17	# MIT OR Apache-2.0
MODCARGO_CRATES +=	prettytable-rs	0.10.0	# BSD-3-Clause
MODCARGO_CRATES +=	primeorder	0.13.6	# Apache-2.0 OR MIT
MODCARGO_CRATES +=	privdrop	0.5.4	# ISC
MODCARGO_CRATES +=	proc-macro-crate	3.1.0	# MIT OR Apache-2.0
MODCARGO_CRATES +=	proc-macro-error	1.0.4	# MIT OR Apache-2.0
MODCARGO_CRATES +=	proc-macro-error-attr	1.0.4	# MIT OR Apache-2.0
MODCARGO_CRATES +=	proc-macro2	1.0.79	# MIT OR Apache-2.0
MODCARGO_CRATES +=	prost	0.12.4	# Apache-2.0
MODCARGO_CRATES +=	prost-derive	0.12.4	# Apache-2.0
MODCARGO_CRATES +=	proxy-header	0.1.0	# MIT
MODCARGO_CRATES +=	ptr_meta	0.1.4	# MIT
MODCARGO_CRATES +=	ptr_meta_derive	0.1.4	# MIT
MODCARGO_CRATES +=	pwhash	1.0.0	# MIT
MODCARGO_CRATES +=	quick-error	1.2.3	# MIT/Apache-2.0
MODCARGO_CRATES +=	quick-xml	0.26.0	# MIT
MODCARGO_CRATES +=	quick-xml	0.31.0	# MIT
MODCARGO_CRATES +=	quote	1.0.36	# MIT OR Apache-2.0
MODCARGO_CRATES +=	r2d2	0.8.10	# MIT/Apache-2.0
MODCARGO_CRATES +=	radium	0.7.0	# MIT
MODCARGO_CRATES +=	rand	0.8.5	# MIT OR Apache-2.0
MODCARGO_CRATES +=	rand_chacha	0.3.1	# MIT OR Apache-2.0
MODCARGO_CRATES +=	rand_core	0.6.4	# MIT OR Apache-2.0
MODCARGO_CRATES +=	rasn	0.10.6	# MIT/Apache-2.0
MODCARGO_CRATES +=	rasn-cms	0.10.6	# MIT/Apache-2.0
MODCARGO_CRATES +=	rasn-derive	0.10.6	# MIT/Apache-2.0
MODCARGO_CRATES +=	rasn-pkix	0.10.6	# MIT/Apache-2.0
MODCARGO_CRATES +=	rayon	1.10.0	# MIT OR Apache-2.0
MODCARGO_CRATES +=	rayon-core	1.12.1	# MIT OR Apache-2.0
MODCARGO_CRATES +=	rcgen	0.12.1	# MIT OR Apache-2.0
MODCARGO_CRATES +=	rcgen	0.13.1	# MIT OR Apache-2.0
MODCARGO_CRATES +=	redis	0.25.3	# BSD-3-Clause
MODCARGO_CRATES +=	redox_syscall	0.4.1	# MIT
MODCARGO_CRATES +=	redox_users	0.4.5	# MIT
MODCARGO_CRATES +=	regex	1.10.4	# MIT OR Apache-2.0
MODCARGO_CRATES +=	regex-automata	0.1.10	# Unlicense/MIT
MODCARGO_CRATES +=	regex-automata	0.4.6	# MIT OR Apache-2.0
MODCARGO_CRATES +=	regex-syntax	0.6.29	# MIT OR Apache-2.0
MODCARGO_CRATES +=	regex-syntax	0.8.3	# MIT OR Apache-2.0
MODCARGO_CRATES +=	rend	0.4.2	# MIT
MODCARGO_CRATES +=	reqwest	0.11.27	# MIT OR Apache-2.0
MODCARGO_CRATES +=	reqwest	0.12.3	# MIT OR Apache-2.0
MODCARGO_CRATES +=	resolv-conf	0.7.0	# MIT/Apache-2.0
MODCARGO_CRATES +=	rev_lines	0.3.0	# MIT
MODCARGO_CRATES +=	rfc6979	0.4.0	# Apache-2.0 OR MIT
MODCARGO_CRATES +=	ring	0.16.20	# LICENSE
MODCARGO_CRATES +=	ring	0.17.8	# LICENSE
MODCARGO_CRATES +=	ripemd	0.1.3	# MIT OR Apache-2.0
MODCARGO_CRATES +=	rkyv	0.7.44	# MIT
MODCARGO_CRATES +=	rkyv_derive	0.7.44	# MIT
MODCARGO_CRATES +=	roaring	0.10.3	# MIT OR Apache-2.0
MODCARGO_CRATES +=	rocksdb	0.22.0	# Apache-2.0
MODCARGO_CRATES +=	rpassword	7.3.1	# Apache-2.0
MODCARGO_CRATES +=	rsa	0.9.6	# MIT OR Apache-2.0
MODCARGO_CRATES +=	rtoolbox	0.0.2	# Apache-2.0
MODCARGO_CRATES +=	rusqlite	0.31.0	# MIT
MODCARGO_CRATES +=	rust-ini	0.18.0	# MIT
MODCARGO_CRATES +=	rust-s3	0.33.0	# MIT
MODCARGO_CRATES +=	rust-stemmers	1.2.0	# MIT/BSD-3-Clause
MODCARGO_CRATES +=	rust_decimal	1.35.0	# MIT
MODCARGO_CRATES +=	rustc-demangle	0.1.23	# MIT/Apache-2.0
MODCARGO_CRATES +=	rustc-hash	1.1.0	# Apache-2.0/MIT
MODCARGO_CRATES +=	rustc_version	0.2.3	# MIT/Apache-2.0
MODCARGO_CRATES +=	rustc_version	0.4.0	# MIT/Apache-2.0
MODCARGO_CRATES +=	rusticata-macros	4.1.0	# MIT/Apache-2.0
MODCARGO_CRATES +=	rustix	0.38.32	# Apache-2.0 WITH LLVM-exception OR Apache-2.0 OR MIT
MODCARGO_CRATES +=	rustls	0.20.9	# Apache-2.0/ISC/MIT
MODCARGO_CRATES +=	rustls	0.21.10	# Apache-2.0 OR ISC OR MIT
MODCARGO_CRATES +=	rustls	0.22.3	# Apache-2.0 OR ISC OR MIT
MODCARGO_CRATES +=	rustls-native-certs	0.6.3	# Apache-2.0 OR ISC OR MIT
MODCARGO_CRATES +=	rustls-native-certs	0.7.0	# Apache-2.0 OR ISC OR MIT
MODCARGO_CRATES +=	rustls-pemfile	1.0.4	# Apache-2.0 OR ISC OR MIT
MODCARGO_CRATES +=	rustls-pemfile	2.1.2	# Apache-2.0 OR ISC OR MIT
MODCARGO_CRATES +=	rustls-pki-types	1.4.1	# MIT OR Apache-2.0
MODCARGO_CRATES +=	rustls-webpki	0.101.7	# ISC
MODCARGO_CRATES +=	rustls-webpki	0.102.2	# ISC
MODCARGO_CRATES +=	rustversion	1.0.15	# MIT OR Apache-2.0
MODCARGO_CRATES +=	ryu	1.0.17	# Apache-2.0 OR BSL-1.0
MODCARGO_CRATES +=	salsa20	0.10.2	# MIT OR Apache-2.0
MODCARGO_CRATES +=	same-file	1.0.6	# Unlicense/MIT
MODCARGO_CRATES +=	saturating	0.1.0	# MIT
MODCARGO_CRATES +=	schannel	0.1.23	# MIT
MODCARGO_CRATES +=	scheduled-thread-pool	0.2.7	# MIT/Apache-2.0
MODCARGO_CRATES +=	scopeguard	1.2.0	# MIT OR Apache-2.0
MODCARGO_CRATES +=	scrypt	0.11.0	# MIT OR Apache-2.0
MODCARGO_CRATES +=	sct	0.7.1	# Apache-2.0 OR ISC OR MIT
MODCARGO_CRATES +=	seahash	4.1.0	# MIT
MODCARGO_CRATES +=	sec1	0.7.3	# Apache-2.0 OR MIT
MODCARGO_CRATES +=	security-framework	2.10.0	# MIT OR Apache-2.0
MODCARGO_CRATES +=	security-framework-sys	2.10.0	# MIT OR Apache-2.0
MODCARGO_CRATES +=	semver	0.9.0	# MIT/Apache-2.0
MODCARGO_CRATES +=	semver	1.0.22	# MIT OR Apache-2.0
MODCARGO_CRATES +=	semver-parser	0.7.0	# MIT/Apache-2.0
MODCARGO_CRATES +=	sequoia-openpgp	1.20.0	# LGPL-2.0-or-later
MODCARGO_CRATES +=	serde	1.0.197	# MIT OR Apache-2.0
MODCARGO_CRATES +=	serde_bytes	0.11.14	# MIT OR Apache-2.0
MODCARGO_CRATES +=	serde_derive	1.0.197	# MIT OR Apache-2.0
MODCARGO_CRATES +=	serde_json	1.0.115	# MIT OR Apache-2.0
MODCARGO_CRATES +=	serde_urlencoded	0.7.1	# MIT/Apache-2.0
MODCARGO_CRATES +=	serde_with	1.14.0	# MIT OR Apache-2.0
MODCARGO_CRATES +=	serde_with_macros	1.5.2	# MIT OR Apache-2.0
MODCARGO_CRATES +=	serial_test	3.0.0	# MIT
MODCARGO_CRATES +=	serial_test_derive	3.0.0	# MIT
MODCARGO_CRATES +=	sha-1	0.9.8	# MIT OR Apache-2.0
MODCARGO_CRATES +=	sha1	0.10.6	# MIT OR Apache-2.0
MODCARGO_CRATES +=	sha1_smol	1.0.0	# BSD-3-Clause
MODCARGO_CRATES +=	sha1collisiondetection	0.3.4	# MIT
MODCARGO_CRATES +=	sha2	0.9.9	# MIT OR Apache-2.0
MODCARGO_CRATES +=	sha2	0.10.8	# MIT OR Apache-2.0
MODCARGO_CRATES +=	sharded-slab	0.1.7	# MIT
MODCARGO_CRATES +=	shlex	1.3.0	# MIT OR Apache-2.0
MODCARGO_CRATES +=	sieve-rs	0.5.0	# AGPL-3.0-only
MODCARGO_CRATES +=	signal-hook-registry	1.4.1	# Apache-2.0/MIT
MODCARGO_CRATES +=	signature	2.2.0	# Apache-2.0 OR MIT
MODCARGO_CRATES +=	simdutf8	0.1.4	# MIT OR Apache-2.0
MODCARGO_CRATES +=	siphasher	0.3.11	# MIT/Apache-2.0
MODCARGO_CRATES +=	siphasher	1.0.1	# MIT/Apache-2.0
MODCARGO_CRATES +=	slab	0.4.9	# MIT
MODCARGO_CRATES +=	smallvec	1.13.2	# MIT OR Apache-2.0
MODCARGO_CRATES +=	smtp-proto	0.1.4	# Apache-2.0 OR MIT
MODCARGO_CRATES +=	snafu	0.7.5	# MIT OR Apache-2.0
MODCARGO_CRATES +=	snafu-derive	0.7.5	# MIT OR Apache-2.0
MODCARGO_CRATES +=	socket2	0.5.6	# MIT OR Apache-2.0
MODCARGO_CRATES +=	spin	0.5.2	# MIT
MODCARGO_CRATES +=	spin	0.9.8	# MIT
MODCARGO_CRATES +=	spki	0.7.3	# Apache-2.0 OR MIT
MODCARGO_CRATES +=	static_assertions	1.1.0	# MIT OR Apache-2.0
MODCARGO_CRATES +=	string_cache	0.8.7	# MIT OR Apache-2.0
MODCARGO_CRATES +=	stringprep	0.1.4	# MIT/Apache-2.0
MODCARGO_CRATES +=	strsim	0.10.0	# MIT
MODCARGO_CRATES +=	strsim	0.11.1	# MIT
MODCARGO_CRATES +=	subprocess	0.2.9	# Apache-2.0/MIT
MODCARGO_CRATES +=	subtle	2.5.0	# BSD-3-Clause
MODCARGO_CRATES +=	syn	1.0.109	# MIT OR Apache-2.0
MODCARGO_CRATES +=	syn	2.0.58	# MIT OR Apache-2.0
MODCARGO_CRATES +=	syn_derive	0.1.8	# MIT OR Apache-2.0
MODCARGO_CRATES +=	sync_wrapper	0.1.2	# Apache-2.0
MODCARGO_CRATES +=	synstructure	0.12.6	# MIT
MODCARGO_CRATES +=	synstructure	0.13.1	# MIT
MODCARGO_CRATES +=	system-configuration	0.5.1	# MIT OR Apache-2.0
MODCARGO_CRATES +=	system-configuration-sys	0.5.0	# MIT OR Apache-2.0
MODCARGO_CRATES +=	tap	1.0.1	# MIT
MODCARGO_CRATES +=	term	0.7.0	# MIT/Apache-2.0
MODCARGO_CRATES +=	termcolor	1.4.1	# Unlicense OR MIT
MODCARGO_CRATES +=	thiserror	1.0.58	# MIT OR Apache-2.0
MODCARGO_CRATES +=	thiserror-impl	1.0.58	# MIT OR Apache-2.0
MODCARGO_CRATES +=	thread_local	1.1.8	# MIT OR Apache-2.0
MODCARGO_CRATES +=	time	0.3.36	# MIT OR Apache-2.0
MODCARGO_CRATES +=	time-core	0.1.2	# MIT OR Apache-2.0
MODCARGO_CRATES +=	time-macros	0.2.18	# MIT OR Apache-2.0
MODCARGO_CRATES +=	tiny-keccak	2.0.2	# CC0-1.0
MODCARGO_CRATES +=	tinysegmenter	0.1.1	# MIT
MODCARGO_CRATES +=	tinyvec	1.6.0	# Zlib OR Apache-2.0 OR MIT
MODCARGO_CRATES +=	tinyvec_macros	0.1.1	# MIT OR Apache-2.0 OR Zlib
MODCARGO_CRATES +=	tokio	1.37.0	# MIT
MODCARGO_CRATES +=	tokio-io-timeout	1.2.0	# MIT/Apache-2.0
MODCARGO_CRATES +=	tokio-macros	2.2.0	# MIT
MODCARGO_CRATES +=	tokio-postgres	0.7.10	# MIT/Apache-2.0
MODCARGO_CRATES +=	tokio-rustls	0.24.1	# MIT/Apache-2.0
MODCARGO_CRATES +=	tokio-rustls	0.25.0	# MIT/Apache-2.0
MODCARGO_CRATES +=	tokio-stream	0.1.15	# MIT
MODCARGO_CRATES +=	tokio-tungstenite	0.21.0	# MIT
MODCARGO_CRATES +=	tokio-util	0.7.10	# MIT
MODCARGO_CRATES +=	toml_datetime	0.6.5	# MIT OR Apache-2.0
MODCARGO_CRATES +=	toml_edit	0.21.1	# MIT OR Apache-2.0
MODCARGO_CRATES +=	tonic	0.11.0	# MIT
MODCARGO_CRATES +=	tower	0.4.13	# MIT
MODCARGO_CRATES +=	tower-layer	0.3.2	# MIT
MODCARGO_CRATES +=	tower-service	0.3.2	# MIT
MODCARGO_CRATES +=	tracing	0.1.40	# MIT
MODCARGO_CRATES +=	tracing-appender	0.2.3	# MIT
MODCARGO_CRATES +=	tracing-attributes	0.1.27	# MIT
MODCARGO_CRATES +=	tracing-core	0.1.32	# MIT
MODCARGO_CRATES +=	tracing-journald	0.3.0	# MIT
MODCARGO_CRATES +=	tracing-log	0.2.0	# MIT
MODCARGO_CRATES +=	tracing-opentelemetry	0.23.0	# MIT
MODCARGO_CRATES +=	tracing-subscriber	0.3.18	# MIT
MODCARGO_CRATES +=	try-lock	0.2.5	# MIT
MODCARGO_CRATES +=	try_map	0.3.1	# Apache-2.0/MIT
MODCARGO_CRATES +=	tungstenite	0.21.0	# MIT OR Apache-2.0
MODCARGO_CRATES +=	twofish	0.7.1	# MIT OR Apache-2.0
MODCARGO_CRATES +=	twox-hash	1.6.3	# MIT
MODCARGO_CRATES +=	typenum	1.17.0	# MIT OR Apache-2.0
MODCARGO_CRATES +=	typewit	1.9.0	# Zlib
MODCARGO_CRATES +=	typewit_proc_macros	1.8.1	# Zlib
MODCARGO_CRATES +=	unicase	2.7.0	# MIT/Apache-2.0
MODCARGO_CRATES +=	unicode-bidi	0.3.15	# MIT OR Apache-2.0
MODCARGO_CRATES +=	unicode-ident	1.0.12	# (MIT OR Apache-2.0) AND Unicode-DFS-2016
MODCARGO_CRATES +=	unicode-normalization	0.1.23	# MIT/Apache-2.0
MODCARGO_CRATES +=	unicode-script	0.5.6	# MIT OR Apache-2.0
MODCARGO_CRATES +=	unicode-security	0.1.1	# MIT/Apache-2.0
MODCARGO_CRATES +=	unicode-width	0.1.11	# MIT/Apache-2.0
MODCARGO_CRATES +=	unicode-xid	0.2.4	# MIT OR Apache-2.0
MODCARGO_CRATES +=	universal-hash	0.5.1	# MIT OR Apache-2.0
MODCARGO_CRATES +=	untrusted	0.7.1	# ISC
MODCARGO_CRATES +=	untrusted	0.9.0	# ISC
MODCARGO_CRATES +=	url	2.5.0	# MIT OR Apache-2.0
MODCARGO_CRATES +=	urlencoding	2.1.3	# MIT
MODCARGO_CRATES +=	utf-8	0.7.6	# MIT OR Apache-2.0
MODCARGO_CRATES +=	utf8parse	0.2.1	# Apache-2.0 OR MIT
MODCARGO_CRATES +=	uuid	1.8.0	# Apache-2.0 OR MIT
MODCARGO_CRATES +=	valuable	0.1.0	# MIT
MODCARGO_CRATES +=	vcpkg	0.2.15	# MIT/Apache-2.0
MODCARGO_CRATES +=	version_check	0.9.4	# MIT/Apache-2.0
MODCARGO_CRATES +=	void	1.0.2	# MIT
MODCARGO_CRATES +=	walkdir	2.5.0	# Unlicense/MIT
MODCARGO_CRATES +=	want	0.3.1	# MIT
MODCARGO_CRATES +=	wasi	0.11.0+wasi-snapshot-preview1	# Apache-2.0 WITH LLVM-exception OR Apache-2.0 OR MIT
MODCARGO_CRATES +=	wasite	0.1.0	# Apache-2.0 OR BSL-1.0 OR MIT
MODCARGO_CRATES +=	wasm-bindgen	0.2.92	# MIT OR Apache-2.0
MODCARGO_CRATES +=	wasm-bindgen-backend	0.2.92	# MIT OR Apache-2.0
MODCARGO_CRATES +=	wasm-bindgen-futures	0.4.42	# MIT OR Apache-2.0
MODCARGO_CRATES +=	wasm-bindgen-macro	0.2.92	# MIT OR Apache-2.0
MODCARGO_CRATES +=	wasm-bindgen-macro-support	0.2.92	# MIT OR Apache-2.0
MODCARGO_CRATES +=	wasm-bindgen-shared	0.2.92	# MIT OR Apache-2.0
MODCARGO_CRATES +=	wasm-streams	0.4.0	# MIT OR Apache-2.0
MODCARGO_CRATES +=	web-sys	0.3.69	# MIT OR Apache-2.0
MODCARGO_CRATES +=	web-time	1.1.0	# MIT OR Apache-2.0
MODCARGO_CRATES +=	webpki	0.22.4	# LICENSE
MODCARGO_CRATES +=	webpki-roots	0.22.6	# MPL-2.0
MODCARGO_CRATES +=	webpki-roots	0.25.4	# MPL-2.0
MODCARGO_CRATES +=	webpki-roots	0.26.1	# MPL-2.0
MODCARGO_CRATES +=	whatlang	0.16.4	# MIT
MODCARGO_CRATES +=	which	4.4.2	# MIT
MODCARGO_CRATES +=	whoami	1.5.1	# Apache-2.0 OR BSL-1.0 OR MIT
MODCARGO_CRATES +=	widestring	1.1.0	# MIT OR Apache-2.0
MODCARGO_CRATES +=	winapi	0.3.9	# MIT/Apache-2.0
MODCARGO_CRATES +=	winapi-i686-pc-windows-gnu	0.4.0	# MIT/Apache-2.0
MODCARGO_CRATES +=	winapi-util	0.1.6	# Unlicense/MIT
MODCARGO_CRATES +=	winapi-x86_64-pc-windows-gnu	0.4.0	# MIT/Apache-2.0
MODCARGO_CRATES +=	windows	0.52.0	# MIT OR Apache-2.0
MODCARGO_CRATES +=	windows-core	0.52.0	# MIT OR Apache-2.0
MODCARGO_CRATES +=	windows-sys	0.48.0	# MIT OR Apache-2.0
MODCARGO_CRATES +=	windows-sys	0.52.0	# MIT OR Apache-2.0
MODCARGO_CRATES +=	windows-targets	0.48.5	# MIT OR Apache-2.0
MODCARGO_CRATES +=	windows-targets	0.52.4	# MIT OR Apache-2.0
MODCARGO_CRATES +=	windows_aarch64_gnullvm	0.48.5	# MIT OR Apache-2.0
MODCARGO_CRATES +=	windows_aarch64_gnullvm	0.52.4	# MIT OR Apache-2.0
MODCARGO_CRATES +=	windows_aarch64_msvc	0.48.5	# MIT OR Apache-2.0
MODCARGO_CRATES +=	windows_aarch64_msvc	0.52.4	# MIT OR Apache-2.0
MODCARGO_CRATES +=	windows_i686_gnu	0.48.5	# MIT OR Apache-2.0
MODCARGO_CRATES +=	windows_i686_gnu	0.52.4	# MIT OR Apache-2.0
MODCARGO_CRATES +=	windows_i686_msvc	0.48.5	# MIT OR Apache-2.0
MODCARGO_CRATES +=	windows_i686_msvc	0.52.4	# MIT OR Apache-2.0
MODCARGO_CRATES +=	windows_x86_64_gnu	0.48.5	# MIT OR Apache-2.0
MODCARGO_CRATES +=	windows_x86_64_gnu	0.52.4	# MIT OR Apache-2.0
MODCARGO_CRATES +=	windows_x86_64_gnullvm	0.48.5	# MIT OR Apache-2.0
MODCARGO_CRATES +=	windows_x86_64_gnullvm	0.52.4	# MIT OR Apache-2.0
MODCARGO_CRATES +=	windows_x86_64_msvc	0.48.5	# MIT OR Apache-2.0
MODCARGO_CRATES +=	windows_x86_64_msvc	0.52.4	# MIT OR Apache-2.0
MODCARGO_CRATES +=	winnow	0.5.40	# MIT
MODCARGO_CRATES +=	winreg	0.50.0	# MIT
MODCARGO_CRATES +=	winreg	0.52.0	# MIT
MODCARGO_CRATES +=	wyz	0.5.1	# MIT
MODCARGO_CRATES +=	x25519-dalek	2.0.1	# BSD-3-Clause
MODCARGO_CRATES +=	x509-parser	0.15.1	# MIT OR Apache-2.0
MODCARGO_CRATES +=	x509-parser	0.16.0	# MIT OR Apache-2.0
MODCARGO_CRATES +=	xml-rs	0.8.20	# MIT
MODCARGO_CRATES +=	xxhash-rust	0.8.10	# BSL-1.0
MODCARGO_CRATES +=	yasna	0.5.2	# MIT OR Apache-2.0
MODCARGO_CRATES +=	zerocopy	0.7.32	# BSD-2-Clause OR Apache-2.0 OR MIT
MODCARGO_CRATES +=	zerocopy-derive	0.7.32	# BSD-2-Clause OR Apache-2.0 OR MIT
MODCARGO_CRATES +=	zeroize	1.7.0	# Apache-2.0 OR MIT
MODCARGO_CRATES +=	zeroize_derive	1.4.2	# Apache-2.0 OR MIT
MODCARGO_CRATES +=	zip	0.6.6	# MIT
MODCARGO_CRATES +=	zstd	0.11.2+zstd.1.5.2	# MIT
MODCARGO_CRATES +=	zstd	0.13.1	# MIT
MODCARGO_CRATES +=	zstd-safe	5.0.2+zstd.1.5.2	# MIT/Apache-2.0
MODCARGO_CRATES +=	zstd-safe	7.1.0	# MIT/Apache-2.0
MODCARGO_CRATES +=	zstd-sys	2.0.10+zstd.1.5.6	# MIT/Apache-2.0
