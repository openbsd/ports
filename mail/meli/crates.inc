MODCARGO_CRATES +=	abnf-core	0.6.0
MODCARGO_CRATES +=	adler2	2.0.0
MODCARGO_CRATES +=	ahash	0.8.11
MODCARGO_CRATES +=	aho-corasick	1.1.3
MODCARGO_CRATES +=	allocator-api2	0.2.18
MODCARGO_CRATES +=	android-tzdata	0.1.1
MODCARGO_CRATES +=	android_system_properties	0.1.5
MODCARGO_CRATES +=	anstyle	1.0.8
MODCARGO_CRATES +=	assert_cmd	2.0.13
MODCARGO_CRATES +=	async-channel	1.9.0
MODCARGO_CRATES +=	async-channel	2.3.1
MODCARGO_CRATES +=	async-executor	1.13.0
MODCARGO_CRATES +=	async-fn-stream	0.2.2
MODCARGO_CRATES +=	async-fs	2.1.2
MODCARGO_CRATES +=	async-io	2.3.4
MODCARGO_CRATES +=	async-lock	3.4.0
MODCARGO_CRATES +=	async-net	2.0.0
MODCARGO_CRATES +=	async-process	2.2.4
MODCARGO_CRATES +=	async-signal	0.2.10
MODCARGO_CRATES +=	async-task	4.7.1
MODCARGO_CRATES +=	atomic-waker	1.1.2
MODCARGO_CRATES +=	autocfg	1.3.0
MODCARGO_CRATES +=	base64	0.22.1
MODCARGO_CRATES +=	bitflags	1.3.2
MODCARGO_CRATES +=	bitflags	2.6.0
MODCARGO_CRATES +=	block	0.1.6
MODCARGO_CRATES +=	blocking	1.6.1
MODCARGO_CRATES +=	bounded-static	0.8.0
MODCARGO_CRATES +=	bounded-static-derive	0.8.0
MODCARGO_CRATES +=	bstr	1.10.0
MODCARGO_CRATES +=	bumpalo	3.16.0
MODCARGO_CRATES +=	bytes	1.7.1
MODCARGO_CRATES +=	castaway	0.1.2
MODCARGO_CRATES +=	cc	1.1.15
MODCARGO_CRATES +=	cfg-if	1.0.0
MODCARGO_CRATES +=	cfg_aliases	0.2.1
MODCARGO_CRATES +=	chrono	0.4.38
MODCARGO_CRATES +=	clap	2.34.0
MODCARGO_CRATES +=	concurrent-queue	2.5.0
MODCARGO_CRATES +=	core-foundation	0.9.4
MODCARGO_CRATES +=	core-foundation-sys	0.8.7
MODCARGO_CRATES +=	crc32fast	1.4.2
MODCARGO_CRATES +=	crossbeam	0.8.4
MODCARGO_CRATES +=	crossbeam-channel	0.5.13
MODCARGO_CRATES +=	crossbeam-deque	0.8.5
MODCARGO_CRATES +=	crossbeam-epoch	0.9.18
MODCARGO_CRATES +=	crossbeam-queue	0.3.11
MODCARGO_CRATES +=	crossbeam-utils	0.8.20
MODCARGO_CRATES +=	csv	1.3.0
MODCARGO_CRATES +=	csv-core	0.1.11
MODCARGO_CRATES +=	curl	0.4.46
MODCARGO_CRATES +=	curl-sys	0.4.74+curl-8.9.0
MODCARGO_CRATES +=	data-encoding	2.6.0
MODCARGO_CRATES +=	dbus	0.9.7
MODCARGO_CRATES +=	deranged	0.3.11
MODCARGO_CRATES +=	difflib	0.4.0
MODCARGO_CRATES +=	dirs-next	2.0.0
MODCARGO_CRATES +=	dirs-sys-next	0.1.2
MODCARGO_CRATES +=	doc-comment	0.3.3
MODCARGO_CRATES +=	encoding_rs	0.8.34
MODCARGO_CRATES +=	equivalent	1.0.1
MODCARGO_CRATES +=	errno	0.3.9
MODCARGO_CRATES +=	event-listener	2.5.3
MODCARGO_CRATES +=	event-listener	5.3.1
MODCARGO_CRATES +=	event-listener-strategy	0.5.2
MODCARGO_CRATES +=	fallible-iterator	0.2.0
MODCARGO_CRATES +=	fallible-streaming-iterator	0.1.9
MODCARGO_CRATES +=	fastrand	1.9.0
MODCARGO_CRATES +=	fastrand	2.1.1
MODCARGO_CRATES +=	filetime	0.2.25
MODCARGO_CRATES +=	flate2	1.0.33
MODCARGO_CRATES +=	float-cmp	0.9.0
MODCARGO_CRATES +=	fnv	1.0.7
MODCARGO_CRATES +=	foreign-types	0.3.2
MODCARGO_CRATES +=	foreign-types-shared	0.1.1
MODCARGO_CRATES +=	form_urlencoded	1.2.1
MODCARGO_CRATES +=	fsevent-sys	4.1.0
MODCARGO_CRATES +=	futures	0.3.30
MODCARGO_CRATES +=	futures-channel	0.3.31
MODCARGO_CRATES +=	futures-core	0.3.31
MODCARGO_CRATES +=	futures-executor	0.3.30
MODCARGO_CRATES +=	futures-io	0.3.31
MODCARGO_CRATES +=	futures-lite	1.13.0
MODCARGO_CRATES +=	futures-lite	2.3.0
MODCARGO_CRATES +=	futures-macro	0.3.31
MODCARGO_CRATES +=	futures-sink	0.3.31
MODCARGO_CRATES +=	futures-task	0.3.31
MODCARGO_CRATES +=	futures-util	0.3.31
MODCARGO_CRATES +=	getrandom	0.2.15
MODCARGO_CRATES +=	hashbrown	0.14.5
MODCARGO_CRATES +=	hashlink	0.8.4
MODCARGO_CRATES +=	heck	0.3.3
MODCARGO_CRATES +=	hermit-abi	0.4.0
MODCARGO_CRATES +=	http	0.2.12
MODCARGO_CRATES +=	iana-time-zone	0.1.60
MODCARGO_CRATES +=	iana-time-zone-haiku	0.1.2
MODCARGO_CRATES +=	idna	0.5.0
MODCARGO_CRATES +=	imap-codec	2.0.0-alpha.5
MODCARGO_CRATES +=	imap-types	2.0.0-alpha.4
MODCARGO_CRATES +=	indexmap	2.4.0
MODCARGO_CRATES +=	inotify	0.9.6
MODCARGO_CRATES +=	inotify-sys	0.1.5
MODCARGO_CRATES +=	instant	0.1.13
MODCARGO_CRATES +=	isahc	1.7.2
MODCARGO_CRATES +=	itoa	1.0.11
MODCARGO_CRATES +=	js-sys	0.3.70
MODCARGO_CRATES +=	kqueue	1.0.8
MODCARGO_CRATES +=	kqueue-sys	1.0.4
MODCARGO_CRATES +=	lazy_static	1.5.0
MODCARGO_CRATES +=	libc	0.2.158
MODCARGO_CRATES +=	libdbus-sys	0.2.5
MODCARGO_CRATES +=	libloading	0.8.5
MODCARGO_CRATES +=	libnghttp2-sys	0.1.10+1.61.0
MODCARGO_CRATES +=	libredox	0.1.3
MODCARGO_CRATES +=	libsqlite3-sys	0.26.0
MODCARGO_CRATES +=	libz-sys	1.1.20
MODCARGO_CRATES +=	linkify	0.10.0
MODCARGO_CRATES +=	linux-raw-sys	0.4.14
MODCARGO_CRATES +=	log	0.4.22
MODCARGO_CRATES +=	mac-notification-sys	0.6.1
MODCARGO_CRATES +=	malloc_buf	0.0.6
MODCARGO_CRATES +=	memchr	2.7.4
MODCARGO_CRATES +=	memoffset	0.9.1
MODCARGO_CRATES +=	mime	0.3.17
MODCARGO_CRATES +=	minimal-lexical	0.2.1
MODCARGO_CRATES +=	miniz_oxide	0.8.0
MODCARGO_CRATES +=	mio	0.8.11
MODCARGO_CRATES +=	native-tls	0.2.12
MODCARGO_CRATES +=	nix	0.29.0
MODCARGO_CRATES +=	nom	7.1.3
MODCARGO_CRATES +=	normalize-line-endings	0.3.0
MODCARGO_CRATES +=	notify	6.1.1
MODCARGO_CRATES +=	notify-rust	4.11.1
MODCARGO_CRATES +=	num-conv	0.1.0
MODCARGO_CRATES +=	num-traits	0.2.19
MODCARGO_CRATES +=	numtoa	0.1.0
MODCARGO_CRATES +=	objc	0.2.7
MODCARGO_CRATES +=	objc-foundation	0.1.1
MODCARGO_CRATES +=	objc_id	0.1.1
MODCARGO_CRATES +=	once_cell	1.19.0
MODCARGO_CRATES +=	openssl	0.10.66
MODCARGO_CRATES +=	openssl-macros	0.1.1
MODCARGO_CRATES +=	openssl-probe	0.1.5
MODCARGO_CRATES +=	openssl-src	300.3.1+3.3.1
MODCARGO_CRATES +=	openssl-sys	0.9.103
MODCARGO_CRATES +=	parking	2.2.0
MODCARGO_CRATES +=	percent-encoding	2.3.1
MODCARGO_CRATES +=	pin-project	1.1.5
MODCARGO_CRATES +=	pin-project-internal	1.1.5
MODCARGO_CRATES +=	pin-project-lite	0.2.14
MODCARGO_CRATES +=	pin-utils	0.1.0
MODCARGO_CRATES +=	piper	0.2.4
MODCARGO_CRATES +=	pkg-config	0.3.30
MODCARGO_CRATES +=	polling	2.8.0
MODCARGO_CRATES +=	polling	3.7.3
MODCARGO_CRATES +=	powerfmt	0.2.0
MODCARGO_CRATES +=	predicates	3.1.0
MODCARGO_CRATES +=	predicates-core	1.0.6
MODCARGO_CRATES +=	predicates-tree	1.0.9
MODCARGO_CRATES +=	proc-macro-error	1.0.4
MODCARGO_CRATES +=	proc-macro-error-attr	1.0.4
MODCARGO_CRATES +=	proc-macro2	1.0.86
MODCARGO_CRATES +=	quick-error	1.2.3
MODCARGO_CRATES +=	quick-xml	0.31.0
MODCARGO_CRATES +=	quote	1.0.37
MODCARGO_CRATES +=	redox_syscall	0.2.16
MODCARGO_CRATES +=	redox_syscall	0.5.3
MODCARGO_CRATES +=	redox_termios	0.1.3
MODCARGO_CRATES +=	redox_users	0.4.6
MODCARGO_CRATES +=	regex	1.10.6
MODCARGO_CRATES +=	regex-automata	0.4.7
MODCARGO_CRATES +=	regex-syntax	0.8.4
MODCARGO_CRATES +=	rusqlite	0.29.0
MODCARGO_CRATES +=	rustix	0.38.35
MODCARGO_CRATES +=	rusty-fork	0.3.0
MODCARGO_CRATES +=	ryu	1.0.18
MODCARGO_CRATES +=	same-file	1.0.6
MODCARGO_CRATES +=	schannel	0.1.23
MODCARGO_CRATES +=	security-framework	2.11.1
MODCARGO_CRATES +=	security-framework-sys	2.11.1
MODCARGO_CRATES +=	serde	1.0.209
MODCARGO_CRATES +=	serde_derive	1.0.209
MODCARGO_CRATES +=	serde_json	1.0.127
MODCARGO_CRATES +=	serde_path_to_error	0.1.16
MODCARGO_CRATES +=	serde_spanned	0.6.7
MODCARGO_CRATES +=	sha1_smol	1.0.1
MODCARGO_CRATES +=	shlex	1.3.0
MODCARGO_CRATES +=	signal-hook	0.3.17
MODCARGO_CRATES +=	signal-hook-registry	1.4.2
MODCARGO_CRATES +=	slab	0.4.9
MODCARGO_CRATES +=	sluice	0.5.5
MODCARGO_CRATES +=	smallvec	1.13.2
MODCARGO_CRATES +=	smol	2.0.1
MODCARGO_CRATES +=	socket2	0.5.7
MODCARGO_CRATES +=	structopt	0.3.26
MODCARGO_CRATES +=	structopt-derive	0.4.18
MODCARGO_CRATES +=	syn	1.0.109
MODCARGO_CRATES +=	syn	2.0.76
MODCARGO_CRATES +=	tauri-winrt-notification	0.2.1
MODCARGO_CRATES +=	tempfile	3.12.0
MODCARGO_CRATES +=	termion	1.5.6
MODCARGO_CRATES +=	termtree	0.4.1
MODCARGO_CRATES +=	textwrap	0.11.0
MODCARGO_CRATES +=	thiserror	1.0.63
MODCARGO_CRATES +=	thiserror-impl	1.0.63
MODCARGO_CRATES +=	time	0.3.36
MODCARGO_CRATES +=	time-core	0.1.2
MODCARGO_CRATES +=	time-macros	0.2.18
MODCARGO_CRATES +=	tinyvec	1.8.0
MODCARGO_CRATES +=	tinyvec_macros	0.1.1
MODCARGO_CRATES +=	toml	0.8.19
MODCARGO_CRATES +=	toml_datetime	0.6.8
MODCARGO_CRATES +=	toml_edit	0.22.20
MODCARGO_CRATES +=	tracing	0.1.40
MODCARGO_CRATES +=	tracing-attributes	0.1.27
MODCARGO_CRATES +=	tracing-core	0.1.32
MODCARGO_CRATES +=	tracing-futures	0.2.5
MODCARGO_CRATES +=	unicode-bidi	0.3.15
MODCARGO_CRATES +=	unicode-ident	1.0.12
MODCARGO_CRATES +=	unicode-normalization	0.1.23
MODCARGO_CRATES +=	unicode-segmentation	1.11.0
MODCARGO_CRATES +=	unicode-width	0.1.13
MODCARGO_CRATES +=	url	2.5.2
MODCARGO_CRATES +=	uuid	1.10.0
MODCARGO_CRATES +=	vcpkg	0.2.15
MODCARGO_CRATES +=	version_check	0.9.5
MODCARGO_CRATES +=	wait-timeout	0.2.0
MODCARGO_CRATES +=	waker-fn	1.2.0
MODCARGO_CRATES +=	walkdir	2.5.0
MODCARGO_CRATES +=	wasi	0.11.0+wasi-snapshot-preview1
MODCARGO_CRATES +=	wasm-bindgen	0.2.93
MODCARGO_CRATES +=	wasm-bindgen-backend	0.2.93
MODCARGO_CRATES +=	wasm-bindgen-macro	0.2.93
MODCARGO_CRATES +=	wasm-bindgen-macro-support	0.2.93
MODCARGO_CRATES +=	wasm-bindgen-shared	0.2.93
MODCARGO_CRATES +=	winapi	0.3.9
MODCARGO_CRATES +=	winapi-i686-pc-windows-gnu	0.4.0
MODCARGO_CRATES +=	winapi-util	0.1.9
MODCARGO_CRATES +=	winapi-x86_64-pc-windows-gnu	0.4.0
MODCARGO_CRATES +=	windows	0.56.0
MODCARGO_CRATES +=	windows-core	0.52.0
MODCARGO_CRATES +=	windows-core	0.56.0
MODCARGO_CRATES +=	windows-implement	0.56.0
MODCARGO_CRATES +=	windows-interface	0.56.0
MODCARGO_CRATES +=	windows-result	0.1.2
MODCARGO_CRATES +=	windows-sys	0.48.0
MODCARGO_CRATES +=	windows-sys	0.52.0
MODCARGO_CRATES +=	windows-sys	0.59.0
MODCARGO_CRATES +=	windows-targets	0.48.5
MODCARGO_CRATES +=	windows-targets	0.52.6
MODCARGO_CRATES +=	windows-version	0.1.1
MODCARGO_CRATES +=	windows_aarch64_gnullvm	0.48.5
MODCARGO_CRATES +=	windows_aarch64_gnullvm	0.52.6
MODCARGO_CRATES +=	windows_aarch64_msvc	0.48.5
MODCARGO_CRATES +=	windows_aarch64_msvc	0.52.6
MODCARGO_CRATES +=	windows_i686_gnu	0.48.5
MODCARGO_CRATES +=	windows_i686_gnu	0.52.6
MODCARGO_CRATES +=	windows_i686_gnullvm	0.52.6
MODCARGO_CRATES +=	windows_i686_msvc	0.48.5
MODCARGO_CRATES +=	windows_i686_msvc	0.52.6
MODCARGO_CRATES +=	windows_x86_64_gnu	0.48.5
MODCARGO_CRATES +=	windows_x86_64_gnu	0.52.6
MODCARGO_CRATES +=	windows_x86_64_gnullvm	0.48.5
MODCARGO_CRATES +=	windows_x86_64_gnullvm	0.52.6
MODCARGO_CRATES +=	windows_x86_64_msvc	0.48.5
MODCARGO_CRATES +=	windows_x86_64_msvc	0.52.6
MODCARGO_CRATES +=	winnow	0.6.18
MODCARGO_CRATES +=	xdg	2.5.2
MODCARGO_CRATES +=	zerocopy	0.7.35
MODCARGO_CRATES +=	zerocopy-derive	0.7.35
