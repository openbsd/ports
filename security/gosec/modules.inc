MODGO_MODULES =	\
	bitbucket.org/creachadair/shell				 v0.0.6 \
	cloud.google.com/go					 v0.60.0 \
	cloud.google.com/go/bigquery				 v1.8.0 \
	cloud.google.com/go/datastore				 v1.1.0 \
	cloud.google.com/go/pubsub				 v1.5.0 \
	cloud.google.com/go/spanner				 v1.7.0 \
	cloud.google.com/go/storage				 v1.8.0 \
	contrib.go.opencensus.io/exporter/stackdriver		 v0.13.4 \
	dmitri.shuralyov.com/gpu/mtl				 v0.0.0-20190408044501-666a987793e9 \
	github.com/!burnt!sushi/toml				 v0.3.1 \
	github.com/!burnt!sushi/xgb				 v0.0.0-20160522181843-27f122750802 \
	github.com/!masterminds/goutils				 v1.1.0 \
	github.com/!masterminds/semver				 v1.5.0 \
	github.com/!masterminds/sprig				 v2.22.0+incompatible \
	github.com/alecthomas/template				 v0.0.0-20190718012654-fb15b899a751 \
	github.com/alecthomas/units				 v0.0.0-20190717042225-c3de453c63f4 \
	github.com/antihax/optional				 v0.0.0-20180407024304-ca021399b1a6 \
	github.com/aokoli/goutils				 v1.0.1 \
	github.com/armon/consul-api				 v0.0.0-20180202201655-eb2c6b5be1b6 \
	github.com/aws/aws-sdk-go				 v1.36.30 \
	github.com/beorn7/perks					 v1.0.1 \
	github.com/bgentry/speakeasy				 v0.1.0 \
	github.com/census-instrumentation/opencensus-proto	 v0.2.1 \
	github.com/cespare/xxhash/v2				 v2.1.1 \
	github.com/chzyer/logex					 v1.1.10 \
	github.com/chzyer/readline				 v0.0.0-20180603132655-2972be24d48e \
	github.com/chzyer/test					 v0.0.0-20180213035817-a1ea475d72b1 \
	github.com/client9/misspell				 v0.3.4 \
	github.com/cncf/udpa/go					 v0.0.0-20191209042840-269d4d468f6f \
	github.com/cockroachdb/datadriven			 v0.0.0-20190809214429-80d97fb3cbaa \
	github.com/coreos/etcd					 v3.3.10+incompatible \
	github.com/coreos/go-etcd				 v2.0.0+incompatible \
	github.com/coreos/go-semver				 v0.3.0 \
	github.com/coreos/go-systemd				 v0.0.0-20190620071333-e64a0ec8b42a \
	github.com/coreos/pkg					 v0.0.0-20180928190104-399ea9e2e55f \
	github.com/cpuguy83/go-md2man				 v1.0.10 \
	github.com/cpuguy83/go-md2man/v2			 v2.0.0 \
	github.com/creack/pty					 v1.1.7 \
	github.com/davecgh/go-spew				 v1.1.1 \
	github.com/dgrijalva/jwt-go				 v3.2.0+incompatible \
	github.com/dustin/go-humanize				 v1.0.0 \
	github.com/envoyproxy/go-control-plane			 v0.9.4 \
	github.com/envoyproxy/protoc-gen-validate		 v0.1.0 \
	github.com/fatih/color					 v1.10.0 \
	github.com/fsnotify/fsnotify				 v1.4.9 \
	github.com/fullstorydev/grpcurl				 v1.6.0 \
	github.com/ghodss/yaml					 v1.0.0 \
	github.com/go-gl/glfw					 v0.0.0-20190409004039-e6da0acd62b1 \
	github.com/go-gl/glfw/v3.3/glfw				 v0.0.0-20200222043503-6f7a984d4dc4 \
	github.com/go-kit/kit					 v0.9.0 \
	github.com/go-logfmt/logfmt				 v0.4.0 \
	github.com/go-redis/redis				 v6.15.8+incompatible \
	github.com/go-sql-driver/mysql				 v1.5.0 \
	github.com/go-stack/stack				 v1.8.0 \
	github.com/go-task/slim-sprig				 v0.0.0-20210107165309-348f09dbbbc0 \
	github.com/gogo/protobuf				 v1.3.1 \
	github.com/golang/glog					 v0.0.0-20160126235308-23def4e6c14b \
	github.com/golang/groupcache				 v0.0.0-20200121045136-8c9f03a8e57e \
	github.com/golang/mock					 v1.4.4 \
	github.com/golang/protobuf				 v1.5.2 \
	github.com/google/btree					 v1.0.0 \
	github.com/google/certificate-transparency-go		 v1.1.1 \
	github.com/google/go-cmp				 v0.5.5 \
	github.com/google/gofuzz				 v1.0.0 \
	github.com/google/martian				 v2.1.0+incompatible \
	github.com/google/pprof					 v0.0.0-20210407192527-94a9f03dee38 \
	github.com/google/renameio				 v0.1.0 \
	github.com/google/trillian				 v1.3.11 \
	github.com/google/uuid					 v1.3.0 \
	github.com/googleapis/gax-go/v2				 v2.0.5 \
	github.com/gookit/color					 v1.5.0 \
	github.com/gordonklaus/ineffassign			 v0.0.0-20200309095847-7953dde2c7bf \
	github.com/gorhill/cronexpr				 v0.0.0-20180427100037-88b0669f7d75 \
	github.com/gorilla/mux					 v1.8.0 \
	github.com/gorilla/websocket				 v1.4.1 \
	github.com/gregjones/httpcache				 v0.0.0-20190611155906-901d90724c79 \
	github.com/grpc-ecosystem/go-grpc-middleware		 v1.2.2 \
	github.com/grpc-ecosystem/go-grpc-prometheus		 v1.2.0 \
	github.com/grpc-ecosystem/grpc-gateway			 v1.12.1 \
	github.com/hashicorp/golang-lru				 v0.5.4 \
	github.com/hashicorp/hcl				 v1.0.0 \
	github.com/hpcloud/tail					 v1.0.0 \
	github.com/huandu/xstrings				 v1.2.0 \
	github.com/ianlancetaylor/demangle			 v0.0.0-20200824232613-28f6c0f3b639 \
	github.com/imdario/mergo				 v0.3.8 \
	github.com/inconshreveable/mousetrap			 v1.0.0 \
	github.com/jhump/protoreflect				 v1.6.1 \
	github.com/jmespath/go-jmespath				 v0.4.0 \
	github.com/jmespath/go-jmespath/internal/testify	 v1.5.1 \
	github.com/jonboulle/clockwork				 v0.2.0 \
	github.com/json-iterator/go				 v1.1.10 \
	github.com/jstemmer/go-junit-report			 v0.9.1 \
	github.com/juju/ratelimit				 v1.0.1 \
	github.com/julienschmidt/httprouter			 v1.2.0 \
	github.com/k0kubun/colorstring				 v0.0.0-20150214042306-9440f1994b88 \
	github.com/kisielk/errcheck				 v1.2.0 \
	github.com/kisielk/gotool				 v1.0.0 \
	github.com/konsorten/go-windows-terminal-sequences	 v1.0.2 \
	github.com/kr/logfmt					 v0.0.0-20140226030751-b84e30acd515 \
	github.com/kr/pretty					 v0.1.0 \
	github.com/kr/pty					 v1.1.1 \
	github.com/kr/text					 v0.1.0 \
	github.com/kylelemons/godebug				 v1.1.0 \
	github.com/letsencrypt/pkcs11key/v4			 v4.0.0 \
	github.com/lib/pq					 v1.10.4 \
	github.com/magiconair/properties			 v1.8.0 \
	github.com/mattn/go-colorable				 v0.1.8 \
	github.com/mattn/go-isatty				 v0.0.12 \
	github.com/mattn/go-runewidth				 v0.0.6 \
	github.com/matttproud/golang_protobuf_extensions	 v1.0.1 \
	github.com/miekg/dns					 v1.1.35 \
	github.com/miekg/pkcs11					 v1.0.3 \
	github.com/mitchellh/copystructure			 v1.0.0 \
	github.com/mitchellh/go-homedir				 v1.1.0 \
	github.com/mitchellh/mapstructure			 v1.1.2 \
	github.com/mitchellh/reflectwalk			 v1.0.1 \
	github.com/modern-go/concurrent				 v0.0.0-20180306012644-bacd9c7ef1dd \
	github.com/modern-go/reflect2				 v1.0.1 \
	github.com/mohae/deepcopy				 v0.0.0-20170929034955-c48cc78d4826 \
	github.com/mozilla/scribe				 v0.0.0-20180711195314-fb71baf557c1 \
	github.com/mozilla/tls-observatory			 v0.0.0-20210609171429-7bc42856d2e5 \
	github.com/mwitkow/go-conntrack				 v0.0.0-20161129095857-cc309e4a2223 \
	github.com/mwitkow/go-proto-validators			 v0.2.0 \
	github.com/nbutton23/zxcvbn-go				 v0.0.0-20210217022336-fa2cb2858354 \
	github.com/nishanths/predeclared			 v0.0.0-20190419143655-18a43bb90ffc \
	github.com/nxadm/tail					 v1.4.8 \
	github.com/olekukonko/tablewriter			 v0.0.2 \
	github.com/onsi/ginkgo					 v1.16.4 \
	github.com/onsi/ginkgo/v2				 v2.0.0 \
	github.com/onsi/gomega					 v1.17.0 \
	github.com/opentracing/opentracing-go			 v1.1.0 \
	github.com/pelletier/go-toml				 v1.2.0 \
	github.com/peterbourgon/diskv				 v2.0.1+incompatible \
	github.com/pkg/errors					 v0.9.1 \
	github.com/pmezard/go-difflib				 v1.0.0 \
	github.com/prometheus/client_golang			 v1.7.1 \
	github.com/prometheus/client_model			 v0.2.0 \
	github.com/prometheus/common				 v0.10.0 \
	github.com/prometheus/procfs				 v0.1.3 \
	github.com/pseudomuto/protoc-gen-doc			 v1.3.2 \
	github.com/pseudomuto/protokit				 v0.2.0 \
	github.com/rogpeppe/fastuuid				 v1.2.0 \
	github.com/rogpeppe/go-internal				 v1.3.0 \
	github.com/rs/cors					 v1.7.0 \
	github.com/russross/blackfriday				 v1.5.2 \
	github.com/russross/blackfriday/v2			 v2.0.1 \
	github.com/sergi/go-diff				 v1.1.0 \
	github.com/shurcoo!l/sanitized_anchor_name		 v1.0.0 \
	github.com/sirupsen/logrus				 v1.7.0 \
	github.com/soheilhy/cmux				 v0.1.4 \
	github.com/spf13/afero					 v1.1.2 \
	github.com/spf13/cast					 v1.3.0 \
	github.com/spf13/cobra					 v0.0.5 \
	github.com/spf13/jwalterweatherman			 v1.0.0 \
	github.com/spf13/pflag					 v1.0.5 \
	github.com/spf13/viper					 v1.3.2 \
	github.com/stretchr/objx				 v0.1.1 \
	github.com/stretchr/testify				 v1.7.0 \
	github.com/tmc/grpc-websocket-proxy			 v0.0.0-20200427203606-3cfed13b9966 \
	github.com/tomasen/realip				 v0.0.0-20180522021738-f0c99a92ddce \
	github.com/ugorji/go/codec				 v0.0.0-20181204163529-d75b2dcb6bc8 \
	github.com/urfave/cli					 v1.22.1 \
	github.com/viki-org/dnscache				 v0.0.0-20130720023526-c70c1f23c5d8 \
	github.com/xiang90/probing				 v0.0.0-20190116061207-43a291ad63a2 \
	github.com/xo/terminfo					 v0.0.0-20210125001918-ca9a967f8778 \
	github.com/xordataexchange/crypt			 v0.0.3-0.20170626215501-b2862e3d0a77 \
	github.com/yudai/gojsondiff				 v1.0.0 \
	github.com/yudai/golcs					 v0.0.0-20170316035057-ecda9a501e82 \
	github.com/yudai/pp					 v2.0.1+incompatible \
	github.com/yuin/goldmark				 v1.4.1 \
	go.etcd.io/bbolt					 v1.3.4 \
	go.etcd.io/etcd						 v0.0.0-20200513171258-e048e166ab9c \
	go.mozilla.org/mozlog					 v0.0.0-20170222151521-4bb13139d403 \
	go.opencensus.io					 v0.22.4 \
	go.uber.org/atomic					 v1.5.0 \
	go.uber.org/multierr					 v1.4.0 \
	go.uber.org/tools					 v0.0.0-20190618225709-2cfd321de3ee \
	go.uber.org/zap						 v1.13.0 \
	golang.org/x/crypto					 v0.0.0-20220112180741-5e0467b6c7ce \
	golang.org/x/exp					 v0.0.0-20200331195152-e8c3332aa8e5 \
	golang.org/x/image					 v0.0.0-20190802002840-cff245a6509b \
	golang.org/x/lint					 v0.0.0-20210508222113-6edffad5e616 \
	golang.org/x/mobile					 v0.0.0-20190719004257-d2bd2a29d028 \
	golang.org/x/mod					 v0.5.1 \
	golang.org/x/net					 v0.0.0-20211112202133-69e39bad7dc2 \
	golang.org/x/oauth2					 v0.0.0-20200107190931-bf48bf16ab8d \
	golang.org/x/sync					 v0.0.0-20210220032951-036812b2e83c \
	golang.org/x/sys					 v0.0.0-20211019181941-9d821ace8654 \
	golang.org/x/term					 v0.0.0-20201126162022-7de9c90e9dd1 \
	golang.org/x/text					 v0.3.7 \
	golang.org/x/time					 v0.0.0-20200416051211-89c76fbcd5d1 \
	golang.org/x/tools					 v0.1.8 \
	golang.org/x/xerrors					 v0.0.0-20200804184101-5ec99f83aff1 \
	google.golang.org/api					 v0.29.0 \
	google.golang.org/appengine				 v1.6.6 \
	google.golang.org/genproto				 v0.0.0-20200707001353-8e8330bf89df \
	google.golang.org/grpc					 v1.29.1 \
	google.golang.org/protobuf				 v1.26.0 \
	gopkg.in/alecthomas/kingpin.v2				 v2.2.6 \
	gopkg.in/check.v1					 v1.0.0-20190902080502-41f04d3bba15 \
	gopkg.in/cheggaaa/pb.v1					 v1.0.28 \
	gopkg.in/errgo.v2					 v2.1.0 \
	gopkg.in/fsnotify.v1					 v1.4.7 \
	gopkg.in/gcfg.v1					 v1.2.3 \
	gopkg.in/resty.v1					 v1.12.0 \
	gopkg.in/tomb.v1					 v1.0.0-20141024135613-dd632973f1e7 \
	gopkg.in/warnings.v0					 v0.1.2 \
	gopkg.in/yaml.v2					 v2.4.0 \
	gopkg.in/yaml.v3					 v3.0.0-20200313102051-9f266ea9e77c \
	honnef.co/go/tools					 v0.0.1-2020.1.4 \
	rsc.io/binaryregexp					 v0.2.0 \
	rsc.io/quote/v3						 v3.1.0 \
	rsc.io/sampler						 v1.3.0 \
	sigs.k8s.io/yaml					 v1.1.0

MODGO_MODFILES =	\
	cloud.google.com/go					 v0.26.0 \
	cloud.google.com/go					 v0.34.0 \
	cloud.google.com/go					 v0.38.0 \
	cloud.google.com/go					 v0.44.1 \
	cloud.google.com/go					 v0.44.2 \
	cloud.google.com/go					 v0.45.1 \
	cloud.google.com/go					 v0.46.3 \
	cloud.google.com/go					 v0.50.0 \
	cloud.google.com/go					 v0.52.0 \
	cloud.google.com/go					 v0.53.0 \
	cloud.google.com/go					 v0.54.0 \
	cloud.google.com/go					 v0.56.0 \
	cloud.google.com/go					 v0.57.0 \
	cloud.google.com/go/bigquery				 v1.0.1 \
	cloud.google.com/go/bigquery				 v1.3.0 \
	cloud.google.com/go/bigquery				 v1.4.0 \
	cloud.google.com/go/bigquery				 v1.5.0 \
	cloud.google.com/go/bigquery				 v1.7.0 \
	cloud.google.com/go/datastore				 v1.0.0 \
	cloud.google.com/go/pubsub				 v1.0.1 \
	cloud.google.com/go/pubsub				 v1.1.0 \
	cloud.google.com/go/pubsub				 v1.2.0 \
	cloud.google.com/go/pubsub				 v1.3.1 \
	cloud.google.com/go/storage				 v1.0.0 \
	cloud.google.com/go/storage				 v1.5.0 \
	cloud.google.com/go/storage				 v1.6.0 \
	github.com/!masterminds/semver				 v1.4.2 \
	github.com/!masterminds/sprig				 v2.15.0+incompatible \
	github.com/alecthomas/template				 v0.0.0-20160405071501-a0175ee3bccc \
	github.com/alecthomas/units				 v0.0.0-20151022065526-2efee857e7cf \
	github.com/aws/aws-sdk-go				 v1.23.20 \
	github.com/aws/aws-sdk-go				 v1.25.37 \
	github.com/beorn7/perks					 v0.0.0-20180321164747-3a771d992973 \
	github.com/beorn7/perks					 v1.0.0 \
	github.com/coreos/go-semver				 v0.2.0 \
	github.com/coreos/go-systemd				 v0.0.0-20180511133405-39ca1b05acc7 \
	github.com/coreos/pkg					 v0.0.0-20160727233714-3ac0863d7acf \
	github.com/cpuguy83/go-md2man/v2			 v2.0.0-20190314233015-f79a8a8ca69d \
	github.com/davecgh/go-spew				 v0.0.0-20161028175848-04cdfd42973b \
	github.com/davecgh/go-spew				 v1.1.0 \
	github.com/dustin/go-humanize				 v0.0.0-20171111073723-bb3d318650d4 \
	github.com/envoyproxy/go-control-plane			 v0.9.0 \
	github.com/envoyproxy/go-control-plane			 v0.9.1-0.20191026205805-5f8ba28d4473 \
	github.com/envoyproxy/protoc-gen-validate		 v0.0.14 \
	github.com/fatih/color					 v1.7.0 \
	github.com/fsnotify/fsnotify				 v1.4.7 \
	github.com/go-gl/glfw/v3.3/glfw				 v0.0.0-20191125211704-12ad95a8df72 \
	github.com/go-kit/kit					 v0.8.0 \
	github.com/go-logfmt/logfmt				 v0.3.0 \
	github.com/gogo/protobuf				 v1.1.1 \
	github.com/gogo/protobuf				 v1.2.1 \
	github.com/gogo/protobuf				 v1.3.0 \
	github.com/golang/groupcache				 v0.0.0-20160516000752-02826c3e7903 \
	github.com/golang/groupcache				 v0.0.0-20190702054246-869f871628b6 \
	github.com/golang/groupcache				 v0.0.0-20191227052852-215e87163ea7 \
	github.com/golang/mock					 v1.1.1 \
	github.com/golang/mock					 v1.2.0 \
	github.com/golang/mock					 v1.3.1 \
	github.com/golang/mock					 v1.4.0 \
	github.com/golang/mock					 v1.4.1 \
	github.com/golang/mock					 v1.4.3 \
	github.com/golang/protobuf				 v1.1.0 \
	github.com/golang/protobuf				 v1.2.0 \
	github.com/golang/protobuf				 v1.3.1 \
	github.com/golang/protobuf				 v1.3.2 \
	github.com/golang/protobuf				 v1.3.3 \
	github.com/golang/protobuf				 v1.3.4 \
	github.com/golang/protobuf				 v1.3.5 \
	github.com/golang/protobuf				 v1.4.0 \
	github.com/golang/protobuf				 v1.4.0-rc.1 \
	github.com/golang/protobuf				 v1.4.0-rc.1.0.20200221234624-67d41d38c208 \
	github.com/golang/protobuf				 v1.4.0-rc.2 \
	github.com/golang/protobuf				 v1.4.0-rc.4.0.20200313231945-b860323f09d0 \
	github.com/golang/protobuf				 v1.4.1 \
	github.com/golang/protobuf				 v1.4.2 \
	github.com/golang/protobuf				 v1.5.0 \
	github.com/google/btree					 v0.0.0-20180813153112-4030bb1f1f0c \
	github.com/google/certificate-transparency-go		 v1.0.21 \
	github.com/google/go-cmp				 v0.2.0 \
	github.com/google/go-cmp				 v0.3.0 \
	github.com/google/go-cmp				 v0.3.1 \
	github.com/google/go-cmp				 v0.4.0 \
	github.com/google/go-cmp				 v0.5.0 \
	github.com/google/go-cmp				 v0.5.2 \
	github.com/google/pprof					 v0.0.0-20181206194817-3ea8567a2e57 \
	github.com/google/pprof					 v0.0.0-20190515194954-54271f7e092f \
	github.com/google/pprof					 v0.0.0-20191218002539-d4f498aebedc \
	github.com/google/pprof					 v0.0.0-20200212024743-f11f1df84d12 \
	github.com/google/pprof					 v0.0.0-20200229191704-1ebb73c60ed3 \
	github.com/google/pprof					 v0.0.0-20200430221834-fc25d7d30c6d \
	github.com/google/pprof					 v0.0.0-20200507031123-427632fa3b1c \
	github.com/google/uuid					 v0.0.0-20161128191214-064e2069ce9c \
	github.com/google/uuid					 v1.0.0 \
	github.com/google/uuid					 v1.1.1 \
	github.com/googleapis/gax-go/v2				 v2.0.4 \
	github.com/gorilla/websocket				 v0.0.0-20170926233335-4201258b820c \
	github.com/grpc-ecosystem/go-grpc-middleware		 v1.0.1-0.20190118093823-f849b5445de4 \
	github.com/grpc-ecosystem/grpc-gateway			 v1.9.5 \
	github.com/hashicorp/golang-lru				 v0.5.0 \
	github.com/hashicorp/golang-lru				 v0.5.1 \
	github.com/huandu/xstrings				 v1.0.0 \
	github.com/ianlancetaylor/demangle			 v0.0.0-20181102032728-5e5cf60278f6 \
	github.com/imdario/mergo				 v0.3.4 \
	github.com/jmespath/go-jmespath				 v0.0.0-20180206201540-c2b33e8439af \
	github.com/jonboulle/clockwork				 v0.1.0 \
	github.com/json-iterator/go				 v1.1.6 \
	github.com/json-iterator/go				 v1.1.7 \
	github.com/jstemmer/go-junit-report			 v0.0.0-20190106144839-af01ea7f8024 \
	github.com/kisielk/errcheck				 v1.1.0 \
	github.com/konsorten/go-windows-terminal-sequences	 v1.0.1 \
	github.com/lib/pq					 v1.8.0 \
	github.com/lib/pq					 v1.9.0 \
	github.com/mattn/go-colorable				 v0.0.9 \
	github.com/mattn/go-colorable				 v0.1.4 \
	github.com/mattn/go-isatty				 v0.0.10 \
	github.com/mattn/go-isatty				 v0.0.4 \
	github.com/mattn/go-isatty				 v0.0.8 \
	github.com/mattn/go-runewidth				 v0.0.2 \
	github.com/mattn/go-runewidth				 v0.0.4 \
	github.com/miekg/pkcs11					 v1.0.2 \
	github.com/mitchellh/reflectwalk			 v1.0.0 \
	github.com/modern-go/concurrent				 v0.0.0-20180228061459-e0a39a4cb421 \
	github.com/modern-go/reflect2				 v0.0.0-20180701023420-4b7aa43c6742 \
	github.com/mwitkow/go-proto-validators			 v0.0.0-20180403085117-0950a7990007 \
	github.com/nxadm/tail					 v1.4.4 \
	github.com/olekukonko/tablewriter			 v0.0.0-20170122224234-a0225b3f23b5 \
	github.com/olekukonko/tablewriter			 v0.0.1 \
	github.com/onsi/ginkgo					 v1.10.3 \
	github.com/onsi/ginkgo					 v1.12.1 \
	github.com/onsi/ginkgo					 v1.6.0 \
	github.com/onsi/gomega					 v1.10.1 \
	github.com/onsi/gomega					 v1.7.1 \
	github.com/pkg/errors					 v0.8.0 \
	github.com/pkg/errors					 v0.8.1 \
	github.com/pmezard/go-difflib				 v0.0.0-20151028094244-d8ed2627bdf0 \
	github.com/prometheus/client_golang			 v0.9.1 \
	github.com/prometheus/client_golang			 v1.0.0 \
	github.com/prometheus/client_model			 v0.0.0-20180712105110-5c3871d89910 \
	github.com/prometheus/client_model			 v0.0.0-20190129233127-fd36f4220a90 \
	github.com/prometheus/client_model			 v0.0.0-20190812154241-14fe0d1b01d4 \
	github.com/prometheus/common				 v0.4.1 \
	github.com/prometheus/procfs				 v0.0.0-20181005140218-185b4288413d \
	github.com/prometheus/procfs				 v0.0.2 \
	github.com/rogpeppe/fastuuid				 v0.0.0-20150106093220-6724a57986af \
	github.com/sirupsen/logrus				 v1.2.0 \
	github.com/sirupsen/logrus				 v1.4.2 \
	github.com/spf13/cobra					 v0.0.3 \
	github.com/spf13/pflag					 v1.0.1 \
	github.com/spf13/pflag					 v1.0.3 \
	github.com/stretchr/objx				 v0.1.0 \
	github.com/stretchr/testify				 v0.0.0-20170130113145-4d4bfba8f1d1 \
	github.com/stretchr/testify				 v1.1.4 \
	github.com/stretchr/testify				 v1.2.2 \
	github.com/stretchr/testify				 v1.3.0 \
	github.com/stretchr/testify				 v1.4.0 \
	github.com/stretchr/testify				 v1.5.1 \
	github.com/stretchr/testify				 v1.6.1 \
	github.com/tmc/grpc-websocket-proxy			 v0.0.0-20170815181823-89b8d40f7ca8 \
	github.com/tmc/grpc-websocket-proxy			 v0.0.0-20190109142713-0ad062ec5ee5 \
	github.com/urfave/cli					 v1.20.0 \
	github.com/yuin/goldmark				 v1.1.25 \
	github.com/yuin/goldmark				 v1.1.27 \
	github.com/yuin/goldmark				 v1.1.32 \
	github.com/yuin/goldmark				 v1.2.1 \
	go.etcd.io/bbolt					 v1.3.3 \
	go.opencensus.io					 v0.21.0 \
	go.opencensus.io					 v0.22.0 \
	go.opencensus.io					 v0.22.2 \
	go.opencensus.io					 v0.22.3 \
	go.uber.org/atomic					 v1.3.2 \
	go.uber.org/atomic					 v1.4.0 \
	go.uber.org/multierr					 v1.1.0 \
	go.uber.org/multierr					 v1.3.0 \
	go.uber.org/zap						 v1.10.0 \
	golang.org/x/crypto					 v0.0.0-20180501155221-613d6eafa307 \
	golang.org/x/crypto					 v0.0.0-20180904163835-0709b304e793 \
	golang.org/x/crypto					 v0.0.0-20181203042331-505ab145d0a9 \
	golang.org/x/crypto					 v0.0.0-20190308221718-c2843e01d9a2 \
	golang.org/x/crypto					 v0.0.0-20190510104115-cbcb75029529 \
	golang.org/x/crypto					 v0.0.0-20190605123033-f99c8df09eb5 \
	golang.org/x/crypto					 v0.0.0-20191011191535-87dc89f01550 \
	golang.org/x/crypto					 v0.0.0-20200622213623-75b288015ac9 \
	golang.org/x/crypto					 v0.0.0-20201221181555-eec23a3978ad \
	golang.org/x/exp					 v0.0.0-20190121172915-509febef88a4 \
	golang.org/x/exp					 v0.0.0-20190306152737-a1d7652674e8 \
	golang.org/x/exp					 v0.0.0-20190510132918-efd6b22b2522 \
	golang.org/x/exp					 v0.0.0-20190829153037-c13cbed26979 \
	golang.org/x/exp					 v0.0.0-20191030013958-a1ab85dbe136 \
	golang.org/x/exp					 v0.0.0-20191129062945-2f5052295587 \
	golang.org/x/exp					 v0.0.0-20191227195350-da58074b4299 \
	golang.org/x/exp					 v0.0.0-20200119233911-0405dc783f0a \
	golang.org/x/exp					 v0.0.0-20200207192155-f17229e696bd \
	golang.org/x/exp					 v0.0.0-20200224162631-6cc2880d07d6 \
	golang.org/x/image					 v0.0.0-20190227222117-0694c2d4d067 \
	golang.org/x/lint					 v0.0.0-20181026193005-c67002cb31c3 \
	golang.org/x/lint					 v0.0.0-20190227174305-5b3e6a55c961 \
	golang.org/x/lint					 v0.0.0-20190301231843-5614ed5bae6f \
	golang.org/x/lint					 v0.0.0-20190313153728-d0100b6bd8b3 \
	golang.org/x/lint					 v0.0.0-20190409202823-959b441ac422 \
	golang.org/x/lint					 v0.0.0-20190909230951-414d861bb4ac \
	golang.org/x/lint					 v0.0.0-20190930215403-16217165b5de \
	golang.org/x/lint					 v0.0.0-20191125180803-fdd1cda4f05f \
	golang.org/x/lint					 v0.0.0-20200130185559-910be7a94367 \
	golang.org/x/lint					 v0.0.0-20200302205851-738671d3881b \
	golang.org/x/mobile					 v0.0.0-20190312151609-d3739f865fa6 \
	golang.org/x/mod					 v0.0.0-20190513183733-4bf6d317e70e \
	golang.org/x/mod					 v0.1.0 \
	golang.org/x/mod					 v0.1.1-0.20191105210325-c90efee705ee \
	golang.org/x/mod					 v0.1.1-0.20191107180719-034126e5016b \
	golang.org/x/mod					 v0.2.0 \
	golang.org/x/mod					 v0.3.0 \
	golang.org/x/net					 v0.0.0-20180724234803-3673e40ba225 \
	golang.org/x/net					 v0.0.0-20180826012351-8a410e7b638d \
	golang.org/x/net					 v0.0.0-20180906233101-161cd47e91fd \
	golang.org/x/net					 v0.0.0-20181114220301-adae6a3d119a \
	golang.org/x/net					 v0.0.0-20181220203305-927f97764cc3 \
	golang.org/x/net					 v0.0.0-20190108225652-1e06a53dbb7e \
	golang.org/x/net					 v0.0.0-20190213061140-3a22650c66bd \
	golang.org/x/net					 v0.0.0-20190311183353-d8887717615a \
	golang.org/x/net					 v0.0.0-20190404232315-eb5bcb51f2a3 \
	golang.org/x/net					 v0.0.0-20190501004415-9ce7a6920f09 \
	golang.org/x/net					 v0.0.0-20190503192946-f4e77d36d62c \
	golang.org/x/net					 v0.0.0-20190603091049-60506f45cf65 \
	golang.org/x/net					 v0.0.0-20190613194153-d28f0bde5980 \
	golang.org/x/net					 v0.0.0-20190620200207-3b0461eec859 \
	golang.org/x/net					 v0.0.0-20190724013045-ca1201d0de80 \
	golang.org/x/net					 v0.0.0-20190813141303-74dc4d7220e7 \
	golang.org/x/net					 v0.0.0-20190923162816-aa69164e4478 \
	golang.org/x/net					 v0.0.0-20191002035440-2ec189313ef0 \
	golang.org/x/net					 v0.0.0-20191209160850-c0dbc17a3553 \
	golang.org/x/net					 v0.0.0-20200114155413-6afb5195e5aa \
	golang.org/x/net					 v0.0.0-20200202094626-16171245cfb2 \
	golang.org/x/net					 v0.0.0-20200222125558-5a598a2470a0 \
	golang.org/x/net					 v0.0.0-20200226121028-0de0cce0169b \
	golang.org/x/net					 v0.0.0-20200301022130-244492dfa37a \
	golang.org/x/net					 v0.0.0-20200324143707-d3edc9973b7e \
	golang.org/x/net					 v0.0.0-20200421231249-e086a090c8fd \
	golang.org/x/net					 v0.0.0-20200501053045-e0ff5e5a1de5 \
	golang.org/x/net					 v0.0.0-20200506145744-7e3656a0809f \
	golang.org/x/net					 v0.0.0-20200513185701-a91f0712d120 \
	golang.org/x/net					 v0.0.0-20200520004742-59133d7f0dd7 \
	golang.org/x/net					 v0.0.0-20200520182314-0ba52f642ac2 \
	golang.org/x/net					 v0.0.0-20200625001655-4c5254603344 \
	golang.org/x/net					 v0.0.0-20201021035429-f5854403a974 \
	golang.org/x/net					 v0.0.0-20201110031124-69a78807bb2b \
	golang.org/x/net					 v0.0.0-20210428140749-89ef3d95e781 \
	golang.org/x/net					 v0.0.0-20211015210444-4f30a5c0130f \
	golang.org/x/oauth2					 v0.0.0-20180821212333-d2e6202438be \
	golang.org/x/oauth2					 v0.0.0-20190226205417-e64efc72b421 \
	golang.org/x/oauth2					 v0.0.0-20190604053449-0f29369cfe45 \
	golang.org/x/oauth2					 v0.0.0-20191202225959-858c2ad4c8b6 \
	golang.org/x/sync					 v0.0.0-20180314180146-1d60e4601c6f \
	golang.org/x/sync					 v0.0.0-20181108010431-42b317875d0f \
	golang.org/x/sync					 v0.0.0-20181221193216-37e7f081c4d4 \
	golang.org/x/sync					 v0.0.0-20190227155943-e225da77a7e6 \
	golang.org/x/sync					 v0.0.0-20190412183630-56d357773e84 \
	golang.org/x/sync					 v0.0.0-20190423024810-112230192c58 \
	golang.org/x/sync					 v0.0.0-20190911185100-cd5d95a43a6e \
	golang.org/x/sync					 v0.0.0-20200317015054-43a5402ce75a \
	golang.org/x/sync					 v0.0.0-20200625203802-6e8e738ad208 \
	golang.org/x/sync					 v0.0.0-20201020160332-67f06af15bc9 \
	golang.org/x/sys					 v0.0.0-20180830151530-49385e6e1522 \
	golang.org/x/sys					 v0.0.0-20180905080454-ebe1bf3edb33 \
	golang.org/x/sys					 v0.0.0-20180909124046-d0be0721c37e \
	golang.org/x/sys					 v0.0.0-20181107165924-66b7b1311ac8 \
	golang.org/x/sys					 v0.0.0-20181116152217-5ac8a444bdc5 \
	golang.org/x/sys					 v0.0.0-20181205085412-a5c9d58dba9a \
	golang.org/x/sys					 v0.0.0-20190215142949-d0b11bdaac8a \
	golang.org/x/sys					 v0.0.0-20190222072716-a9d3bda3a223 \
	golang.org/x/sys					 v0.0.0-20190312061237-fead79001313 \
	golang.org/x/sys					 v0.0.0-20190412213103-97732733099d \
	golang.org/x/sys					 v0.0.0-20190422165155-953cdadca894 \
	golang.org/x/sys					 v0.0.0-20190502145724-3ef323f4f1fd \
	golang.org/x/sys					 v0.0.0-20190507160741-ecd444e8653b \
	golang.org/x/sys					 v0.0.0-20190606165138-5da285871e9c \
	golang.org/x/sys					 v0.0.0-20190624142023-c5567b49c5d0 \
	golang.org/x/sys					 v0.0.0-20190726091711-fc99dfbffb4e \
	golang.org/x/sys					 v0.0.0-20190826190057-c7b8b68b1456 \
	golang.org/x/sys					 v0.0.0-20190904154756-749cb33beabd \
	golang.org/x/sys					 v0.0.0-20190924154521-2837fb4f24fe \
	golang.org/x/sys					 v0.0.0-20191001151750-bb3f8db39f24 \
	golang.org/x/sys					 v0.0.0-20191005200804-aed5e4c7ecf9 \
	golang.org/x/sys					 v0.0.0-20191008105621-543471e840be \
	golang.org/x/sys					 v0.0.0-20191026070338-33540a1f6037 \
	golang.org/x/sys					 v0.0.0-20191120155948-bd437916bb0e \
	golang.org/x/sys					 v0.0.0-20191204072324-ce4227a45e2e \
	golang.org/x/sys					 v0.0.0-20191228213918-04cbcbbfeed8 \
	golang.org/x/sys					 v0.0.0-20200106162015-b016eb3dc98e \
	golang.org/x/sys					 v0.0.0-20200113162924-86b910548bc1 \
	golang.org/x/sys					 v0.0.0-20200116001909-b77594299b42 \
	golang.org/x/sys					 v0.0.0-20200122134326-e047566fdf82 \
	golang.org/x/sys					 v0.0.0-20200202164722-d101bd2416d5 \
	golang.org/x/sys					 v0.0.0-20200212091648-12a6c2dcc1e4 \
	golang.org/x/sys					 v0.0.0-20200223170610-d5e6a3e2c0ae \
	golang.org/x/sys					 v0.0.0-20200302150141-5c8b2ff67527 \
	golang.org/x/sys					 v0.0.0-20200323222414-85ca7c5b95cd \
	golang.org/x/sys					 v0.0.0-20200331124033-c3d80250170d \
	golang.org/x/sys					 v0.0.0-20200420163511-1957bb5e6d1f \
	golang.org/x/sys					 v0.0.0-20200501052902-10377860bb8e \
	golang.org/x/sys					 v0.0.0-20200511232937-7e40ca221e25 \
	golang.org/x/sys					 v0.0.0-20200515095857-1151b9dac4a9 \
	golang.org/x/sys					 v0.0.0-20200523222454-059865788121 \
	golang.org/x/sys					 v0.0.0-20200615200032-f1bc736245b1 \
	golang.org/x/sys					 v0.0.0-20200930185726-fdedc70b468f \
	golang.org/x/sys					 v0.0.0-20201119102817-f84b799fce68 \
	golang.org/x/sys					 v0.0.0-20210112080510-489259a85091 \
	golang.org/x/sys					 v0.0.0-20210330210617-4fbd30eecc44 \
	golang.org/x/sys					 v0.0.0-20210423082822-04245dca01da \
	golang.org/x/sys					 v0.0.0-20210615035016-665e8c7367d1 \
	golang.org/x/term					 v0.0.0-20201117132131-f5c789dd3221 \
	golang.org/x/text					 v0.0.0-20170915032832-14c0d48ead0c \
	golang.org/x/text					 v0.3.0 \
	golang.org/x/text					 v0.3.1-0.20180807135948-17ff2d5776d2 \
	golang.org/x/text					 v0.3.2 \
	golang.org/x/text					 v0.3.3 \
	golang.org/x/text					 v0.3.6 \
	golang.org/x/time					 v0.0.0-20180412165947-fbb02b2291d2 \
	golang.org/x/time					 v0.0.0-20181108054448-85acf8d2951c \
	golang.org/x/time					 v0.0.0-20190308202827-9d24e82272b4 \
	golang.org/x/time					 v0.0.0-20191024005414-555d28b269f0 \
	golang.org/x/tools					 v0.0.0-20180221164845-07fd8470d635 \
	golang.org/x/tools					 v0.0.0-20180917221912-90fa682c2a6e \
	golang.org/x/tools					 v0.0.0-20181030221726-6c7e314b6563 \
	golang.org/x/tools					 v0.0.0-20190114222345-bf090417da8b \
	golang.org/x/tools					 v0.0.0-20190226205152-f727befe758c \
	golang.org/x/tools					 v0.0.0-20190311212946-11955173bddd \
	golang.org/x/tools					 v0.0.0-20190312151545-0bb0c0a6e846 \
	golang.org/x/tools					 v0.0.0-20190312170243-e65039ee4138 \
	golang.org/x/tools					 v0.0.0-20190425150028-36563e24a262 \
	golang.org/x/tools					 v0.0.0-20190506145303-2d16b83fe98c \
	golang.org/x/tools					 v0.0.0-20190524140312-2c0ae7006135 \
	golang.org/x/tools					 v0.0.0-20190606124116-d0a3d012864b \
	golang.org/x/tools					 v0.0.0-20190621195816-6e04913cbbac \
	golang.org/x/tools					 v0.0.0-20190628153133-6cdbf07be9d0 \
	golang.org/x/tools					 v0.0.0-20190816200558-6889da9d5479 \
	golang.org/x/tools					 v0.0.0-20190911174233-4f2ddba30aff \
	golang.org/x/tools					 v0.0.0-20191010075000-0337d82405ff \
	golang.org/x/tools					 v0.0.0-20191012152004-8de300cfc20a \
	golang.org/x/tools					 v0.0.0-20191029041327-9cc4af7d6b2c \
	golang.org/x/tools					 v0.0.0-20191029190741-b9c20aec41a5 \
	golang.org/x/tools					 v0.0.0-20191113191852-77e3bb0ad9e7 \
	golang.org/x/tools					 v0.0.0-20191115202509-3a792d9c32b2 \
	golang.org/x/tools					 v0.0.0-20191119224855-298f0cb1881e \
	golang.org/x/tools					 v0.0.0-20191125144606-a911d9008d1f \
	golang.org/x/tools					 v0.0.0-20191130070609-6e064ea0cf2d \
	golang.org/x/tools					 v0.0.0-20191216052735-49a3e744a425 \
	golang.org/x/tools					 v0.0.0-20191216173652-a0e659d51361 \
	golang.org/x/tools					 v0.0.0-20191227053925-7b8e75db28f4 \
	golang.org/x/tools					 v0.0.0-20200117161641-43d50277825c \
	golang.org/x/tools					 v0.0.0-20200122220014-bf1340f18c4a \
	golang.org/x/tools					 v0.0.0-20200130002326-2f3ba24bd6e7 \
	golang.org/x/tools					 v0.0.0-20200204074204-1cc6d1ef6c74 \
	golang.org/x/tools					 v0.0.0-20200207183749-b753a1ba74fa \
	golang.org/x/tools					 v0.0.0-20200212150539-ea181f53ac56 \
	golang.org/x/tools					 v0.0.0-20200224181240-023911ca70b2 \
	golang.org/x/tools					 v0.0.0-20200227222343-706bc42d1f0d \
	golang.org/x/tools					 v0.0.0-20200304193943-95d2e580d8eb \
	golang.org/x/tools					 v0.0.0-20200312045724-11d5b4c81c7d \
	golang.org/x/tools					 v0.0.0-20200331025713-a30bf2db82d4 \
	golang.org/x/tools					 v0.0.0-20200426102838-f3a5411a4c3b \
	golang.org/x/tools					 v0.0.0-20200501065659-ab2804fb9c9d \
	golang.org/x/tools					 v0.0.0-20200512131952-2bc93b1c0c88 \
	golang.org/x/tools					 v0.0.0-20200515010526-7d3b6ebf133d \
	golang.org/x/tools					 v0.0.0-20200626171337-aa94e735be7f \
	golang.org/x/tools					 v0.0.0-20200630154851-b2d8b0336632 \
	golang.org/x/tools					 v0.0.0-20200706234117-b22de6825cf7 \
	golang.org/x/tools					 v0.0.0-20201224043029-2b0845dc783e \
	golang.org/x/xerrors					 v0.0.0-20190717185122-a985d3407aa7 \
	golang.org/x/xerrors					 v0.0.0-20191011141410-1b5146add898 \
	golang.org/x/xerrors					 v0.0.0-20191204190536-9bdfabe68543 \
	google.golang.org/api					 v0.10.0 \
	google.golang.org/api					 v0.13.0 \
	google.golang.org/api					 v0.14.0 \
	google.golang.org/api					 v0.15.0 \
	google.golang.org/api					 v0.17.0 \
	google.golang.org/api					 v0.18.0 \
	google.golang.org/api					 v0.19.0 \
	google.golang.org/api					 v0.20.0 \
	google.golang.org/api					 v0.22.0 \
	google.golang.org/api					 v0.24.0 \
	google.golang.org/api					 v0.28.0 \
	google.golang.org/api					 v0.4.0 \
	google.golang.org/api					 v0.7.0 \
	google.golang.org/api					 v0.8.0 \
	google.golang.org/api					 v0.9.0 \
	google.golang.org/appengine				 v1.1.0 \
	google.golang.org/appengine				 v1.4.0 \
	google.golang.org/appengine				 v1.5.0 \
	google.golang.org/appengine				 v1.6.1 \
	google.golang.org/appengine				 v1.6.2 \
	google.golang.org/appengine				 v1.6.5 \
	google.golang.org/genproto				 v0.0.0-20170818010345-ee236bd376b0 \
	google.golang.org/genproto				 v0.0.0-20180817151627-c66870c02cf8 \
	google.golang.org/genproto				 v0.0.0-20181107211654-5fc9ac540362 \
	google.golang.org/genproto				 v0.0.0-20190307195333-5fe7a883aa19 \
	google.golang.org/genproto				 v0.0.0-20190418145605-e7d98fc518a7 \
	google.golang.org/genproto				 v0.0.0-20190425155659-357c62f0e4bb \
	google.golang.org/genproto				 v0.0.0-20190502173448-54afdca5d873 \
	google.golang.org/genproto				 v0.0.0-20190801165951-fa694d86fc64 \
	google.golang.org/genproto				 v0.0.0-20190819201941-24fa4b261c55 \
	google.golang.org/genproto				 v0.0.0-20190911173649-1774047e7e51 \
	google.golang.org/genproto				 v0.0.0-20190927181202-20e1ac93f88c \
	google.golang.org/genproto				 v0.0.0-20191108220845-16a3f7862a1a \
	google.golang.org/genproto				 v0.0.0-20191115194625-c23dd37a84c9 \
	google.golang.org/genproto				 v0.0.0-20191216164720-4f79533eabd1 \
	google.golang.org/genproto				 v0.0.0-20191230161307-f3c370f40bfb \
	google.golang.org/genproto				 v0.0.0-20200115191322-ca5a22157cba \
	google.golang.org/genproto				 v0.0.0-20200122232147-0452cf42e150 \
	google.golang.org/genproto				 v0.0.0-20200204135345-fa8e72b47b90 \
	google.golang.org/genproto				 v0.0.0-20200212174721-66ed5ce911ce \
	google.golang.org/genproto				 v0.0.0-20200224152610-e50cd9704f63 \
	google.golang.org/genproto				 v0.0.0-20200228133532-8c2c7df3a383 \
	google.golang.org/genproto				 v0.0.0-20200305110556-506484158171 \
	google.golang.org/genproto				 v0.0.0-20200312145019-da6875a35672 \
	google.golang.org/genproto				 v0.0.0-20200331122359-1ee6d9798940 \
	google.golang.org/genproto				 v0.0.0-20200423170343-7949de9c1215 \
	google.golang.org/genproto				 v0.0.0-20200430143042-b979b6f78d84 \
	google.golang.org/genproto				 v0.0.0-20200511104702-f5ebc3bea380 \
	google.golang.org/genproto				 v0.0.0-20200515170657-fc4c6c6a6587 \
	google.golang.org/genproto				 v0.0.0-20200526211855-cb27e3aa2013 \
	google.golang.org/genproto				 v0.0.0-20200626011028-ee7919e894b5 \
	google.golang.org/grpc					 v1.19.0 \
	google.golang.org/grpc					 v1.20.1 \
	google.golang.org/grpc					 v1.21.1 \
	google.golang.org/grpc					 v1.23.0 \
	google.golang.org/grpc					 v1.23.1 \
	google.golang.org/grpc					 v1.24.0 \
	google.golang.org/grpc					 v1.25.1 \
	google.golang.org/grpc					 v1.26.0 \
	google.golang.org/grpc					 v1.27.0 \
	google.golang.org/grpc					 v1.27.1 \
	google.golang.org/grpc					 v1.28.0 \
	google.golang.org/grpc					 v1.29.0 \
	google.golang.org/grpc					 v1.8.0 \
	google.golang.org/protobuf				 v0.0.0-20200109180630-ec00e32a8dfd \
	google.golang.org/protobuf				 v0.0.0-20200221191635-4d8936d0db64 \
	google.golang.org/protobuf				 v0.0.0-20200228230310-ab0ca4ff8a60 \
	google.golang.org/protobuf				 v1.20.1-0.20200309200217-e05f789c0967 \
	google.golang.org/protobuf				 v1.21.0 \
	google.golang.org/protobuf				 v1.22.0 \
	google.golang.org/protobuf				 v1.23.0 \
	google.golang.org/protobuf				 v1.23.1-0.20200526195155-81db48ad09cc \
	google.golang.org/protobuf				 v1.24.0 \
	google.golang.org/protobuf				 v1.25.0 \
	google.golang.org/protobuf				 v1.26.0-rc.1 \
	gopkg.in/check.v1					 v0.0.0-20161208181325-20d25e280405 \
	gopkg.in/check.v1					 v1.0.0-20180628173108-788fd7840127 \
	gopkg.in/cheggaaa/pb.v1					 v1.0.25 \
	gopkg.in/yaml.v2					 v2.0.0-20170812160011-eb3733d160e7 \
	gopkg.in/yaml.v2					 v2.2.1 \
	gopkg.in/yaml.v2					 v2.2.2 \
	gopkg.in/yaml.v2					 v2.2.3 \
	gopkg.in/yaml.v2					 v2.2.4 \
	gopkg.in/yaml.v2					 v2.2.5 \
	gopkg.in/yaml.v2					 v2.2.6 \
	gopkg.in/yaml.v2					 v2.2.8 \
	gopkg.in/yaml.v2					 v2.3.0 \
	honnef.co/go/tools					 v0.0.0-20190102054323-c2f93a96b099 \
	honnef.co/go/tools					 v0.0.0-20190106161140-3f1c8253044a \
	honnef.co/go/tools					 v0.0.0-20190418001031-e561f6794a2a \
	honnef.co/go/tools					 v0.0.0-20190523083050-ea95bdfd59fc \
	honnef.co/go/tools					 v0.0.1-2019.2.3 \
	honnef.co/go/tools					 v0.0.1-2020.1.3

