MODGO_MODULES =	\
	github.com/!burnt!sushi/toml		 v1.5.0 \
	github.com/cpuguy83/go-md2man/v2	 v2.0.7 \
	github.com/davecgh/go-spew		 v1.1.1 \
	github.com/fatih/color			 v1.18.0 \
	github.com/go-quicktest/qt		 v1.101.0 \
	github.com/google/go-cmp		 v0.7.0 \
	github.com/google/uuid			 v1.6.0 \
	github.com/kr/pretty			 v0.3.1 \
	github.com/kr/text			 v0.2.0 \
	github.com/mattn/go-colorable		 v0.1.14 \
	github.com/mattn/go-isatty		 v0.0.20 \
	github.com/pin/tftp/v3			 v3.1.0 \
	github.com/pmezard/go-difflib		 v1.0.0 \
	github.com/prashantv/gostub		 v1.1.0 \
	github.com/rogpeppe/go-internal		 v1.14.1 \
	github.com/russross/blackfriday/v2	 v2.1.0 \
	github.com/stretchr/testify		 v1.7.1 \
	github.com/urfave/cli/v2		 v2.27.7 \
	github.com/xrash/smetrics		 v0.0.0-20240521201337-686a1a2994c1 \
	github.com/yuin/goldmark		 v1.4.13 \
	go.uber.org/automaxprocs		 v1.6.0 \
	golang.org/x/crypto			 v0.39.0 \
	golang.org/x/mod			 v0.25.0 \
	golang.org/x/net			 v0.41.0 \
	golang.org/x/sync			 v0.15.0 \
	golang.org/x/sys			 v0.33.0 \
	golang.org/x/telemetry			 v0.0.0-20240521205824-bda55230c457 \
	golang.org/x/term			 v0.32.0 \
	golang.org/x/text			 v0.26.0 \
	golang.org/x/tools			 v0.34.0 \
	gopkg.in/check.v1			 v1.0.0-20180628173108-788fd7840127 \
	gopkg.in/yaml.v3			 v3.0.1 \
	mvdan.cc/gofumpt			 v0.8.0 \
	software.sslmate.com/src/go-pkcs12	 v0.5.0

MODGO_MODFILES =	\
	github.com/google/go-cmp	 v0.6.0 \
	github.com/kr/pretty		 v0.1.0 \
	github.com/mattn/go-colorable	 v0.1.13 \
	golang.org/x/crypto		 v0.0.0-20190308221718-c2843e01d9a2 \
	golang.org/x/crypto		 v0.11.0 \
	golang.org/x/mod		 v0.24.0 \
	golang.org/x/net		 v0.0.0-20200202094626-16171245cfb2 \
	golang.org/x/net		 v0.21.0 \
	golang.org/x/sync		 v0.13.0 \
	golang.org/x/sys		 v0.0.0-20190215142949-d0b11bdaac8a \
	golang.org/x/sys		 v0.25.0 \
	golang.org/x/sys		 v0.29.0 \
	golang.org/x/sys		 v0.32.0 \
	golang.org/x/sys		 v0.6.0 \
	golang.org/x/text		 v0.3.0 \
	golang.org/x/tools		 v0.13.0 \
	golang.org/x/tools		 v0.32.0

