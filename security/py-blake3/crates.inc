MODCARGO_CRATES +=	arrayref	0.3.9	# BSD-2-Clause
MODCARGO_CRATES +=	arrayvec	0.7.7	# MIT OR Apache-2.0
MODCARGO_CRATES +=	blake3	1.8.5	# CC0-1.0 OR Apache-2.0 OR Apache-2.0 WITH LLVM-exception
MODCARGO_CRATES +=	cc	1.2.65	# MIT OR Apache-2.0
MODCARGO_CRATES +=	cfg-if	1.0.4	# MIT OR Apache-2.0
MODCARGO_CRATES +=	constant_time_eq	0.4.2	# CC0-1.0 OR MIT-0 OR Apache-2.0
MODCARGO_CRATES +=	cpufeatures	0.3.0	# MIT OR Apache-2.0
MODCARGO_CRATES +=	crossbeam-deque	0.8.6	# MIT OR Apache-2.0
MODCARGO_CRATES +=	crossbeam-epoch	0.9.18	# MIT OR Apache-2.0
MODCARGO_CRATES +=	crossbeam-utils	0.8.21	# MIT OR Apache-2.0
MODCARGO_CRATES +=	either	1.16.0	# MIT OR Apache-2.0
MODCARGO_CRATES +=	find-msvc-tools	0.1.9	# MIT OR Apache-2.0
MODCARGO_CRATES +=	heck	0.5.0	# MIT OR Apache-2.0
MODCARGO_CRATES +=	hex	0.4.3	# MIT OR Apache-2.0
MODCARGO_CRATES +=	libc	0.2.186	# MIT OR Apache-2.0
MODCARGO_CRATES +=	memmap2	0.9.11	# MIT OR Apache-2.0
MODCARGO_CRATES +=	once_cell	1.21.4	# MIT OR Apache-2.0
MODCARGO_CRATES +=	portable-atomic	1.13.1	# Apache-2.0 OR MIT
MODCARGO_CRATES +=	proc-macro2	1.0.106	# MIT OR Apache-2.0
MODCARGO_CRATES +=	pyo3	0.29.0	# MIT OR Apache-2.0
MODCARGO_CRATES +=	pyo3-build-config	0.29.0	# MIT OR Apache-2.0
MODCARGO_CRATES +=	pyo3-ffi	0.29.0	# MIT OR Apache-2.0
MODCARGO_CRATES +=	pyo3-macros	0.29.0	# MIT OR Apache-2.0
MODCARGO_CRATES +=	pyo3-macros-backend	0.29.0	# MIT OR Apache-2.0
MODCARGO_CRATES +=	quote	1.0.46	# MIT OR Apache-2.0
MODCARGO_CRATES +=	rayon	1.12.0	# MIT OR Apache-2.0
MODCARGO_CRATES +=	rayon-core	1.13.0	# MIT OR Apache-2.0
MODCARGO_CRATES +=	shlex	2.0.1	# MIT OR Apache-2.0
MODCARGO_CRATES +=	syn	2.0.118	# MIT OR Apache-2.0
MODCARGO_CRATES +=	target-lexicon	0.13.5	# Apache-2.0 WITH LLVM-exception
MODCARGO_CRATES +=	unicode-ident	1.0.24	# (MIT OR Apache-2.0) AND Unicode-3.0
