MODCARGO_CRATES +=	addr2line	0.24.2	# Apache-2.0 OR MIT
MODCARGO_CRATES +=	adler2	2.0.0	# 0BSD OR MIT OR Apache-2.0
MODCARGO_CRATES +=	aead	0.5.2	# MIT OR Apache-2.0
MODCARGO_CRATES +=	aho-corasick	1.1.3	# Unlicense OR MIT
MODCARGO_CRATES +=	allocator-api2	0.2.21	# MIT OR Apache-2.0
MODCARGO_CRATES +=	anes	0.1.6	# MIT OR Apache-2.0
MODCARGO_CRATES +=	anstream	0.6.18	# MIT OR Apache-2.0
MODCARGO_CRATES +=	anstyle	1.0.10	# MIT OR Apache-2.0
MODCARGO_CRATES +=	anstyle-parse	0.2.6	# MIT OR Apache-2.0
MODCARGO_CRATES +=	anstyle-query	1.1.2	# MIT OR Apache-2.0
MODCARGO_CRATES +=	anstyle-wincon	3.0.6	# MIT OR Apache-2.0
MODCARGO_CRATES +=	anyhow	1.0.95	# MIT OR Apache-2.0
MODCARGO_CRATES +=	arc-swap	1.7.1	# MIT OR Apache-2.0
MODCARGO_CRATES +=	arrayvec	0.7.6	# MIT OR Apache-2.0
MODCARGO_CRATES +=	assert_matches	1.5.0	# MIT/Apache-2.0
MODCARGO_CRATES +=	async-channel	2.3.1	# Apache-2.0 OR MIT
MODCARGO_CRATES +=	async-stream	0.3.6	# MIT
MODCARGO_CRATES +=	async-stream-impl	0.3.6	# MIT
MODCARGO_CRATES +=	async-task	4.7.1	# Apache-2.0 OR MIT
MODCARGO_CRATES +=	async-trait	0.1.83	# MIT OR Apache-2.0
MODCARGO_CRATES +=	atomic-waker	1.1.2	# Apache-2.0 OR MIT
MODCARGO_CRATES +=	autocfg	1.4.0	# Apache-2.0 OR MIT
MODCARGO_CRATES +=	axum	0.7.9	# MIT
MODCARGO_CRATES +=	axum-core	0.4.5	# MIT
MODCARGO_CRATES +=	aya	0.13.1	# MIT OR Apache-2.0
MODCARGO_CRATES +=	aya-ebpf	0.1.1	# MIT OR Apache-2.0
MODCARGO_CRATES +=	aya-ebpf-bindings	0.1.1	# MIT OR Apache-2.0
MODCARGO_CRATES +=	aya-ebpf-cty	0.2.2	# MIT OR Apache-2.0
MODCARGO_CRATES +=	aya-ebpf-macros	0.1.1	# MIT OR Apache-2.0
MODCARGO_CRATES +=	aya-log	0.2.1	# MIT OR Apache-2.0
MODCARGO_CRATES +=	aya-log-common	0.1.15	# MIT OR Apache-2.0
MODCARGO_CRATES +=	aya-log-ebpf	0.1.1	# MIT OR Apache-2.0
MODCARGO_CRATES +=	aya-log-ebpf-macros	0.1.0	# MIT OR Apache-2.0
MODCARGO_CRATES +=	aya-log-parser	0.1.13	# MIT OR Apache-2.0
MODCARGO_CRATES +=	aya-obj	0.2.1	# MIT OR Apache-2.0
MODCARGO_CRATES +=	backtrace	0.3.74	# MIT OR Apache-2.0
MODCARGO_CRATES +=	base64	0.13.1	# MIT/Apache-2.0
MODCARGO_CRATES +=	base64	0.21.7	# MIT OR Apache-2.0
MODCARGO_CRATES +=	base64	0.22.1	# MIT OR Apache-2.0
MODCARGO_CRATES +=	bitflags	1.3.2	# MIT/Apache-2.0
MODCARGO_CRATES +=	bitflags	2.6.0	# MIT OR Apache-2.0
MODCARGO_CRATES +=	blake2	0.10.6	# MIT OR Apache-2.0
MODCARGO_CRATES +=	block	0.1.6	# MIT
MODCARGO_CRATES +=	block-buffer	0.10.4	# MIT OR Apache-2.0
MODCARGO_CRATES +=	blocking	1.6.1	# Apache-2.0 OR MIT
MODCARGO_CRATES +=	bumpalo	3.16.0	# MIT OR Apache-2.0
MODCARGO_CRATES +=	bytemuck	1.21.0	# Zlib OR Apache-2.0 OR MIT
MODCARGO_CRATES +=	byteorder	1.5.0	# Unlicense OR MIT
MODCARGO_CRATES +=	byteorder-lite	0.1.0	# Unlicense OR MIT
MODCARGO_CRATES +=	bytes	1.9.0	# MIT
MODCARGO_CRATES +=	c2rust-bitfields	0.19.0	# BSD-3-Clause
MODCARGO_CRATES +=	c2rust-bitfields-derive	0.19.0	# BSD-3-Clause
MODCARGO_CRATES +=	camino	1.1.9	# MIT OR Apache-2.0
MODCARGO_CRATES +=	cargo-platform	0.1.9	# MIT OR Apache-2.0
MODCARGO_CRATES +=	cargo_metadata	0.19.1	# MIT
MODCARGO_CRATES +=	cast	0.3.0	# MIT OR Apache-2.0
MODCARGO_CRATES +=	cc	1.2.6	# MIT OR Apache-2.0
MODCARGO_CRATES +=	cfg-if	1.0.0	# MIT/Apache-2.0
MODCARGO_CRATES +=	cfg_aliases	0.2.1	# MIT
MODCARGO_CRATES +=	chacha20	0.9.1	# Apache-2.0 OR MIT
MODCARGO_CRATES +=	chacha20poly1305	0.10.1	# Apache-2.0 OR MIT
MODCARGO_CRATES +=	ciborium	0.2.2	# Apache-2.0
MODCARGO_CRATES +=	ciborium-io	0.2.2	# Apache-2.0
MODCARGO_CRATES +=	ciborium-ll	0.2.2	# Apache-2.0
MODCARGO_CRATES +=	cipher	0.4.4	# MIT OR Apache-2.0
MODCARGO_CRATES +=	clap	4.5.23	# MIT OR Apache-2.0
MODCARGO_CRATES +=	clap_builder	4.5.23	# MIT OR Apache-2.0
MODCARGO_CRATES +=	clap_lex	0.7.4	# MIT OR Apache-2.0
MODCARGO_CRATES +=	cocoa	0.26.0	# MIT OR Apache-2.0
MODCARGO_CRATES +=	cocoa-foundation	0.2.0	# MIT OR Apache-2.0
MODCARGO_CRATES +=	colorchoice	1.0.3	# MIT OR Apache-2.0
MODCARGO_CRATES +=	concurrent-queue	2.5.0	# Apache-2.0 OR MIT
MODCARGO_CRATES +=	console-api	0.8.1	# MIT
MODCARGO_CRATES +=	console-subscriber	0.4.1	# MIT
MODCARGO_CRATES +=	const-sha1	0.3.0	# Apache-2.0/MIT
MODCARGO_CRATES +=	core-error	0.0.0	# MIT OR Apache-2.0
MODCARGO_CRATES +=	core-foundation	0.10.0	# MIT OR Apache-2.0
MODCARGO_CRATES +=	core-foundation-sys	0.8.7	# MIT OR Apache-2.0
MODCARGO_CRATES +=	core-graphics	0.24.0	# MIT OR Apache-2.0
MODCARGO_CRATES +=	core-graphics-types	0.2.0	# MIT OR Apache-2.0
MODCARGO_CRATES +=	cpufeatures	0.2.16	# MIT OR Apache-2.0
MODCARGO_CRATES +=	crc32fast	1.4.2	# MIT OR Apache-2.0
MODCARGO_CRATES +=	criterion	0.5.1	# Apache-2.0 OR MIT
MODCARGO_CRATES +=	criterion-plot	0.5.0	# MIT/Apache-2.0
MODCARGO_CRATES +=	crossbeam-channel	0.5.14	# MIT OR Apache-2.0
MODCARGO_CRATES +=	crossbeam-deque	0.8.6	# MIT OR Apache-2.0
MODCARGO_CRATES +=	crossbeam-epoch	0.9.18	# MIT OR Apache-2.0
MODCARGO_CRATES +=	crossbeam-utils	0.8.21	# MIT OR Apache-2.0
MODCARGO_CRATES +=	crunchy	0.2.2	# MIT
MODCARGO_CRATES +=	crypto-common	0.1.6	# MIT OR Apache-2.0
MODCARGO_CRATES +=	curve25519-dalek	4.1.3	# BSD-3-Clause
MODCARGO_CRATES +=	curve25519-dalek-derive	0.1.1	# MIT/Apache-2.0
MODCARGO_CRATES +=	data-encoding	2.6.0	# MIT
MODCARGO_CRATES +=	defmt	0.3.10	# MIT OR Apache-2.0
MODCARGO_CRATES +=	defmt-macros	0.4.0	# MIT OR Apache-2.0
MODCARGO_CRATES +=	defmt-parser	0.4.1	# MIT OR Apache-2.0
MODCARGO_CRATES +=	deranged	0.3.11	# MIT OR Apache-2.0
MODCARGO_CRATES +=	digest	0.10.7	# MIT OR Apache-2.0
MODCARGO_CRATES +=	displaydoc	0.2.5	# MIT OR Apache-2.0
MODCARGO_CRATES +=	either	1.13.0	# MIT OR Apache-2.0
MODCARGO_CRATES +=	enum-as-inner	0.6.1	# MIT/Apache-2.0
MODCARGO_CRATES +=	env_filter	0.1.3	# MIT OR Apache-2.0
MODCARGO_CRATES +=	env_home	0.1.0	# MIT OR Apache-2.0
MODCARGO_CRATES +=	env_logger	0.11.6	# MIT OR Apache-2.0
MODCARGO_CRATES +=	equivalent	1.0.1	# Apache-2.0 OR MIT
MODCARGO_CRATES +=	errno	0.3.10	# MIT OR Apache-2.0
MODCARGO_CRATES +=	etherparse	0.13.0	# MIT OR Apache-2.0
MODCARGO_CRATES +=	event-listener	5.3.1	# Apache-2.0 OR MIT
MODCARGO_CRATES +=	event-listener-strategy	0.5.3	# Apache-2.0 OR MIT
MODCARGO_CRATES +=	fastrand	2.3.0	# Apache-2.0 OR MIT
MODCARGO_CRATES +=	fdeflate	0.3.7	# MIT OR Apache-2.0
MODCARGO_CRATES +=	fiat-crypto	0.2.9	# MIT OR Apache-2.0 OR BSD-1-Clause
MODCARGO_CRATES +=	filetime	0.2.25	# MIT/Apache-2.0
MODCARGO_CRATES +=	flate2	1.0.35	# MIT OR Apache-2.0
MODCARGO_CRATES +=	fnv	1.0.7	# Apache-2.0 / MIT
MODCARGO_CRATES +=	foldhash	0.1.4	# Zlib
MODCARGO_CRATES +=	foreign-types	0.5.0	# MIT/Apache-2.0
MODCARGO_CRATES +=	foreign-types-macros	0.2.3	# MIT/Apache-2.0
MODCARGO_CRATES +=	foreign-types-shared	0.3.1	# MIT/Apache-2.0
MODCARGO_CRATES +=	form_urlencoded	1.2.1	# MIT OR Apache-2.0
MODCARGO_CRATES +=	futures	0.3.31	# MIT OR Apache-2.0
MODCARGO_CRATES +=	futures-channel	0.3.31	# MIT OR Apache-2.0
MODCARGO_CRATES +=	futures-core	0.3.31	# MIT OR Apache-2.0
MODCARGO_CRATES +=	futures-executor	0.3.31	# MIT OR Apache-2.0
MODCARGO_CRATES +=	futures-io	0.3.31	# MIT OR Apache-2.0
MODCARGO_CRATES +=	futures-lite	2.5.0	# Apache-2.0 OR MIT
MODCARGO_CRATES +=	futures-macro	0.3.31	# MIT OR Apache-2.0
MODCARGO_CRATES +=	futures-sink	0.3.31	# MIT OR Apache-2.0
MODCARGO_CRATES +=	futures-task	0.3.31	# MIT OR Apache-2.0
MODCARGO_CRATES +=	futures-util	0.3.31	# MIT OR Apache-2.0
MODCARGO_CRATES +=	generic-array	0.14.7	# MIT
MODCARGO_CRATES +=	getrandom	0.2.15	# MIT OR Apache-2.0
MODCARGO_CRATES +=	gimli	0.31.1	# MIT OR Apache-2.0
MODCARGO_CRATES +=	h2	0.4.7	# MIT
MODCARGO_CRATES +=	half	2.4.1	# MIT OR Apache-2.0
MODCARGO_CRATES +=	hash32	0.3.1	# MIT OR Apache-2.0
MODCARGO_CRATES +=	hashbrown	0.12.3	# MIT OR Apache-2.0
MODCARGO_CRATES +=	hashbrown	0.15.2	# MIT OR Apache-2.0
MODCARGO_CRATES +=	hdrhistogram	7.5.4	# MIT/Apache-2.0
MODCARGO_CRATES +=	heapless	0.8.0	# MIT OR Apache-2.0
MODCARGO_CRATES +=	heck	0.5.0	# MIT OR Apache-2.0
MODCARGO_CRATES +=	hermit-abi	0.4.0	# MIT OR Apache-2.0
MODCARGO_CRATES +=	hex	0.4.3	# MIT OR Apache-2.0
MODCARGO_CRATES +=	hickory-proto	0.24.2	# MIT OR Apache-2.0
MODCARGO_CRATES +=	hickory-resolver	0.24.2	# MIT OR Apache-2.0
MODCARGO_CRATES +=	hickory-server	0.24.2	# MIT OR Apache-2.0
MODCARGO_CRATES +=	hmac	0.12.1	# MIT OR Apache-2.0
MODCARGO_CRATES +=	hostname	0.3.1	# MIT
MODCARGO_CRATES +=	http	1.2.0	# MIT OR Apache-2.0
MODCARGO_CRATES +=	http-body	1.0.1	# MIT
MODCARGO_CRATES +=	http-body-util	0.1.2	# MIT
MODCARGO_CRATES +=	httparse	1.9.5	# MIT OR Apache-2.0
MODCARGO_CRATES +=	httpdate	1.0.3	# MIT OR Apache-2.0
MODCARGO_CRATES +=	humantime	2.1.0	# MIT/Apache-2.0
MODCARGO_CRATES +=	hyper	1.5.2	# MIT
MODCARGO_CRATES +=	hyper-timeout	0.5.2	# MIT OR Apache-2.0
MODCARGO_CRATES +=	hyper-util	0.1.10	# MIT
MODCARGO_CRATES +=	icu_collections	1.5.0	# Unicode-3.0
MODCARGO_CRATES +=	icu_locid	1.5.0	# Unicode-3.0
MODCARGO_CRATES +=	icu_locid_transform	1.5.0	# Unicode-3.0
MODCARGO_CRATES +=	icu_locid_transform_data	1.5.0	# Unicode-3.0
MODCARGO_CRATES +=	icu_normalizer	1.5.0	# Unicode-3.0
MODCARGO_CRATES +=	icu_normalizer_data	1.5.0	# Unicode-3.0
MODCARGO_CRATES +=	icu_properties	1.5.1	# Unicode-3.0
MODCARGO_CRATES +=	icu_properties_data	1.5.0	# Unicode-3.0
MODCARGO_CRATES +=	icu_provider	1.5.0	# Unicode-3.0
MODCARGO_CRATES +=	icu_provider_macros	1.5.0	# Unicode-3.0
MODCARGO_CRATES +=	idna	1.0.3	# MIT OR Apache-2.0
MODCARGO_CRATES +=	idna_adapter	1.2.0	# Apache-2.0 OR MIT
MODCARGO_CRATES +=	image	0.25.5	# MIT OR Apache-2.0
MODCARGO_CRATES +=	indexmap	1.9.3	# Apache-2.0 OR MIT
MODCARGO_CRATES +=	indexmap	2.7.0	# Apache-2.0 OR MIT
MODCARGO_CRATES +=	indoc	2.0.5	# MIT OR Apache-2.0
MODCARGO_CRATES +=	inout	0.1.3	# MIT OR Apache-2.0
MODCARGO_CRATES +=	internet-checksum	0.2.1	# LICENSE
MODCARGO_CRATES +=	internet-packet	0.2.3	# MIT
MODCARGO_CRATES +=	inventory	0.3.16	# MIT OR Apache-2.0
MODCARGO_CRATES +=	ip_network	0.4.1	# BSD-2-Clause
MODCARGO_CRATES +=	ip_network_table	0.2.0	# BSD-2-Clause
MODCARGO_CRATES +=	ip_network_table-deps-treebitmap	0.5.0	# MIT
MODCARGO_CRATES +=	ipconfig	0.3.2	# MIT/Apache-2.0
MODCARGO_CRATES +=	ipnet	2.10.1	# MIT OR Apache-2.0
MODCARGO_CRATES +=	is-terminal	0.4.13	# MIT
MODCARGO_CRATES +=	is_terminal_polyfill	1.70.1	# MIT OR Apache-2.0
MODCARGO_CRATES +=	itertools	0.10.5	# MIT/Apache-2.0
MODCARGO_CRATES +=	itertools	0.13.0	# MIT OR Apache-2.0
MODCARGO_CRATES +=	itoa	1.0.14	# MIT OR Apache-2.0
MODCARGO_CRATES +=	jpeg-decoder	0.3.1	# MIT OR Apache-2.0
MODCARGO_CRATES +=	js-sys	0.3.76	# MIT OR Apache-2.0
MODCARGO_CRATES +=	lazy_static	1.5.0	# MIT OR Apache-2.0
MODCARGO_CRATES +=	libc	0.2.169	# MIT OR Apache-2.0
MODCARGO_CRATES +=	libloading	0.8.6	# ISC
MODCARGO_CRATES +=	libredox	0.1.3	# MIT
MODCARGO_CRATES +=	linked-hash-map	0.5.6	# MIT/Apache-2.0
MODCARGO_CRATES +=	linux-raw-sys	0.4.14	# Apache-2.0 WITH LLVM-exception OR Apache-2.0 OR MIT
MODCARGO_CRATES +=	litemap	0.7.4	# Unicode-3.0
MODCARGO_CRATES +=	lock_api	0.4.12	# MIT OR Apache-2.0
MODCARGO_CRATES +=	log	0.4.22	# MIT OR Apache-2.0
MODCARGO_CRATES +=	lru-cache	0.1.2	# MIT/Apache-2.0
MODCARGO_CRATES +=	lru_time_cache	0.11.11	# MIT OR BSD-3-Clause
MODCARGO_CRATES +=	malloc_buf	0.0.6	# MIT
MODCARGO_CRATES +=	managed	0.8.0	# 0BSD
MODCARGO_CRATES +=	match_cfg	0.1.0	# MIT/Apache-2.0
MODCARGO_CRATES +=	matchers	0.1.0	# MIT
MODCARGO_CRATES +=	matchit	0.7.3	# MIT AND BSD-3-Clause
MODCARGO_CRATES +=	memchr	2.7.4	# Unlicense OR MIT
MODCARGO_CRATES +=	memoffset	0.9.1	# MIT
MODCARGO_CRATES +=	mime	0.3.17	# MIT OR Apache-2.0
MODCARGO_CRATES +=	minimal-lexical	0.2.1	# MIT/Apache-2.0
MODCARGO_CRATES +=	miniz_oxide	0.8.2	# MIT OR Zlib OR Apache-2.0
MODCARGO_CRATES +=	mio	1.0.3	# MIT
MODCARGO_CRATES +=	nix	0.25.1	# MIT
MODCARGO_CRATES +=	nix	0.29.0	# MIT
MODCARGO_CRATES +=	nom	7.1.3	# MIT
MODCARGO_CRATES +=	ntapi	0.4.1	# Apache-2.0 OR MIT
MODCARGO_CRATES +=	num-conv	0.1.0	# MIT OR Apache-2.0
MODCARGO_CRATES +=	num-traits	0.2.19	# MIT OR Apache-2.0
MODCARGO_CRATES +=	num_enum	0.7.3	# BSD-3-Clause OR MIT OR Apache-2.0
MODCARGO_CRATES +=	num_enum_derive	0.7.3	# BSD-3-Clause OR MIT OR Apache-2.0
MODCARGO_CRATES +=	objc	0.2.7	# MIT
MODCARGO_CRATES +=	object	0.36.7	# Apache-2.0 OR MIT
MODCARGO_CRATES +=	once_cell	1.20.2	# MIT OR Apache-2.0
MODCARGO_CRATES +=	oorandom	11.1.4	# MIT
MODCARGO_CRATES +=	opaque-debug	0.3.1	# MIT OR Apache-2.0
MODCARGO_CRATES +=	parking	2.2.1	# Apache-2.0 OR MIT
MODCARGO_CRATES +=	parking_lot	0.12.3	# MIT OR Apache-2.0
MODCARGO_CRATES +=	parking_lot_core	0.9.10	# MIT OR Apache-2.0
MODCARGO_CRATES +=	percent-encoding	2.3.1	# MIT OR Apache-2.0
MODCARGO_CRATES +=	pin-project	1.1.7	# Apache-2.0 OR MIT
MODCARGO_CRATES +=	pin-project-internal	1.1.7	# Apache-2.0 OR MIT
MODCARGO_CRATES +=	pin-project-lite	0.2.15	# Apache-2.0 OR MIT
MODCARGO_CRATES +=	pin-utils	0.1.0	# MIT OR Apache-2.0
MODCARGO_CRATES +=	piper	0.2.4	# MIT OR Apache-2.0
MODCARGO_CRATES +=	plotters	0.3.7	# MIT
MODCARGO_CRATES +=	plotters-backend	0.3.7	# MIT
MODCARGO_CRATES +=	plotters-svg	0.3.7	# MIT
MODCARGO_CRATES +=	png	0.17.16	# MIT OR Apache-2.0
MODCARGO_CRATES +=	poly1305	0.8.0	# Apache-2.0 OR MIT
MODCARGO_CRATES +=	portable-atomic	1.10.0	# Apache-2.0 OR MIT
MODCARGO_CRATES +=	powerfmt	0.2.0	# MIT OR Apache-2.0
MODCARGO_CRATES +=	ppv-lite86	0.2.20	# MIT/Apache-2.0
MODCARGO_CRATES +=	pretty-hex	0.4.1	# MIT
MODCARGO_CRATES +=	proc-macro-error	1.0.4	# MIT OR Apache-2.0
MODCARGO_CRATES +=	proc-macro-error-attr	1.0.4	# MIT OR Apache-2.0
MODCARGO_CRATES +=	proc-macro-error-attr2	2.0.0	# MIT OR Apache-2.0
MODCARGO_CRATES +=	proc-macro-error2	2.0.1	# MIT OR Apache-2.0
MODCARGO_CRATES +=	proc-macro2	1.0.92	# MIT OR Apache-2.0
MODCARGO_CRATES +=	prost	0.13.4	# Apache-2.0
MODCARGO_CRATES +=	prost-derive	0.13.4	# Apache-2.0
MODCARGO_CRATES +=	prost-types	0.13.4	# Apache-2.0
MODCARGO_CRATES +=	pyo3	0.23.3	# MIT OR Apache-2.0
MODCARGO_CRATES +=	pyo3-async-runtimes	0.23.0	# Apache-2.0
MODCARGO_CRATES +=	pyo3-async-runtimes-macros	0.23.0	# Apache-2.0
MODCARGO_CRATES +=	pyo3-build-config	0.23.3	# MIT OR Apache-2.0
MODCARGO_CRATES +=	pyo3-ffi	0.23.3	# MIT OR Apache-2.0
MODCARGO_CRATES +=	pyo3-log	0.12.1	# Apache-2.0 OR MIT
MODCARGO_CRATES +=	pyo3-macros	0.23.3	# MIT OR Apache-2.0
MODCARGO_CRATES +=	pyo3-macros-backend	0.23.3	# MIT OR Apache-2.0
MODCARGO_CRATES +=	quick-error	1.2.3	# MIT/Apache-2.0
MODCARGO_CRATES +=	quote	1.0.38	# MIT OR Apache-2.0
MODCARGO_CRATES +=	rand	0.8.5	# MIT OR Apache-2.0
MODCARGO_CRATES +=	rand_chacha	0.3.1	# MIT OR Apache-2.0
MODCARGO_CRATES +=	rand_core	0.6.4	# MIT OR Apache-2.0
MODCARGO_CRATES +=	rayon	1.10.0	# MIT OR Apache-2.0
MODCARGO_CRATES +=	rayon-core	1.12.1	# MIT OR Apache-2.0
MODCARGO_CRATES +=	redox_syscall	0.5.8	# MIT
MODCARGO_CRATES +=	regex	1.11.1	# MIT OR Apache-2.0
MODCARGO_CRATES +=	regex-automata	0.1.10	# Unlicense/MIT
MODCARGO_CRATES +=	regex-automata	0.4.9	# MIT OR Apache-2.0
MODCARGO_CRATES +=	regex-syntax	0.6.29	# MIT OR Apache-2.0
MODCARGO_CRATES +=	regex-syntax	0.8.5	# MIT OR Apache-2.0
MODCARGO_CRATES +=	resolv-conf	0.7.0	# MIT/Apache-2.0
MODCARGO_CRATES +=	ring	0.17.8	# LICENSE
MODCARGO_CRATES +=	rustc-demangle	0.1.24	# MIT/Apache-2.0
MODCARGO_CRATES +=	rustc_version	0.4.1	# MIT OR Apache-2.0
MODCARGO_CRATES +=	rustix	0.38.42	# Apache-2.0 WITH LLVM-exception OR Apache-2.0 OR MIT
MODCARGO_CRATES +=	rustversion	1.0.19	# MIT OR Apache-2.0
MODCARGO_CRATES +=	ryu	1.0.18	# Apache-2.0 OR BSL-1.0
MODCARGO_CRATES +=	same-file	1.0.6	# Unlicense/MIT
MODCARGO_CRATES +=	scopeguard	1.2.0	# MIT OR Apache-2.0
MODCARGO_CRATES +=	security-framework	3.1.0	# MIT OR Apache-2.0
MODCARGO_CRATES +=	security-framework-sys	2.13.0	# MIT OR Apache-2.0
MODCARGO_CRATES +=	semver	1.0.24	# MIT OR Apache-2.0
MODCARGO_CRATES +=	serde	1.0.217	# MIT OR Apache-2.0
MODCARGO_CRATES +=	serde_derive	1.0.217	# MIT OR Apache-2.0
MODCARGO_CRATES +=	serde_json	1.0.134	# MIT OR Apache-2.0
MODCARGO_CRATES +=	sharded-slab	0.1.7	# MIT
MODCARGO_CRATES +=	shlex	1.3.0	# MIT OR Apache-2.0
MODCARGO_CRATES +=	signal-hook-registry	1.4.2	# Apache-2.0/MIT
MODCARGO_CRATES +=	simd-adler32	0.3.7	# MIT
MODCARGO_CRATES +=	slab	0.4.9	# MIT
MODCARGO_CRATES +=	smallvec	1.13.2	# MIT OR Apache-2.0
MODCARGO_CRATES +=	smoltcp	0.12.0	# 0BSD
MODCARGO_CRATES +=	socket2	0.5.8	# MIT OR Apache-2.0
MODCARGO_CRATES +=	spin	0.9.8	# MIT
MODCARGO_CRATES +=	stable_deref_trait	1.2.0	# MIT/Apache-2.0
MODCARGO_CRATES +=	strsim	0.11.1	# MIT
MODCARGO_CRATES +=	subtle	2.6.1	# BSD-3-Clause
MODCARGO_CRATES +=	syn	1.0.109	# MIT OR Apache-2.0
MODCARGO_CRATES +=	syn	2.0.94	# MIT OR Apache-2.0
MODCARGO_CRATES +=	sync_wrapper	1.0.2	# Apache-2.0
MODCARGO_CRATES +=	synstructure	0.13.1	# MIT
MODCARGO_CRATES +=	sysinfo	0.33.1	# MIT
MODCARGO_CRATES +=	tar	0.4.43	# MIT OR Apache-2.0
MODCARGO_CRATES +=	target-lexicon	0.12.16	# Apache-2.0 WITH LLVM-exception
MODCARGO_CRATES +=	tempfile	3.15.0	# MIT OR Apache-2.0
MODCARGO_CRATES +=	thiserror	1.0.69	# MIT OR Apache-2.0
MODCARGO_CRATES +=	thiserror	2.0.9	# MIT OR Apache-2.0
MODCARGO_CRATES +=	thiserror-impl	1.0.69	# MIT OR Apache-2.0
MODCARGO_CRATES +=	thiserror-impl	2.0.9	# MIT OR Apache-2.0
MODCARGO_CRATES +=	thread_local	1.1.8	# MIT OR Apache-2.0
MODCARGO_CRATES +=	tiff	0.9.1	# MIT
MODCARGO_CRATES +=	time	0.3.37	# MIT OR Apache-2.0
MODCARGO_CRATES +=	time-core	0.1.2	# MIT OR Apache-2.0
MODCARGO_CRATES +=	tinystr	0.7.6	# Unicode-3.0
MODCARGO_CRATES +=	tinytemplate	1.2.1	# Apache-2.0 OR MIT
MODCARGO_CRATES +=	tinyvec	1.8.1	# Zlib OR Apache-2.0 OR MIT
MODCARGO_CRATES +=	tinyvec_macros	0.1.1	# MIT OR Apache-2.0 OR Zlib
MODCARGO_CRATES +=	tokio	1.42.0	# MIT
MODCARGO_CRATES +=	tokio-macros	2.4.0	# MIT
MODCARGO_CRATES +=	tokio-stream	0.1.17	# MIT
MODCARGO_CRATES +=	tokio-util	0.7.13	# MIT
MODCARGO_CRATES +=	toml	0.5.11	# MIT/Apache-2.0
MODCARGO_CRATES +=	tonic	0.12.3	# MIT
MODCARGO_CRATES +=	tower	0.4.13	# MIT
MODCARGO_CRATES +=	tower	0.5.2	# MIT
MODCARGO_CRATES +=	tower-layer	0.3.3	# MIT
MODCARGO_CRATES +=	tower-service	0.3.3	# MIT
MODCARGO_CRATES +=	tracing	0.1.41	# MIT
MODCARGO_CRATES +=	tracing-attributes	0.1.28	# MIT
MODCARGO_CRATES +=	tracing-core	0.1.33	# MIT
MODCARGO_CRATES +=	tracing-subscriber	0.3.19	# MIT
MODCARGO_CRATES +=	try-lock	0.2.5	# MIT
MODCARGO_CRATES +=	tun	0.7.10	# WTFPL
MODCARGO_CRATES +=	typenum	1.17.0	# MIT OR Apache-2.0
MODCARGO_CRATES +=	unicode-ident	1.0.14	# (MIT OR Apache-2.0) AND Unicode-3.0
MODCARGO_CRATES +=	unindent	0.2.3	# MIT OR Apache-2.0
MODCARGO_CRATES +=	universal-hash	0.5.1	# MIT OR Apache-2.0
MODCARGO_CRATES +=	untrusted	0.9.0	# ISC
MODCARGO_CRATES +=	url	2.5.4	# MIT OR Apache-2.0
MODCARGO_CRATES +=	utf16_iter	1.0.5	# Apache-2.0 OR MIT
MODCARGO_CRATES +=	utf8_iter	1.0.4	# Apache-2.0 OR MIT
MODCARGO_CRATES +=	utf8parse	0.2.2	# Apache-2.0 OR MIT
MODCARGO_CRATES +=	valuable	0.1.0	# MIT
MODCARGO_CRATES +=	version_check	0.9.5	# MIT/Apache-2.0
MODCARGO_CRATES +=	walkdir	2.5.0	# Unlicense/MIT
MODCARGO_CRATES +=	want	0.3.1	# MIT
MODCARGO_CRATES +=	wasi	0.11.0+wasi-snapshot-preview1	# Apache-2.0 WITH LLVM-exception OR Apache-2.0 OR MIT
MODCARGO_CRATES +=	wasm-bindgen	0.2.99	# MIT OR Apache-2.0
MODCARGO_CRATES +=	wasm-bindgen-backend	0.2.99	# MIT OR Apache-2.0
MODCARGO_CRATES +=	wasm-bindgen-macro	0.2.99	# MIT OR Apache-2.0
MODCARGO_CRATES +=	wasm-bindgen-macro-support	0.2.99	# MIT OR Apache-2.0
MODCARGO_CRATES +=	wasm-bindgen-shared	0.2.99	# MIT OR Apache-2.0
MODCARGO_CRATES +=	web-sys	0.3.76	# MIT OR Apache-2.0
MODCARGO_CRATES +=	weezl	0.1.8	# MIT OR Apache-2.0
MODCARGO_CRATES +=	which	7.0.1	# MIT
MODCARGO_CRATES +=	widestring	1.1.0	# MIT OR Apache-2.0
MODCARGO_CRATES +=	winapi	0.3.9	# MIT/Apache-2.0
MODCARGO_CRATES +=	winapi-i686-pc-windows-gnu	0.4.0	# MIT/Apache-2.0
MODCARGO_CRATES +=	winapi-util	0.1.9	# Unlicense OR MIT
MODCARGO_CRATES +=	winapi-x86_64-pc-windows-gnu	0.4.0	# MIT/Apache-2.0
MODCARGO_CRATES +=	windivert	0.6.0	# LGPL-3.0-or-later
MODCARGO_CRATES +=	windivert-sys	0.10.0	# LGPL-3.0-or-later
MODCARGO_CRATES +=	windows	0.48.0	# MIT OR Apache-2.0
MODCARGO_CRATES +=	windows	0.57.0	# MIT OR Apache-2.0
MODCARGO_CRATES +=	windows	0.58.0	# MIT OR Apache-2.0
MODCARGO_CRATES +=	windows-core	0.57.0	# MIT OR Apache-2.0
MODCARGO_CRATES +=	windows-core	0.58.0	# MIT OR Apache-2.0
MODCARGO_CRATES +=	windows-implement	0.57.0	# MIT OR Apache-2.0
MODCARGO_CRATES +=	windows-implement	0.58.0	# MIT OR Apache-2.0
MODCARGO_CRATES +=	windows-interface	0.57.0	# MIT OR Apache-2.0
MODCARGO_CRATES +=	windows-interface	0.58.0	# MIT OR Apache-2.0
MODCARGO_CRATES +=	windows-result	0.1.2	# MIT OR Apache-2.0
MODCARGO_CRATES +=	windows-result	0.2.0	# MIT OR Apache-2.0
MODCARGO_CRATES +=	windows-strings	0.1.0	# MIT OR Apache-2.0
MODCARGO_CRATES +=	windows-sys	0.48.0	# MIT OR Apache-2.0
MODCARGO_CRATES +=	windows-sys	0.52.0	# MIT OR Apache-2.0
MODCARGO_CRATES +=	windows-sys	0.59.0	# MIT OR Apache-2.0
MODCARGO_CRATES +=	windows-targets	0.48.5	# MIT OR Apache-2.0
MODCARGO_CRATES +=	windows-targets	0.52.6	# MIT OR Apache-2.0
MODCARGO_CRATES +=	windows_aarch64_gnullvm	0.48.5	# MIT OR Apache-2.0
MODCARGO_CRATES +=	windows_aarch64_gnullvm	0.52.6	# MIT OR Apache-2.0
MODCARGO_CRATES +=	windows_aarch64_msvc	0.48.5	# MIT OR Apache-2.0
MODCARGO_CRATES +=	windows_aarch64_msvc	0.52.6	# MIT OR Apache-2.0
MODCARGO_CRATES +=	windows_i686_gnu	0.48.5	# MIT OR Apache-2.0
MODCARGO_CRATES +=	windows_i686_gnu	0.52.6	# MIT OR Apache-2.0
MODCARGO_CRATES +=	windows_i686_gnullvm	0.52.6	# MIT OR Apache-2.0
MODCARGO_CRATES +=	windows_i686_msvc	0.48.5	# MIT OR Apache-2.0
MODCARGO_CRATES +=	windows_i686_msvc	0.52.6	# MIT OR Apache-2.0
MODCARGO_CRATES +=	windows_x86_64_gnu	0.48.5	# MIT OR Apache-2.0
MODCARGO_CRATES +=	windows_x86_64_gnu	0.52.6	# MIT OR Apache-2.0
MODCARGO_CRATES +=	windows_x86_64_gnullvm	0.48.5	# MIT OR Apache-2.0
MODCARGO_CRATES +=	windows_x86_64_gnullvm	0.52.6	# MIT OR Apache-2.0
MODCARGO_CRATES +=	windows_x86_64_msvc	0.48.5	# MIT OR Apache-2.0
MODCARGO_CRATES +=	windows_x86_64_msvc	0.52.6	# MIT OR Apache-2.0
MODCARGO_CRATES +=	winreg	0.50.0	# MIT
MODCARGO_CRATES +=	winreg2	0.53.1	# MIT
MODCARGO_CRATES +=	winres	0.1.12	# MIT
MODCARGO_CRATES +=	winsafe	0.0.19	# MIT
MODCARGO_CRATES +=	wintun-bindings	0.7.27	# MIT
MODCARGO_CRATES +=	write16	1.0.0	# Apache-2.0 OR MIT
MODCARGO_CRATES +=	writeable	0.5.5	# Unicode-3.0
MODCARGO_CRATES +=	x25519-dalek	2.0.1	# BSD-3-Clause
MODCARGO_CRATES +=	xattr	1.3.1	# MIT/Apache-2.0
MODCARGO_CRATES +=	yoke	0.7.5	# Unicode-3.0
MODCARGO_CRATES +=	yoke-derive	0.7.5	# Unicode-3.0
MODCARGO_CRATES +=	zerocopy	0.7.35	# BSD-2-Clause OR Apache-2.0 OR MIT
MODCARGO_CRATES +=	zerocopy-derive	0.7.35	# BSD-2-Clause OR Apache-2.0 OR MIT
MODCARGO_CRATES +=	zerofrom	0.1.5	# Unicode-3.0
MODCARGO_CRATES +=	zerofrom-derive	0.1.5	# Unicode-3.0
MODCARGO_CRATES +=	zeroize	1.8.1	# Apache-2.0 OR MIT
MODCARGO_CRATES +=	zeroize_derive	1.4.2	# Apache-2.0 OR MIT
MODCARGO_CRATES +=	zerovec	0.10.4	# Unicode-3.0
MODCARGO_CRATES +=	zerovec-derive	0.10.3	# Unicode-3.0
