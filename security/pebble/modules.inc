MODGO_MODULES =	\
	github.com/go-jose/go-jose/v4		 v4.1.3 \
	github.com/google/go-cmp		 v0.6.0 \
	github.com/letsencrypt/challtestsrv	 v1.4.2 \
	github.com/miekg/dns			 v1.1.62 \
	github.com/yuin/goldmark		 v1.4.13 \
	golang.org/x/crypto			 v0.38.0 \
	golang.org/x/mod			 v0.24.0 \
	golang.org/x/net			 v0.40.0 \
	golang.org/x/sync			 v0.14.0 \
	golang.org/x/sys			 v0.33.0 \
	golang.org/x/telemetry			 v0.0.0-20240521205824-bda55230c457 \
	golang.org/x/term			 v0.32.0 \
	golang.org/x/text			 v0.25.0 \
	golang.org/x/tools			 v0.33.0

MODGO_MODFILES =	\
	golang.org/x/mod	 v0.18.0 \
	golang.org/x/net	 v0.27.0 \
	golang.org/x/sync	 v0.7.0 \
	golang.org/x/sys	 v0.22.0 \
	golang.org/x/tools	 v0.13.0 \
	golang.org/x/tools	 v0.22.0

