## sysutils/u-boot/patches/patch-configs_rock960-rk3399_defconfig
```kconfig
$OpenBSD: patch-configs_rock960-rk3399_defconfig,v 1.5 2021/01/14 00:56:54 jsg Exp $

Disable CONFIG_USE_PREBOOT / usb start to fix boot.

Index: configs/rock960-rk3399_defconfig
--- configs/rock960-rk3399_defconfig.orig
+++ configs/rock960-rk3399_defconfig
@@ -8,7 +8,7 @@ CONFIG_DEBUG_UART_BASE=0xFF1A0000
 CONFIG_DEBUG_UART_CLOCK=24000000
 CONFIG_DEFAULT_DEVICE_TREE="rk3399-rock960"
 CONFIG_DEBUG_UART=y
-CONFIG_USE_PREBOOT=y
+# CONFIG_USE_PREBOOT is not set
 CONFIG_DEFAULT_FDT_FILE="rockchip/rk3399-rock960.dtb"
 CONFIG_DISPLAY_BOARDINFO_LATE=y
 CONFIG_MISC_INIT_R=y
@@ -49,7 +49,7 @@ CONFIG_REGULATOR_PWM=y
 CONFIG_REGULATOR_RK8XX=y
 CONFIG_PWM_ROCKCHIP=y
 CONFIG_DM_RESET=y
-CONFIG_BAUDRATE=1500000
+CONFIG_BAUDRATE=115200
 CONFIG_DEBUG_UART_SHIFT=2
 CONFIG_SYSRESET=y
 CONFIG_USB=y
```

## sysutils/u-boot/patches/patch-configs_rockpro64-rk3399_defconfig
```kconfig
Disable CONFIG_USE_PREBOOT / usb start to fix boot.

Index: configs/rockpro64-rk3399_defconfig
--- configs/rockpro64-rk3399_defconfig.orig
+++ configs/rockpro64-rk3399_defconfig
@@ -12,7 +12,7 @@ CONFIG_DEBUG_UART_CLOCK=24000000
 CONFIG_SPL_SPI_FLASH_SUPPORT=y
 CONFIG_SPL_SPI_SUPPORT=y
 CONFIG_DEBUG_UART=y
-CONFIG_USE_PREBOOT=y
+# CONFIG_USE_PREBOOT is not set
 CONFIG_DEFAULT_FDT_FILE="rockchip/rk3399-rockpro64.dtb"
 CONFIG_DISPLAY_BOARDINFO_LATE=y
 CONFIG_MISC_INIT_R=y
@@ -58,7 +58,7 @@ CONFIG_RAM_RK3399_LPDDR4=y
 CONFIG_DM_RESET=y
 CONFIG_DM_RNG=y
 CONFIG_RNG_ROCKCHIP=y
-CONFIG_BAUDRATE=1500000
+CONFIG_BAUDRATE=115200
 CONFIG_DEBUG_UART_SHIFT=2
 CONFIG_ROCKCHIP_SPI=y
 CONFIG_SYSRESET=y
```

## sysutils/u-boot/patches/patch-configs_rpi_2_defconfig
```kconfig
$OpenBSD: patch-configs_rpi_2_defconfig,v 1.7 2019/09/28 01:40:24 jsg Exp $

rpi: Use firmware provided device tree

Currently the firmware generates a device tree for us that we could
just use to adjust ourselves. We then on boot throw that away and
use our own built-in device tree to configure device access.

This is bad for a multitude of reasons. For starters, it breaks
overlay support in config.txt, confusing users. Much worse however
is that we are stuck with individual U-Boot builds per board.
The firmware can easily give us the right DT depending on the
target board and revision though.

So let's use the firmware provided device tree instead. That way
U-Boot as well as payloads loaded by it can automatically adapt
to variants of RPi hardware.

Index: configs/rpi_2_defconfig
--- configs/rpi_2_defconfig.orig
+++ configs/rpi_2_defconfig
@@ -17,7 +17,7 @@ CONFIG_CMD_GPIO=y
 CONFIG_CMD_MMC=y
 CONFIG_CMD_USB=y
 CONFIG_CMD_FS_UUID=y
-CONFIG_OF_EMBED=y
+CONFIG_OF_BOARD=y
 CONFIG_DEFAULT_DEVICE_TREE="bcm2836-rpi-2-b"
 CONFIG_ENV_FAT_INTERFACE="mmc"
 CONFIG_ENV_FAT_DEVICE_AND_PART="0:1"
```

## sysutils/u-boot/patches/patch-configs_rpi_3_32b_defconfig
```kconfig
$OpenBSD: patch-configs_rpi_3_32b_defconfig,v 1.8 2020/07/07 08:26:27 jsg Exp $

rpi: Use firmware provided device tree

Currently the firmware generates a device tree for us that we could
just use to adjust ourselves. We then on boot throw that away and
use our own built-in device tree to configure device access.

This is bad for a multitude of reasons. For starters, it breaks
overlay support in config.txt, confusing users. Much worse however
is that we are stuck with individual U-Boot builds per board.
The firmware can easily give us the right DT depending on the
target board and revision though.

So let's use the firmware provided device tree instead. That way
U-Boot as well as payloads loaded by it can automatically adapt
to variants of RPi hardware.

Index: configs/rpi_3_32b_defconfig
--- configs/rpi_3_32b_defconfig.orig
+++ configs/rpi_3_32b_defconfig
@@ -18,7 +18,7 @@ CONFIG_CMD_GPIO=y
 CONFIG_CMD_MMC=y
 CONFIG_CMD_USB=y
 CONFIG_CMD_FS_UUID=y
-CONFIG_OF_EMBED=y
+CONFIG_OF_BOARD=y
 CONFIG_DEFAULT_DEVICE_TREE="bcm2837-rpi-3-b"
 CONFIG_ENV_FAT_DEVICE_AND_PART="0:1"
 CONFIG_SYS_RELOC_GD_ENV_ADDR=y
```

## sysutils/u-boot/patches/patch-configs_rpi_3_defconfig
```kconfig
$OpenBSD: patch-configs_rpi_3_defconfig,v 1.2 2017/08/19 04:40:40 jsg Exp $

revert 25877d4e4c45451c5398aec3de50e0d5befe0e9f

Index: configs/rpi_3_defconfig
--- configs/rpi_3_defconfig.orig
+++ configs/rpi_3_defconfig
@@ -14,6 +14,7 @@ CONFIG_SYS_PROMPT="U-Boot> "
 # CONFIG_CMD_FLASH is not set
 # CONFIG_CMD_FPGA is not set
 CONFIG_CMD_GPIO=y
+CONFIG_OF_EMBED=y
 CONFIG_CMD_MMC=y
 CONFIG_CMD_USB=y
 CONFIG_DM_MMC=y
```
