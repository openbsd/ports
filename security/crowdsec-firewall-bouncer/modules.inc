MODGO_MODULES =	\
	ariga.io/atlas						 v0.19.1-0.20240203083654-5948b60a8e43 \
	entgo.io/ent						 v0.13.1 \
	github.com/!alec!aivazis/survey/v2			 v2.3.7 \
	github.com/!masterminds/goutils				 v1.1.1 \
	github.com/!masterminds/semver/v3			 v3.2.1 \
	github.com/!masterminds/sprig/v3			 v3.2.3 \
	github.com/!microsoft/go-winio				 v0.6.1 \
	github.com/agext/levenshtein				 v1.2.3 \
	github.com/ahmetalpbalkan/dlog				 v0.0.0-20170105205344-4fb5f8204f26 \
	github.com/alecthomas/kingpin/v2			 v2.4.0 \
	github.com/alecthomas/units				 v0.0.0-20211218093645-b94a6e3cc137 \
	github.com/alexliesenfeld/health			 v0.8.0 \
	github.com/apparentlymart/go-textseg/v13		 v13.0.0 \
	github.com/appleboy/gin-jwt/v2				 v2.9.2 \
	github.com/asaskevich/govalidator			 v0.0.0-20230301143203-a9d515a09cc2 \
	github.com/aws/aws-lambda-go				 v1.47.0 \
	github.com/aws/aws-sdk-go				 v1.52.0 \
	github.com/beevik/etree					 v1.3.0 \
	github.com/beorn7/perks					 v1.0.1 \
	github.com/blackfireio/osinfo				 v1.0.5 \
	github.com/bluele/gcache				 v0.0.2 \
	github.com/buger/jsonparser				 v1.1.1 \
	github.com/bytedance/sonic				 v1.10.2 \
	github.com/c-robinson/iplib				 v1.0.8 \
	github.com/cespare/xxhash/v2				 v2.3.0 \
	github.com/chenzhuoyu/base64x				 v0.0.0-20230717121745-296ad89f973d \
	github.com/chenzhuoyu/iasm				 v0.9.1 \
	github.com/corazawaf/libinjection-go			 v0.1.2 \
	github.com/coreos/go-systemd/v22			 v22.5.0 \
	github.com/cpuguy83/go-md2man/v2			 v2.0.3 \
	github.com/creack/pty					 v1.1.18 \
	github.com/crowdsecurity/coraza/v3			 v3.0.0-20240108124027-a62b8d8e5607 \
	github.com/crowdsecurity/crowdsec			 v1.6.3 \
	github.com/crowdsecurity/dlog				 v0.0.0-20170105205344-4fb5f8204f26 \
	github.com/crowdsecurity/go-cs-bouncer			 v0.0.14 \
	github.com/crowdsecurity/go-cs-lib			 v0.0.15 \
	github.com/crowdsecurity/grokky				 v0.2.2 \
	github.com/crowdsecurity/machineid			 v1.0.2 \
	github.com/davecgh/go-spew				 v1.1.1 \
	github.com/dghubble/sling				 v1.4.2 \
	github.com/docker/distribution				 v2.8.2+incompatible \
	github.com/docker/docker				 v24.0.9+incompatible \
	github.com/docker/go-connections			 v0.4.0 \
	github.com/docker/go-units				 v0.5.0 \
	github.com/expr-lang/expr				 v1.16.9 \
	github.com/fatih/color					 v1.17.0 \
	github.com/fsnotify/fsnotify				 v1.7.0 \
	github.com/gabriel-vasile/mimetype			 v1.4.3 \
	github.com/gin-contrib/sse				 v0.1.0 \
	github.com/gin-gonic/gin				 v1.9.1 \
	github.com/go-co-op/gocron				 v1.37.0 \
	github.com/go-kit/log					 v0.2.1 \
	github.com/go-logfmt/logfmt				 v0.5.1 \
	github.com/go-logr/logr					 v1.2.4 \
	github.com/go-ole/go-ole				 v1.2.6 \
	github.com/go-openapi/analysis				 v0.23.0 \
	github.com/go-openapi/errors				 v0.22.0 \
	github.com/go-openapi/inflect				 v0.19.0 \
	github.com/go-openapi/jsonpointer			 v0.21.0 \
	github.com/go-openapi/jsonreference			 v0.21.0 \
	github.com/go-openapi/loads				 v0.22.0 \
	github.com/go-openapi/runtime				 v0.19.24 \
	github.com/go-openapi/spec				 v0.21.0 \
	github.com/go-openapi/strfmt				 v0.23.0 \
	github.com/go-openapi/swag				 v0.23.0 \
	github.com/go-openapi/validate				 v0.24.0 \
	github.com/go-playground/locales			 v0.14.1 \
	github.com/go-playground/universal-translator		 v0.18.1 \
	github.com/go-playground/validator/v10			 v10.17.0 \
	github.com/go-sql-driver/mysql				 v1.6.0 \
	github.com/go-stack/stack				 v1.8.0 \
	github.com/goccy/go-json				 v0.10.2 \
	github.com/goccy/go-yaml				 v1.12.0 \
	github.com/godbus/dbus/v5				 v5.0.4 \
	github.com/gofrs/uuid					 v4.0.0+incompatible \
	github.com/gogo/protobuf				 v1.3.2 \
	github.com/golang-jwt/jwt/v4				 v4.5.0 \
	github.com/golang/glog					 v1.1.0 \
	github.com/golang/protobuf				 v1.5.3 \
	github.com/golang/snappy				 v0.0.4 \
	github.com/google/go-cmp				 v0.6.0 \
	github.com/google/go-querystring			 v1.1.0 \
	github.com/google/gofuzz				 v1.2.0 \
	github.com/google/nftables				 v0.2.0 \
	github.com/google/uuid					 v1.6.0 \
	github.com/google/winops				 v0.0.0-20230712152054-af9b550d0601 \
	github.com/goombaio/namegenerator			 v0.0.0-20181006234301-989e774b106e \
	github.com/gorilla/websocket				 v1.5.0 \
	github.com/hashicorp/go-hclog				 v1.5.0 \
	github.com/hashicorp/go-plugin				 v1.4.10 \
	github.com/hashicorp/go-version				 v1.2.1 \
	github.com/hashicorp/hcl/v2				 v2.13.0 \
	github.com/hashicorp/yamux				 v0.0.0-20180604194846-3520598351bb \
	github.com/hexops/gotextdiff				 v1.0.3 \
	github.com/huandu/xstrings				 v1.3.3 \
	github.com/imdario/mergo				 v0.3.12 \
	github.com/inconshreveable/mousetrap			 v1.1.0 \
	github.com/ivanpirog/coloredcobra			 v1.0.1 \
	github.com/jackc/chunkreader/v2				 v2.0.1 \
	github.com/jackc/pgconn					 v1.14.3 \
	github.com/jackc/pgio					 v1.0.0 \
	github.com/jackc/pgpassfile				 v1.0.0 \
	github.com/jackc/pgproto3/v2				 v2.3.3 \
	github.com/jackc/pgservicefile				 v0.0.0-20221227161230-091c0ba34f0a \
	github.com/jackc/pgtype					 v1.14.0 \
	github.com/jackc/pgx/v4					 v4.18.2 \
	github.com/jarcoal/httpmock				 v1.1.0 \
	github.com/jedib0t/go-pretty/v6				 v6.5.9 \
	github.com/jmespath/go-jmespath				 v0.4.0 \
	github.com/josharian/intern				 v1.0.0 \
	github.com/josharian/native				 v1.1.0 \
	github.com/jpillora/backoff				 v1.0.0 \
	github.com/json-iterator/go				 v1.1.12 \
	github.com/jszwec/csvutil				 v1.5.1 \
	github.com/julienschmidt/httprouter			 v1.3.0 \
	github.com/kballard/go-shellquote			 v0.0.0-20180428030007-95032a82bc51 \
	github.com/klauspost/compress				 v1.17.9 \
	github.com/klauspost/cpuid/v2				 v2.2.6 \
	github.com/kr/pretty					 v0.3.1 \
	github.com/kr/text					 v0.2.0 \
	github.com/kylelemons/godebug				 v1.1.0 \
	github.com/leodido/go-urn				 v1.3.0 \
	github.com/lithammer/dedent				 v1.1.0 \
	github.com/lufia/plan9stats				 v0.0.0-20211012122336-39d0f177ccd0 \
	github.com/magefile/mage				 v1.15.1-0.20230912152418-9f54e0f83e2a \
	github.com/mailru/easyjson				 v0.7.7 \
	github.com/mattn/go-colorable				 v0.1.13 \
	github.com/mattn/go-isatty				 v0.0.20 \
	github.com/mattn/go-runewidth				 v0.0.15 \
	github.com/mattn/go-sqlite3				 v1.14.16 \
	github.com/matttproud/golang_protobuf_extensions	 v1.0.4 \
	github.com/matttproud/golang_protobuf_extensions/v2	 v2.0.0 \
	github.com/mdlayher/netlink				 v1.7.2 \
	github.com/mdlayher/socket				 v0.5.1 \
	github.com/mgutz/ansi					 v0.0.0-20200706080929-d51e80ef957d \
	github.com/mitchellh/copystructure			 v1.2.0 \
	github.com/mitchellh/go-testing-interface		 v1.0.0 \
	github.com/mitchellh/go-wordwrap			 v1.0.1 \
	github.com/mitchellh/mapstructure			 v1.5.0 \
	github.com/mitchellh/reflectwalk			 v1.0.2 \
	github.com/moby/term					 v0.5.0 \
	github.com/modern-go/concurrent				 v0.0.0-20180306012644-bacd9c7ef1dd \
	github.com/modern-go/reflect2				 v1.0.2 \
	github.com/mohae/deepcopy				 v0.0.0-20170929034955-c48cc78d4826 \
	github.com/montanaflynn/stats				 v0.7.1 \
	github.com/morikuni/aec					 v1.0.0 \
	github.com/munnerz/goautoneg				 v0.0.0-20191010083416-a7dc8b61c822 \
	github.com/mwitkow/go-conntrack				 v0.0.0-20190716064945-2f068394615f \
	github.com/niemeyer/pretty				 v0.0.0-20200227124842-a10e7caefd8e \
	github.com/nxadm/tail					 v1.4.8 \
	github.com/oklog/run					 v1.0.0 \
	github.com/oklog/ulid					 v1.3.1 \
	github.com/opencontainers/go-digest			 v1.0.0 \
	github.com/opencontainers/image-spec			 v1.0.3-0.20211202183452-c5a74bcca799 \
	github.com/oschwald/geoip2-golang			 v1.9.0 \
	github.com/oschwald/maxminddb-golang			 v1.12.0 \
	github.com/pbnjay/memory				 v0.0.0-20210728143218-7b4eea64cf58 \
	github.com/pelletier/go-toml/v2				 v2.1.1 \
	github.com/petar-dambovaliev/aho-corasick		 v0.0.0-20230725210150-fb29fc3c913e \
	github.com/pierrec/lz4/v4				 v4.1.18 \
	github.com/pkg/errors					 v0.9.1 \
	github.com/pmezard/go-difflib				 v1.0.0 \
	github.com/power-devops/perfstat			 v0.0.0-20210106213030-5aafc221ea8c \
	github.com/prometheus/client_golang			 v1.20.0 \
	github.com/prometheus/client_model			 v0.6.1 \
	github.com/prometheus/common				 v0.55.0 \
	github.com/prometheus/procfs				 v0.15.1 \
	github.com/prometheus/prom2json				 v1.3.0 \
	github.com/r3labs/diff/v2				 v2.14.1 \
	github.com/rivo/uniseg					 v0.2.0 \
	github.com/robfig/cron/v3				 v3.0.1 \
	github.com/rogpeppe/go-internal				 v1.11.0 \
	github.com/russross/blackfriday/v2			 v2.1.0 \
	github.com/sanity-io/litter				 v1.5.5 \
	github.com/segmentio/kafka-go				 v0.4.45 \
	github.com/sergi/go-diff				 v1.3.1 \
	github.com/shirou/gopsutil/v3				 v3.23.5 \
	github.com/shoenig/go-m1cpu				 v0.1.6 \
	github.com/shopspring/decimal				 v1.2.0 \
	github.com/sirupsen/logrus				 v1.9.3 \
	github.com/slack-go/slack				 v0.12.2 \
	github.com/spf13/cast					 v1.3.1 \
	github.com/spf13/cobra					 v1.8.0 \
	github.com/spf13/pflag					 v1.0.5 \
	github.com/stretchr/objx				 v0.5.2 \
	github.com/stretchr/testify				 v1.9.0 \
	github.com/tetratelabs/wazero				 v1.8.0 \
	github.com/tidwall/gjson				 v1.17.0 \
	github.com/tidwall/match				 v1.1.1 \
	github.com/tidwall/pretty				 v1.2.1 \
	github.com/tklauser/go-sysconf				 v0.3.11 \
	github.com/tklauser/numcpus				 v0.6.0 \
	github.com/toorop/go-dkim				 v0.0.0-20201103131630-e1cd1a0a5208 \
	github.com/twitchyliquid64/golang-asm			 v0.15.1 \
	github.com/ugorji/go/codec				 v1.2.12 \
	github.com/umahmood/haversine				 v0.0.0-20151105152445-808ab04add26 \
	github.com/vishvananda/netns				 v0.0.0-20180720170159-13995c7128cc \
	github.com/vmihailenco/msgpack				 v4.0.4+incompatible \
	github.com/wasilibs/go-re2				 v1.6.0 \
	github.com/xdg-go/pbkdf2				 v1.0.0 \
	github.com/xdg-go/scram					 v1.1.2 \
	github.com/xdg-go/stringprep				 v1.0.4 \
	github.com/xhit/go-simple-mail/v2			 v2.16.0 \
	github.com/xhit/go-str2duration/v2			 v2.1.0 \
	github.com/youmark/pkcs8				 v0.0.0-20181117223130-1be2e3e5546d \
	github.com/yusufpapurcu/wmi				 v1.2.3 \
	github.com/zclconf/go-cty				 v1.8.0 \
	go.mongodb.org/mongo-driver				 v1.16.1 \
	go.uber.org/atomic					 v1.10.0 \
	golang.org/x/arch					 v0.7.0 \
	golang.org/x/crypto					 v0.26.0 \
	golang.org/x/mod					 v0.15.0 \
	golang.org/x/net					 v0.28.0 \
	golang.org/x/oauth2					 v0.21.0 \
	golang.org/x/sync					 v0.8.0 \
	golang.org/x/sys					 v0.24.0 \
	golang.org/x/term					 v0.23.0 \
	golang.org/x/text					 v0.17.0 \
	golang.org/x/time					 v0.3.0 \
	golang.org/x/tools					 v0.18.0 \
	golang.org/x/xerrors					 v0.0.0-20240716161551-93cc26a95ae9 \
	google.golang.org/appengine				 v1.6.7 \
	google.golang.org/genproto/googleapis/rpc		 v0.0.0-20230525234030-28d5490b6b19 \
	google.golang.org/grpc					 v1.56.3 \
	google.golang.org/protobuf				 v1.34.2 \
	gopkg.in/check.v1					 v1.0.0-20201130134442-10cb98267c6c \
	gopkg.in/inf.v0						 v0.9.1 \
	gopkg.in/natefinch/lumberjack.v2			 v2.2.1 \
	gopkg.in/tomb.v1					 v1.0.0-20141024135613-dd632973f1e7 \
	gopkg.in/tomb.v2					 v2.0.0-20161208151619-d5d1b5820637 \
	gopkg.in/yaml.v2					 v2.4.0 \
	gopkg.in/yaml.v3					 v3.0.1 \
	gotest.tools/v3						 v3.5.0 \
	k8s.io/api						 v0.28.4 \
	k8s.io/apimachinery					 v0.28.4 \
	k8s.io/apiserver					 v0.28.4 \
	k8s.io/klog/v2						 v2.100.1 \
	k8s.io/utils						 v0.0.0-20230406110748-d93618cff8a2 \
	rsc.io/binaryregexp					 v0.2.0 \
	sigs.k8s.io/json					 v0.0.0-20221116044647-bc3834ca7abd \
	sigs.k8s.io/structured-merge-diff/v4			 v4.2.3

MODGO_MODFILES =	\
	github.com/asaskevich/govalidator		 v0.0.0-20200907205600-7a23bdc65eef \
	github.com/cespare/xxhash/v2			 v2.2.0 \
	github.com/davecgh/go-spew			 v1.1.0 \
	github.com/fatih/color				 v1.10.0 \
	github.com/fatih/color				 v1.16.0 \
	github.com/go-openapi/analysis			 v0.19.16 \
	github.com/go-openapi/analysis			 v0.21.4 \
	github.com/go-openapi/errors			 v0.20.1 \
	github.com/go-openapi/errors			 v0.20.4 \
	github.com/go-openapi/jsonpointer		 v0.19.6 \
	github.com/go-openapi/jsonpointer		 v0.20.0 \
	github.com/go-openapi/jsonreference		 v0.20.2 \
	github.com/go-openapi/loads			 v0.20.0 \
	github.com/go-openapi/loads			 v0.21.2 \
	github.com/go-openapi/spec			 v0.20.0 \
	github.com/go-openapi/spec			 v0.20.9 \
	github.com/go-openapi/strfmt			 v0.19.11 \
	github.com/go-openapi/strfmt			 v0.21.7 \
	github.com/go-openapi/swag			 v0.22.3 \
	github.com/go-openapi/swag			 v0.22.4 \
	github.com/go-openapi/validate			 v0.20.0 \
	github.com/go-openapi/validate			 v0.22.1 \
	github.com/go-playground/locales		 v0.13.0 \
	github.com/go-playground/universal-translator	 v0.17.0 \
	github.com/go-playground/validator/v10		 v10.4.1 \
	github.com/goccy/go-yaml			 v1.11.0 \
	github.com/goccy/go-yaml			 v1.11.2 \
	github.com/golang/protobuf			 v1.5.0 \
	github.com/google/go-cmp			 v0.5.2 \
	github.com/google/go-cmp			 v0.5.5 \
	github.com/google/go-cmp			 v0.5.9 \
	github.com/klauspost/compress			 v1.13.6 \
	github.com/klauspost/compress			 v1.17.3 \
	github.com/leodido/go-urn			 v1.2.0 \
	github.com/mattn/go-colorable			 v0.1.8 \
	github.com/mattn/go-isatty			 v0.0.12 \
	github.com/mattn/go-isatty			 v0.0.16 \
	github.com/mdlayher/socket			 v0.4.1 \
	github.com/mdlayher/socket			 v0.5.0 \
	github.com/prometheus/client_golang		 v1.16.0 \
	github.com/prometheus/client_golang		 v1.18.0 \
	github.com/prometheus/client_golang		 v1.19.1 \
	github.com/prometheus/client_model		 v0.4.0 \
	github.com/prometheus/client_model		 v0.5.0 \
	github.com/prometheus/common			 v0.44.0 \
	github.com/prometheus/common			 v0.45.0 \
	github.com/prometheus/procfs			 v0.10.1 \
	github.com/prometheus/procfs			 v0.12.0 \
	github.com/rogpeppe/go-internal			 v1.10.0 \
	github.com/stretchr/objx			 v0.1.0 \
	github.com/stretchr/testify			 v1.7.0 \
	github.com/stretchr/testify			 v1.8.4 \
	go.mongodb.org/mongo-driver			 v1.12.1 \
	go.mongodb.org/mongo-driver			 v1.14.0 \
	go.mongodb.org/mongo-driver			 v1.9.4 \
	golang.org/x/crypto				 v0.22.0 \
	golang.org/x/crypto				 v0.7.0 \
	golang.org/x/net				 v0.14.0 \
	golang.org/x/net				 v0.22.0 \
	golang.org/x/net				 v0.24.0 \
	golang.org/x/net				 v0.26.0 \
	golang.org/x/net				 v0.9.0 \
	golang.org/x/sync				 v0.1.0 \
	golang.org/x/sync				 v0.3.0 \
	golang.org/x/sync				 v0.6.0 \
	golang.org/x/sync				 v0.7.0 \
	golang.org/x/sys				 v0.0.0-20220715151400-c0bba94af5f8 \
	golang.org/x/sys				 v0.0.0-20220811171246-fbc7d0a398ab \
	golang.org/x/sys				 v0.11.0 \
	golang.org/x/sys				 v0.18.0 \
	golang.org/x/sys				 v0.20.0 \
	golang.org/x/sys				 v0.21.0 \
	golang.org/x/sys				 v0.22.0 \
	golang.org/x/sys				 v0.23.0 \
	golang.org/x/sys				 v0.6.0 \
	golang.org/x/sys				 v0.7.0 \
	golang.org/x/term				 v0.19.0 \
	golang.org/x/text				 v0.14.0 \
	golang.org/x/text				 v0.16.0 \
	golang.org/x/xerrors				 v0.0.0-20191204190536-9bdfabe68543 \
	golang.org/x/xerrors				 v0.0.0-20200804184101-5ec99f83aff1 \
	golang.org/x/xerrors				 v0.0.0-20231012003039-104605ab7028 \
	google.golang.org/protobuf			 v1.33.0 \
	gopkg.in/check.v1				 v0.0.0-20161208181325-20d25e280405 \
	gopkg.in/check.v1				 v1.0.0-20200227125254-8fa46927fb4f \
	gopkg.in/yaml.v3				 v3.0.0-20200313102051-9f266ea9e77c
