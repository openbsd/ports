MODCARGO_CRATES +=	addr2line	0.24.2	# Apache-2.0 OR MIT
MODCARGO_CRATES +=	adler2	2.0.0	# 0BSD OR MIT OR Apache-2.0
MODCARGO_CRATES +=	aead	0.5.2	# MIT OR Apache-2.0
MODCARGO_CRATES +=	aes	0.8.4	# MIT OR Apache-2.0
MODCARGO_CRATES +=	aes-gcm	0.10.3	# Apache-2.0 OR MIT
MODCARGO_CRATES +=	ahash	0.8.11	# MIT OR Apache-2.0
MODCARGO_CRATES +=	aho-corasick	1.1.3	# Unlicense OR MIT
MODCARGO_CRATES +=	aligned	0.4.2	# MIT OR Apache-2.0
MODCARGO_CRATES +=	android-tzdata	0.1.1	# MIT OR Apache-2.0
MODCARGO_CRATES +=	android_system_properties	0.1.5	# MIT/Apache-2.0
MODCARGO_CRATES +=	anstream	0.6.18	# MIT OR Apache-2.0
MODCARGO_CRATES +=	anstyle	1.0.10	# MIT OR Apache-2.0
MODCARGO_CRATES +=	anstyle-parse	0.2.6	# MIT OR Apache-2.0
MODCARGO_CRATES +=	anstyle-query	1.1.2	# MIT OR Apache-2.0
MODCARGO_CRATES +=	anstyle-wincon	3.0.7	# MIT OR Apache-2.0
MODCARGO_CRATES +=	anyhow	1.0.97	# MIT OR Apache-2.0
MODCARGO_CRATES +=	argon2	0.5.3	# MIT OR Apache-2.0
MODCARGO_CRATES +=	arraydeque	0.5.1	# MIT/Apache-2.0
MODCARGO_CRATES +=	as-slice	0.2.1	# MIT OR Apache-2.0
MODCARGO_CRATES +=	ascii-canvas	3.0.0	# Apache-2.0/MIT
MODCARGO_CRATES +=	ascii-canvas	4.0.0	# Apache-2.0/MIT
MODCARGO_CRATES +=	assert_cmd	2.0.16	# MIT OR Apache-2.0
MODCARGO_CRATES +=	async-generic	1.1.2	# MIT OR Apache-2.0
MODCARGO_CRATES +=	async-trait	0.1.87	# MIT OR Apache-2.0
MODCARGO_CRATES +=	atomic-waker	1.1.2	# Apache-2.0 OR MIT
MODCARGO_CRATES +=	autocfg	1.4.0	# Apache-2.0 OR MIT
MODCARGO_CRATES +=	backtrace	0.3.74	# MIT OR Apache-2.0
MODCARGO_CRATES +=	base16ct	0.2.0	# Apache-2.0 OR MIT
MODCARGO_CRATES +=	base64	0.22.1	# MIT OR Apache-2.0
MODCARGO_CRATES +=	base64ct	1.6.0	# Apache-2.0 OR MIT
MODCARGO_CRATES +=	bindgen	0.70.1	# BSD-3-Clause
MODCARGO_CRATES +=	bit-set	0.5.3	# MIT/Apache-2.0
MODCARGO_CRATES +=	bit-set	0.8.0	# Apache-2.0 OR MIT
MODCARGO_CRATES +=	bit-vec	0.6.3	# MIT/Apache-2.0
MODCARGO_CRATES +=	bit-vec	0.8.0	# Apache-2.0 OR MIT
MODCARGO_CRATES +=	bitflags	2.9.0	# MIT OR Apache-2.0
MODCARGO_CRATES +=	blake2	0.10.6	# MIT OR Apache-2.0
MODCARGO_CRATES +=	block-buffer	0.10.4	# MIT OR Apache-2.0
MODCARGO_CRATES +=	block-padding	0.3.3	# MIT OR Apache-2.0
MODCARGO_CRATES +=	blowfish	0.9.1	# MIT OR Apache-2.0
MODCARGO_CRATES +=	botan	0.11.1	# MIT
MODCARGO_CRATES +=	botan-sys	0.11.1	# MIT
MODCARGO_CRATES +=	bstr	1.11.3	# MIT OR Apache-2.0
MODCARGO_CRATES +=	buffered-reader	1.4.0	# LGPL-2.0-or-later
MODCARGO_CRATES +=	bumpalo	3.17.0	# MIT OR Apache-2.0
MODCARGO_CRATES +=	byteorder	1.5.0	# Unlicense OR MIT
MODCARGO_CRATES +=	bytes	1.10.0	# MIT
MODCARGO_CRATES +=	bzip2	0.5.2	# MIT OR Apache-2.0
MODCARGO_CRATES +=	bzip2-sys	0.1.13+1.0.8	# MIT/Apache-2.0
MODCARGO_CRATES +=	camellia	0.1.0	# MIT OR Apache-2.0
MODCARGO_CRATES +=	capnp	0.19.8	# MIT
MODCARGO_CRATES +=	capnp-futures	0.19.1	# MIT
MODCARGO_CRATES +=	capnp-rpc	0.19.5	# MIT
MODCARGO_CRATES +=	capnpc	0.19.0	# MIT
MODCARGO_CRATES +=	cast5	0.11.1	# MIT OR Apache-2.0
MODCARGO_CRATES +=	cc	1.2.16	# MIT OR Apache-2.0
MODCARGO_CRATES +=	cexpr	0.6.0	# Apache-2.0/MIT
MODCARGO_CRATES +=	cfb-mode	0.8.2	# MIT OR Apache-2.0
MODCARGO_CRATES +=	cfg-if	1.0.0	# MIT/Apache-2.0
MODCARGO_CRATES +=	cfg_aliases	0.2.1	# MIT
MODCARGO_CRATES +=	chrono	0.4.40	# MIT OR Apache-2.0
MODCARGO_CRATES +=	cipher	0.4.4	# MIT OR Apache-2.0
MODCARGO_CRATES +=	clang-sys	1.8.1	# Apache-2.0
MODCARGO_CRATES +=	clap	4.5.31	# MIT OR Apache-2.0
MODCARGO_CRATES +=	clap_builder	4.5.31	# MIT OR Apache-2.0
MODCARGO_CRATES +=	clap_complete	4.5.46	# MIT OR Apache-2.0
MODCARGO_CRATES +=	clap_derive	4.5.28	# MIT OR Apache-2.0
MODCARGO_CRATES +=	clap_lex	0.7.4	# MIT OR Apache-2.0
MODCARGO_CRATES +=	cmac	0.7.2	# MIT OR Apache-2.0
MODCARGO_CRATES +=	colorchoice	1.0.3	# MIT OR Apache-2.0
MODCARGO_CRATES +=	console	0.15.11	# MIT
MODCARGO_CRATES +=	const-oid	0.9.6	# Apache-2.0 OR MIT
MODCARGO_CRATES +=	core-foundation	0.9.4	# MIT OR Apache-2.0
MODCARGO_CRATES +=	core-foundation-sys	0.8.7	# MIT OR Apache-2.0
MODCARGO_CRATES +=	cpufeatures	0.2.17	# MIT OR Apache-2.0
MODCARGO_CRATES +=	crc32fast	1.4.2	# MIT OR Apache-2.0
MODCARGO_CRATES +=	crossbeam	0.8.4	# MIT OR Apache-2.0
MODCARGO_CRATES +=	crossbeam-channel	0.5.14	# MIT OR Apache-2.0
MODCARGO_CRATES +=	crossbeam-deque	0.8.6	# MIT OR Apache-2.0
MODCARGO_CRATES +=	crossbeam-epoch	0.9.18	# MIT OR Apache-2.0
MODCARGO_CRATES +=	crossbeam-queue	0.3.12	# MIT OR Apache-2.0
MODCARGO_CRATES +=	crossbeam-utils	0.8.21	# MIT OR Apache-2.0
MODCARGO_CRATES +=	crunchy	0.2.3	# MIT
MODCARGO_CRATES +=	crypto-bigint	0.5.5	# Apache-2.0 OR MIT
MODCARGO_CRATES +=	crypto-common	0.1.6	# MIT OR Apache-2.0
MODCARGO_CRATES +=	ctor	0.2.9	# Apache-2.0 OR MIT
MODCARGO_CRATES +=	ctr	0.9.2	# MIT OR Apache-2.0
MODCARGO_CRATES +=	culpa	1.0.2	# MIT OR Apache-2.0
MODCARGO_CRATES +=	culpa-macros	1.0.2	# MIT OR Apache-2.0
MODCARGO_CRATES +=	curve25519-dalek	4.1.3	# BSD-3-Clause
MODCARGO_CRATES +=	curve25519-dalek-derive	0.1.1	# MIT/Apache-2.0
MODCARGO_CRATES +=	cvt	0.1.2	# Apache-2.0
MODCARGO_CRATES +=	data-encoding	2.8.0	# MIT
MODCARGO_CRATES +=	dbl	0.3.2	# MIT OR Apache-2.0
MODCARGO_CRATES +=	der	0.7.9	# Apache-2.0 OR MIT
MODCARGO_CRATES +=	deranged	0.3.11	# MIT OR Apache-2.0
MODCARGO_CRATES +=	des	0.8.1	# MIT OR Apache-2.0
MODCARGO_CRATES +=	descape	2.0.3	# Apache-2.0 OR MIT
MODCARGO_CRATES +=	deunicode	1.6.0	# BSD-3-Clause
MODCARGO_CRATES +=	difflib	0.4.0	# MIT
MODCARGO_CRATES +=	digest	0.10.7	# MIT OR Apache-2.0
MODCARGO_CRATES +=	directories	5.0.1	# MIT OR Apache-2.0
MODCARGO_CRATES +=	dirs	5.0.1	# MIT OR Apache-2.0
MODCARGO_CRATES +=	dirs	6.0.0	# MIT OR Apache-2.0
MODCARGO_CRATES +=	dirs-next	2.0.0	# MIT OR Apache-2.0
MODCARGO_CRATES +=	dirs-sys	0.4.1	# MIT OR Apache-2.0
MODCARGO_CRATES +=	dirs-sys	0.5.0	# MIT OR Apache-2.0
MODCARGO_CRATES +=	dirs-sys-next	0.1.2	# MIT OR Apache-2.0
MODCARGO_CRATES +=	displaydoc	0.2.5	# MIT OR Apache-2.0
MODCARGO_CRATES +=	doc-comment	0.3.3	# MIT
MODCARGO_CRATES +=	dsa	0.6.3	# Apache-2.0 OR MIT
MODCARGO_CRATES +=	dyn-clone	1.0.18	# MIT OR Apache-2.0
MODCARGO_CRATES +=	eax	0.5.0	# Apache-2.0 OR MIT
MODCARGO_CRATES +=	ecb	0.1.2	# MIT
MODCARGO_CRATES +=	ecdsa	0.16.9	# Apache-2.0 OR MIT
MODCARGO_CRATES +=	ed25519	2.2.3	# Apache-2.0 OR MIT
MODCARGO_CRATES +=	ed25519-dalek	2.1.1	# BSD-3-Clause
MODCARGO_CRATES +=	either	1.14.0	# MIT OR Apache-2.0
MODCARGO_CRATES +=	elliptic-curve	0.13.8	# Apache-2.0 OR MIT
MODCARGO_CRATES +=	embedded-io	0.6.1	# MIT OR Apache-2.0
MODCARGO_CRATES +=	ena	0.14.3	# MIT OR Apache-2.0
MODCARGO_CRATES +=	encode_unicode	1.0.0	# Apache-2.0 OR MIT
MODCARGO_CRATES +=	encoding_rs	0.8.35	# (Apache-2.0 OR MIT) AND BSD-3-Clause
MODCARGO_CRATES +=	endian-type	0.1.2	# MIT
MODCARGO_CRATES +=	enum-as-inner	0.6.1	# MIT/Apache-2.0
MODCARGO_CRATES +=	env_filter	0.1.3	# MIT OR Apache-2.0
MODCARGO_CRATES +=	env_logger	0.11.6	# MIT OR Apache-2.0
MODCARGO_CRATES +=	equivalent	1.0.2	# Apache-2.0 OR MIT
MODCARGO_CRATES +=	errno	0.3.10	# MIT OR Apache-2.0
MODCARGO_CRATES +=	fallible-iterator	0.3.0	# MIT/Apache-2.0
MODCARGO_CRATES +=	fallible-streaming-iterator	0.1.9	# MIT/Apache-2.0
MODCARGO_CRATES +=	fastrand	2.3.0	# Apache-2.0 OR MIT
MODCARGO_CRATES +=	fd-lock	4.0.2	# MIT OR Apache-2.0
MODCARGO_CRATES +=	ff	0.13.0	# MIT/Apache-2.0
MODCARGO_CRATES +=	fiat-crypto	0.2.9	# MIT OR Apache-2.0 OR BSD-1-Clause
MODCARGO_CRATES +=	filetime	0.2.25	# MIT/Apache-2.0
MODCARGO_CRATES +=	fixedbitset	0.4.2	# MIT/Apache-2.0
MODCARGO_CRATES +=	fixedbitset	0.5.7	# MIT OR Apache-2.0
MODCARGO_CRATES +=	flate2	1.1.0	# MIT OR Apache-2.0
MODCARGO_CRATES +=	float-cmp	0.10.0	# MIT
MODCARGO_CRATES +=	fnv	1.0.7	# Apache-2.0 / MIT
MODCARGO_CRATES +=	foreign-types	0.3.2	# MIT/Apache-2.0
MODCARGO_CRATES +=	foreign-types-shared	0.1.1	# MIT/Apache-2.0
MODCARGO_CRATES +=	form_urlencoded	1.2.1	# MIT OR Apache-2.0
MODCARGO_CRATES +=	fs2	0.4.3	# MIT/Apache-2.0
MODCARGO_CRATES +=	fs_at	0.2.1	# Apache-2.0
MODCARGO_CRATES +=	fs_extra	1.3.0	# MIT
MODCARGO_CRATES +=	futures	0.3.31	# MIT OR Apache-2.0
MODCARGO_CRATES +=	futures-channel	0.3.31	# MIT OR Apache-2.0
MODCARGO_CRATES +=	futures-core	0.3.31	# MIT OR Apache-2.0
MODCARGO_CRATES +=	futures-executor	0.3.31	# MIT OR Apache-2.0
MODCARGO_CRATES +=	futures-io	0.3.31	# MIT OR Apache-2.0
MODCARGO_CRATES +=	futures-macro	0.3.31	# MIT OR Apache-2.0
MODCARGO_CRATES +=	futures-sink	0.3.31	# MIT OR Apache-2.0
MODCARGO_CRATES +=	futures-task	0.3.31	# MIT OR Apache-2.0
MODCARGO_CRATES +=	futures-util	0.3.31	# MIT OR Apache-2.0
MODCARGO_CRATES +=	generator	0.7.5	# MIT/Apache-2.0
MODCARGO_CRATES +=	generic-array	0.14.7	# MIT
MODCARGO_CRATES +=	gethostname	0.5.0	# Apache-2.0
MODCARGO_CRATES +=	getopts	0.2.21	# MIT/Apache-2.0
MODCARGO_CRATES +=	getrandom	0.2.15	# MIT OR Apache-2.0
MODCARGO_CRATES +=	getrandom	0.3.1	# MIT OR Apache-2.0
MODCARGO_CRATES +=	ghash	0.5.1	# Apache-2.0 OR MIT
MODCARGO_CRATES +=	gimli	0.31.1	# MIT OR Apache-2.0
MODCARGO_CRATES +=	glob	0.3.2	# MIT OR Apache-2.0
MODCARGO_CRATES +=	globset	0.4.16	# Unlicense OR MIT
MODCARGO_CRATES +=	globwalk	0.9.1	# MIT
MODCARGO_CRATES +=	group	0.13.0	# MIT/Apache-2.0
MODCARGO_CRATES +=	h2	0.4.8	# MIT
MODCARGO_CRATES +=	hashbrown	0.14.5	# MIT OR Apache-2.0
MODCARGO_CRATES +=	hashbrown	0.15.2	# MIT OR Apache-2.0
MODCARGO_CRATES +=	hashlink	0.9.1	# MIT OR Apache-2.0
MODCARGO_CRATES +=	heck	0.5.0	# MIT OR Apache-2.0
MODCARGO_CRATES +=	hermit-abi	0.3.9	# MIT OR Apache-2.0
MODCARGO_CRATES +=	hickory-client	0.24.4	# MIT OR Apache-2.0
MODCARGO_CRATES +=	hickory-proto	0.24.4	# MIT OR Apache-2.0
MODCARGO_CRATES +=	hickory-resolver	0.24.4	# MIT OR Apache-2.0
MODCARGO_CRATES +=	hkdf	0.12.4	# MIT OR Apache-2.0
MODCARGO_CRATES +=	hmac	0.12.1	# MIT OR Apache-2.0
MODCARGO_CRATES +=	home	0.5.9	# MIT OR Apache-2.0
MODCARGO_CRATES +=	hostname	0.3.1	# MIT
MODCARGO_CRATES +=	html-escape	0.2.13	# MIT
MODCARGO_CRATES +=	http	1.2.0	# MIT OR Apache-2.0
MODCARGO_CRATES +=	http-body	1.0.1	# MIT
MODCARGO_CRATES +=	http-body-util	0.1.2	# MIT
MODCARGO_CRATES +=	httparse	1.10.0	# MIT OR Apache-2.0
MODCARGO_CRATES +=	humansize	2.1.3	# MIT/Apache-2.0
MODCARGO_CRATES +=	humantime	2.1.0	# MIT/Apache-2.0
MODCARGO_CRATES +=	hyper	1.6.0	# MIT
MODCARGO_CRATES +=	hyper-rustls	0.27.5	# Apache-2.0 OR ISC OR MIT
MODCARGO_CRATES +=	hyper-tls	0.6.0	# MIT/Apache-2.0
MODCARGO_CRATES +=	hyper-util	0.1.10	# MIT
MODCARGO_CRATES +=	iana-time-zone	0.1.61	# MIT OR Apache-2.0
MODCARGO_CRATES +=	iana-time-zone-haiku	0.1.2	# MIT OR Apache-2.0
MODCARGO_CRATES +=	icu_collections	1.5.0	# Unicode-3.0
MODCARGO_CRATES +=	icu_locid	1.5.0	# Unicode-3.0
MODCARGO_CRATES +=	icu_locid_transform	1.5.0	# Unicode-3.0
MODCARGO_CRATES +=	icu_locid_transform_data	1.5.0	# Unicode-3.0
MODCARGO_CRATES +=	icu_normalizer	1.5.0	# Unicode-3.0
MODCARGO_CRATES +=	icu_normalizer_data	1.5.0	# Unicode-3.0
MODCARGO_CRATES +=	icu_properties	1.5.1	# Unicode-3.0
MODCARGO_CRATES +=	icu_properties_data	1.5.0	# Unicode-3.0
MODCARGO_CRATES +=	icu_provider	1.5.0	# Unicode-3.0
MODCARGO_CRATES +=	icu_provider_macros	1.5.0	# Unicode-3.0
MODCARGO_CRATES +=	idea	0.5.1	# MIT OR Apache-2.0
MODCARGO_CRATES +=	idna	1.0.3	# MIT OR Apache-2.0
MODCARGO_CRATES +=	idna_adapter	1.2.0	# Apache-2.0 OR MIT
MODCARGO_CRATES +=	ignore	0.4.23	# Unlicense OR MIT
MODCARGO_CRATES +=	indexmap	2.7.1	# Apache-2.0 OR MIT
MODCARGO_CRATES +=	indicatif	0.17.11	# MIT
MODCARGO_CRATES +=	inout	0.1.4	# MIT OR Apache-2.0
MODCARGO_CRATES +=	ipconfig	0.3.2	# MIT/Apache-2.0
MODCARGO_CRATES +=	ipnet	2.11.0	# MIT OR Apache-2.0
MODCARGO_CRATES +=	is_terminal_polyfill	1.70.1	# MIT OR Apache-2.0
MODCARGO_CRATES +=	itertools	0.11.0	# MIT OR Apache-2.0
MODCARGO_CRATES +=	itertools	0.13.0	# MIT OR Apache-2.0
MODCARGO_CRATES +=	itertools	0.14.0	# MIT OR Apache-2.0
MODCARGO_CRATES +=	itoa	1.0.14	# MIT OR Apache-2.0
MODCARGO_CRATES +=	js-sys	0.3.77	# MIT OR Apache-2.0
MODCARGO_CRATES +=	keccak	0.1.5	# Apache-2.0 OR MIT
MODCARGO_CRATES +=	lalrpop	0.20.2	# Apache-2.0 OR MIT
MODCARGO_CRATES +=	lalrpop	0.22.1	# Apache-2.0 OR MIT
MODCARGO_CRATES +=	lalrpop-util	0.20.2	# Apache-2.0 OR MIT
MODCARGO_CRATES +=	lalrpop-util	0.22.1	# Apache-2.0 OR MIT
MODCARGO_CRATES +=	lazy_static	1.5.0	# MIT OR Apache-2.0
MODCARGO_CRATES +=	libc	0.2.170	# MIT OR Apache-2.0
MODCARGO_CRATES +=	libloading	0.8.6	# ISC
MODCARGO_CRATES +=	libm	0.2.11	# MIT AND (MIT OR Apache-2.0)
MODCARGO_CRATES +=	libredox	0.1.3	# MIT
MODCARGO_CRATES +=	libsqlite3-sys	0.28.0	# MIT
MODCARGO_CRATES +=	line-col	0.2.1	# MIT
MODCARGO_CRATES +=	linked-hash-map	0.5.6	# MIT/Apache-2.0
MODCARGO_CRATES +=	linux-raw-sys	0.4.15	# Apache-2.0 WITH LLVM-exception OR Apache-2.0 OR MIT
MODCARGO_CRATES +=	litemap	0.7.3	# Unicode-3.0
MODCARGO_CRATES +=	lock_api	0.4.12	# MIT OR Apache-2.0
MODCARGO_CRATES +=	log	0.4.26	# MIT OR Apache-2.0
MODCARGO_CRATES +=	loom	0.5.6	# MIT
MODCARGO_CRATES +=	lru-cache	0.1.2	# MIT/Apache-2.0
MODCARGO_CRATES +=	marked-yaml	0.7.2	# MIT
MODCARGO_CRATES +=	match_cfg	0.1.0	# MIT/Apache-2.0
MODCARGO_CRATES +=	matchers	0.1.0	# MIT
MODCARGO_CRATES +=	md-5	0.10.6	# MIT OR Apache-2.0
MODCARGO_CRATES +=	memchr	2.7.4	# Unlicense OR MIT
MODCARGO_CRATES +=	memsec	0.7.0	# MIT
MODCARGO_CRATES +=	mime	0.3.17	# MIT OR Apache-2.0
MODCARGO_CRATES +=	minimal-lexical	0.2.1	# MIT/Apache-2.0
MODCARGO_CRATES +=	miniz_oxide	0.8.5	# MIT OR Zlib OR Apache-2.0
MODCARGO_CRATES +=	mio	1.0.3	# MIT
MODCARGO_CRATES +=	native-tls	0.2.13	# MIT OR Apache-2.0
MODCARGO_CRATES +=	nettle	7.4.0	# LGPL-3.0 OR GPL-2.0 OR GPL-3.0
MODCARGO_CRATES +=	nettle-sys	2.3.1	# LGPL-3.0-only OR GPL-2.0-only OR GPL-3.0-only
MODCARGO_CRATES +=	new_debug_unreachable	1.0.6	# MIT
MODCARGO_CRATES +=	nibble_vec	0.1.0	# MIT
MODCARGO_CRATES +=	nix	0.29.0	# MIT
MODCARGO_CRATES +=	nom	7.1.3	# MIT
MODCARGO_CRATES +=	normalize-line-endings	0.3.0	# Apache-2.0
MODCARGO_CRATES +=	normpath	1.3.0	# MIT OR Apache-2.0
MODCARGO_CRATES +=	nu-ansi-term	0.46.0	# MIT
MODCARGO_CRATES +=	num-bigint-dig	0.8.4	# MIT/Apache-2.0
MODCARGO_CRATES +=	num-conv	0.1.0	# MIT OR Apache-2.0
MODCARGO_CRATES +=	num-integer	0.1.46	# MIT OR Apache-2.0
MODCARGO_CRATES +=	num-iter	0.1.45	# MIT OR Apache-2.0
MODCARGO_CRATES +=	num-traits	0.2.19	# MIT OR Apache-2.0
MODCARGO_CRATES +=	num_cpus	1.16.0	# MIT OR Apache-2.0
MODCARGO_CRATES +=	number_prefix	0.4.0	# MIT
MODCARGO_CRATES +=	object	0.36.7	# Apache-2.0 OR MIT
MODCARGO_CRATES +=	ocb3	0.1.0	# Apache-2.0 OR MIT
MODCARGO_CRATES +=	once_cell	1.20.3	# MIT OR Apache-2.0
MODCARGO_CRATES +=	opaque-debug	0.3.1	# MIT OR Apache-2.0
MODCARGO_CRATES +=	openpgp-cert-d	0.3.4	# MIT
MODCARGO_CRATES +=	openssl	0.10.71	# Apache-2.0
MODCARGO_CRATES +=	openssl-macros	0.1.1	# MIT/Apache-2.0
MODCARGO_CRATES +=	openssl-probe	0.1.6	# MIT/Apache-2.0
MODCARGO_CRATES +=	openssl-sys	0.9.106	# MIT
MODCARGO_CRATES +=	option-ext	0.2.0	# MPL-2.0
MODCARGO_CRATES +=	overload	0.1.1	# MIT
MODCARGO_CRATES +=	p256	0.13.2	# Apache-2.0 OR MIT
MODCARGO_CRATES +=	p384	0.13.1	# Apache-2.0 OR MIT
MODCARGO_CRATES +=	p521	0.13.3	# Apache-2.0 OR MIT
MODCARGO_CRATES +=	parking_lot	0.12.3	# MIT OR Apache-2.0
MODCARGO_CRATES +=	parking_lot_core	0.9.10	# MIT OR Apache-2.0
MODCARGO_CRATES +=	password-hash	0.5.0	# MIT OR Apache-2.0
MODCARGO_CRATES +=	paste	1.0.15	# MIT OR Apache-2.0
MODCARGO_CRATES +=	pem-rfc7468	0.7.0	# Apache-2.0 OR MIT
MODCARGO_CRATES +=	percent-encoding	2.3.1	# MIT OR Apache-2.0
MODCARGO_CRATES +=	pest	2.7.15	# MIT OR Apache-2.0
MODCARGO_CRATES +=	pest_derive	2.7.15	# MIT OR Apache-2.0
MODCARGO_CRATES +=	pest_generator	2.7.15	# MIT OR Apache-2.0
MODCARGO_CRATES +=	pest_meta	2.7.15	# MIT OR Apache-2.0
MODCARGO_CRATES +=	petgraph	0.6.5	# MIT OR Apache-2.0
MODCARGO_CRATES +=	petgraph	0.7.1	# MIT OR Apache-2.0
MODCARGO_CRATES +=	phf_shared	0.11.3	# MIT
MODCARGO_CRATES +=	pikchr	0.1.4	# MIT OR Apache-2.0
MODCARGO_CRATES +=	pin-project-lite	0.2.16	# Apache-2.0 OR MIT
MODCARGO_CRATES +=	pin-utils	0.1.0	# MIT OR Apache-2.0
MODCARGO_CRATES +=	pkcs1	0.7.5	# Apache-2.0 OR MIT
MODCARGO_CRATES +=	pkcs8	0.10.2	# Apache-2.0 OR MIT
MODCARGO_CRATES +=	pkg-config	0.3.32	# MIT OR Apache-2.0
MODCARGO_CRATES +=	polyval	0.6.2	# Apache-2.0 OR MIT
MODCARGO_CRATES +=	portable-atomic	1.11.0	# Apache-2.0 OR MIT
MODCARGO_CRATES +=	powerfmt	0.2.0	# MIT OR Apache-2.0
MODCARGO_CRATES +=	ppv-lite86	0.2.20	# MIT/Apache-2.0
MODCARGO_CRATES +=	precomputed-hash	0.1.1	# MIT
MODCARGO_CRATES +=	predicates	3.1.3	# MIT OR Apache-2.0
MODCARGO_CRATES +=	predicates-core	1.0.9	# MIT OR Apache-2.0
MODCARGO_CRATES +=	predicates-tree	1.0.12	# MIT OR Apache-2.0
MODCARGO_CRATES +=	primeorder	0.13.6	# Apache-2.0 OR MIT
MODCARGO_CRATES +=	proc-macro2	1.0.94	# MIT OR Apache-2.0
MODCARGO_CRATES +=	pulldown-cmark	0.12.2	# MIT
MODCARGO_CRATES +=	pulldown-cmark-escape	0.11.0	# MIT
MODCARGO_CRATES +=	quick-error	1.2.3	# MIT/Apache-2.0
MODCARGO_CRATES +=	quote	1.0.39	# MIT OR Apache-2.0
MODCARGO_CRATES +=	radix_trie	0.2.1	# MIT
MODCARGO_CRATES +=	rand	0.8.5	# MIT OR Apache-2.0
MODCARGO_CRATES +=	rand_chacha	0.3.1	# MIT OR Apache-2.0
MODCARGO_CRATES +=	rand_core	0.6.4	# MIT OR Apache-2.0
MODCARGO_CRATES +=	rayon	1.10.0	# MIT OR Apache-2.0
MODCARGO_CRATES +=	rayon-core	1.12.1	# MIT OR Apache-2.0
MODCARGO_CRATES +=	redox_syscall	0.5.9	# MIT
MODCARGO_CRATES +=	redox_users	0.4.6	# MIT
MODCARGO_CRATES +=	redox_users	0.5.0	# MIT
MODCARGO_CRATES +=	regex	1.11.1	# MIT OR Apache-2.0
MODCARGO_CRATES +=	regex-automata	0.1.10	# Unlicense/MIT
MODCARGO_CRATES +=	regex-automata	0.4.9	# MIT OR Apache-2.0
MODCARGO_CRATES +=	regex-syntax	0.6.29	# MIT OR Apache-2.0
MODCARGO_CRATES +=	regex-syntax	0.8.5	# MIT OR Apache-2.0
MODCARGO_CRATES +=	remove_dir_all	1.0.0	# MIT OR Apache-2.0
MODCARGO_CRATES +=	reqwest	0.12.12	# MIT OR Apache-2.0
MODCARGO_CRATES +=	resolv-conf	0.7.0	# MIT/Apache-2.0
MODCARGO_CRATES +=	rfc6979	0.4.0	# Apache-2.0 OR MIT
MODCARGO_CRATES +=	ring	0.17.11	# Apache-2.0 AND ISC
MODCARGO_CRATES +=	ripemd	0.1.3	# MIT OR Apache-2.0
MODCARGO_CRATES +=	roadmap	0.7.0	# MIT-0
MODCARGO_CRATES +=	roff	0.2.2	# MIT OR Apache-2.0
MODCARGO_CRATES +=	rpassword	7.3.1	# Apache-2.0
MODCARGO_CRATES +=	rsa	0.9.7	# MIT OR Apache-2.0
MODCARGO_CRATES +=	rtoolbox	0.0.2	# Apache-2.0
MODCARGO_CRATES +=	rusqlite	0.31.0	# MIT
MODCARGO_CRATES +=	rustc-demangle	0.1.24	# MIT/Apache-2.0
MODCARGO_CRATES +=	rustc-hash	1.1.0	# Apache-2.0/MIT
MODCARGO_CRATES +=	rustc_version	0.4.1	# MIT OR Apache-2.0
MODCARGO_CRATES +=	rustix	0.38.44	# Apache-2.0 WITH LLVM-exception OR Apache-2.0 OR MIT
MODCARGO_CRATES +=	rustls	0.23.23	# Apache-2.0 OR ISC OR MIT
MODCARGO_CRATES +=	rustls-pemfile	2.2.0	# Apache-2.0 OR ISC OR MIT
MODCARGO_CRATES +=	rustls-pki-types	1.11.0	# MIT OR Apache-2.0
MODCARGO_CRATES +=	rustls-webpki	0.102.8	# ISC
MODCARGO_CRATES +=	rustversion	1.0.19	# MIT OR Apache-2.0
MODCARGO_CRATES +=	ryu	1.0.19	# Apache-2.0 OR BSL-1.0
MODCARGO_CRATES +=	same-file	1.0.6	# Unlicense/MIT
MODCARGO_CRATES +=	schannel	0.1.27	# MIT
MODCARGO_CRATES +=	scoped-tls	1.0.1	# MIT/Apache-2.0
MODCARGO_CRATES +=	scopeguard	1.2.0	# MIT OR Apache-2.0
MODCARGO_CRATES +=	sec1	0.7.3	# Apache-2.0 OR MIT
MODCARGO_CRATES +=	security-framework	2.11.1	# MIT OR Apache-2.0
MODCARGO_CRATES +=	security-framework-sys	2.14.0	# MIT OR Apache-2.0
MODCARGO_CRATES +=	semver	1.0.25	# MIT OR Apache-2.0
MODCARGO_CRATES +=	sequoia-autocrypt	0.26.0	# LGPL-2.0-or-later
MODCARGO_CRATES +=	sequoia-cert-store	0.7.0	# LGPL-2.0-or-later
MODCARGO_CRATES +=	sequoia-directories	0.1.0	# LGPL-2.0-or-later
MODCARGO_CRATES +=	sequoia-gpg-agent	0.6.0	# LGPL-2.0-or-later
MODCARGO_CRATES +=	sequoia-ipc	0.36.0	# LGPL-2.0-or-later
MODCARGO_CRATES +=	sequoia-keystore	0.7.0	# LGPL-2.0-or-later
MODCARGO_CRATES +=	sequoia-keystore-backend	0.7.0	# LGPL-2.0-or-later
MODCARGO_CRATES +=	sequoia-keystore-gpg-agent	0.5.0	# LGPL-2.0-or-later
MODCARGO_CRATES +=	sequoia-keystore-softkeys	0.7.0	# LGPL-2.0-or-later
MODCARGO_CRATES +=	sequoia-man	0.3.1	# LGPL-2.0-or-later
MODCARGO_CRATES +=	sequoia-net	0.30.0	# LGPL-2.0-or-later
MODCARGO_CRATES +=	sequoia-openpgp	2.0.0	# LGPL-2.0-or-later
MODCARGO_CRATES +=	sequoia-policy-config	0.8.0	# LGPL-2.0-or-later
MODCARGO_CRATES +=	sequoia-wot	0.14.0	# LGPL-2.0-or-later
MODCARGO_CRATES +=	serde	1.0.218	# MIT OR Apache-2.0
MODCARGO_CRATES +=	serde_derive	1.0.218	# MIT OR Apache-2.0
MODCARGO_CRATES +=	serde_json	1.0.140	# MIT OR Apache-2.0
MODCARGO_CRATES +=	serde_path_to_error	0.1.17	# MIT OR Apache-2.0
MODCARGO_CRATES +=	serde_urlencoded	0.7.1	# MIT/Apache-2.0
MODCARGO_CRATES +=	sha1collisiondetection	0.3.4	# MIT
MODCARGO_CRATES +=	sha2	0.10.8	# MIT OR Apache-2.0
MODCARGO_CRATES +=	sha3	0.10.8	# MIT OR Apache-2.0
MODCARGO_CRATES +=	sharded-slab	0.1.7	# MIT
MODCARGO_CRATES +=	shell-words	1.1.0	# MIT/Apache-2.0
MODCARGO_CRATES +=	shlex	1.3.0	# MIT OR Apache-2.0
MODCARGO_CRATES +=	signature	2.2.0	# Apache-2.0 OR MIT
MODCARGO_CRATES +=	siphasher	1.0.1	# MIT/Apache-2.0
MODCARGO_CRATES +=	slab	0.4.9	# MIT
MODCARGO_CRATES +=	slug	0.1.6	# MIT/Apache-2.0
MODCARGO_CRATES +=	smallvec	1.14.0	# MIT OR Apache-2.0
MODCARGO_CRATES +=	smawk	0.3.2	# MIT
MODCARGO_CRATES +=	socket2	0.5.8	# MIT OR Apache-2.0
MODCARGO_CRATES +=	spin	0.9.8	# MIT
MODCARGO_CRATES +=	spki	0.7.3	# Apache-2.0 OR MIT
MODCARGO_CRATES +=	stable_deref_trait	1.2.0	# MIT/Apache-2.0
MODCARGO_CRATES +=	state	0.6.0	# MIT/Apache-2.0
MODCARGO_CRATES +=	stfu8	0.2.7	# MIT OR Apache-2.0
MODCARGO_CRATES +=	string_cache	0.8.8	# MIT OR Apache-2.0
MODCARGO_CRATES +=	strsim	0.11.1	# MIT
MODCARGO_CRATES +=	subplot	0.12.0	# MIT-0
MODCARGO_CRATES +=	subplot-build	0.12.0	# MIT-0
MODCARGO_CRATES +=	subplotlib	0.12.0	# MIT-0
MODCARGO_CRATES +=	subplotlib-derive	0.12.0	# MIT-0
MODCARGO_CRATES +=	subtle	2.6.1	# BSD-3-Clause
MODCARGO_CRATES +=	syn	2.0.99	# MIT OR Apache-2.0
MODCARGO_CRATES +=	sync_wrapper	1.0.2	# Apache-2.0
MODCARGO_CRATES +=	synstructure	0.13.1	# MIT
MODCARGO_CRATES +=	system-configuration	0.6.1	# MIT OR Apache-2.0
MODCARGO_CRATES +=	system-configuration-sys	0.6.0	# MIT OR Apache-2.0
MODCARGO_CRATES +=	tempfile	3.17.1	# MIT OR Apache-2.0
MODCARGO_CRATES +=	tera	1.20.0	# MIT
MODCARGO_CRATES +=	term	0.7.0	# MIT/Apache-2.0
MODCARGO_CRATES +=	term	1.0.1	# MIT OR Apache-2.0
MODCARGO_CRATES +=	termcolor	1.4.1	# Unlicense OR MIT
MODCARGO_CRATES +=	terminal_size	0.4.1	# MIT OR Apache-2.0
MODCARGO_CRATES +=	termtree	0.5.1	# MIT
MODCARGO_CRATES +=	textwrap	0.16.1	# MIT
MODCARGO_CRATES +=	thiserror	1.0.69	# MIT OR Apache-2.0
MODCARGO_CRATES +=	thiserror	2.0.12	# MIT OR Apache-2.0
MODCARGO_CRATES +=	thiserror-impl	1.0.69	# MIT OR Apache-2.0
MODCARGO_CRATES +=	thiserror-impl	2.0.12	# MIT OR Apache-2.0
MODCARGO_CRATES +=	thread_local	1.1.8	# MIT OR Apache-2.0
MODCARGO_CRATES +=	time	0.3.37	# MIT OR Apache-2.0
MODCARGO_CRATES +=	time-core	0.1.2	# MIT OR Apache-2.0
MODCARGO_CRATES +=	time-macros	0.2.19	# MIT OR Apache-2.0
MODCARGO_CRATES +=	tiny-keccak	2.0.2	# CC0-1.0
MODCARGO_CRATES +=	tinystr	0.7.6	# Unicode-3.0
MODCARGO_CRATES +=	tinyvec	1.9.0	# Zlib OR Apache-2.0 OR MIT
MODCARGO_CRATES +=	tinyvec_macros	0.1.1	# MIT OR Apache-2.0 OR Zlib
MODCARGO_CRATES +=	tokio	1.43.0	# MIT
MODCARGO_CRATES +=	tokio-macros	2.5.0	# MIT
MODCARGO_CRATES +=	tokio-native-tls	0.3.1	# MIT
MODCARGO_CRATES +=	tokio-rustls	0.26.2	# MIT OR Apache-2.0
MODCARGO_CRATES +=	tokio-util	0.7.13	# MIT
MODCARGO_CRATES +=	toml	0.5.11	# MIT/Apache-2.0
MODCARGO_CRATES +=	toml_datetime	0.6.8	# MIT OR Apache-2.0
MODCARGO_CRATES +=	toml_edit	0.22.24	# MIT OR Apache-2.0
MODCARGO_CRATES +=	tower	0.5.2	# MIT
MODCARGO_CRATES +=	tower-layer	0.3.3	# MIT
MODCARGO_CRATES +=	tower-service	0.3.3	# MIT
MODCARGO_CRATES +=	tracing	0.1.41	# MIT
MODCARGO_CRATES +=	tracing-attributes	0.1.28	# MIT
MODCARGO_CRATES +=	tracing-core	0.1.33	# MIT
MODCARGO_CRATES +=	tracing-log	0.2.0	# MIT
MODCARGO_CRATES +=	tracing-subscriber	0.3.19	# MIT
MODCARGO_CRATES +=	try-lock	0.2.5	# MIT
MODCARGO_CRATES +=	twofish	0.7.1	# MIT OR Apache-2.0
MODCARGO_CRATES +=	typenum	1.18.0	# MIT OR Apache-2.0
MODCARGO_CRATES +=	ucd-trie	0.1.7	# MIT OR Apache-2.0
MODCARGO_CRATES +=	unic-char-property	0.9.0	# MIT/Apache-2.0
MODCARGO_CRATES +=	unic-char-range	0.9.0	# MIT/Apache-2.0
MODCARGO_CRATES +=	unic-common	0.9.0	# MIT/Apache-2.0
MODCARGO_CRATES +=	unic-segment	0.9.0	# MIT/Apache-2.0
MODCARGO_CRATES +=	unic-ucd-segment	0.9.0	# MIT/Apache-2.0
MODCARGO_CRATES +=	unic-ucd-version	0.9.0	# MIT/Apache-2.0
MODCARGO_CRATES +=	unicase	2.8.1	# MIT OR Apache-2.0
MODCARGO_CRATES +=	unicode-ident	1.0.17	# (MIT OR Apache-2.0) AND Unicode-3.0
MODCARGO_CRATES +=	unicode-linebreak	0.1.5	# Apache-2.0
MODCARGO_CRATES +=	unicode-width	0.1.14	# MIT OR Apache-2.0
MODCARGO_CRATES +=	unicode-width	0.2.0	# MIT OR Apache-2.0
MODCARGO_CRATES +=	unicode-xid	0.2.6	# MIT OR Apache-2.0
MODCARGO_CRATES +=	universal-hash	0.5.1	# MIT OR Apache-2.0
MODCARGO_CRATES +=	untrusted	0.9.0	# ISC
MODCARGO_CRATES +=	url	2.5.4	# MIT OR Apache-2.0
MODCARGO_CRATES +=	utf16_iter	1.0.5	# Apache-2.0 OR MIT
MODCARGO_CRATES +=	utf8-width	0.1.7	# MIT
MODCARGO_CRATES +=	utf8_iter	1.0.4	# Apache-2.0 OR MIT
MODCARGO_CRATES +=	utf8parse	0.2.2	# Apache-2.0 OR MIT
MODCARGO_CRATES +=	valuable	0.1.1	# MIT
MODCARGO_CRATES +=	vcpkg	0.2.15	# MIT/Apache-2.0
MODCARGO_CRATES +=	version_check	0.9.5	# MIT/Apache-2.0
MODCARGO_CRATES +=	wait-timeout	0.2.1	# MIT/Apache-2.0
MODCARGO_CRATES +=	walkdir	2.5.0	# Unlicense/MIT
MODCARGO_CRATES +=	want	0.3.1	# MIT
MODCARGO_CRATES +=	wasi	0.11.0+wasi-snapshot-preview1	# Apache-2.0 WITH LLVM-exception OR Apache-2.0 OR MIT
MODCARGO_CRATES +=	wasi	0.13.3+wasi-0.2.2	# Apache-2.0 WITH LLVM-exception OR Apache-2.0 OR MIT
MODCARGO_CRATES +=	wasm-bindgen	0.2.100	# MIT OR Apache-2.0
MODCARGO_CRATES +=	wasm-bindgen-backend	0.2.100	# MIT OR Apache-2.0
MODCARGO_CRATES +=	wasm-bindgen-futures	0.4.50	# MIT OR Apache-2.0
MODCARGO_CRATES +=	wasm-bindgen-macro	0.2.100	# MIT OR Apache-2.0
MODCARGO_CRATES +=	wasm-bindgen-macro-support	0.2.100	# MIT OR Apache-2.0
MODCARGO_CRATES +=	wasm-bindgen-shared	0.2.100	# MIT OR Apache-2.0
MODCARGO_CRATES +=	wasm-streams	0.4.2	# MIT OR Apache-2.0
MODCARGO_CRATES +=	web-sys	0.3.77	# MIT OR Apache-2.0
MODCARGO_CRATES +=	web-time	1.1.0	# MIT OR Apache-2.0
MODCARGO_CRATES +=	widestring	1.1.0	# MIT OR Apache-2.0
MODCARGO_CRATES +=	win-crypto-ng	0.5.1	# BSD-3-Clause
MODCARGO_CRATES +=	winapi	0.3.9	# MIT/Apache-2.0
MODCARGO_CRATES +=	winapi-i686-pc-windows-gnu	0.4.0	# MIT/Apache-2.0
MODCARGO_CRATES +=	winapi-util	0.1.9	# Unlicense OR MIT
MODCARGO_CRATES +=	winapi-x86_64-pc-windows-gnu	0.4.0	# MIT/Apache-2.0
MODCARGO_CRATES +=	windows	0.48.0	# MIT OR Apache-2.0
MODCARGO_CRATES +=	windows-core	0.52.0	# MIT OR Apache-2.0
MODCARGO_CRATES +=	windows-link	0.1.0	# MIT OR Apache-2.0
MODCARGO_CRATES +=	windows-registry	0.2.0	# MIT OR Apache-2.0
MODCARGO_CRATES +=	windows-result	0.2.0	# MIT OR Apache-2.0
MODCARGO_CRATES +=	windows-strings	0.1.0	# MIT OR Apache-2.0
MODCARGO_CRATES +=	windows-sys	0.48.0	# MIT OR Apache-2.0
MODCARGO_CRATES +=	windows-sys	0.52.0	# MIT OR Apache-2.0
MODCARGO_CRATES +=	windows-sys	0.59.0	# MIT OR Apache-2.0
MODCARGO_CRATES +=	windows-targets	0.48.5	# MIT OR Apache-2.0
MODCARGO_CRATES +=	windows-targets	0.52.6	# MIT OR Apache-2.0
MODCARGO_CRATES +=	windows_aarch64_gnullvm	0.48.5	# MIT OR Apache-2.0
MODCARGO_CRATES +=	windows_aarch64_gnullvm	0.52.6	# MIT OR Apache-2.0
MODCARGO_CRATES +=	windows_aarch64_msvc	0.48.5	# MIT OR Apache-2.0
MODCARGO_CRATES +=	windows_aarch64_msvc	0.52.6	# MIT OR Apache-2.0
MODCARGO_CRATES +=	windows_i686_gnu	0.48.5	# MIT OR Apache-2.0
MODCARGO_CRATES +=	windows_i686_gnu	0.52.6	# MIT OR Apache-2.0
MODCARGO_CRATES +=	windows_i686_gnullvm	0.52.6	# MIT OR Apache-2.0
MODCARGO_CRATES +=	windows_i686_msvc	0.48.5	# MIT OR Apache-2.0
MODCARGO_CRATES +=	windows_i686_msvc	0.52.6	# MIT OR Apache-2.0
MODCARGO_CRATES +=	windows_x86_64_gnu	0.48.5	# MIT OR Apache-2.0
MODCARGO_CRATES +=	windows_x86_64_gnu	0.52.6	# MIT OR Apache-2.0
MODCARGO_CRATES +=	windows_x86_64_gnullvm	0.48.5	# MIT OR Apache-2.0
MODCARGO_CRATES +=	windows_x86_64_gnullvm	0.52.6	# MIT OR Apache-2.0
MODCARGO_CRATES +=	windows_x86_64_msvc	0.48.5	# MIT OR Apache-2.0
MODCARGO_CRATES +=	windows_x86_64_msvc	0.52.6	# MIT OR Apache-2.0
MODCARGO_CRATES +=	winnow	0.7.3	# MIT
MODCARGO_CRATES +=	winreg	0.50.0	# MIT
MODCARGO_CRATES +=	wit-bindgen-rt	0.33.0	# Apache-2.0 WITH LLVM-exception OR Apache-2.0 OR MIT
MODCARGO_CRATES +=	write16	1.0.0	# Apache-2.0 OR MIT
MODCARGO_CRATES +=	writeable	0.5.5	# Unicode-3.0
MODCARGO_CRATES +=	x25519-dalek	2.0.1	# BSD-3-Clause
MODCARGO_CRATES +=	xxhash-rust	0.8.15	# BSL-1.0
MODCARGO_CRATES +=	yaml-rust2	0.9.0	# MIT OR Apache-2.0
MODCARGO_CRATES +=	yoke	0.7.5	# Unicode-3.0
MODCARGO_CRATES +=	yoke-derive	0.7.5	# Unicode-3.0
MODCARGO_CRATES +=	z-base-32	0.1.4	# MIT
MODCARGO_CRATES +=	zerocopy	0.7.35	# BSD-2-Clause OR Apache-2.0 OR MIT
MODCARGO_CRATES +=	zerocopy-derive	0.7.35	# BSD-2-Clause OR Apache-2.0 OR MIT
MODCARGO_CRATES +=	zerofrom	0.1.4	# Unicode-3.0
MODCARGO_CRATES +=	zerofrom-derive	0.1.6	# Unicode-3.0
MODCARGO_CRATES +=	zeroize	1.8.1	# Apache-2.0 OR MIT
MODCARGO_CRATES +=	zeroize_derive	1.4.2	# Apache-2.0 OR MIT
MODCARGO_CRATES +=	zerovec	0.10.4	# Unicode-3.0
MODCARGO_CRATES +=	zerovec-derive	0.10.3	# Unicode-3.0
