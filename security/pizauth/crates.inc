MODCARGO_CRATES +=	adler2	2.0.1	# 0BSD OR MIT OR Apache-2.0
MODCARGO_CRATES +=	aead	0.5.2	# MIT OR Apache-2.0
MODCARGO_CRATES +=	aho-corasick	1.1.4	# Unlicense OR MIT
MODCARGO_CRATES +=	android_system_properties	0.1.5	# MIT/Apache-2.0
MODCARGO_CRATES +=	anyhow	1.0.102	# MIT OR Apache-2.0
MODCARGO_CRATES +=	asn1-rs	0.7.1	# MIT OR Apache-2.0
MODCARGO_CRATES +=	asn1-rs-derive	0.6.0	# MIT OR Apache-2.0
MODCARGO_CRATES +=	asn1-rs-impl	0.2.0	# MIT/Apache-2.0
MODCARGO_CRATES +=	autocfg	1.5.0	# Apache-2.0 OR MIT
MODCARGO_CRATES +=	base64	0.22.1	# MIT OR Apache-2.0
MODCARGO_CRATES +=	bincode	2.0.1	# MIT
MODCARGO_CRATES +=	bincode_derive	2.0.1	# MIT
MODCARGO_CRATES +=	bitflags	2.11.1	# MIT OR Apache-2.0
MODCARGO_CRATES +=	block-buffer	0.12.0	# MIT OR Apache-2.0
MODCARGO_CRATES +=	boot-time	0.1.3	# MIT
MODCARGO_CRATES +=	bstr	1.12.1	# MIT OR Apache-2.0
MODCARGO_CRATES +=	bumpalo	3.20.2	# MIT OR Apache-2.0
MODCARGO_CRATES +=	bytes	1.11.1	# MIT
MODCARGO_CRATES +=	cactus	1.0.7	# Apache-2.0/MIT
MODCARGO_CRATES +=	cc	1.2.61	# MIT OR Apache-2.0
MODCARGO_CRATES +=	cfg-if	1.0.4	# MIT OR Apache-2.0
MODCARGO_CRATES +=	cfg_aliases	0.2.1	# MIT
MODCARGO_CRATES +=	cfgrammar	0.14.2	# Apache-2.0/MIT
MODCARGO_CRATES +=	chacha20	0.9.1	# Apache-2.0 OR MIT
MODCARGO_CRATES +=	chacha20	0.10.0	# MIT OR Apache-2.0
MODCARGO_CRATES +=	chacha20poly1305	0.10.1	# Apache-2.0 OR MIT
MODCARGO_CRATES +=	chrono	0.4.44	# MIT OR Apache-2.0
MODCARGO_CRATES +=	cipher	0.4.4	# MIT OR Apache-2.0
MODCARGO_CRATES +=	const-oid	0.10.2	# Apache-2.0 OR MIT
MODCARGO_CRATES +=	core-foundation-sys	0.8.7	# MIT OR Apache-2.0
MODCARGO_CRATES +=	cpufeatures	0.2.17	# MIT OR Apache-2.0
MODCARGO_CRATES +=	cpufeatures	0.3.0	# MIT OR Apache-2.0
MODCARGO_CRATES +=	crc32fast	1.5.0	# MIT OR Apache-2.0
MODCARGO_CRATES +=	crossbeam-deque	0.8.6	# MIT OR Apache-2.0
MODCARGO_CRATES +=	crossbeam-epoch	0.9.18	# MIT OR Apache-2.0
MODCARGO_CRATES +=	crossbeam-utils	0.8.21	# MIT OR Apache-2.0
MODCARGO_CRATES +=	crypto-common	0.1.7	# MIT OR Apache-2.0
MODCARGO_CRATES +=	crypto-common	0.2.1	# MIT OR Apache-2.0
MODCARGO_CRATES +=	darling	0.21.3	# MIT
MODCARGO_CRATES +=	darling_core	0.21.3	# MIT
MODCARGO_CRATES +=	darling_macro	0.21.3	# MIT
MODCARGO_CRATES +=	data-encoding	2.11.0	# MIT
MODCARGO_CRATES +=	der-parser	10.0.0	# MIT OR Apache-2.0
MODCARGO_CRATES +=	deranged	0.5.8	# MIT OR Apache-2.0
MODCARGO_CRATES +=	digest	0.11.3	# MIT OR Apache-2.0
MODCARGO_CRATES +=	displaydoc	0.2.5	# MIT OR Apache-2.0
MODCARGO_CRATES +=	equivalent	1.0.2	# Apache-2.0 OR MIT
MODCARGO_CRATES +=	errno	0.3.14	# MIT OR Apache-2.0
MODCARGO_CRATES +=	fastrand	2.4.1	# Apache-2.0 OR MIT
MODCARGO_CRATES +=	filetime	0.2.27	# MIT/Apache-2.0
MODCARGO_CRATES +=	find-msvc-tools	0.1.9	# MIT OR Apache-2.0
MODCARGO_CRATES +=	flate2	1.1.9	# MIT OR Apache-2.0
MODCARGO_CRATES +=	fnv	1.0.7	# Apache-2.0 / MIT
MODCARGO_CRATES +=	foldhash	0.1.5	# Zlib
MODCARGO_CRATES +=	form_urlencoded	1.2.2	# MIT OR Apache-2.0
MODCARGO_CRATES +=	futures-core	0.3.32	# MIT OR Apache-2.0
MODCARGO_CRATES +=	futures-task	0.3.32	# MIT OR Apache-2.0
MODCARGO_CRATES +=	futures-util	0.3.32	# MIT OR Apache-2.0
MODCARGO_CRATES +=	generic-array	0.14.7	# MIT
MODCARGO_CRATES +=	getopts	0.2.24	# MIT OR Apache-2.0
MODCARGO_CRATES +=	getrandom	0.2.17	# MIT OR Apache-2.0
MODCARGO_CRATES +=	getrandom	0.4.2	# MIT OR Apache-2.0
MODCARGO_CRATES +=	glob	0.3.3	# MIT OR Apache-2.0
MODCARGO_CRATES +=	globset	0.4.18	# Unlicense OR MIT
MODCARGO_CRATES +=	hashbrown	0.15.5	# MIT OR Apache-2.0
MODCARGO_CRATES +=	hashbrown	0.17.0	# MIT OR Apache-2.0
MODCARGO_CRATES +=	heck	0.5.0	# MIT OR Apache-2.0
MODCARGO_CRATES +=	hermit-abi	0.5.2	# MIT OR Apache-2.0
MODCARGO_CRATES +=	hostname	0.4.2	# MIT
MODCARGO_CRATES +=	http	1.4.0	# MIT OR Apache-2.0
MODCARGO_CRATES +=	httparse	1.10.1	# MIT OR Apache-2.0
MODCARGO_CRATES +=	hybrid-array	0.4.11	# MIT OR Apache-2.0
MODCARGO_CRATES +=	iana-time-zone	0.1.65	# MIT OR Apache-2.0
MODCARGO_CRATES +=	iana-time-zone-haiku	0.1.2	# MIT OR Apache-2.0
MODCARGO_CRATES +=	icu_collections	2.2.0	# Unicode-3.0
MODCARGO_CRATES +=	icu_locale_core	2.2.0	# Unicode-3.0
MODCARGO_CRATES +=	icu_normalizer	2.2.0	# Unicode-3.0
MODCARGO_CRATES +=	icu_normalizer_data	2.2.0	# Unicode-3.0
MODCARGO_CRATES +=	icu_properties	2.2.0	# Unicode-3.0
MODCARGO_CRATES +=	icu_properties_data	2.2.0	# Unicode-3.0
MODCARGO_CRATES +=	icu_provider	2.2.0	# Unicode-3.0
MODCARGO_CRATES +=	id-arena	2.3.0	# MIT/Apache-2.0
MODCARGO_CRATES +=	ident_case	1.0.1	# MIT/Apache-2.0
MODCARGO_CRATES +=	idna	1.1.0	# MIT OR Apache-2.0
MODCARGO_CRATES +=	idna_adapter	1.2.2	# Apache-2.0 OR MIT
MODCARGO_CRATES +=	ignore	0.4.25	# Unlicense OR MIT
MODCARGO_CRATES +=	indexmap	2.14.0	# Apache-2.0 OR MIT
MODCARGO_CRATES +=	inout	0.1.4	# MIT OR Apache-2.0
MODCARGO_CRATES +=	is-terminal	0.4.17	# MIT
MODCARGO_CRATES +=	itoa	1.0.18	# MIT OR Apache-2.0
MODCARGO_CRATES +=	js-sys	0.3.97	# MIT OR Apache-2.0
MODCARGO_CRATES +=	lazy_static	1.5.0	# MIT OR Apache-2.0
MODCARGO_CRATES +=	leb128fmt	0.1.0	# MIT OR Apache-2.0
MODCARGO_CRATES +=	libc	0.2.186	# MIT OR Apache-2.0
MODCARGO_CRATES +=	libredox	0.1.16	# MIT
MODCARGO_CRATES +=	linux-raw-sys	0.12.1	# Apache-2.0 WITH LLVM-exception OR Apache-2.0 OR MIT
MODCARGO_CRATES +=	litemap	0.8.2	# Unicode-3.0
MODCARGO_CRATES +=	log	0.4.29	# MIT OR Apache-2.0
MODCARGO_CRATES +=	lrlex	0.14.2	# Apache-2.0/MIT
MODCARGO_CRATES +=	lrpar	0.14.2	# Apache-2.0/MIT
MODCARGO_CRATES +=	lrtable	0.14.2	# Apache-2.0/MIT
MODCARGO_CRATES +=	memchr	2.8.0	# Unlicense OR MIT
MODCARGO_CRATES +=	minimal-lexical	0.2.1	# MIT/Apache-2.0
MODCARGO_CRATES +=	miniz_oxide	0.8.9	# MIT OR Zlib OR Apache-2.0
MODCARGO_CRATES +=	nix	0.31.2	# MIT
MODCARGO_CRATES +=	nom	7.1.3	# MIT
MODCARGO_CRATES +=	num-bigint	0.4.6	# MIT OR Apache-2.0
MODCARGO_CRATES +=	num-conv	0.2.1	# MIT OR Apache-2.0
MODCARGO_CRATES +=	num-integer	0.1.46	# MIT OR Apache-2.0
MODCARGO_CRATES +=	num-traits	0.2.19	# MIT OR Apache-2.0
MODCARGO_CRATES +=	num_threads	0.1.7	# MIT OR Apache-2.0
MODCARGO_CRATES +=	objc2-core-foundation	0.3.2	# Zlib OR Apache-2.0 OR MIT
MODCARGO_CRATES +=	objc2-system-configuration	0.3.2	# Zlib OR Apache-2.0 OR MIT
MODCARGO_CRATES +=	oid-registry	0.8.1	# MIT OR Apache-2.0
MODCARGO_CRATES +=	once_cell	1.21.4	# MIT OR Apache-2.0
MODCARGO_CRATES +=	opaque-debug	0.3.1	# MIT OR Apache-2.0
MODCARGO_CRATES +=	packedvec	1.2.5	# Apache-2.0/MIT
MODCARGO_CRATES +=	pastey	0.2.2	# MIT OR Apache-2.0
MODCARGO_CRATES +=	percent-encoding	2.3.2	# MIT OR Apache-2.0
MODCARGO_CRATES +=	pin-project-lite	0.2.17	# Apache-2.0 OR MIT
MODCARGO_CRATES +=	plain	0.2.3	# MIT/Apache-2.0
MODCARGO_CRATES +=	pledge	0.4.2	# MIT
MODCARGO_CRATES +=	poly1305	0.8.0	# Apache-2.0 OR MIT
MODCARGO_CRATES +=	potential_utf	0.1.5	# Unicode-3.0
MODCARGO_CRATES +=	powerfmt	0.2.0	# MIT OR Apache-2.0
MODCARGO_CRATES +=	prettyplease	0.2.37	# MIT OR Apache-2.0
MODCARGO_CRATES +=	proc-macro2	1.0.106	# MIT OR Apache-2.0
MODCARGO_CRATES +=	quote	1.0.45	# MIT OR Apache-2.0
MODCARGO_CRATES +=	r-efi	6.0.0	# MIT OR Apache-2.0 OR LGPL-2.1-or-later
MODCARGO_CRATES +=	rand	0.10.1	# MIT OR Apache-2.0
MODCARGO_CRATES +=	rand_core	0.6.4	# MIT OR Apache-2.0
MODCARGO_CRATES +=	rand_core	0.10.1	# MIT OR Apache-2.0
MODCARGO_CRATES +=	rcgen	0.14.7	# MIT OR Apache-2.0
MODCARGO_CRATES +=	redox_syscall	0.7.4	# MIT
MODCARGO_CRATES +=	regex	1.12.3	# MIT OR Apache-2.0
MODCARGO_CRATES +=	regex-automata	0.4.14	# MIT OR Apache-2.0
MODCARGO_CRATES +=	regex-syntax	0.8.10	# MIT OR Apache-2.0
MODCARGO_CRATES +=	rerun_except	1.0.0	# Apache-2.0/MIT
MODCARGO_CRATES +=	ring	0.17.14	# Apache-2.0 AND ISC
MODCARGO_CRATES +=	rusticata-macros	4.1.0	# MIT/Apache-2.0
MODCARGO_CRATES +=	rustix	1.1.4	# Apache-2.0 WITH LLVM-exception OR Apache-2.0 OR MIT
MODCARGO_CRATES +=	rustls	0.23.40	# Apache-2.0 OR ISC OR MIT
MODCARGO_CRATES +=	rustls-pki-types	1.14.1	# MIT OR Apache-2.0
MODCARGO_CRATES +=	rustls-webpki	0.103.13	# ISC
MODCARGO_CRATES +=	rustversion	1.0.22	# MIT OR Apache-2.0
MODCARGO_CRATES +=	same-file	1.0.6	# Unlicense/MIT
MODCARGO_CRATES +=	sd-notify	0.5.0	# MIT OR Apache-2.0
MODCARGO_CRATES +=	semver	1.0.28	# MIT OR Apache-2.0
MODCARGO_CRATES +=	serde	1.0.228	# MIT OR Apache-2.0
MODCARGO_CRATES +=	serde_core	1.0.228	# MIT OR Apache-2.0
MODCARGO_CRATES +=	serde_derive	1.0.228	# MIT OR Apache-2.0
MODCARGO_CRATES +=	serde_json	1.0.149	# MIT OR Apache-2.0
MODCARGO_CRATES +=	sha2	0.11.0	# MIT OR Apache-2.0
MODCARGO_CRATES +=	shlex	1.3.0	# MIT OR Apache-2.0
MODCARGO_CRATES +=	simd-adler32	0.3.9	# MIT
MODCARGO_CRATES +=	slab	0.4.12	# MIT
MODCARGO_CRATES +=	smallvec	1.15.1	# MIT OR Apache-2.0
MODCARGO_CRATES +=	sparsevec	0.2.2	# Apache-2.0/MIT
MODCARGO_CRATES +=	stable_deref_trait	1.2.1	# MIT OR Apache-2.0
MODCARGO_CRATES +=	stderrlog	0.6.0	# MIT OR Apache-2.0
MODCARGO_CRATES +=	strsim	0.11.1	# MIT
MODCARGO_CRATES +=	subtle	2.6.1	# BSD-3-Clause
MODCARGO_CRATES +=	syn	2.0.117	# MIT OR Apache-2.0
MODCARGO_CRATES +=	synstructure	0.13.2	# MIT
MODCARGO_CRATES +=	syslog	7.0.0	# MIT
MODCARGO_CRATES +=	tempfile	3.27.0	# MIT OR Apache-2.0
MODCARGO_CRATES +=	termcolor	1.1.3	# Unlicense OR MIT
MODCARGO_CRATES +=	thiserror	2.0.18	# MIT OR Apache-2.0
MODCARGO_CRATES +=	thiserror-impl	2.0.18	# MIT OR Apache-2.0
MODCARGO_CRATES +=	thread_local	1.1.9	# MIT OR Apache-2.0
MODCARGO_CRATES +=	time	0.3.47	# MIT OR Apache-2.0
MODCARGO_CRATES +=	time-core	0.1.8	# MIT OR Apache-2.0
MODCARGO_CRATES +=	time-macros	0.2.27	# MIT OR Apache-2.0
MODCARGO_CRATES +=	tinystr	0.8.3	# Unicode-3.0
MODCARGO_CRATES +=	typenum	1.20.0	# MIT OR Apache-2.0
MODCARGO_CRATES +=	unicode-ident	1.0.24	# (MIT OR Apache-2.0) AND Unicode-3.0
MODCARGO_CRATES +=	unicode-width	0.1.14	# MIT OR Apache-2.0
MODCARGO_CRATES +=	unicode-width	0.2.2	# MIT OR Apache-2.0
MODCARGO_CRATES +=	unicode-xid	0.2.6	# MIT OR Apache-2.0
MODCARGO_CRATES +=	universal-hash	0.5.1	# MIT OR Apache-2.0
MODCARGO_CRATES +=	untrusted	0.9.0	# ISC
MODCARGO_CRATES +=	unty	0.0.4	# MIT OR Apache-2.0
MODCARGO_CRATES +=	unveil	0.3.2	# MIT/Apache-2.0
MODCARGO_CRATES +=	ureq	3.3.0	# MIT OR Apache-2.0
MODCARGO_CRATES +=	ureq-proto	0.6.0	# MIT OR Apache-2.0
MODCARGO_CRATES +=	url	2.5.8	# MIT OR Apache-2.0
MODCARGO_CRATES +=	utf8-zero	0.8.1	# MIT OR Apache-2.0
MODCARGO_CRATES +=	utf8_iter	1.0.4	# Apache-2.0 OR MIT
MODCARGO_CRATES +=	vergen	8.3.2	# MIT OR Apache-2.0
MODCARGO_CRATES +=	version_check	0.9.5	# MIT/Apache-2.0
MODCARGO_CRATES +=	virtue	0.0.18	# MIT
MODCARGO_CRATES +=	vob	3.0.6	# Apache-2.0/MIT
MODCARGO_CRATES +=	wait-timeout	0.2.1	# MIT/Apache-2.0
MODCARGO_CRATES +=	walkdir	2.5.0	# Unlicense/MIT
MODCARGO_CRATES +=	wasi	0.11.1+wasi-snapshot-preview1	# Apache-2.0 WITH LLVM-exception OR Apache-2.0 OR MIT
MODCARGO_CRATES +=	wasi	0.14.7+wasi-0.2.4	# Apache-2.0 WITH LLVM-exception OR Apache-2.0 OR MIT
MODCARGO_CRATES +=	wasip2	1.0.3+wasi-0.2.9	# Apache-2.0 WITH LLVM-exception OR Apache-2.0 OR MIT
MODCARGO_CRATES +=	wasip3	0.4.0+wasi-0.3.0-rc-2026-01-06	# Apache-2.0 WITH LLVM-exception OR Apache-2.0 OR MIT
MODCARGO_CRATES +=	wasite	1.0.2	# Apache-2.0 OR BSL-1.0 OR MIT
MODCARGO_CRATES +=	wasm-bindgen	0.2.120	# MIT OR Apache-2.0
MODCARGO_CRATES +=	wasm-bindgen-macro	0.2.120	# MIT OR Apache-2.0
MODCARGO_CRATES +=	wasm-bindgen-macro-support	0.2.120	# MIT OR Apache-2.0
MODCARGO_CRATES +=	wasm-bindgen-shared	0.2.120	# MIT OR Apache-2.0
MODCARGO_CRATES +=	wasm-encoder	0.244.0	# Apache-2.0 WITH LLVM-exception OR Apache-2.0 OR MIT
MODCARGO_CRATES +=	wasm-metadata	0.244.0	# Apache-2.0 WITH LLVM-exception OR Apache-2.0 OR MIT
MODCARGO_CRATES +=	wasmparser	0.244.0	# Apache-2.0 WITH LLVM-exception OR Apache-2.0 OR MIT
MODCARGO_CRATES +=	web-sys	0.3.97	# MIT OR Apache-2.0
MODCARGO_CRATES +=	web-time	1.1.0	# MIT OR Apache-2.0
MODCARGO_CRATES +=	webpki-roots	1.0.7	# CDLA-Permissive-2.0
MODCARGO_CRATES +=	whoami	2.1.2	# Apache-2.0 OR BSL-1.0 OR MIT
MODCARGO_CRATES +=	winapi-util	0.1.11	# Unlicense OR MIT
MODCARGO_CRATES +=	wincode	0.5.3	# Apache-2.0
MODCARGO_CRATES +=	wincode-derive	0.4.4	# Apache-2.0
MODCARGO_CRATES +=	windows-core	0.62.2	# MIT OR Apache-2.0
MODCARGO_CRATES +=	windows-implement	0.60.2	# MIT OR Apache-2.0
MODCARGO_CRATES +=	windows-interface	0.59.3	# MIT OR Apache-2.0
MODCARGO_CRATES +=	windows-link	0.2.1	# MIT OR Apache-2.0
MODCARGO_CRATES +=	windows-result	0.4.1	# MIT OR Apache-2.0
MODCARGO_CRATES +=	windows-strings	0.5.1	# MIT OR Apache-2.0
MODCARGO_CRATES +=	windows-sys	0.52.0	# MIT OR Apache-2.0
MODCARGO_CRATES +=	windows-sys	0.61.2	# MIT OR Apache-2.0
MODCARGO_CRATES +=	windows-targets	0.52.6	# MIT OR Apache-2.0
MODCARGO_CRATES +=	windows_aarch64_gnullvm	0.52.6	# MIT OR Apache-2.0
MODCARGO_CRATES +=	windows_aarch64_msvc	0.52.6	# MIT OR Apache-2.0
MODCARGO_CRATES +=	windows_i686_gnu	0.52.6	# MIT OR Apache-2.0
MODCARGO_CRATES +=	windows_i686_gnullvm	0.52.6	# MIT OR Apache-2.0
MODCARGO_CRATES +=	windows_i686_msvc	0.52.6	# MIT OR Apache-2.0
MODCARGO_CRATES +=	windows_x86_64_gnu	0.52.6	# MIT OR Apache-2.0
MODCARGO_CRATES +=	windows_x86_64_gnullvm	0.52.6	# MIT OR Apache-2.0
MODCARGO_CRATES +=	windows_x86_64_msvc	0.52.6	# MIT OR Apache-2.0
MODCARGO_CRATES +=	wit-bindgen	0.51.0	# Apache-2.0 WITH LLVM-exception OR Apache-2.0 OR MIT
MODCARGO_CRATES +=	wit-bindgen	0.57.1	# Apache-2.0 WITH LLVM-exception OR Apache-2.0 OR MIT
MODCARGO_CRATES +=	wit-bindgen-core	0.51.0	# Apache-2.0 WITH LLVM-exception OR Apache-2.0 OR MIT
MODCARGO_CRATES +=	wit-bindgen-rust	0.51.0	# Apache-2.0 WITH LLVM-exception OR Apache-2.0 OR MIT
MODCARGO_CRATES +=	wit-bindgen-rust-macro	0.51.0	# Apache-2.0 WITH LLVM-exception OR Apache-2.0 OR MIT
MODCARGO_CRATES +=	wit-component	0.244.0	# Apache-2.0 WITH LLVM-exception OR Apache-2.0 OR MIT
MODCARGO_CRATES +=	wit-parser	0.244.0	# Apache-2.0 WITH LLVM-exception OR Apache-2.0 OR MIT
MODCARGO_CRATES +=	writeable	0.6.3	# Unicode-3.0
MODCARGO_CRATES +=	x509-parser	0.18.1	# MIT OR Apache-2.0
MODCARGO_CRATES +=	yasna	0.5.2	# MIT OR Apache-2.0
MODCARGO_CRATES +=	yoke	0.8.2	# Unicode-3.0
MODCARGO_CRATES +=	yoke-derive	0.8.2	# Unicode-3.0
MODCARGO_CRATES +=	zerofrom	0.1.7	# Unicode-3.0
MODCARGO_CRATES +=	zerofrom-derive	0.1.7	# Unicode-3.0
MODCARGO_CRATES +=	zeroize	1.8.2	# Apache-2.0 OR MIT
MODCARGO_CRATES +=	zerotrie	0.2.4	# Unicode-3.0
MODCARGO_CRATES +=	zerovec	0.11.6	# Unicode-3.0
MODCARGO_CRATES +=	zerovec-derive	0.11.3	# Unicode-3.0
MODCARGO_CRATES +=	zmij	1.0.21	# MIT
