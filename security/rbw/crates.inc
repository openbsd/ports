MODCARGO_CRATES +=	aes	0.8.4	# MIT OR Apache-2.0
MODCARGO_CRATES +=	aho-corasick	1.1.4	# Unlicense OR MIT
MODCARGO_CRATES +=	anstream	0.6.21	# MIT OR Apache-2.0
MODCARGO_CRATES +=	anstyle	1.0.13	# MIT OR Apache-2.0
MODCARGO_CRATES +=	anstyle-parse	0.2.7	# MIT OR Apache-2.0
MODCARGO_CRATES +=	anstyle-query	1.1.5	# MIT OR Apache-2.0
MODCARGO_CRATES +=	anstyle-wincon	3.0.11	# MIT OR Apache-2.0
MODCARGO_CRATES +=	anyhow	1.0.100	# MIT OR Apache-2.0
MODCARGO_CRATES +=	arboard	3.6.1	# MIT OR Apache-2.0
MODCARGO_CRATES +=	argon2	0.5.3	# MIT OR Apache-2.0
MODCARGO_CRATES +=	arrayvec	0.7.6	# MIT OR Apache-2.0
MODCARGO_CRATES +=	async-trait	0.1.89	# MIT OR Apache-2.0
MODCARGO_CRATES +=	atomic-waker	1.1.2	# Apache-2.0 OR MIT
MODCARGO_CRATES +=	autocfg	1.5.0	# Apache-2.0 OR MIT
MODCARGO_CRATES +=	axum	0.8.8	# MIT
MODCARGO_CRATES +=	axum-core	0.5.5	# MIT
MODCARGO_CRATES +=	base16ct	0.2.0	# Apache-2.0 OR MIT
MODCARGO_CRATES +=	base32	0.5.1	# MIT OR Apache-2.0
MODCARGO_CRATES +=	base64	0.22.1	# MIT OR Apache-2.0
MODCARGO_CRATES +=	base64ct	1.8.1	# Apache-2.0 OR MIT
MODCARGO_CRATES +=	bitflags	1.3.2	# MIT/Apache-2.0
MODCARGO_CRATES +=	bitflags	2.10.0	# MIT OR Apache-2.0
MODCARGO_CRATES +=	blake2	0.10.6	# MIT OR Apache-2.0
MODCARGO_CRATES +=	block-buffer	0.10.4	# MIT OR Apache-2.0
MODCARGO_CRATES +=	block-padding	0.3.3	# MIT OR Apache-2.0
MODCARGO_CRATES +=	bumpalo	3.19.1	# MIT OR Apache-2.0
MODCARGO_CRATES +=	byteorder	1.5.0	# Unlicense OR MIT
MODCARGO_CRATES +=	bytes	1.11.0	# MIT
MODCARGO_CRATES +=	cbc	0.1.2	# MIT OR Apache-2.0
MODCARGO_CRATES +=	cc	1.2.50	# MIT OR Apache-2.0
MODCARGO_CRATES +=	cfg-if	1.0.4	# MIT OR Apache-2.0
MODCARGO_CRATES +=	cfg_aliases	0.2.1	# MIT
MODCARGO_CRATES +=	cipher	0.4.4	# MIT OR Apache-2.0
MODCARGO_CRATES +=	clap	4.5.53	# MIT OR Apache-2.0
MODCARGO_CRATES +=	clap_builder	4.5.53	# MIT OR Apache-2.0
MODCARGO_CRATES +=	clap_complete	4.5.62	# MIT OR Apache-2.0
MODCARGO_CRATES +=	clap_complete_fig	4.5.2	# MIT OR Apache-2.0
MODCARGO_CRATES +=	clap_complete_nushell	4.5.10	# MIT OR Apache-2.0
MODCARGO_CRATES +=	clap_derive	4.5.49	# MIT OR Apache-2.0
MODCARGO_CRATES +=	clap_lex	0.7.6	# MIT OR Apache-2.0
MODCARGO_CRATES +=	clipboard-win	5.4.1	# BSL-1.0
MODCARGO_CRATES +=	colorchoice	1.0.4	# MIT OR Apache-2.0
MODCARGO_CRATES +=	const-oid	0.9.6	# Apache-2.0 OR MIT
MODCARGO_CRATES +=	constant_time_eq	0.3.1	# CC0-1.0 OR MIT-0 OR Apache-2.0
MODCARGO_CRATES +=	core-foundation	0.10.1	# MIT OR Apache-2.0
MODCARGO_CRATES +=	core-foundation-sys	0.8.7	# MIT OR Apache-2.0
MODCARGO_CRATES +=	cpufeatures	0.2.17	# MIT OR Apache-2.0
MODCARGO_CRATES +=	crypto-bigint	0.5.5	# Apache-2.0 OR MIT
MODCARGO_CRATES +=	crypto-common	0.1.7	# MIT OR Apache-2.0
MODCARGO_CRATES +=	curve25519-dalek	4.1.3	# BSD-3-Clause
MODCARGO_CRATES +=	curve25519-dalek-derive	0.1.1	# MIT/Apache-2.0
MODCARGO_CRATES +=	daemonize	0.5.0	# MIT/Apache-2.0
MODCARGO_CRATES +=	data-encoding	2.9.0	# MIT
MODCARGO_CRATES +=	der	0.7.10	# Apache-2.0 OR MIT
MODCARGO_CRATES +=	digest	0.10.7	# MIT OR Apache-2.0
MODCARGO_CRATES +=	directories	6.0.0	# MIT OR Apache-2.0
MODCARGO_CRATES +=	dirs-sys	0.5.0	# MIT OR Apache-2.0
MODCARGO_CRATES +=	dispatch2	0.3.0	# Zlib OR Apache-2.0 OR MIT
MODCARGO_CRATES +=	displaydoc	0.2.5	# MIT OR Apache-2.0
MODCARGO_CRATES +=	downcast-rs	1.2.1	# MIT/Apache-2.0
MODCARGO_CRATES +=	ecdsa	0.16.9	# Apache-2.0 OR MIT
MODCARGO_CRATES +=	ed25519	2.2.3	# Apache-2.0 OR MIT
MODCARGO_CRATES +=	ed25519-dalek	2.2.0	# BSD-3-Clause
MODCARGO_CRATES +=	elliptic-curve	0.13.8	# Apache-2.0 OR MIT
MODCARGO_CRATES +=	env_filter	0.1.4	# MIT OR Apache-2.0
MODCARGO_CRATES +=	env_logger	0.11.8	# MIT OR Apache-2.0
MODCARGO_CRATES +=	equivalent	1.0.2	# Apache-2.0 OR MIT
MODCARGO_CRATES +=	errno	0.3.14	# MIT OR Apache-2.0
MODCARGO_CRATES +=	error-code	3.3.2	# BSL-1.0
MODCARGO_CRATES +=	fastrand	2.3.0	# Apache-2.0 OR MIT
MODCARGO_CRATES +=	ff	0.13.1	# MIT/Apache-2.0
MODCARGO_CRATES +=	fiat-crypto	0.2.9	# MIT OR Apache-2.0 OR BSD-1-Clause
MODCARGO_CRATES +=	find-msvc-tools	0.1.5	# MIT OR Apache-2.0
MODCARGO_CRATES +=	fixedbitset	0.4.2	# MIT/Apache-2.0
MODCARGO_CRATES +=	form_urlencoded	1.2.2	# MIT OR Apache-2.0
MODCARGO_CRATES +=	futures	0.3.31	# MIT OR Apache-2.0
MODCARGO_CRATES +=	futures-channel	0.3.31	# MIT OR Apache-2.0
MODCARGO_CRATES +=	futures-core	0.3.31	# MIT OR Apache-2.0
MODCARGO_CRATES +=	futures-executor	0.3.31	# MIT OR Apache-2.0
MODCARGO_CRATES +=	futures-io	0.3.31	# MIT OR Apache-2.0
MODCARGO_CRATES +=	futures-macro	0.3.31	# MIT OR Apache-2.0
MODCARGO_CRATES +=	futures-sink	0.3.31	# MIT OR Apache-2.0
MODCARGO_CRATES +=	futures-task	0.3.31	# MIT OR Apache-2.0
MODCARGO_CRATES +=	futures-util	0.3.31	# MIT OR Apache-2.0
MODCARGO_CRATES +=	generic-array	0.14.7	# MIT
MODCARGO_CRATES +=	gethostname	1.1.0	# Apache-2.0
MODCARGO_CRATES +=	getrandom	0.2.16	# MIT OR Apache-2.0
MODCARGO_CRATES +=	getrandom	0.3.4	# MIT OR Apache-2.0
MODCARGO_CRATES +=	group	0.13.0	# MIT/Apache-2.0
MODCARGO_CRATES +=	hashbrown	0.16.1	# MIT OR Apache-2.0
MODCARGO_CRATES +=	heck	0.5.0	# MIT OR Apache-2.0
MODCARGO_CRATES +=	hermit-abi	0.5.2	# MIT OR Apache-2.0
MODCARGO_CRATES +=	hkdf	0.12.4	# MIT OR Apache-2.0
MODCARGO_CRATES +=	hmac	0.12.1	# MIT OR Apache-2.0
MODCARGO_CRATES +=	http	1.4.0	# MIT OR Apache-2.0
MODCARGO_CRATES +=	http-body	1.0.1	# MIT
MODCARGO_CRATES +=	http-body-util	0.1.3	# MIT
MODCARGO_CRATES +=	httparse	1.10.1	# MIT OR Apache-2.0
MODCARGO_CRATES +=	httpdate	1.0.3	# MIT OR Apache-2.0
MODCARGO_CRATES +=	humantime	2.3.0	# MIT OR Apache-2.0
MODCARGO_CRATES +=	hyper	1.8.1	# MIT
MODCARGO_CRATES +=	hyper-rustls	0.27.7	# Apache-2.0 OR ISC OR MIT
MODCARGO_CRATES +=	hyper-util	0.1.19	# MIT
MODCARGO_CRATES +=	icu_collections	2.1.1	# Unicode-3.0
MODCARGO_CRATES +=	icu_locale_core	2.1.1	# Unicode-3.0
MODCARGO_CRATES +=	icu_normalizer	2.1.1	# Unicode-3.0
MODCARGO_CRATES +=	icu_normalizer_data	2.1.1	# Unicode-3.0
MODCARGO_CRATES +=	icu_properties	2.1.2	# Unicode-3.0
MODCARGO_CRATES +=	icu_properties_data	2.1.2	# Unicode-3.0
MODCARGO_CRATES +=	icu_provider	2.1.1	# Unicode-3.0
MODCARGO_CRATES +=	idna	1.1.0	# MIT OR Apache-2.0
MODCARGO_CRATES +=	idna_adapter	1.2.1	# Apache-2.0 OR MIT
MODCARGO_CRATES +=	indexmap	2.12.1	# Apache-2.0 OR MIT
MODCARGO_CRATES +=	inout	0.1.4	# MIT OR Apache-2.0
MODCARGO_CRATES +=	ipnet	2.11.0	# MIT OR Apache-2.0
MODCARGO_CRATES +=	iri-string	0.7.9	# MIT OR Apache-2.0
MODCARGO_CRATES +=	is-docker	0.2.0	# MIT
MODCARGO_CRATES +=	is-terminal	0.4.17	# MIT
MODCARGO_CRATES +=	is-wsl	0.4.0	# MIT
MODCARGO_CRATES +=	is_terminal_polyfill	1.70.2	# MIT OR Apache-2.0
MODCARGO_CRATES +=	itoa	1.0.16	# MIT OR Apache-2.0
MODCARGO_CRATES +=	jiff	0.2.17	# Unlicense OR MIT
MODCARGO_CRATES +=	jiff-static	0.2.17	# Unlicense OR MIT
MODCARGO_CRATES +=	js-sys	0.3.83	# MIT OR Apache-2.0
MODCARGO_CRATES +=	lazy_static	1.5.0	# MIT OR Apache-2.0
MODCARGO_CRATES +=	libc	0.2.178	# MIT OR Apache-2.0
MODCARGO_CRATES +=	libm	0.2.15	# MIT
MODCARGO_CRATES +=	libredox	0.1.11	# MIT
MODCARGO_CRATES +=	linux-raw-sys	0.11.0	# Apache-2.0 WITH LLVM-exception OR Apache-2.0 OR MIT
MODCARGO_CRATES +=	litemap	0.8.1	# Unicode-3.0
MODCARGO_CRATES +=	lock_api	0.4.14	# MIT OR Apache-2.0
MODCARGO_CRATES +=	log	0.4.29	# MIT OR Apache-2.0
MODCARGO_CRATES +=	lru-slab	0.1.2	# MIT OR Apache-2.0 OR Zlib
MODCARGO_CRATES +=	mach2	0.4.3	# BSD-2-Clause OR MIT OR Apache-2.0
MODCARGO_CRATES +=	matchit	0.8.4	# MIT AND BSD-3-Clause
MODCARGO_CRATES +=	memchr	2.7.6	# Unlicense OR MIT
MODCARGO_CRATES +=	mime	0.3.17	# MIT OR Apache-2.0
MODCARGO_CRATES +=	minimal-lexical	0.2.1	# MIT/Apache-2.0
MODCARGO_CRATES +=	mio	1.1.1	# MIT
MODCARGO_CRATES +=	nom	7.1.3	# MIT
MODCARGO_CRATES +=	num-bigint-dig	0.8.6	# MIT/Apache-2.0
MODCARGO_CRATES +=	num-integer	0.1.46	# MIT OR Apache-2.0
MODCARGO_CRATES +=	num-iter	0.1.45	# MIT OR Apache-2.0
MODCARGO_CRATES +=	num-traits	0.2.19	# MIT OR Apache-2.0
MODCARGO_CRATES +=	objc2	0.6.3	# MIT
MODCARGO_CRATES +=	objc2-app-kit	0.3.2	# Zlib OR Apache-2.0 OR MIT
MODCARGO_CRATES +=	objc2-core-foundation	0.3.2	# Zlib OR Apache-2.0 OR MIT
MODCARGO_CRATES +=	objc2-core-graphics	0.3.2	# Zlib OR Apache-2.0 OR MIT
MODCARGO_CRATES +=	objc2-encode	4.1.0	# MIT
MODCARGO_CRATES +=	objc2-foundation	0.3.2	# MIT
MODCARGO_CRATES +=	objc2-io-surface	0.3.2	# Zlib OR Apache-2.0 OR MIT
MODCARGO_CRATES +=	once_cell	1.21.3	# MIT OR Apache-2.0
MODCARGO_CRATES +=	once_cell_polyfill	1.70.2	# MIT OR Apache-2.0
MODCARGO_CRATES +=	open	5.3.3	# MIT
MODCARGO_CRATES +=	openssl-probe	0.1.6	# MIT/Apache-2.0
MODCARGO_CRATES +=	option-ext	0.2.0	# MPL-2.0
MODCARGO_CRATES +=	os_pipe	1.2.3	# MIT
MODCARGO_CRATES +=	p256	0.13.2	# Apache-2.0 OR MIT
MODCARGO_CRATES +=	p384	0.13.1	# Apache-2.0 OR MIT
MODCARGO_CRATES +=	p521	0.13.3	# Apache-2.0 OR MIT
MODCARGO_CRATES +=	parking_lot	0.12.5	# MIT OR Apache-2.0
MODCARGO_CRATES +=	parking_lot_core	0.9.12	# MIT OR Apache-2.0
MODCARGO_CRATES +=	password-hash	0.5.0	# MIT OR Apache-2.0
MODCARGO_CRATES +=	pathdiff	0.2.3	# MIT/Apache-2.0
MODCARGO_CRATES +=	pbkdf2	0.12.2	# MIT OR Apache-2.0
MODCARGO_CRATES +=	pem-rfc7468	0.7.0	# Apache-2.0 OR MIT
MODCARGO_CRATES +=	percent-encoding	2.3.2	# MIT OR Apache-2.0
MODCARGO_CRATES +=	petgraph	0.6.5	# MIT OR Apache-2.0
MODCARGO_CRATES +=	pin-project-lite	0.2.16	# Apache-2.0 OR MIT
MODCARGO_CRATES +=	pin-utils	0.1.0	# MIT OR Apache-2.0
MODCARGO_CRATES +=	pkcs1	0.7.5	# Apache-2.0 OR MIT
MODCARGO_CRATES +=	pkcs8	0.10.2	# Apache-2.0 OR MIT
MODCARGO_CRATES +=	pkg-config	0.3.32	# MIT OR Apache-2.0
MODCARGO_CRATES +=	portable-atomic	1.12.0	# Apache-2.0 OR MIT
MODCARGO_CRATES +=	portable-atomic-util	0.2.4	# Apache-2.0 OR MIT
MODCARGO_CRATES +=	potential_utf	0.1.4	# Unicode-3.0
MODCARGO_CRATES +=	ppv-lite86	0.2.21	# MIT OR Apache-2.0
MODCARGO_CRATES +=	primeorder	0.13.6	# Apache-2.0 OR MIT
MODCARGO_CRATES +=	proc-macro2	1.0.103	# MIT OR Apache-2.0
MODCARGO_CRATES +=	quick-xml	0.37.5	# MIT
MODCARGO_CRATES +=	quinn	0.11.9	# MIT OR Apache-2.0
MODCARGO_CRATES +=	quinn-proto	0.11.13	# MIT OR Apache-2.0
MODCARGO_CRATES +=	quinn-udp	0.5.14	# MIT OR Apache-2.0
MODCARGO_CRATES +=	quote	1.0.42	# MIT OR Apache-2.0
MODCARGO_CRATES +=	r-efi	5.3.0	# MIT OR Apache-2.0 OR LGPL-2.1-or-later
MODCARGO_CRATES +=	rand	0.8.5	# MIT OR Apache-2.0
MODCARGO_CRATES +=	rand	0.9.2	# MIT OR Apache-2.0
MODCARGO_CRATES +=	rand_chacha	0.3.1	# MIT OR Apache-2.0
MODCARGO_CRATES +=	rand_chacha	0.9.0	# MIT OR Apache-2.0
MODCARGO_CRATES +=	rand_core	0.6.4	# MIT OR Apache-2.0
MODCARGO_CRATES +=	rand_core	0.9.3	# MIT OR Apache-2.0
MODCARGO_CRATES +=	raunch	1.0.1	# MIT OR Apache-2.0
MODCARGO_CRATES +=	redox_syscall	0.5.18	# MIT
MODCARGO_CRATES +=	redox_users	0.5.2	# MIT
MODCARGO_CRATES +=	regex	1.12.2	# MIT OR Apache-2.0
MODCARGO_CRATES +=	regex-automata	0.4.13	# MIT OR Apache-2.0
MODCARGO_CRATES +=	regex-syntax	0.8.8	# MIT OR Apache-2.0
MODCARGO_CRATES +=	region	3.0.2	# MIT
MODCARGO_CRATES +=	reqwest	0.12.28	# MIT OR Apache-2.0
MODCARGO_CRATES +=	rfc6979	0.4.0	# Apache-2.0 OR MIT
MODCARGO_CRATES +=	ring	0.17.14	# Apache-2.0 AND ISC
MODCARGO_CRATES +=	rmp	0.8.15	# MIT
MODCARGO_CRATES +=	rmpv	1.3.1	# MIT
MODCARGO_CRATES +=	rsa	0.9.9	# MIT OR Apache-2.0
MODCARGO_CRATES +=	rustc-hash	2.1.1	# Apache-2.0 OR MIT
MODCARGO_CRATES +=	rustc_version	0.4.1	# MIT OR Apache-2.0
MODCARGO_CRATES +=	rustix	1.1.3	# Apache-2.0 WITH LLVM-exception OR Apache-2.0 OR MIT
MODCARGO_CRATES +=	rustls	0.23.35	# Apache-2.0 OR ISC OR MIT
MODCARGO_CRATES +=	rustls-native-certs	0.8.2	# Apache-2.0 OR ISC OR MIT
MODCARGO_CRATES +=	rustls-pki-types	1.13.2	# MIT OR Apache-2.0
MODCARGO_CRATES +=	rustls-webpki	0.103.8	# ISC
MODCARGO_CRATES +=	rustversion	1.0.22	# MIT OR Apache-2.0
MODCARGO_CRATES +=	ryu	1.0.21	# Apache-2.0 OR BSL-1.0
MODCARGO_CRATES +=	schannel	0.1.28	# MIT
MODCARGO_CRATES +=	scopeguard	1.2.0	# MIT OR Apache-2.0
MODCARGO_CRATES +=	sec1	0.7.3	# Apache-2.0 OR MIT
MODCARGO_CRATES +=	secrecy	0.8.0	# Apache-2.0 OR MIT
MODCARGO_CRATES +=	security-framework	3.5.1	# MIT OR Apache-2.0
MODCARGO_CRATES +=	security-framework-sys	2.15.0	# MIT OR Apache-2.0
MODCARGO_CRATES +=	semver	1.0.27	# MIT OR Apache-2.0
MODCARGO_CRATES +=	serde	1.0.228	# MIT OR Apache-2.0
MODCARGO_CRATES +=	serde_core	1.0.228	# MIT OR Apache-2.0
MODCARGO_CRATES +=	serde_derive	1.0.228	# MIT OR Apache-2.0
MODCARGO_CRATES +=	serde_json	1.0.147	# MIT OR Apache-2.0
MODCARGO_CRATES +=	serde_path_to_error	0.1.20	# MIT OR Apache-2.0
MODCARGO_CRATES +=	serde_repr	0.1.20	# MIT OR Apache-2.0
MODCARGO_CRATES +=	serde_urlencoded	0.7.1	# MIT/Apache-2.0
MODCARGO_CRATES +=	service-binding	3.0.0	# MIT OR Apache-2.0
MODCARGO_CRATES +=	sha1	0.10.6	# MIT OR Apache-2.0
MODCARGO_CRATES +=	sha2	0.10.9	# MIT OR Apache-2.0
MODCARGO_CRATES +=	shlex	1.3.0	# MIT OR Apache-2.0
MODCARGO_CRATES +=	signal-hook-registry	1.4.8	# MIT OR Apache-2.0
MODCARGO_CRATES +=	signature	2.2.0	# Apache-2.0 OR MIT
MODCARGO_CRATES +=	slab	0.4.11	# MIT
MODCARGO_CRATES +=	smallvec	1.15.1	# MIT OR Apache-2.0
MODCARGO_CRATES +=	smawk	0.3.2	# MIT
MODCARGO_CRATES +=	socket2	0.6.1	# MIT OR Apache-2.0
MODCARGO_CRATES +=	spin	0.9.8	# MIT
MODCARGO_CRATES +=	spki	0.7.3	# Apache-2.0 OR MIT
MODCARGO_CRATES +=	ssh-agent-lib	0.5.1	# MIT OR Apache-2.0
MODCARGO_CRATES +=	ssh-cipher	0.2.0	# Apache-2.0 OR MIT
MODCARGO_CRATES +=	ssh-encoding	0.2.0	# Apache-2.0 OR MIT
MODCARGO_CRATES +=	ssh-key	0.6.7	# Apache-2.0 OR MIT
MODCARGO_CRATES +=	stable_deref_trait	1.2.1	# MIT OR Apache-2.0
MODCARGO_CRATES +=	strsim	0.11.1	# MIT
MODCARGO_CRATES +=	subtle	2.6.1	# BSD-3-Clause
MODCARGO_CRATES +=	syn	2.0.111	# MIT OR Apache-2.0
MODCARGO_CRATES +=	sync_wrapper	1.0.2	# Apache-2.0
MODCARGO_CRATES +=	synstructure	0.13.2	# MIT
MODCARGO_CRATES +=	tempfile	3.24.0	# MIT OR Apache-2.0
MODCARGO_CRATES +=	terminal_size	0.4.3	# MIT OR Apache-2.0
MODCARGO_CRATES +=	textwrap	0.16.2	# MIT
MODCARGO_CRATES +=	thiserror	1.0.69	# MIT OR Apache-2.0
MODCARGO_CRATES +=	thiserror	2.0.17	# MIT OR Apache-2.0
MODCARGO_CRATES +=	thiserror-impl	1.0.69	# MIT OR Apache-2.0
MODCARGO_CRATES +=	thiserror-impl	2.0.17	# MIT OR Apache-2.0
MODCARGO_CRATES +=	tinystr	0.8.2	# Unicode-3.0
MODCARGO_CRATES +=	tinyvec	1.10.0	# Zlib OR Apache-2.0 OR MIT
MODCARGO_CRATES +=	tinyvec_macros	0.1.1	# MIT OR Apache-2.0 OR Zlib
MODCARGO_CRATES +=	tokio	1.48.0	# MIT
MODCARGO_CRATES +=	tokio-macros	2.6.0	# MIT
MODCARGO_CRATES +=	tokio-rustls	0.26.4	# MIT OR Apache-2.0
MODCARGO_CRATES +=	tokio-stream	0.1.17	# MIT
MODCARGO_CRATES +=	tokio-tungstenite	0.28.0	# MIT
MODCARGO_CRATES +=	tokio-util	0.7.17	# MIT
MODCARGO_CRATES +=	totp-rs	5.7.0	# MIT
MODCARGO_CRATES +=	tower	0.5.2	# MIT
MODCARGO_CRATES +=	tower-http	0.6.8	# MIT
MODCARGO_CRATES +=	tower-layer	0.3.3	# MIT
MODCARGO_CRATES +=	tower-service	0.3.3	# MIT
MODCARGO_CRATES +=	tracing	0.1.44	# MIT
MODCARGO_CRATES +=	tracing-core	0.1.36	# MIT
MODCARGO_CRATES +=	tree_magic_mini	3.2.0	# MIT
MODCARGO_CRATES +=	try-lock	0.2.5	# MIT
MODCARGO_CRATES +=	tungstenite	0.28.0	# MIT OR Apache-2.0
MODCARGO_CRATES +=	typenum	1.19.0	# MIT OR Apache-2.0
MODCARGO_CRATES +=	unicode-ident	1.0.22	# (MIT OR Apache-2.0) AND Unicode-3.0
MODCARGO_CRATES +=	unicode-linebreak	0.1.5	# Apache-2.0
MODCARGO_CRATES +=	unicode-width	0.2.2	# MIT OR Apache-2.0
MODCARGO_CRATES +=	untrusted	0.9.0	# ISC
MODCARGO_CRATES +=	url	2.5.7	# MIT OR Apache-2.0
MODCARGO_CRATES +=	urlencoding	2.1.3	# MIT
MODCARGO_CRATES +=	utf-8	0.7.6	# MIT OR Apache-2.0
MODCARGO_CRATES +=	utf8_iter	1.0.4	# Apache-2.0 OR MIT
MODCARGO_CRATES +=	utf8parse	0.2.2	# Apache-2.0 OR MIT
MODCARGO_CRATES +=	uuid	1.19.0	# Apache-2.0 OR MIT
MODCARGO_CRATES +=	version_check	0.9.5	# MIT/Apache-2.0
MODCARGO_CRATES +=	want	0.3.1	# MIT
MODCARGO_CRATES +=	wasi	0.11.1+wasi-snapshot-preview1	# Apache-2.0 WITH LLVM-exception OR Apache-2.0 OR MIT
MODCARGO_CRATES +=	wasip2	1.0.1+wasi-0.2.4	# Apache-2.0 WITH LLVM-exception OR Apache-2.0 OR MIT
MODCARGO_CRATES +=	wasm-bindgen	0.2.106	# MIT OR Apache-2.0
MODCARGO_CRATES +=	wasm-bindgen-futures	0.4.56	# MIT OR Apache-2.0
MODCARGO_CRATES +=	wasm-bindgen-macro	0.2.106	# MIT OR Apache-2.0
MODCARGO_CRATES +=	wasm-bindgen-macro-support	0.2.106	# MIT OR Apache-2.0
MODCARGO_CRATES +=	wasm-bindgen-shared	0.2.106	# MIT OR Apache-2.0
MODCARGO_CRATES +=	wayland-backend	0.3.11	# MIT
MODCARGO_CRATES +=	wayland-client	0.31.11	# MIT
MODCARGO_CRATES +=	wayland-protocols	0.32.9	# MIT
MODCARGO_CRATES +=	wayland-protocols-wlr	0.3.9	# MIT
MODCARGO_CRATES +=	wayland-scanner	0.31.7	# MIT
MODCARGO_CRATES +=	wayland-sys	0.31.7	# MIT
MODCARGO_CRATES +=	web-sys	0.3.83	# MIT OR Apache-2.0
MODCARGO_CRATES +=	web-time	1.1.0	# MIT OR Apache-2.0
MODCARGO_CRATES +=	windows-link	0.2.1	# MIT OR Apache-2.0
MODCARGO_CRATES +=	windows-sys	0.52.0	# MIT OR Apache-2.0
MODCARGO_CRATES +=	windows-sys	0.60.2	# MIT OR Apache-2.0
MODCARGO_CRATES +=	windows-sys	0.61.2	# MIT OR Apache-2.0
MODCARGO_CRATES +=	windows-targets	0.52.6	# MIT OR Apache-2.0
MODCARGO_CRATES +=	windows-targets	0.53.5	# MIT OR Apache-2.0
MODCARGO_CRATES +=	windows_aarch64_gnullvm	0.52.6	# MIT OR Apache-2.0
MODCARGO_CRATES +=	windows_aarch64_gnullvm	0.53.1	# MIT OR Apache-2.0
MODCARGO_CRATES +=	windows_aarch64_msvc	0.52.6	# MIT OR Apache-2.0
MODCARGO_CRATES +=	windows_aarch64_msvc	0.53.1	# MIT OR Apache-2.0
MODCARGO_CRATES +=	windows_i686_gnu	0.52.6	# MIT OR Apache-2.0
MODCARGO_CRATES +=	windows_i686_gnu	0.53.1	# MIT OR Apache-2.0
MODCARGO_CRATES +=	windows_i686_gnullvm	0.52.6	# MIT OR Apache-2.0
MODCARGO_CRATES +=	windows_i686_gnullvm	0.53.1	# MIT OR Apache-2.0
MODCARGO_CRATES +=	windows_i686_msvc	0.52.6	# MIT OR Apache-2.0
MODCARGO_CRATES +=	windows_i686_msvc	0.53.1	# MIT OR Apache-2.0
MODCARGO_CRATES +=	windows_x86_64_gnu	0.52.6	# MIT OR Apache-2.0
MODCARGO_CRATES +=	windows_x86_64_gnu	0.53.1	# MIT OR Apache-2.0
MODCARGO_CRATES +=	windows_x86_64_gnullvm	0.52.6	# MIT OR Apache-2.0
MODCARGO_CRATES +=	windows_x86_64_gnullvm	0.53.1	# MIT OR Apache-2.0
MODCARGO_CRATES +=	windows_x86_64_msvc	0.52.6	# MIT OR Apache-2.0
MODCARGO_CRATES +=	windows_x86_64_msvc	0.53.1	# MIT OR Apache-2.0
MODCARGO_CRATES +=	wit-bindgen	0.46.0	# Apache-2.0 WITH LLVM-exception OR Apache-2.0 OR MIT
MODCARGO_CRATES +=	wl-clipboard-rs	0.9.3	# MIT/Apache-2.0
MODCARGO_CRATES +=	writeable	0.6.2	# Unicode-3.0
MODCARGO_CRATES +=	x11rb	0.13.2	# MIT OR Apache-2.0
MODCARGO_CRATES +=	x11rb-protocol	0.13.2	# MIT OR Apache-2.0
MODCARGO_CRATES +=	yoke	0.8.1	# Unicode-3.0
MODCARGO_CRATES +=	yoke-derive	0.8.1	# Unicode-3.0
MODCARGO_CRATES +=	zerocopy	0.8.31	# BSD-2-Clause OR Apache-2.0 OR MIT
MODCARGO_CRATES +=	zerocopy-derive	0.8.31	# BSD-2-Clause OR Apache-2.0 OR MIT
MODCARGO_CRATES +=	zerofrom	0.1.6	# Unicode-3.0
MODCARGO_CRATES +=	zerofrom-derive	0.1.6	# Unicode-3.0
MODCARGO_CRATES +=	zeroize	1.8.2	# Apache-2.0 OR MIT
MODCARGO_CRATES +=	zerotrie	0.2.3	# Unicode-3.0
MODCARGO_CRATES +=	zerovec	0.11.5	# Unicode-3.0
MODCARGO_CRATES +=	zerovec-derive	0.11.2	# Unicode-3.0
MODCARGO_CRATES +=	zmij	0.1.9	# MIT
