MODCARGO_CRATES +=	autocfg	1.5.0	# Apache-2.0 OR MIT
MODCARGO_CRATES +=	base64	0.22.1	# MIT OR Apache-2.0
MODCARGO_CRATES +=	bcrypt	0.17.1	# MIT
MODCARGO_CRATES +=	bcrypt-pbkdf	0.10.0	# MIT OR Apache-2.0
MODCARGO_CRATES +=	block-buffer	0.10.4	# MIT OR Apache-2.0
MODCARGO_CRATES +=	blowfish	0.9.1	# MIT OR Apache-2.0
MODCARGO_CRATES +=	byteorder	1.5.0	# Unlicense OR MIT
MODCARGO_CRATES +=	cfg-if	1.0.3	# MIT OR Apache-2.0
MODCARGO_CRATES +=	cipher	0.4.4	# MIT OR Apache-2.0
MODCARGO_CRATES +=	cpufeatures	0.2.17	# MIT OR Apache-2.0
MODCARGO_CRATES +=	crypto-common	0.1.6	# MIT OR Apache-2.0
MODCARGO_CRATES +=	digest	0.10.7	# MIT OR Apache-2.0
MODCARGO_CRATES +=	generic-array	0.14.7	# MIT
MODCARGO_CRATES +=	getrandom	0.3.3	# MIT OR Apache-2.0
MODCARGO_CRATES +=	heck	0.5.0	# MIT OR Apache-2.0
MODCARGO_CRATES +=	indoc	2.0.6	# MIT OR Apache-2.0
MODCARGO_CRATES +=	inout	0.1.4	# MIT OR Apache-2.0
MODCARGO_CRATES +=	libc	0.2.176	# MIT OR Apache-2.0
MODCARGO_CRATES +=	memoffset	0.9.1	# MIT
MODCARGO_CRATES +=	once_cell	1.21.3	# MIT OR Apache-2.0
MODCARGO_CRATES +=	pbkdf2	0.12.2	# MIT OR Apache-2.0
MODCARGO_CRATES +=	portable-atomic	1.11.1	# Apache-2.0 OR MIT
MODCARGO_CRATES +=	proc-macro2	1.0.101	# MIT OR Apache-2.0
MODCARGO_CRATES +=	pyo3	0.26.0	# MIT OR Apache-2.0
MODCARGO_CRATES +=	pyo3-build-config	0.26.0	# MIT OR Apache-2.0
MODCARGO_CRATES +=	pyo3-ffi	0.26.0	# MIT OR Apache-2.0
MODCARGO_CRATES +=	pyo3-macros	0.26.0	# MIT OR Apache-2.0
MODCARGO_CRATES +=	pyo3-macros-backend	0.26.0	# MIT OR Apache-2.0
MODCARGO_CRATES +=	quote	1.0.40	# MIT OR Apache-2.0
MODCARGO_CRATES +=	r-efi	5.3.0	# MIT OR Apache-2.0 OR LGPL-2.1-or-later
MODCARGO_CRATES +=	sha2	0.10.9	# MIT OR Apache-2.0
MODCARGO_CRATES +=	subtle	2.6.1	# BSD-3-Clause
MODCARGO_CRATES +=	syn	2.0.106	# MIT OR Apache-2.0
MODCARGO_CRATES +=	target-lexicon	0.13.3	# Apache-2.0 WITH LLVM-exception
MODCARGO_CRATES +=	typenum	1.18.0	# MIT OR Apache-2.0
MODCARGO_CRATES +=	unicode-ident	1.0.19	# (MIT OR Apache-2.0) AND Unicode-3.0
MODCARGO_CRATES +=	unindent	0.2.4	# MIT OR Apache-2.0
MODCARGO_CRATES +=	version_check	0.9.5	# MIT/Apache-2.0
MODCARGO_CRATES +=	wasi	0.14.7+wasi-0.2.4	# Apache-2.0 WITH LLVM-exception OR Apache-2.0 OR MIT
MODCARGO_CRATES +=	wasip2	1.0.1+wasi-0.2.4	# Apache-2.0 WITH LLVM-exception OR Apache-2.0 OR MIT
MODCARGO_CRATES +=	wit-bindgen	0.46.0	# Apache-2.0 WITH LLVM-exception OR Apache-2.0 OR MIT
MODCARGO_CRATES +=	zeroize	1.8.1	# Apache-2.0 OR MIT
