MODCARGO_CRATES +=	addr2line	0.21.0	# Apache-2.0 OR MIT
MODCARGO_CRATES +=	adler	1.0.2	# 0BSD OR MIT OR Apache-2.0
MODCARGO_CRATES +=	ahash	0.8.9	# MIT OR Apache-2.0
MODCARGO_CRATES +=	aho-corasick	1.1.2	# Unlicense OR MIT
MODCARGO_CRATES +=	alloc-no-stdlib	2.0.4	# BSD-3-Clause
MODCARGO_CRATES +=	alloc-stdlib	0.2.2	# BSD-3-Clause
MODCARGO_CRATES +=	allocator-api2	0.2.16	# MIT OR Apache-2.0
MODCARGO_CRATES +=	android-tzdata	0.1.1	# MIT OR Apache-2.0
MODCARGO_CRATES +=	android_system_properties	0.1.5	# MIT/Apache-2.0
MODCARGO_CRATES +=	argon2	0.5.3	# MIT OR Apache-2.0
MODCARGO_CRATES +=	async-channel	1.9.0	# Apache-2.0 OR MIT
MODCARGO_CRATES +=	async-channel	2.2.0	# Apache-2.0 OR MIT
MODCARGO_CRATES +=	async-compression	0.4.6	# MIT OR Apache-2.0
MODCARGO_CRATES +=	async-executor	1.8.0	# Apache-2.0 OR MIT
MODCARGO_CRATES +=	async-global-executor	2.4.1	# Apache-2.0 OR MIT
MODCARGO_CRATES +=	async-io	1.13.0	# Apache-2.0 OR MIT
MODCARGO_CRATES +=	async-io	2.3.1	# Apache-2.0 OR MIT
MODCARGO_CRATES +=	async-lock	2.8.0	# Apache-2.0 OR MIT
MODCARGO_CRATES +=	async-lock	3.3.0	# Apache-2.0 OR MIT
MODCARGO_CRATES +=	async-process	1.8.1	# Apache-2.0 OR MIT
MODCARGO_CRATES +=	async-signal	0.2.5	# Apache-2.0 OR MIT
MODCARGO_CRATES +=	async-std	1.12.0	# Apache-2.0/MIT
MODCARGO_CRATES +=	async-stream	0.3.5	# MIT
MODCARGO_CRATES +=	async-stream-impl	0.3.5	# MIT
MODCARGO_CRATES +=	async-task	4.7.0	# Apache-2.0 OR MIT
MODCARGO_CRATES +=	async-trait	0.1.77	# MIT OR Apache-2.0
MODCARGO_CRATES +=	atomic	0.5.3	# Apache-2.0/MIT
MODCARGO_CRATES +=	atomic	0.6.0	# Apache-2.0/MIT
MODCARGO_CRATES +=	atomic-waker	1.1.2	# Apache-2.0 OR MIT
MODCARGO_CRATES +=	autocfg	1.1.0	# Apache-2.0 OR MIT
MODCARGO_CRATES +=	backtrace	0.3.69	# MIT OR Apache-2.0
MODCARGO_CRATES +=	base64	0.13.1	# MIT/Apache-2.0
MODCARGO_CRATES +=	base64	0.21.7	# MIT OR Apache-2.0
MODCARGO_CRATES +=	base64ct	1.6.0	# Apache-2.0 OR MIT
MODCARGO_CRATES +=	bigdecimal	0.4.2	# MIT/Apache-2.0
MODCARGO_CRATES +=	binascii	0.1.4	# MIT
MODCARGO_CRATES +=	bitflags	1.3.2	# MIT/Apache-2.0
MODCARGO_CRATES +=	bitflags	2.4.2	# MIT OR Apache-2.0
MODCARGO_CRATES +=	blake2	0.10.6	# MIT OR Apache-2.0
MODCARGO_CRATES +=	block-buffer	0.10.4	# MIT OR Apache-2.0
MODCARGO_CRATES +=	blocking	1.5.1	# Apache-2.0 OR MIT
MODCARGO_CRATES +=	brotli	3.4.0	# BSD-3-Clause/MIT
MODCARGO_CRATES +=	brotli-decompressor	2.5.1	# BSD-3-Clause/MIT
MODCARGO_CRATES +=	bumpalo	3.15.3	# MIT OR Apache-2.0
MODCARGO_CRATES +=	bytemuck	1.14.3	# Zlib OR Apache-2.0 OR MIT
MODCARGO_CRATES +=	byteorder	1.5.0	# Unlicense OR MIT
MODCARGO_CRATES +=	bytes	1.5.0	# MIT
MODCARGO_CRATES +=	cached	0.48.1	# MIT
MODCARGO_CRATES +=	cached_proc_macro	0.19.1	# MIT
MODCARGO_CRATES +=	cached_proc_macro_types	0.1.1	# MIT
MODCARGO_CRATES +=	cc	1.0.86	# MIT OR Apache-2.0
MODCARGO_CRATES +=	cfg-if	1.0.0	# MIT/Apache-2.0
MODCARGO_CRATES +=	chrono	0.4.34	# MIT OR Apache-2.0
MODCARGO_CRATES +=	chrono-tz	0.8.6	# MIT OR Apache-2.0
MODCARGO_CRATES +=	chrono-tz-build	0.2.1	# MIT OR Apache-2.0
MODCARGO_CRATES +=	chumsky	0.9.3	# MIT
MODCARGO_CRATES +=	concurrent-queue	2.4.0	# Apache-2.0 OR MIT
MODCARGO_CRATES +=	cookie	0.17.0	# MIT OR Apache-2.0
MODCARGO_CRATES +=	cookie	0.18.0	# MIT OR Apache-2.0
MODCARGO_CRATES +=	cookie_store	0.20.0	# MIT/Apache-2.0
MODCARGO_CRATES +=	core-foundation	0.9.4	# MIT OR Apache-2.0
MODCARGO_CRATES +=	core-foundation-sys	0.8.6	# MIT OR Apache-2.0
MODCARGO_CRATES +=	cpufeatures	0.2.12	# MIT OR Apache-2.0
MODCARGO_CRATES +=	crc32fast	1.4.0	# MIT OR Apache-2.0
MODCARGO_CRATES +=	cron	0.12.0	# MIT OR Apache-2.0
MODCARGO_CRATES +=	crossbeam-utils	0.8.19	# MIT OR Apache-2.0
MODCARGO_CRATES +=	crypto-common	0.1.6	# MIT OR Apache-2.0
MODCARGO_CRATES +=	darling	0.14.4	# MIT
MODCARGO_CRATES +=	darling_core	0.14.4	# MIT
MODCARGO_CRATES +=	darling_macro	0.14.4	# MIT
MODCARGO_CRATES +=	dashmap	5.5.3	# MIT
MODCARGO_CRATES +=	data-encoding	2.5.0	# MIT
MODCARGO_CRATES +=	data-url	0.3.1	# MIT OR Apache-2.0
MODCARGO_CRATES +=	deranged	0.3.11	# MIT OR Apache-2.0
MODCARGO_CRATES +=	devise	0.4.1	# MIT/Apache-2.0
MODCARGO_CRATES +=	devise_codegen	0.4.1	# MIT/Apache-2.0
MODCARGO_CRATES +=	devise_core	0.4.1	# MIT/Apache-2.0
MODCARGO_CRATES +=	diesel	2.1.4	# MIT OR Apache-2.0
MODCARGO_CRATES +=	diesel_derives	2.1.2	# MIT OR Apache-2.0
MODCARGO_CRATES +=	diesel_logger	0.3.0	# MIT
MODCARGO_CRATES +=	diesel_migrations	2.1.0	# MIT OR Apache-2.0
MODCARGO_CRATES +=	diesel_table_macro_syntax	0.1.0	# MIT OR Apache-2.0
MODCARGO_CRATES +=	digest	0.10.7	# MIT OR Apache-2.0
MODCARGO_CRATES +=	dotenvy	0.15.7	# MIT
MODCARGO_CRATES +=	either	1.10.0	# MIT OR Apache-2.0
MODCARGO_CRATES +=	email-encoding	0.2.0	# MIT OR Apache-2.0
MODCARGO_CRATES +=	email_address	0.2.4	# MIT
MODCARGO_CRATES +=	encoding_rs	0.8.33	# (Apache-2.0 OR MIT) AND BSD-3-Clause
MODCARGO_CRATES +=	enum-as-inner	0.6.0	# MIT/Apache-2.0
MODCARGO_CRATES +=	equivalent	1.0.1	# Apache-2.0 OR MIT
MODCARGO_CRATES +=	errno	0.3.8	# MIT OR Apache-2.0
MODCARGO_CRATES +=	error-chain	0.12.4	# MIT/Apache-2.0
MODCARGO_CRATES +=	event-listener	2.5.3	# Apache-2.0 OR MIT
MODCARGO_CRATES +=	event-listener	3.1.0	# Apache-2.0 OR MIT
MODCARGO_CRATES +=	event-listener	4.0.3	# Apache-2.0 OR MIT
MODCARGO_CRATES +=	event-listener	5.1.0	# Apache-2.0 OR MIT
MODCARGO_CRATES +=	event-listener-strategy	0.4.0	# Apache-2.0 OR MIT
MODCARGO_CRATES +=	event-listener-strategy	0.5.0	# Apache-2.0 OR MIT
MODCARGO_CRATES +=	fastrand	1.9.0	# Apache-2.0 OR MIT
MODCARGO_CRATES +=	fastrand	2.0.1	# Apache-2.0 OR MIT
MODCARGO_CRATES +=	fern	0.6.2	# MIT
MODCARGO_CRATES +=	figment	0.10.14	# MIT OR Apache-2.0
MODCARGO_CRATES +=	flate2	1.0.28	# MIT OR Apache-2.0
MODCARGO_CRATES +=	fnv	1.0.7	# Apache-2.0 / MIT
MODCARGO_CRATES +=	foreign-types	0.3.2	# MIT/Apache-2.0
MODCARGO_CRATES +=	foreign-types-shared	0.1.1	# MIT/Apache-2.0
MODCARGO_CRATES +=	form_urlencoded	1.2.1	# MIT OR Apache-2.0
MODCARGO_CRATES +=	futures	0.3.30	# MIT OR Apache-2.0
MODCARGO_CRATES +=	futures-channel	0.3.30	# MIT OR Apache-2.0
MODCARGO_CRATES +=	futures-core	0.3.30	# MIT OR Apache-2.0
MODCARGO_CRATES +=	futures-executor	0.3.30	# MIT OR Apache-2.0
MODCARGO_CRATES +=	futures-io	0.3.30	# MIT OR Apache-2.0
MODCARGO_CRATES +=	futures-lite	1.13.0	# Apache-2.0 OR MIT
MODCARGO_CRATES +=	futures-lite	2.2.0	# Apache-2.0 OR MIT
MODCARGO_CRATES +=	futures-macro	0.3.30	# MIT OR Apache-2.0
MODCARGO_CRATES +=	futures-sink	0.3.30	# MIT OR Apache-2.0
MODCARGO_CRATES +=	futures-task	0.3.30	# MIT OR Apache-2.0
MODCARGO_CRATES +=	futures-timer	3.0.3	# MIT/Apache-2.0
MODCARGO_CRATES +=	futures-util	0.3.30	# MIT OR Apache-2.0
MODCARGO_CRATES +=	generator	0.7.5	# MIT/Apache-2.0
MODCARGO_CRATES +=	generic-array	0.14.7	# MIT
MODCARGO_CRATES +=	getrandom	0.2.12	# MIT OR Apache-2.0
MODCARGO_CRATES +=	gimli	0.28.1	# MIT OR Apache-2.0
MODCARGO_CRATES +=	glob	0.3.1	# MIT OR Apache-2.0
MODCARGO_CRATES +=	gloo-timers	0.2.6	# MIT/Apache-2.0
MODCARGO_CRATES +=	governor	0.6.3	# MIT
MODCARGO_CRATES +=	h2	0.3.24	# MIT
MODCARGO_CRATES +=	half	1.8.2	# MIT OR Apache-2.0
MODCARGO_CRATES +=	handlebars	5.1.0	# MIT
MODCARGO_CRATES +=	hashbrown	0.14.3	# MIT OR Apache-2.0
MODCARGO_CRATES +=	heck	0.4.1	# MIT OR Apache-2.0
MODCARGO_CRATES +=	hermit-abi	0.3.6	# MIT OR Apache-2.0
MODCARGO_CRATES +=	hmac	0.12.1	# MIT OR Apache-2.0
MODCARGO_CRATES +=	home	0.5.9	# MIT OR Apache-2.0
MODCARGO_CRATES +=	hostname	0.3.1	# MIT
MODCARGO_CRATES +=	html5gum	0.5.7	# MIT
MODCARGO_CRATES +=	http	0.2.11	# MIT OR Apache-2.0
MODCARGO_CRATES +=	http-body	0.4.6	# MIT
MODCARGO_CRATES +=	httparse	1.8.0	# MIT/Apache-2.0
MODCARGO_CRATES +=	httpdate	1.0.3	# MIT OR Apache-2.0
MODCARGO_CRATES +=	hyper	0.14.28	# MIT
MODCARGO_CRATES +=	hyper-tls	0.5.0	# MIT/Apache-2.0
MODCARGO_CRATES +=	iana-time-zone	0.1.60	# MIT OR Apache-2.0
MODCARGO_CRATES +=	iana-time-zone-haiku	0.1.2	# MIT OR Apache-2.0
MODCARGO_CRATES +=	ident_case	1.0.1	# MIT/Apache-2.0
MODCARGO_CRATES +=	idna	0.3.0	# MIT OR Apache-2.0
MODCARGO_CRATES +=	idna	0.4.0	# MIT OR Apache-2.0
MODCARGO_CRATES +=	idna	0.5.0	# MIT OR Apache-2.0
MODCARGO_CRATES +=	indexmap	2.2.3	# Apache-2.0 OR MIT
MODCARGO_CRATES +=	inlinable_string	0.1.15	# Apache-2.0/MIT
MODCARGO_CRATES +=	instant	0.1.12	# BSD-3-Clause
MODCARGO_CRATES +=	io-lifetimes	1.0.11	# Apache-2.0 WITH LLVM-exception OR Apache-2.0 OR MIT
MODCARGO_CRATES +=	ipconfig	0.3.2	# MIT/Apache-2.0
MODCARGO_CRATES +=	ipnet	2.9.0	# MIT OR Apache-2.0
MODCARGO_CRATES +=	is-terminal	0.4.12	# MIT
MODCARGO_CRATES +=	itoa	1.0.10	# MIT OR Apache-2.0
MODCARGO_CRATES +=	jetscii	0.5.3	# MIT OR Apache-2.0
MODCARGO_CRATES +=	job_scheduler_ng	2.0.4	# MIT OR Apache-2.0
MODCARGO_CRATES +=	js-sys	0.3.68	# MIT OR Apache-2.0
MODCARGO_CRATES +=	jsonwebtoken	9.2.0	# MIT
MODCARGO_CRATES +=	kv-log-macro	1.0.7	# MIT OR Apache-2.0
MODCARGO_CRATES +=	lazy_static	1.4.0	# MIT/Apache-2.0
MODCARGO_CRATES +=	lettre	0.11.4	# MIT
MODCARGO_CRATES +=	libc	0.2.153	# MIT OR Apache-2.0
MODCARGO_CRATES +=	libm	0.2.8	# MIT OR Apache-2.0
MODCARGO_CRATES +=	libmimalloc-sys	0.1.35	# MIT
MODCARGO_CRATES +=	libsqlite3-sys	0.27.0	# MIT
MODCARGO_CRATES +=	linked-hash-map	0.5.6	# MIT/Apache-2.0
MODCARGO_CRATES +=	linux-raw-sys	0.3.8	# Apache-2.0 WITH LLVM-exception OR Apache-2.0 OR MIT
MODCARGO_CRATES +=	linux-raw-sys	0.4.13	# Apache-2.0 WITH LLVM-exception OR Apache-2.0 OR MIT
MODCARGO_CRATES +=	lock_api	0.4.11	# MIT OR Apache-2.0
MODCARGO_CRATES +=	log	0.4.20	# MIT OR Apache-2.0
MODCARGO_CRATES +=	loom	0.5.6	# MIT
MODCARGO_CRATES +=	lru-cache	0.1.2	# MIT/Apache-2.0
MODCARGO_CRATES +=	match_cfg	0.1.0	# MIT/Apache-2.0
MODCARGO_CRATES +=	matchers	0.1.0	# MIT
MODCARGO_CRATES +=	memchr	2.7.1	# Unlicense OR MIT
MODCARGO_CRATES +=	migrations_internals	2.1.0	# MIT OR Apache-2.0
MODCARGO_CRATES +=	migrations_macros	2.1.0	# MIT OR Apache-2.0
MODCARGO_CRATES +=	mimalloc	0.1.39	# MIT
MODCARGO_CRATES +=	mime	0.3.17	# MIT OR Apache-2.0
MODCARGO_CRATES +=	minimal-lexical	0.2.1	# MIT/Apache-2.0
MODCARGO_CRATES +=	miniz_oxide	0.7.2	# MIT OR Zlib OR Apache-2.0
MODCARGO_CRATES +=	mio	0.8.10	# MIT
MODCARGO_CRATES +=	multer	2.1.0	# MIT
MODCARGO_CRATES +=	mysqlclient-sys	0.2.5	# MIT OR Apache-2.0
MODCARGO_CRATES +=	native-tls	0.2.11	# MIT/Apache-2.0
MODCARGO_CRATES +=	no-std-compat	0.4.1	# MIT
MODCARGO_CRATES +=	nom	7.1.3	# MIT
MODCARGO_CRATES +=	nonzero_ext	0.3.0	# Apache-2.0
MODCARGO_CRATES +=	nu-ansi-term	0.46.0	# MIT
MODCARGO_CRATES +=	num-bigint	0.4.4	# MIT OR Apache-2.0
MODCARGO_CRATES +=	num-conv	0.1.0	# MIT OR Apache-2.0
MODCARGO_CRATES +=	num-derive	0.4.2	# MIT OR Apache-2.0
MODCARGO_CRATES +=	num-integer	0.1.46	# MIT OR Apache-2.0
MODCARGO_CRATES +=	num-traits	0.2.18	# MIT OR Apache-2.0
MODCARGO_CRATES +=	num_cpus	1.16.0	# MIT OR Apache-2.0
MODCARGO_CRATES +=	num_threads	0.1.7	# MIT OR Apache-2.0
MODCARGO_CRATES +=	object	0.32.2	# Apache-2.0 OR MIT
MODCARGO_CRATES +=	once_cell	1.19.0	# MIT OR Apache-2.0
MODCARGO_CRATES +=	openssl	0.10.64	# Apache-2.0
MODCARGO_CRATES +=	openssl-macros	0.1.1	# MIT/Apache-2.0
MODCARGO_CRATES +=	openssl-probe	0.1.5	# MIT/Apache-2.0
MODCARGO_CRATES +=	openssl-src	300.2.3+3.2.1	# MIT/Apache-2.0
MODCARGO_CRATES +=	openssl-sys	0.9.101	# MIT
MODCARGO_CRATES +=	overload	0.1.1	# MIT
MODCARGO_CRATES +=	parking	2.2.0	# Apache-2.0 OR MIT
MODCARGO_CRATES +=	parking_lot	0.12.1	# MIT OR Apache-2.0
MODCARGO_CRATES +=	parking_lot_core	0.9.9	# MIT OR Apache-2.0
MODCARGO_CRATES +=	parse-zoneinfo	0.3.0	# MIT
MODCARGO_CRATES +=	password-hash	0.5.0	# MIT OR Apache-2.0
MODCARGO_CRATES +=	paste	1.0.14	# MIT OR Apache-2.0
MODCARGO_CRATES +=	pear	0.2.8	# MIT/Apache-2.0
MODCARGO_CRATES +=	pear_codegen	0.2.8	# MIT/Apache-2.0
MODCARGO_CRATES +=	pem	3.0.3	# MIT
MODCARGO_CRATES +=	percent-encoding	2.3.1	# MIT OR Apache-2.0
MODCARGO_CRATES +=	pest	2.7.7	# MIT OR Apache-2.0
MODCARGO_CRATES +=	pest_derive	2.7.7	# MIT OR Apache-2.0
MODCARGO_CRATES +=	pest_generator	2.7.7	# MIT OR Apache-2.0
MODCARGO_CRATES +=	pest_meta	2.7.7	# MIT OR Apache-2.0
MODCARGO_CRATES +=	phf	0.11.2	# MIT
MODCARGO_CRATES +=	phf_codegen	0.11.2	# MIT
MODCARGO_CRATES +=	phf_generator	0.11.2	# MIT
MODCARGO_CRATES +=	phf_shared	0.11.2	# MIT
MODCARGO_CRATES +=	pico-args	0.5.0	# MIT
MODCARGO_CRATES +=	pin-project-lite	0.2.13	# Apache-2.0 OR MIT
MODCARGO_CRATES +=	pin-utils	0.1.0	# MIT OR Apache-2.0
MODCARGO_CRATES +=	piper	0.2.1	# MIT OR Apache-2.0
MODCARGO_CRATES +=	pkg-config	0.3.30	# MIT OR Apache-2.0
MODCARGO_CRATES +=	polling	2.8.0	# Apache-2.0 OR MIT
MODCARGO_CRATES +=	polling	3.5.0	# Apache-2.0 OR MIT
MODCARGO_CRATES +=	portable-atomic	1.6.0	# Apache-2.0 OR MIT
MODCARGO_CRATES +=	powerfmt	0.2.0	# MIT OR Apache-2.0
MODCARGO_CRATES +=	ppv-lite86	0.2.17	# MIT/Apache-2.0
MODCARGO_CRATES +=	pq-sys	0.4.8	# MIT OR Apache-2.0
MODCARGO_CRATES +=	proc-macro2	1.0.78	# MIT OR Apache-2.0
MODCARGO_CRATES +=	proc-macro2-diagnostics	0.10.1	# MIT/Apache-2.0
MODCARGO_CRATES +=	psl-types	2.0.11	# MIT/Apache-2.0
MODCARGO_CRATES +=	psm	0.1.21	# MIT OR Apache-2.0
MODCARGO_CRATES +=	publicsuffix	2.2.3	# MIT/Apache-2.0
MODCARGO_CRATES +=	quanta	0.12.2	# MIT
MODCARGO_CRATES +=	quick-error	1.2.3	# MIT/Apache-2.0
MODCARGO_CRATES +=	quote	1.0.35	# MIT OR Apache-2.0
MODCARGO_CRATES +=	quoted_printable	0.5.0	# 0BSD
MODCARGO_CRATES +=	r2d2	0.8.10	# MIT/Apache-2.0
MODCARGO_CRATES +=	rand	0.8.5	# MIT OR Apache-2.0
MODCARGO_CRATES +=	rand_chacha	0.3.1	# MIT OR Apache-2.0
MODCARGO_CRATES +=	rand_core	0.6.4	# MIT OR Apache-2.0
MODCARGO_CRATES +=	raw-cpuid	11.0.1	# MIT
MODCARGO_CRATES +=	redox_syscall	0.4.1	# MIT
MODCARGO_CRATES +=	ref-cast	1.0.22	# MIT OR Apache-2.0
MODCARGO_CRATES +=	ref-cast-impl	1.0.22	# MIT OR Apache-2.0
MODCARGO_CRATES +=	regex	1.10.3	# MIT OR Apache-2.0
MODCARGO_CRATES +=	regex-automata	0.1.10	# Unlicense/MIT
MODCARGO_CRATES +=	regex-automata	0.4.5	# MIT OR Apache-2.0
MODCARGO_CRATES +=	regex-syntax	0.6.29	# MIT OR Apache-2.0
MODCARGO_CRATES +=	regex-syntax	0.8.2	# MIT OR Apache-2.0
MODCARGO_CRATES +=	reopen	1.0.3	# Apache-2.0/MIT
MODCARGO_CRATES +=	reqwest	0.11.24	# MIT OR Apache-2.0
MODCARGO_CRATES +=	resolv-conf	0.7.0	# MIT/Apache-2.0
MODCARGO_CRATES +=	ring	0.17.8	# LICENSE
MODCARGO_CRATES +=	rmp	0.8.12	# MIT
MODCARGO_CRATES +=	rmpv	1.0.1	# MIT
MODCARGO_CRATES +=	rocket	0.5.0	# MIT OR Apache-2.0
MODCARGO_CRATES +=	rocket_codegen	0.5.0	# MIT OR Apache-2.0
MODCARGO_CRATES +=	rocket_http	0.5.0	# MIT OR Apache-2.0
MODCARGO_CRATES +=	rocket_ws	0.1.0	# MIT OR Apache-2.0
MODCARGO_CRATES +=	rpassword	7.3.1	# Apache-2.0
MODCARGO_CRATES +=	rtoolbox	0.0.2	# Apache-2.0
MODCARGO_CRATES +=	rustc-demangle	0.1.23	# MIT/Apache-2.0
MODCARGO_CRATES +=	rustix	0.37.27	# Apache-2.0 WITH LLVM-exception OR Apache-2.0 OR MIT
MODCARGO_CRATES +=	rustix	0.38.31	# Apache-2.0 WITH LLVM-exception OR Apache-2.0 OR MIT
MODCARGO_CRATES +=	rustls	0.21.10	# Apache-2.0 OR ISC OR MIT
MODCARGO_CRATES +=	rustls-pemfile	1.0.4	# Apache-2.0 OR ISC OR MIT
MODCARGO_CRATES +=	rustls-webpki	0.101.7	# ISC
MODCARGO_CRATES +=	rustversion	1.0.14	# MIT OR Apache-2.0
MODCARGO_CRATES +=	ryu	1.0.17	# Apache-2.0 OR BSL-1.0
MODCARGO_CRATES +=	same-file	1.0.6	# Unlicense/MIT
MODCARGO_CRATES +=	schannel	0.1.23	# MIT
MODCARGO_CRATES +=	scheduled-thread-pool	0.2.7	# MIT/Apache-2.0
MODCARGO_CRATES +=	scoped-tls	1.0.1	# MIT/Apache-2.0
MODCARGO_CRATES +=	scopeguard	1.2.0	# MIT OR Apache-2.0
MODCARGO_CRATES +=	sct	0.7.1	# Apache-2.0 OR ISC OR MIT
MODCARGO_CRATES +=	security-framework	2.9.2	# MIT OR Apache-2.0
MODCARGO_CRATES +=	security-framework-sys	2.9.1	# MIT OR Apache-2.0
MODCARGO_CRATES +=	semver	1.0.22	# MIT OR Apache-2.0
MODCARGO_CRATES +=	serde	1.0.197	# MIT OR Apache-2.0
MODCARGO_CRATES +=	serde_cbor	0.11.2	# MIT/Apache-2.0
MODCARGO_CRATES +=	serde_derive	1.0.197	# MIT OR Apache-2.0
MODCARGO_CRATES +=	serde_json	1.0.114	# MIT OR Apache-2.0
MODCARGO_CRATES +=	serde_spanned	0.6.5	# MIT OR Apache-2.0
MODCARGO_CRATES +=	serde_urlencoded	0.7.1	# MIT/Apache-2.0
MODCARGO_CRATES +=	sha1	0.10.6	# MIT OR Apache-2.0
MODCARGO_CRATES +=	sha2	0.10.8	# MIT OR Apache-2.0
MODCARGO_CRATES +=	sharded-slab	0.1.7	# MIT
MODCARGO_CRATES +=	signal-hook	0.3.17	# Apache-2.0/MIT
MODCARGO_CRATES +=	signal-hook-registry	1.4.1	# Apache-2.0/MIT
MODCARGO_CRATES +=	simple_asn1	0.6.2	# ISC
MODCARGO_CRATES +=	siphasher	0.3.11	# MIT/Apache-2.0
MODCARGO_CRATES +=	slab	0.4.9	# MIT
MODCARGO_CRATES +=	smallvec	1.13.1	# MIT OR Apache-2.0
MODCARGO_CRATES +=	socket2	0.4.10	# MIT OR Apache-2.0
MODCARGO_CRATES +=	socket2	0.5.6	# MIT OR Apache-2.0
MODCARGO_CRATES +=	spin	0.9.8	# MIT
MODCARGO_CRATES +=	spinning_top	0.3.0	# MIT/Apache-2.0
MODCARGO_CRATES +=	stable-pattern	0.1.0	# MIT OR Apache-2.0
MODCARGO_CRATES +=	stacker	0.1.15	# MIT OR Apache-2.0
MODCARGO_CRATES +=	state	0.6.0	# MIT/Apache-2.0
MODCARGO_CRATES +=	strsim	0.10.0	# MIT
MODCARGO_CRATES +=	subtle	2.5.0	# BSD-3-Clause
MODCARGO_CRATES +=	syn	1.0.109	# MIT OR Apache-2.0
MODCARGO_CRATES +=	syn	2.0.50	# MIT OR Apache-2.0
MODCARGO_CRATES +=	sync_wrapper	0.1.2	# Apache-2.0
MODCARGO_CRATES +=	syslog	6.1.0	# MIT
MODCARGO_CRATES +=	system-configuration	0.5.1	# MIT OR Apache-2.0
MODCARGO_CRATES +=	system-configuration-sys	0.5.0	# MIT OR Apache-2.0
MODCARGO_CRATES +=	tempfile	3.10.0	# MIT OR Apache-2.0
MODCARGO_CRATES +=	thiserror	1.0.57	# MIT OR Apache-2.0
MODCARGO_CRATES +=	thiserror-impl	1.0.57	# MIT OR Apache-2.0
MODCARGO_CRATES +=	thread_local	1.1.8	# MIT OR Apache-2.0
MODCARGO_CRATES +=	threadpool	1.8.1	# MIT/Apache-2.0
MODCARGO_CRATES +=	time	0.3.34	# MIT OR Apache-2.0
MODCARGO_CRATES +=	time-core	0.1.2	# MIT OR Apache-2.0
MODCARGO_CRATES +=	time-macros	0.2.17	# MIT OR Apache-2.0
MODCARGO_CRATES +=	tinyvec	1.6.0	# Zlib OR Apache-2.0 OR MIT
MODCARGO_CRATES +=	tinyvec_macros	0.1.1	# MIT OR Apache-2.0 OR Zlib
MODCARGO_CRATES +=	tokio	1.36.0	# MIT
MODCARGO_CRATES +=	tokio-macros	2.2.0	# MIT
MODCARGO_CRATES +=	tokio-native-tls	0.3.1	# MIT
MODCARGO_CRATES +=	tokio-rustls	0.24.1	# MIT/Apache-2.0
MODCARGO_CRATES +=	tokio-socks	0.5.1	# MIT
MODCARGO_CRATES +=	tokio-stream	0.1.14	# MIT
MODCARGO_CRATES +=	tokio-tungstenite	0.20.1	# MIT
MODCARGO_CRATES +=	tokio-util	0.7.10	# MIT
MODCARGO_CRATES +=	toml	0.7.8	# MIT OR Apache-2.0
MODCARGO_CRATES +=	toml	0.8.10	# MIT OR Apache-2.0
MODCARGO_CRATES +=	toml_datetime	0.6.5	# MIT OR Apache-2.0
MODCARGO_CRATES +=	toml_edit	0.19.15	# MIT OR Apache-2.0
MODCARGO_CRATES +=	toml_edit	0.22.6	# MIT OR Apache-2.0
MODCARGO_CRATES +=	totp-lite	2.0.1	# MIT
MODCARGO_CRATES +=	tower-service	0.3.2	# MIT
MODCARGO_CRATES +=	tracing	0.1.40	# MIT
MODCARGO_CRATES +=	tracing-attributes	0.1.27	# MIT
MODCARGO_CRATES +=	tracing-core	0.1.32	# MIT
MODCARGO_CRATES +=	tracing-log	0.2.0	# MIT
MODCARGO_CRATES +=	tracing-subscriber	0.3.18	# MIT
MODCARGO_CRATES +=	trust-dns-proto	0.23.2	# MIT OR Apache-2.0
MODCARGO_CRATES +=	trust-dns-resolver	0.23.2	# MIT OR Apache-2.0
MODCARGO_CRATES +=	try-lock	0.2.5	# MIT
MODCARGO_CRATES +=	tungstenite	0.20.1	# MIT OR Apache-2.0
MODCARGO_CRATES +=	typenum	1.17.0	# MIT OR Apache-2.0
MODCARGO_CRATES +=	ubyte	0.10.4	# MIT OR Apache-2.0
MODCARGO_CRATES +=	ucd-trie	0.1.6	# MIT OR Apache-2.0
MODCARGO_CRATES +=	uncased	0.9.10	# MIT OR Apache-2.0
MODCARGO_CRATES +=	unicode-bidi	0.3.15	# MIT OR Apache-2.0
MODCARGO_CRATES +=	unicode-ident	1.0.12	# (MIT OR Apache-2.0) AND Unicode-DFS-2016
MODCARGO_CRATES +=	unicode-normalization	0.1.23	# MIT/Apache-2.0
MODCARGO_CRATES +=	unicode-xid	0.2.4	# MIT OR Apache-2.0
MODCARGO_CRATES +=	untrusted	0.9.0	# ISC
MODCARGO_CRATES +=	url	2.5.0	# MIT OR Apache-2.0
MODCARGO_CRATES +=	utf-8	0.7.6	# MIT OR Apache-2.0
MODCARGO_CRATES +=	uuid	1.7.0	# Apache-2.0 OR MIT
MODCARGO_CRATES +=	valuable	0.1.0	# MIT
MODCARGO_CRATES +=	value-bag	1.7.0	# Apache-2.0 OR MIT
MODCARGO_CRATES +=	vcpkg	0.2.15	# MIT/Apache-2.0
MODCARGO_CRATES +=	version_check	0.9.4	# MIT/Apache-2.0
MODCARGO_CRATES +=	waker-fn	1.1.1	# Apache-2.0 OR MIT
MODCARGO_CRATES +=	walkdir	2.4.0	# Unlicense/MIT
MODCARGO_CRATES +=	want	0.3.1	# MIT
MODCARGO_CRATES +=	wasi	0.11.0+wasi-snapshot-preview1	# Apache-2.0 WITH LLVM-exception OR Apache-2.0 OR MIT
MODCARGO_CRATES +=	wasm-bindgen	0.2.91	# MIT OR Apache-2.0
MODCARGO_CRATES +=	wasm-bindgen-backend	0.2.91	# MIT OR Apache-2.0
MODCARGO_CRATES +=	wasm-bindgen-futures	0.4.41	# MIT OR Apache-2.0
MODCARGO_CRATES +=	wasm-bindgen-macro	0.2.91	# MIT OR Apache-2.0
MODCARGO_CRATES +=	wasm-bindgen-macro-support	0.2.91	# MIT OR Apache-2.0
MODCARGO_CRATES +=	wasm-bindgen-shared	0.2.91	# MIT OR Apache-2.0
MODCARGO_CRATES +=	wasm-streams	0.4.0	# MIT OR Apache-2.0
MODCARGO_CRATES +=	web-sys	0.3.68	# MIT OR Apache-2.0
MODCARGO_CRATES +=	webauthn-rs	0.3.2	# MPL-2.0
MODCARGO_CRATES +=	which	6.0.0	# MIT
MODCARGO_CRATES +=	widestring	1.0.2	# MIT OR Apache-2.0
MODCARGO_CRATES +=	winapi	0.3.9	# MIT/Apache-2.0
MODCARGO_CRATES +=	winapi-i686-pc-windows-gnu	0.4.0	# MIT/Apache-2.0
MODCARGO_CRATES +=	winapi-util	0.1.6	# Unlicense/MIT
MODCARGO_CRATES +=	winapi-x86_64-pc-windows-gnu	0.4.0	# MIT/Apache-2.0
MODCARGO_CRATES +=	windows	0.48.0	# MIT OR Apache-2.0
MODCARGO_CRATES +=	windows-core	0.52.0	# MIT OR Apache-2.0
MODCARGO_CRATES +=	windows-sys	0.48.0	# MIT OR Apache-2.0
MODCARGO_CRATES +=	windows-sys	0.52.0	# MIT OR Apache-2.0
MODCARGO_CRATES +=	windows-targets	0.48.5	# MIT OR Apache-2.0
MODCARGO_CRATES +=	windows-targets	0.52.3	# MIT OR Apache-2.0
MODCARGO_CRATES +=	windows_aarch64_gnullvm	0.48.5	# MIT OR Apache-2.0
MODCARGO_CRATES +=	windows_aarch64_gnullvm	0.52.3	# MIT OR Apache-2.0
MODCARGO_CRATES +=	windows_aarch64_msvc	0.48.5	# MIT OR Apache-2.0
MODCARGO_CRATES +=	windows_aarch64_msvc	0.52.3	# MIT OR Apache-2.0
MODCARGO_CRATES +=	windows_i686_gnu	0.48.5	# MIT OR Apache-2.0
MODCARGO_CRATES +=	windows_i686_gnu	0.52.3	# MIT OR Apache-2.0
MODCARGO_CRATES +=	windows_i686_msvc	0.48.5	# MIT OR Apache-2.0
MODCARGO_CRATES +=	windows_i686_msvc	0.52.3	# MIT OR Apache-2.0
MODCARGO_CRATES +=	windows_x86_64_gnu	0.48.5	# MIT OR Apache-2.0
MODCARGO_CRATES +=	windows_x86_64_gnu	0.52.3	# MIT OR Apache-2.0
MODCARGO_CRATES +=	windows_x86_64_gnullvm	0.48.5	# MIT OR Apache-2.0
MODCARGO_CRATES +=	windows_x86_64_gnullvm	0.52.3	# MIT OR Apache-2.0
MODCARGO_CRATES +=	windows_x86_64_msvc	0.48.5	# MIT OR Apache-2.0
MODCARGO_CRATES +=	windows_x86_64_msvc	0.52.3	# MIT OR Apache-2.0
MODCARGO_CRATES +=	winnow	0.5.40	# MIT
MODCARGO_CRATES +=	winnow	0.6.2	# MIT
MODCARGO_CRATES +=	winreg	0.50.0	# MIT
MODCARGO_CRATES +=	yansi	1.0.0-rc.1	# MIT OR Apache-2.0
MODCARGO_CRATES +=	yubico	0.11.0	# MIT OR Apache-2.0
MODCARGO_CRATES +=	zerocopy	0.7.32	# BSD-2-Clause OR Apache-2.0 OR MIT
MODCARGO_CRATES +=	zerocopy-derive	0.7.32	# BSD-2-Clause OR Apache-2.0 OR MIT
