MODCARGO_CRATES +=	aho-corasick	1.1.4	# Unlicense OR MIT
MODCARGO_CRATES +=	annotate-snippets	0.11.5	# MIT OR Apache-2.0
MODCARGO_CRATES +=	anstyle	1.0.14	# MIT OR Apache-2.0
MODCARGO_CRATES +=	askama	0.14.0	# MIT OR Apache-2.0
MODCARGO_CRATES +=	askama_derive	0.14.0	# MIT OR Apache-2.0
MODCARGO_CRATES +=	askama_parser	0.14.0	# MIT OR Apache-2.0
MODCARGO_CRATES +=	aws-lc-fips-sys	0.13.14	# ISC AND (Apache-2.0 OR ISC) AND OpenSSL
MODCARGO_CRATES +=	aws-lc-sys	0.41.0	# ISC AND (Apache-2.0 OR ISC) AND Apache-2.0 AND MIT AND BSD-3-Clause AND (Apache-2.0 OR ISC OR MIT) AND (Apache-2.0 OR ISC OR MIT-0)
MODCARGO_CRATES +=	basic-toml	0.1.10	# MIT OR Apache-2.0
MODCARGO_CRATES +=	bindgen	0.72.1	# BSD-3-Clause
MODCARGO_CRATES +=	bitflags	2.13.0	# MIT OR Apache-2.0
MODCARGO_CRATES +=	bssl-sys	0.1.0	# MIT
MODCARGO_CRATES +=	cc	1.2.65	# MIT OR Apache-2.0
MODCARGO_CRATES +=	cexpr	0.6.0	# Apache-2.0/MIT
MODCARGO_CRATES +=	cfg-if	1.0.4	# MIT OR Apache-2.0
MODCARGO_CRATES +=	clang-sys	1.8.1	# Apache-2.0
MODCARGO_CRATES +=	cmake	0.1.58	# MIT OR Apache-2.0
MODCARGO_CRATES +=	ctest	0.5.1	# MIT OR Apache-2.0
MODCARGO_CRATES +=	dunce	1.0.5	# CC0-1.0 OR MIT-0 OR Apache-2.0
MODCARGO_CRATES +=	either	1.16.0	# MIT OR Apache-2.0
MODCARGO_CRATES +=	find-msvc-tools	0.1.9	# MIT OR Apache-2.0
MODCARGO_CRATES +=	foreign-types	0.3.2	# MIT/Apache-2.0
MODCARGO_CRATES +=	foreign-types-shared	0.1.1	# MIT/Apache-2.0
MODCARGO_CRATES +=	fs_extra	1.3.0	# MIT
MODCARGO_CRATES +=	getrandom	0.3.4	# MIT OR Apache-2.0
MODCARGO_CRATES +=	glob	0.3.3	# MIT OR Apache-2.0
MODCARGO_CRATES +=	hex	0.4.3	# MIT OR Apache-2.0
MODCARGO_CRATES +=	itertools	0.13.0	# MIT OR Apache-2.0
MODCARGO_CRATES +=	itoa	1.0.18	# MIT OR Apache-2.0
MODCARGO_CRATES +=	jobserver	0.1.34	# MIT OR Apache-2.0
MODCARGO_CRATES +=	libc	0.2.186	# MIT OR Apache-2.0
MODCARGO_CRATES +=	libloading	0.8.9	# ISC
MODCARGO_CRATES +=	log	0.4.33	# MIT OR Apache-2.0
MODCARGO_CRATES +=	memchr	2.8.2	# Unlicense OR MIT
MODCARGO_CRATES +=	minimal-lexical	0.2.1	# MIT/Apache-2.0
MODCARGO_CRATES +=	nom	7.1.3	# MIT
MODCARGO_CRATES +=	openssl-src	300.6.1+3.6.3	# MIT/Apache-2.0
MODCARGO_CRATES +=	percent-encoding	2.3.2	# MIT OR Apache-2.0
MODCARGO_CRATES +=	pkg-config	0.3.33	# MIT OR Apache-2.0
MODCARGO_CRATES +=	prettyplease	0.2.37	# MIT OR Apache-2.0
MODCARGO_CRATES +=	proc-macro2	1.0.106	# MIT OR Apache-2.0
MODCARGO_CRATES +=	quote	1.0.46	# MIT OR Apache-2.0
MODCARGO_CRATES +=	r-efi	5.3.0	# MIT OR Apache-2.0 OR LGPL-2.1-or-later
MODCARGO_CRATES +=	regex	1.12.4	# MIT OR Apache-2.0
MODCARGO_CRATES +=	regex-automata	0.4.14	# MIT OR Apache-2.0
MODCARGO_CRATES +=	regex-syntax	0.8.11	# MIT OR Apache-2.0
MODCARGO_CRATES +=	rustc-hash	2.1.2	# Apache-2.0 OR MIT
MODCARGO_CRATES +=	serde	1.0.228	# MIT OR Apache-2.0
MODCARGO_CRATES +=	serde_core	1.0.228	# MIT OR Apache-2.0
MODCARGO_CRATES +=	serde_derive	1.0.228	# MIT OR Apache-2.0
MODCARGO_CRATES +=	serde_json	1.0.150	# MIT OR Apache-2.0
MODCARGO_CRATES +=	shlex	1.3.0	# MIT OR Apache-2.0
MODCARGO_CRATES +=	shlex	2.0.1	# MIT OR Apache-2.0
MODCARGO_CRATES +=	syn	2.0.118	# MIT OR Apache-2.0
MODCARGO_CRATES +=	thiserror	2.0.18	# MIT OR Apache-2.0
MODCARGO_CRATES +=	thiserror-impl	2.0.18	# MIT OR Apache-2.0
MODCARGO_CRATES +=	unicode-ident	1.0.24	# (MIT OR Apache-2.0) AND Unicode-3.0
MODCARGO_CRATES +=	unicode-width	0.2.2	# MIT OR Apache-2.0
MODCARGO_CRATES +=	vcpkg	0.2.15	# MIT/Apache-2.0
MODCARGO_CRATES +=	wasip2	1.0.4+wasi-0.2.12	# Apache-2.0 WITH LLVM-exception OR Apache-2.0 OR MIT
MODCARGO_CRATES +=	windows-link	0.2.1	# MIT OR Apache-2.0
MODCARGO_CRATES +=	winnow	0.7.15	# MIT
MODCARGO_CRATES +=	wit-bindgen	0.57.1	# Apache-2.0 WITH LLVM-exception OR Apache-2.0 OR MIT
MODCARGO_CRATES +=	zmij	1.0.21	# MIT
