MODGO_MODULES =	\
	c2sp.org/!c!c!t!v/age		 v0.0.0-20251208015420-e9274a7bdbfd \
	filippo.io/edwards25519		 v1.1.0 \
	filippo.io/hpke			 v0.4.0 \
	filippo.io/nistec		 v0.0.4 \
	github.com/evanw/esbuild	 v0.24.2 \
	github.com/google/go-cmp	 v0.6.0 \
	github.com/rogpeppe/go-internal	 v1.14.1 \
	github.com/yuin/goldmark	 v1.4.13 \
	golang.org/x/crypto		 v0.45.0 \
	golang.org/x/mod		 v0.30.0 \
	golang.org/x/net		 v0.47.0 \
	golang.org/x/sync		 v0.18.0 \
	golang.org/x/sys		 v0.38.0 \
	golang.org/x/telemetry		 v0.0.0-20251111182119-bc8e575c7b54 \
	golang.org/x/term		 v0.37.0 \
	golang.org/x/text		 v0.31.0 \
	golang.org/x/tools		 v0.39.0

MODGO_MODFILES =	\
	golang.org/x/crypto	 v0.32.0 \
	golang.org/x/crypto	 v0.41.0 \
	golang.org/x/mod	 v0.21.0 \
	golang.org/x/sys	 v0.26.0 \
	golang.org/x/sys	 v0.29.0 \
	golang.org/x/sys	 v0.35.0 \
	golang.org/x/sys	 v0.36.0 \
	golang.org/x/tools	 v0.26.0

