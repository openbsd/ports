MODCARGO_CRATES +=	asn1	0.24.1	# BSD-3-Clause
MODCARGO_CRATES +=	asn1_derive	0.24.1	# BSD-3-Clause
MODCARGO_CRATES +=	base64	0.22.1	# MIT OR Apache-2.0
MODCARGO_CRATES +=	bitflags	2.13.0	# MIT OR Apache-2.0
MODCARGO_CRATES +=	cc	1.2.64	# MIT OR Apache-2.0
MODCARGO_CRATES +=	cfg-if	1.0.4	# MIT OR Apache-2.0
MODCARGO_CRATES +=	find-msvc-tools	0.1.9	# MIT OR Apache-2.0
MODCARGO_CRATES +=	foreign-types	0.3.2	# MIT/Apache-2.0
MODCARGO_CRATES +=	foreign-types-shared	0.1.1	# MIT/Apache-2.0
MODCARGO_CRATES +=	heck	0.5.0	# MIT OR Apache-2.0
MODCARGO_CRATES +=	itoa	1.0.18	# MIT OR Apache-2.0
MODCARGO_CRATES +=	libc	0.2.186	# MIT OR Apache-2.0
MODCARGO_CRATES +=	once_cell	1.21.4	# MIT OR Apache-2.0
MODCARGO_CRATES +=	openssl	0.10.81	# Apache-2.0
MODCARGO_CRATES +=	openssl-macros	0.1.1	# MIT/Apache-2.0
MODCARGO_CRATES +=	openssl-sys	0.9.117	# MIT
MODCARGO_CRATES +=	pem	3.0.6	# MIT
MODCARGO_CRATES +=	pkg-config	0.3.33	# MIT OR Apache-2.0
MODCARGO_CRATES +=	portable-atomic	1.13.1	# Apache-2.0 OR MIT
MODCARGO_CRATES +=	proc-macro2	1.0.106	# MIT OR Apache-2.0
MODCARGO_CRATES +=	pyo3	0.29.0	# MIT OR Apache-2.0
MODCARGO_CRATES +=	pyo3-build-config	0.29.0	# MIT OR Apache-2.0
MODCARGO_CRATES +=	pyo3-ffi	0.29.0	# MIT OR Apache-2.0
MODCARGO_CRATES +=	pyo3-macros	0.29.0	# MIT OR Apache-2.0
MODCARGO_CRATES +=	pyo3-macros-backend	0.29.0	# MIT OR Apache-2.0
MODCARGO_CRATES +=	quote	1.0.45	# MIT OR Apache-2.0
MODCARGO_CRATES +=	self_cell	1.2.2	# Apache-2.0 OR GPL-2.0-only
MODCARGO_CRATES +=	shlex	2.0.1	# MIT OR Apache-2.0
MODCARGO_CRATES +=	syn	2.0.117	# MIT OR Apache-2.0
MODCARGO_CRATES +=	target-lexicon	0.13.5	# Apache-2.0 WITH LLVM-exception
MODCARGO_CRATES +=	unicode-ident	1.0.24	# (MIT OR Apache-2.0) AND Unicode-3.0
MODCARGO_CRATES +=	vcpkg	0.2.15	# MIT/Apache-2.0
