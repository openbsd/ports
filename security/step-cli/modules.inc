MODGO_MODULES =	\
	bitbucket.org/creachadair/shell							 v0.0.8 \
	cel.dev/expr									 v0.16.0 \
	cloud.google.com/go								 v0.116.0 \
	cloud.google.com/go/accessapproval						 v1.8.2 \
	cloud.google.com/go/accesscontextmanager					 v1.9.2 \
	cloud.google.com/go/aiplatform							 v1.68.0 \
	cloud.google.com/go/analytics							 v0.25.2 \
	cloud.google.com/go/apigateway							 v1.7.2 \
	cloud.google.com/go/apigeeconnect						 v1.7.2 \
	cloud.google.com/go/apigeeregistry						 v0.9.2 \
	cloud.google.com/go/appengine							 v1.9.2 \
	cloud.google.com/go/area120							 v0.9.2 \
	cloud.google.com/go/artifactregistry						 v1.15.2 \
	cloud.google.com/go/asset							 v1.20.3 \
	cloud.google.com/go/assuredworkloads						 v1.12.2 \
	cloud.google.com/go/auth							 v0.10.2 \
	cloud.google.com/go/auth/oauth2adapt						 v0.2.5 \
	cloud.google.com/go/automl							 v1.14.2 \
	cloud.google.com/go/baremetalsolution						 v1.3.2 \
	cloud.google.com/go/batch							 v1.11.2 \
	cloud.google.com/go/beyondcorp							 v1.1.2 \
	cloud.google.com/go/bigquery							 v1.64.0 \
	cloud.google.com/go/bigtable							 v1.33.0 \
	cloud.google.com/go/billing							 v1.19.2 \
	cloud.google.com/go/binaryauthorization						 v1.9.2 \
	cloud.google.com/go/certificatemanager						 v1.9.2 \
	cloud.google.com/go/channel							 v1.19.1 \
	cloud.google.com/go/cloudbuild							 v1.18.1 \
	cloud.google.com/go/clouddms							 v1.8.2 \
	cloud.google.com/go/cloudtasks							 v1.13.2 \
	cloud.google.com/go/compute							 v1.28.2 \
	cloud.google.com/go/compute/metadata						 v0.5.2 \
	cloud.google.com/go/contactcenterinsights					 v1.15.1 \
	cloud.google.com/go/container							 v1.41.0 \
	cloud.google.com/go/containeranalysis						 v0.13.2 \
	cloud.google.com/go/datacatalog							 v1.22.2 \
	cloud.google.com/go/dataflow							 v0.10.2 \
	cloud.google.com/go/dataform							 v0.10.2 \
	cloud.google.com/go/datafusion							 v1.8.2 \
	cloud.google.com/go/datalabeling						 v0.9.2 \
	cloud.google.com/go/dataplex							 v1.19.2 \
	cloud.google.com/go/dataproc/v2							 v2.10.0 \
	cloud.google.com/go/dataqna							 v0.9.2 \
	cloud.google.com/go/datastore							 v1.20.0 \
	cloud.google.com/go/datastream							 v1.11.2 \
	cloud.google.com/go/deploy							 v1.23.1 \
	cloud.google.com/go/dialogflow							 v1.58.1 \
	cloud.google.com/go/dlp								 v1.20.0 \
	cloud.google.com/go/documentai							 v1.35.0 \
	cloud.google.com/go/domains							 v0.10.2 \
	cloud.google.com/go/edgecontainer						 v1.3.2 \
	cloud.google.com/go/errorreporting						 v0.3.1 \
	cloud.google.com/go/essentialcontacts						 v1.7.2 \
	cloud.google.com/go/eventarc							 v1.14.2 \
	cloud.google.com/go/filestore							 v1.9.2 \
	cloud.google.com/go/firestore							 v1.17.0 \
	cloud.google.com/go/functions							 v1.19.2 \
	cloud.google.com/go/gkebackup							 v1.6.2 \
	cloud.google.com/go/gkeconnect							 v0.11.2 \
	cloud.google.com/go/gkehub							 v0.15.2 \
	cloud.google.com/go/gkemulticloud						 v1.4.1 \
	cloud.google.com/go/gsuiteaddons						 v1.7.2 \
	cloud.google.com/go/iam								 v1.2.2 \
	cloud.google.com/go/iap								 v1.10.2 \
	cloud.google.com/go/ids								 v1.5.2 \
	cloud.google.com/go/iot								 v1.8.2 \
	cloud.google.com/go/kms								 v1.20.1 \
	cloud.google.com/go/language							 v1.14.2 \
	cloud.google.com/go/lifesciences						 v0.10.2 \
	cloud.google.com/go/logging							 v1.12.0 \
	cloud.google.com/go/longrunning							 v0.6.2 \
	cloud.google.com/go/managedidentities						 v1.7.2 \
	cloud.google.com/go/maps							 v1.14.1 \
	cloud.google.com/go/mediatranslation						 v0.9.2 \
	cloud.google.com/go/memcache							 v1.11.2 \
	cloud.google.com/go/metastore							 v1.14.2 \
	cloud.google.com/go/monitoring							 v1.21.2 \
	cloud.google.com/go/networkconnectivity						 v1.15.2 \
	cloud.google.com/go/networkmanagement						 v1.15.0 \
	cloud.google.com/go/networksecurity						 v0.10.2 \
	cloud.google.com/go/notebooks							 v1.12.2 \
	cloud.google.com/go/optimization						 v1.7.2 \
	cloud.google.com/go/orchestration						 v1.11.1 \
	cloud.google.com/go/orgpolicy							 v1.14.1 \
	cloud.google.com/go/osconfig							 v1.14.2 \
	cloud.google.com/go/oslogin							 v1.14.2 \
	cloud.google.com/go/phishingprotection						 v0.9.2 \
	cloud.google.com/go/policytroubleshooter					 v1.11.2 \
	cloud.google.com/go/privatecatalog						 v0.10.2 \
	cloud.google.com/go/pubsub							 v1.45.1 \
	cloud.google.com/go/pubsublite							 v1.8.2 \
	cloud.google.com/go/recaptchaenterprise/v2					 v2.17.3 \
	cloud.google.com/go/recommendationengine					 v0.9.2 \
	cloud.google.com/go/recommender							 v1.13.2 \
	cloud.google.com/go/redis							 v1.17.2 \
	cloud.google.com/go/resourcemanager						 v1.10.2 \
	cloud.google.com/go/resourcesettings						 v1.8.2 \
	cloud.google.com/go/retail							 v1.19.1 \
	cloud.google.com/go/run								 v1.6.1 \
	cloud.google.com/go/scheduler							 v1.11.2 \
	cloud.google.com/go/secretmanager						 v1.14.2 \
	cloud.google.com/go/security							 v1.18.2 \
	cloud.google.com/go/securitycenter						 v1.35.2 \
	cloud.google.com/go/servicedirectory						 v1.12.2 \
	cloud.google.com/go/shell							 v1.8.2 \
	cloud.google.com/go/spanner							 v1.71.0 \
	cloud.google.com/go/speech							 v1.25.2 \
	cloud.google.com/go/storage							 v1.43.0 \
	cloud.google.com/go/storagetransfer						 v1.11.2 \
	cloud.google.com/go/talent							 v1.7.2 \
	cloud.google.com/go/texttospeech						 v1.9.0 \
	cloud.google.com/go/tpu								 v1.7.2 \
	cloud.google.com/go/trace							 v1.11.2 \
	cloud.google.com/go/translate							 v1.12.2 \
	cloud.google.com/go/video							 v1.23.2 \
	cloud.google.com/go/videointelligence						 v1.12.2 \
	cloud.google.com/go/vision/v2							 v2.9.2 \
	cloud.google.com/go/vmmigration							 v1.8.2 \
	cloud.google.com/go/vmwareengine						 v1.3.2 \
	cloud.google.com/go/vpcaccess							 v1.8.2 \
	cloud.google.com/go/webrisk							 v1.10.2 \
	cloud.google.com/go/websecurityscanner						 v1.7.2 \
	cloud.google.com/go/workflows							 v1.13.2 \
	contrib.go.opencensus.io/exporter/stackdriver					 v0.13.14 \
	dario.cat/mergo									 v1.0.1 \
	filippo.io/edwards25519								 v1.1.0 \
	github.com/!andreas!briese/bbloom						 v0.0.0-20190825152654-46b345b51c96 \
	github.com/!azure!a!d/microsoft-authentication-extensions-for-go/cache		 v0.1.1 \
	github.com/!azure!a!d/microsoft-authentication-library-for-go			 v1.2.2 \
	github.com/!azure/azure-sdk-for-go/sdk/azcore					 v1.16.0 \
	github.com/!azure/azure-sdk-for-go/sdk/azidentity				 v1.8.0 \
	github.com/!azure/azure-sdk-for-go/sdk/azidentity/cache				 v0.3.0 \
	github.com/!azure/azure-sdk-for-go/sdk/internal					 v1.10.0 \
	github.com/!azure/azure-sdk-for-go/sdk/keyvault/azkeys				 v0.10.0 \
	github.com/!azure/azure-sdk-for-go/sdk/keyvault/internal			 v0.7.1 \
	github.com/!burnt!sushi/toml							 v1.4.0 \
	github.com/!d!a!t!a-!d!o!g/go-sqlmock						 v1.5.2 \
	github.com/!masterminds/goutils							 v1.1.1 \
	github.com/!masterminds/semver/v3						 v3.3.0 \
	github.com/!masterminds/sprig/v3						 v3.3.0 \
	github.com/!microsoft/go-winio							 v0.6.2 \
	github.com/!one!of!one/xxhash							 v1.2.2 \
	github.com/!thales!ignite/crypto11						 v1.2.5 \
	github.com/!thomas!rooney/gexpect						 v0.0.0-20161231170123-5482f0350944 \
	github.com/alecthomas/kingpin/v2						 v2.4.0 \
	github.com/alecthomas/units							 v0.0.0-20211218093645-b94a6e3cc137 \
	github.com/anmitsu/go-shlex							 v0.0.0-20200514113438-38f4b401e2be \
	github.com/armon/consul-api							 v0.0.0-20180202201655-eb2c6b5be1b6 \
	github.com/armon/go-radix							 v1.0.0 \
	github.com/asaskevich/govalidator						 v0.0.0-20210307081110-f21760c49a8d \
	github.com/aws/aws-sdk-go							 v1.51.8 \
	github.com/aws/aws-sdk-go-v2							 v1.32.4 \
	github.com/aws/aws-sdk-go-v2/config						 v1.28.3 \
	github.com/aws/aws-sdk-go-v2/credentials					 v1.17.44 \
	github.com/aws/aws-sdk-go-v2/feature/ec2/imds					 v1.16.19 \
	github.com/aws/aws-sdk-go-v2/internal/configsources				 v1.3.23 \
	github.com/aws/aws-sdk-go-v2/internal/endpoints/v2				 v2.6.23 \
	github.com/aws/aws-sdk-go-v2/internal/ini					 v1.8.1 \
	github.com/aws/aws-sdk-go-v2/service/internal/accept-encoding			 v1.12.0 \
	github.com/aws/aws-sdk-go-v2/service/internal/presigned-url			 v1.12.4 \
	github.com/aws/aws-sdk-go-v2/service/kms					 v1.37.5 \
	github.com/aws/aws-sdk-go-v2/service/sso					 v1.24.5 \
	github.com/aws/aws-sdk-go-v2/service/ssooidc					 v1.28.4 \
	github.com/aws/aws-sdk-go-v2/service/sts					 v1.32.4 \
	github.com/aws/smithy-go							 v1.22.0 \
	github.com/beorn7/perks								 v1.0.1 \
	github.com/bgentry/speakeasy							 v0.1.0 \
	github.com/bits-and-blooms/bitset						 v1.13.0 \
	github.com/boombuler/barcode							 v1.0.1 \
	github.com/bufbuild/protocompile						 v0.10.0 \
	github.com/cenkalti/backoff/v4							 v4.3.0 \
	github.com/census-instrumentation/opencensus-proto				 v0.4.1 \
	github.com/cespare/xxhash							 v1.1.0 \
	github.com/cespare/xxhash/v2							 v2.3.0 \
	github.com/chzyer/logex								 v1.2.1 \
	github.com/chzyer/readline							 v1.5.1 \
	github.com/chzyer/test								 v1.0.0 \
	github.com/client9/misspell							 v0.3.4 \
	github.com/cncf/udpa/go								 v0.0.0-20191209042840-269d4d468f6f \
	github.com/cncf/xds/go								 v0.0.0-20240723142845-024c85f92f20 \
	github.com/coreos/etcd								 v3.3.10+incompatible \
	github.com/coreos/go-etcd							 v2.0.0+incompatible \
	github.com/coreos/go-oidc/v3							 v3.11.0 \
	github.com/coreos/go-semver							 v0.3.1 \
	github.com/coreos/go-systemd/v22						 v22.5.0 \
	github.com/corpix/uarand							 v0.2.0 \
	github.com/cpuguy83/go-md2man							 v1.0.10 \
	github.com/cpuguy83/go-md2man/v2						 v2.0.5 \
	github.com/creack/pty								 v1.1.18 \
	github.com/cyberdelia/go-metrics-graphite					 v0.0.0-20161219230853-39f87cc3b432 \
	github.com/davecgh/go-spew							 v1.1.1 \
	github.com/dgraph-io/badger							 v1.6.2 \
	github.com/dgraph-io/badger/v2							 v2.2007.4 \
	github.com/dgraph-io/ristretto							 v0.1.1 \
	github.com/dgryski/go-farm							 v0.0.0-20200201041132-a6ae2369ad13 \
	github.com/dgryski/go-rendezvous						 v0.0.0-20200823014737-9f7001d12a5f \
	github.com/dnaeon/go-vcr							 v1.1.0 \
	github.com/dustin/go-humanize							 v1.0.1 \
	github.com/envoyproxy/go-control-plane						 v0.13.0 \
	github.com/envoyproxy/protoc-gen-validate					 v1.1.0 \
	github.com/fatih/color								 v1.16.0 \
	github.com/felixge/httpsnoop							 v1.0.4 \
	github.com/flynn/noise								 v1.1.0 \
	github.com/frankban/quicktest							 v1.14.6 \
	github.com/fsnotify/fsnotify							 v1.4.7 \
	github.com/fullstorydev/grpcurl							 v1.9.1 \
	github.com/fxamacker/cbor/v2							 v2.7.0 \
	github.com/gaissmai/bart							 v0.11.1 \
	github.com/go-chi/chi/v5							 v5.1.0 \
	github.com/go-jose/go-jose/v3							 v3.0.3 \
	github.com/go-jose/go-jose/v4							 v4.0.2 \
	github.com/go-kit/log								 v0.2.1 \
	github.com/go-logfmt/logfmt							 v0.5.1 \
	github.com/go-logr/logr								 v1.4.2 \
	github.com/go-logr/stdr								 v1.2.2 \
	github.com/go-piv/piv-go/v2							 v2.3.0 \
	github.com/go-sql-driver/mysql							 v1.8.1 \
	github.com/gogo/protobuf							 v1.3.2 \
	github.com/golang-jwt/jwt							 v3.2.1+incompatible \
	github.com/golang-jwt/jwt/v4							 v4.5.0 \
	github.com/golang-jwt/jwt/v5							 v5.2.1 \
	github.com/golang/glog								 v1.2.2 \
	github.com/golang/groupcache							 v0.0.0-20210331224755-41bb18bfe9da \
	github.com/golang/mock								 v1.6.0 \
	github.com/golang/protobuf							 v1.5.4 \
	github.com/golang/snappy							 v0.0.4 \
	github.com/google/btree								 v1.1.3 \
	github.com/google/certificate-transparency-go					 v1.2.2 \
	github.com/google/go-attestation						 v0.5.0 \
	github.com/google/go-cmp							 v0.6.0 \
	github.com/google/go-configfs-tsm						 v0.2.2 \
	github.com/google/go-github							 v17.0.0+incompatible \
	github.com/google/go-pkcs11							 v0.3.0 \
	github.com/google/go-querystring						 v1.0.0 \
	github.com/google/go-sev-guest							 v0.9.3 \
	github.com/google/go-tdx-guest							 v0.3.1 \
	github.com/google/go-tpm							 v0.9.1 \
	github.com/google/go-tpm-tools							 v0.4.4 \
	github.com/google/go-tspi							 v0.3.0 \
	github.com/google/gopacket							 v1.1.19 \
	github.com/google/logger							 v1.1.1 \
	github.com/google/martian/v3							 v3.3.3 \
	github.com/google/s2a-go							 v0.1.8 \
	github.com/google/trillian							 v1.6.1 \
	github.com/google/uuid								 v1.6.0 \
	github.com/googleapis/enterprise-certificate-proxy				 v0.3.4 \
	github.com/googleapis/gax-go/v2							 v2.14.0 \
	github.com/gorilla/mux								 v1.8.1 \
	github.com/gorilla/websocket							 v1.5.1 \
	github.com/grpc-ecosystem/go-grpc-middleware					 v1.4.0 \
	github.com/grpc-ecosystem/go-grpc-prometheus					 v1.2.0 \
	github.com/grpc-ecosystem/grpc-gateway						 v1.16.0 \
	github.com/grpc-ecosystem/grpc-gateway/v2					 v2.19.1 \
	github.com/hashicorp/errwrap							 v1.1.0 \
	github.com/hashicorp/go-cleanhttp						 v0.5.2 \
	github.com/hashicorp/go-hclog							 v1.6.3 \
	github.com/hashicorp/go-multierror						 v1.1.1 \
	github.com/hashicorp/go-retryablehttp						 v0.7.7 \
	github.com/hashicorp/go-rootcerts						 v1.0.2 \
	github.com/hashicorp/go-secure-stdlib/awsutil					 v0.1.6 \
	github.com/hashicorp/go-secure-stdlib/parseutil					 v0.1.6 \
	github.com/hashicorp/go-secure-stdlib/strutil					 v0.1.2 \
	github.com/hashicorp/go-sockaddr						 v1.0.2 \
	github.com/hashicorp/go-uuid							 v1.0.2 \
	github.com/hashicorp/golang-lru/v2						 v2.0.7 \
	github.com/hashicorp/hcl							 v1.0.0 \
	github.com/hashicorp/vault/api							 v1.15.0 \
	github.com/hashicorp/vault/api/auth/approle					 v0.8.0 \
	github.com/hashicorp/vault/api/auth/aws						 v0.8.0 \
	github.com/hashicorp/vault/api/auth/kubernetes					 v0.8.0 \
	github.com/huandu/xstrings							 v1.5.0 \
	github.com/icrowley/fake							 v0.0.0-20221112152111-d7b7e2276db2 \
	github.com/inconshreveable/mousetrap						 v1.1.0 \
	github.com/jackc/pgpassfile							 v1.0.0 \
	github.com/jackc/pgservicefile							 v0.0.0-20221227161230-091c0ba34f0a \
	github.com/jackc/pgx/v5								 v5.6.0 \
	github.com/jackc/puddle/v2							 v2.2.1 \
	github.com/jessevdk/go-flags							 v1.4.0 \
	github.com/jhump/protoreflect							 v1.16.0 \
	github.com/jmespath/go-jmespath							 v0.4.1-0.20220621161143-b0104c826a24 \
	github.com/jonboulle/clockwork							 v0.4.0 \
	github.com/jpillora/backoff							 v1.0.0 \
	github.com/json-iterator/go							 v1.1.12 \
	github.com/julienschmidt/httprouter						 v1.3.0 \
	github.com/kardianos/service							 v1.2.2 \
	github.com/kballard/go-shellquote						 v0.0.0-20180428030007-95032a82bc51 \
	github.com/keybase/go-keychain							 v0.0.0-20231219164618-57a3676c3af6 \
	github.com/klauspost/compress							 v1.17.9 \
	github.com/konsorten/go-windows-terminal-sequences				 v1.0.1 \
	github.com/kr/pretty								 v0.3.1 \
	github.com/kr/pty								 v1.1.8 \
	github.com/kr/text								 v0.2.0 \
	github.com/kylelemons/godebug							 v1.1.0 \
	github.com/letsencrypt/pkcs11key/v4						 v4.0.0 \
	github.com/lib/pq								 v1.10.9 \
	github.com/magiconair/properties						 v1.8.0 \
	github.com/manifoldco/promptui							 v0.9.0 \
	github.com/mattn/go-colorable							 v0.1.13 \
	github.com/mattn/go-isatty							 v0.0.20 \
	github.com/mattn/go-runewidth							 v0.0.13 \
	github.com/mattn/go-sqlite3							 v1.14.24 \
	github.com/mgutz/ansi								 v0.0.0-20200706080929-d51e80ef957d \
	github.com/miekg/dns								 v1.1.61 \
	github.com/miekg/pkcs11								 v1.1.1 \
	github.com/mitchellh/copystructure						 v1.2.0 \
	github.com/mitchellh/go-homedir							 v1.1.0 \
	github.com/mitchellh/mapstructure						 v1.5.0 \
	github.com/mitchellh/reflectwalk						 v1.0.2 \
	github.com/modern-go/concurrent							 v0.0.0-20180306012644-bacd9c7ef1dd \
	github.com/modern-go/reflect2							 v1.0.2 \
	github.com/montanaflynn/stats							 v0.7.0 \
	github.com/mreiferson/go-httpclient						 v0.0.0-20160630210159-31f0106b4474 \
	github.com/munnerz/goautoneg							 v0.0.0-20191010083416-a7dc8b61c822 \
	github.com/mwitkow/go-conntrack							 v0.0.0-20190716064945-2f068394615f \
	github.com/nbrownus/go-metrics-prometheus					 v0.0.0-20210712211119-974a6260965f \
	github.com/newrelic/go-agent/v3							 v3.35.1 \
	github.com/olekukonko/tablewriter						 v0.0.5 \
	github.com/op/go-logging							 v0.0.0-20160315200505-970db520ece7 \
	github.com/pborman/uuid								 v1.2.1 \
	github.com/pelletier/go-toml							 v1.2.0 \
	github.com/peterbourgon/diskv/v3						 v3.0.1 \
	github.com/pkg/browser								 v0.0.0-20240102092130-5ac0b6a4141c \
	github.com/pkg/errors								 v0.9.1 \
	github.com/planetscale/vtprotobuf						 v0.6.1-0.20240319094008-0393e58bdf10 \
	github.com/pmezard/go-difflib							 v1.0.0 \
	github.com/pquerna/otp								 v1.4.0 \
	github.com/prometheus/client_golang						 v1.20.5 \
	github.com/prometheus/client_model						 v0.6.1 \
	github.com/prometheus/common							 v0.55.0 \
	github.com/prometheus/procfs							 v0.15.1 \
	github.com/prometheus/prometheus						 v0.51.0 \
	github.com/rcrowley/go-metrics							 v0.0.0-20201227073835-cf1acfcdf475 \
	github.com/redis/go-redis/v9							 v9.6.1 \
	github.com/rivo/uniseg								 v0.4.4 \
	github.com/rogpeppe/go-internal							 v1.12.0 \
	github.com/rs/cors								 v1.11.1 \
	github.com/rs/xid								 v1.6.0 \
	github.com/russross/blackfriday							 v1.5.2 \
	github.com/russross/blackfriday/v2						 v2.1.0 \
	github.com/ryanuber/go-glob							 v1.0.0 \
	github.com/schollz/jsonstore							 v1.1.0 \
	github.com/sergi/go-diff							 v1.3.1 \
	github.com/shopspring/decimal							 v1.4.0 \
	github.com/shurcoo!l/sanitized_anchor_name					 v1.0.0 \
	github.com/sirupsen/logrus							 v1.9.3 \
	github.com/skip2/go-qrcode							 v0.0.0-20200617195104-da1b6568686e \
	github.com/slackhq/nebula							 v1.9.4 \
	github.com/smallstep/assert							 v0.0.0-20200723003110-82e2b9b3b262 \
	github.com/smallstep/certificates						 v0.28.1 \
	github.com/smallstep/certinfo							 v1.13.0 \
	github.com/smallstep/cli-utils							 v0.10.0 \
	github.com/smallstep/go-attestation						 v0.4.4-0.20240109183208-413678f90935 \
	github.com/smallstep/nosql							 v0.7.0 \
	github.com/smallstep/pkcs7							 v0.0.0-20240911091500-b1cae6277023 \
	github.com/smallstep/scep							 v0.0.0-20240926084937-8cf1ca453101 \
	github.com/smallstep/truststore							 v0.13.0 \
	github.com/smallstep/zcrypto							 v0.0.0-20221001003018-1ab2364d2a91 \
	github.com/smallstep/zlint							 v0.0.0-20220930192201-67fb4aa21910 \
	github.com/soheilhy/cmux							 v0.1.5 \
	github.com/songgao/water							 v0.0.0-20200317203138-2b4b6d7c09d8 \
	github.com/spaolacci/murmur3							 v1.1.0 \
	github.com/spf13/afero								 v1.1.2 \
	github.com/spf13/cast								 v1.7.0 \
	github.com/spf13/cobra								 v1.8.1 \
	github.com/spf13/jwalterweatherman						 v1.0.0 \
	github.com/spf13/pflag								 v1.0.5 \
	github.com/spf13/viper								 v1.3.2 \
	github.com/stretchr/objx							 v0.5.2 \
	github.com/stretchr/testify							 v1.9.0 \
	github.com/thales-e-security/pool						 v0.0.2 \
	github.com/tmc/grpc-websocket-proxy						 v0.0.0-20220101234140-673ab2c3ae75 \
	github.com/tomasen/realip							 v0.0.0-20180522021738-f0c99a92ddce \
	github.com/transparency-dev/merkle						 v0.0.2 \
	github.com/ugorji/go/codec							 v0.0.0-20181204163529-d75b2dcb6bc8 \
	github.com/urfave/cli								 v1.22.16 \
	github.com/vishvananda/netlink							 v1.2.1-beta.2 \
	github.com/vishvananda/netns							 v0.0.4 \
	github.com/weppos/publicsuffix-go						 v0.20.0 \
	github.com/weppos/publicsuffix-go/publicsuffix/generator			 v0.0.0-20220704091424-e0182326a282 \
	github.com/x448/float16								 v0.8.4 \
	github.com/xhit/go-str2duration/v2						 v2.1.0 \
	github.com/xiang90/probing							 v0.0.0-20221125231312-a49e3df8f510 \
	github.com/xordataexchange/crypt						 v0.0.3-0.20170626215501-b2862e3d0a77 \
	github.com/yuin/goldmark							 v1.4.13 \
	github.com/zmap/rc2								 v0.0.0-20190804163417-abaa70531248 \
	github.com/zmap/zcertificate							 v0.0.0-20190521191901-30e388164f71 \
	go.etcd.io/bbolt								 v1.3.11 \
	go.etcd.io/etcd/api/v3								 v3.5.16 \
	go.etcd.io/etcd/client/pkg/v3							 v3.5.16 \
	go.etcd.io/etcd/client/v2							 v2.305.16 \
	go.etcd.io/etcd/client/v3							 v3.5.16 \
	go.etcd.io/etcd/etcdctl/v3							 v3.5.16 \
	go.etcd.io/etcd/etcdutl/v3							 v3.5.16 \
	go.etcd.io/etcd/pkg/v3								 v3.5.16 \
	go.etcd.io/etcd/raft/v3								 v3.5.16 \
	go.etcd.io/etcd/server/v3							 v3.5.16 \
	go.etcd.io/etcd/tests/v3							 v3.5.16 \
	go.etcd.io/etcd/v3								 v3.5.16 \
	go.etcd.io/gofail								 v0.1.0 \
	go.mozilla.org/pkcs7								 v0.9.0 \
	go.opencensus.io								 v0.24.0 \
	go.opentelemetry.io/contrib/instrumentation/google.golang.org/grpc/otelgrpc	 v0.54.0 \
	go.opentelemetry.io/contrib/instrumentation/net/http/otelhttp			 v0.54.0 \
	go.opentelemetry.io/otel							 v1.29.0 \
	go.opentelemetry.io/otel/exporters/otlp/otlptrace				 v1.24.0 \
	go.opentelemetry.io/otel/exporters/otlp/otlptrace/otlptracegrpc			 v1.24.0 \
	go.opentelemetry.io/otel/metric							 v1.29.0 \
	go.opentelemetry.io/otel/sdk							 v1.29.0 \
	go.opentelemetry.io/otel/trace							 v1.29.0 \
	go.opentelemetry.io/proto/otlp							 v1.1.0 \
	go.step.sm/crypto								 v0.54.2 \
	go.step.sm/linkedca								 v0.22.2 \
	go.uber.org/multierr								 v1.11.0 \
	go.uber.org/zap									 v1.27.0 \
	golang.org/x/crypto								 v0.29.0 \
	golang.org/x/exp								 v0.0.0-20240318143956-a85f2c67cd81 \
	golang.org/x/lint								 v0.0.0-20190313153728-d0100b6bd8b3 \
	golang.org/x/mod								 v0.20.0 \
	golang.org/x/net								 v0.31.0 \
	golang.org/x/oauth2								 v0.24.0 \
	golang.org/x/sync								 v0.9.0 \
	golang.org/x/sys								 v0.27.0 \
	golang.org/x/telemetry								 v0.0.0-20240228155512-f48c80bd79b2 \
	golang.org/x/term								 v0.26.0 \
	golang.org/x/text								 v0.20.0 \
	golang.org/x/time								 v0.8.0 \
	golang.org/x/tools								 v0.24.0 \
	golang.org/x/xerrors								 v0.0.0-20200804184101-5ec99f83aff1 \
	golang.zx2c4.com/wintun								 v0.0.0-20230126152724-0fa3db229ce2 \
	golang.zx2c4.com/wireguard							 v0.0.0-20230325221338-052af4a8072b \
	golang.zx2c4.com/wireguard/windows						 v0.5.3 \
	google.golang.org/api								 v0.206.0 \
	google.golang.org/appengine							 v1.6.8 \
	google.golang.org/genproto							 v0.0.0-20241104194629-dd2ea8efbc28 \
	google.golang.org/genproto/googleapis/api					 v0.0.0-20241104194629-dd2ea8efbc28 \
	google.golang.org/genproto/googleapis/bytestream				 v0.0.0-20241104194629-dd2ea8efbc28 \
	google.golang.org/genproto/googleapis/rpc					 v0.0.0-20241104194629-dd2ea8efbc28 \
	google.golang.org/grpc								 v1.67.1 \
	google.golang.org/protobuf							 v1.35.2 \
	gopkg.in/check.v1								 v1.0.0-20201130134442-10cb98267c6c \
	gopkg.in/cheggaaa/pb.v1								 v1.0.28 \
	gopkg.in/natefinch/lumberjack.v2						 v2.2.1 \
	gopkg.in/yaml.v1								 v1.0.0-20140924161607-9f9df34309c0 \
	gopkg.in/yaml.v2								 v2.4.0 \
	gopkg.in/yaml.v3								 v3.0.1 \
	gvisor.dev/gvisor								 v0.0.0-20240423190808-9d7a357edefe \
	honnef.co/go/tools								 v0.0.0-20190523083050-ea95bdfd59fc \
	howett.net/plist								 v1.0.0 \
	k8s.io/klog/v2									 v2.130.1 \
	sigs.k8s.io/yaml								 v1.4.0 \
	software.sslmate.com/src/go-pkcs12						 v0.5.0

MODGO_MODFILES =	\
	cloud.google.com/go								 v0.112.2 \
	cloud.google.com/go								 v0.26.0 \
	cloud.google.com/go/auth							 v0.10.1 \
	cloud.google.com/go/auth							 v0.3.0 \
	cloud.google.com/go/auth							 v0.9.1 \
	cloud.google.com/go/auth							 v0.9.3 \
	cloud.google.com/go/auth							 v0.9.4 \
	cloud.google.com/go/auth							 v0.9.9 \
	cloud.google.com/go/auth/oauth2adapt						 v0.2.2 \
	cloud.google.com/go/auth/oauth2adapt						 v0.2.4 \
	cloud.google.com/go/compute/metadata						 v0.3.0 \
	cloud.google.com/go/compute/metadata						 v0.5.0 \
	cloud.google.com/go/compute/metadata						 v0.5.1 \
	cloud.google.com/go/iam								 v1.2.0 \
	cloud.google.com/go/iam								 v1.2.1 \
	cloud.google.com/go/longrunning							 v0.5.6 \
	cloud.google.com/go/longrunning							 v0.6.1 \
	cloud.google.com/go/monitoring							 v1.20.3 \
	cloud.google.com/go/trace							 v1.10.11 \
	cloud.google.com/go/translate							 v1.10.3 \
	dario.cat/mergo									 v1.0.0 \
	github.com/!azure!a!d/microsoft-authentication-library-for-go			 v0.5.1 \
	github.com/!azure/azure-sdk-for-go/sdk/azcore					 v1.0.0 \
	github.com/!azure/azure-sdk-for-go/sdk/azcore					 v1.12.0 \
	github.com/!azure/azure-sdk-for-go/sdk/azcore					 v1.14.0 \
	github.com/!azure/azure-sdk-for-go/sdk/azcore					 v1.4.0 \
	github.com/!azure/azure-sdk-for-go/sdk/azidentity				 v1.1.0 \
	github.com/!azure/azure-sdk-for-go/sdk/azidentity				 v1.7.0 \
	github.com/!azure/azure-sdk-for-go/sdk/internal					 v1.0.0 \
	github.com/!azure/azure-sdk-for-go/sdk/internal					 v1.2.0 \
	github.com/!burnt!sushi/toml							 v0.3.1 \
	github.com/asaskevich/govalidator						 v0.0.0-20180720115003-f9ffefc3facf \
	github.com/aws/aws-sdk-go							 v1.49.22 \
	github.com/boombuler/barcode							 v1.0.1-0.20190219062509-6c824513bacc \
	github.com/census-instrumentation/opencensus-proto				 v0.2.1 \
	github.com/cespare/xxhash/v2							 v2.1.1 \
	github.com/cespare/xxhash/v2							 v2.2.0 \
	github.com/chzyer/logex								 v1.1.10 \
	github.com/chzyer/readline							 v0.0.0-20180603132655-2972be24d48e \
	github.com/chzyer/test								 v0.0.0-20180213035817-a1ea475d72b1 \
	github.com/coreos/go-semver							 v0.2.0 \
	github.com/corpix/uarand							 v0.0.0-20170723150923-031be390f409 \
	github.com/cpuguy83/go-md2man/v2						 v2.0.4 \
	github.com/creack/pty								 v1.1.7 \
	github.com/davecgh/go-spew							 v1.1.0 \
	github.com/dgraph-io/ristretto							 v0.0.2 \
	github.com/dgraph-io/ristretto							 v0.0.3-0.20200630154024-f66de99634de \
	github.com/dgraph-io/ristretto							 v0.1.0 \
	github.com/dgryski/go-farm							 v0.0.0-20190423205320-6a90982ecee2 \
	github.com/dustin/go-humanize							 v1.0.0 \
	github.com/envoyproxy/go-control-plane						 v0.9.0 \
	github.com/envoyproxy/go-control-plane						 v0.9.1-0.20191026205805-5f8ba28d4473 \
	github.com/envoyproxy/go-control-plane						 v0.9.4 \
	github.com/envoyproxy/protoc-gen-validate					 v0.1.0 \
	github.com/go-logr/logr								 v1.2.2 \
	github.com/go-logr/logr								 v1.4.1 \
	github.com/golang-jwt/jwt/v5							 v5.0.0 \
	github.com/golang/glog								 v0.0.0-20160126235308-23def4e6c14b \
	github.com/golang/groupcache							 v0.0.0-20200121045136-8c9f03a8e57e \
	github.com/golang/mock								 v1.1.1 \
	github.com/golang/protobuf							 v1.2.0 \
	github.com/golang/protobuf							 v1.3.1 \
	github.com/golang/protobuf							 v1.3.2 \
	github.com/golang/protobuf							 v1.4.0 \
	github.com/golang/protobuf							 v1.4.0-rc.1 \
	github.com/golang/protobuf							 v1.4.0-rc.1.0.20200221234624-67d41d38c208 \
	github.com/golang/protobuf							 v1.4.0-rc.2 \
	github.com/golang/protobuf							 v1.4.0-rc.4.0.20200313231945-b860323f09d0 \
	github.com/golang/protobuf							 v1.4.1 \
	github.com/golang/protobuf							 v1.4.3 \
	github.com/golang/protobuf							 v1.5.0 \
	github.com/golang/protobuf							 v1.5.3 \
	github.com/golang/snappy							 v0.0.3 \
	github.com/google/btree								 v1.0.0 \
	github.com/google/btree								 v1.0.1 \
	github.com/google/btree								 v1.1.2 \
	github.com/google/certificate-transparency-go					 v1.0.21 \
	github.com/google/certificate-transparency-go					 v1.1.2 \
	github.com/google/certificate-transparency-go					 v1.1.7 \
	github.com/google/go-cmp							 v0.2.0 \
	github.com/google/go-cmp							 v0.3.0 \
	github.com/google/go-cmp							 v0.3.1 \
	github.com/google/go-cmp							 v0.4.0 \
	github.com/google/go-cmp							 v0.5.0 \
	github.com/google/go-cmp							 v0.5.3 \
	github.com/google/go-cmp							 v0.5.5 \
	github.com/google/go-cmp							 v0.5.8 \
	github.com/google/go-cmp							 v0.5.9 \
	github.com/google/go-tpm							 v0.9.0 \
	github.com/google/go-tpm-tools							 v0.3.13-0.20230620182252-4639ecce2aba \
	github.com/google/uuid								 v1.1.1 \
	github.com/google/uuid								 v1.1.2 \
	github.com/google/uuid								 v1.3.0 \
	github.com/google/uuid								 v1.3.1 \
	github.com/googleapis/enterprise-certificate-proxy				 v0.3.2 \
	github.com/googleapis/gax-go/v2							 v2.12.3 \
	github.com/googleapis/gax-go/v2							 v2.13.0 \
	github.com/inconshreveable/mousetrap						 v1.0.0 \
	github.com/jmespath/go-jmespath							 v0.4.0 \
	github.com/klauspost/compress							 v1.12.3 \
	github.com/kr/pretty								 v0.1.0 \
	github.com/kr/pretty								 v0.2.0 \
	github.com/kr/pretty								 v0.3.0 \
	github.com/kr/pty								 v1.1.1 \
	github.com/kr/text								 v0.1.0 \
	github.com/mattn/go-colorable							 v0.1.4 \
	github.com/mattn/go-isatty							 v0.0.11 \
	github.com/mattn/go-isatty							 v0.0.16 \
	github.com/miekg/pkcs11								 v1.0.3 \
	github.com/mitchellh/mapstructure						 v1.1.2 \
	github.com/pkg/browser								 v0.0.0-20210115035449-ce105d075bb4 \
	github.com/pkg/browser								 v0.0.0-20210911075715-681adbf594b8 \
	github.com/pkg/errors								 v0.8.1 \
	github.com/prometheus/client_golang						 v1.19.1 \
	github.com/prometheus/client_model						 v0.0.0-20190812154241-14fe0d1b01d4 \
	github.com/prometheus/client_model						 v0.5.0 \
	github.com/prometheus/common							 v0.48.0 \
	github.com/prometheus/procfs							 v0.12.0 \
	github.com/rogpeppe/go-internal							 v1.10.0 \
	github.com/rogpeppe/go-internal							 v1.9.0 \
	github.com/sirupsen/logrus							 v1.4.2 \
	github.com/smallstep/assert							 v0.0.0-20180720014142-de77670473b5 \
	github.com/spaolacci/murmur3							 v0.0.0-20180118202830-f09979ecbc72 \
	github.com/spf13/cast								 v1.3.0 \
	github.com/spf13/cobra								 v0.0.5 \
	github.com/spf13/pflag								 v1.0.3 \
	github.com/stretchr/objx							 v0.1.0 \
	github.com/stretchr/objx							 v0.4.0 \
	github.com/stretchr/objx							 v0.5.0 \
	github.com/stretchr/testify							 v1.2.2 \
	github.com/stretchr/testify							 v1.3.0 \
	github.com/stretchr/testify							 v1.4.0 \
	github.com/stretchr/testify							 v1.5.1 \
	github.com/stretchr/testify							 v1.7.0 \
	github.com/stretchr/testify							 v1.7.1 \
	github.com/stretchr/testify							 v1.7.5 \
	github.com/stretchr/testify							 v1.8.0 \
	github.com/stretchr/testify							 v1.8.1 \
	github.com/stretchr/testify							 v1.8.2 \
	github.com/stretchr/testify							 v1.8.3 \
	github.com/stretchr/testify							 v1.8.4 \
	github.com/urfave/cli								 v1.22.14 \
	github.com/urfave/cli								 v1.22.15 \
	github.com/weppos/publicsuffix-go						 v0.12.0 \
	github.com/weppos/publicsuffix-go						 v0.4.0 \
	go.etcd.io/bbolt								 v1.3.10 \
	go.opentelemetry.io/contrib/instrumentation/google.golang.org/grpc/otelgrpc	 v0.49.0 \
	go.opentelemetry.io/contrib/instrumentation/net/http/otelhttp			 v0.49.0 \
	go.opentelemetry.io/otel							 v1.24.0 \
	go.opentelemetry.io/otel/metric							 v1.24.0 \
	go.opentelemetry.io/otel/sdk							 v1.24.0 \
	go.opentelemetry.io/otel/trace							 v1.24.0 \
	go.step.sm/crypto								 v0.51.2 \
	golang.org/x/crypto								 v0.0.0-20180904163835-0709b304e793 \
	golang.org/x/crypto								 v0.0.0-20181203042331-505ab145d0a9 \
	golang.org/x/crypto								 v0.0.0-20190308221718-c2843e01d9a2 \
	golang.org/x/crypto								 v0.0.0-20200622213623-75b288015ac9 \
	golang.org/x/crypto								 v0.0.0-20210921155107-089bfa567519 \
	golang.org/x/crypto								 v0.0.0-20220511200225-c6db032c6c88 \
	golang.org/x/crypto								 v0.0.0-20220525230936-793ad666bf5e \
	golang.org/x/crypto								 v0.11.0 \
	golang.org/x/crypto								 v0.13.0 \
	golang.org/x/crypto								 v0.16.0 \
	golang.org/x/crypto								 v0.17.0 \
	golang.org/x/crypto								 v0.19.0 \
	golang.org/x/crypto								 v0.21.0 \
	golang.org/x/crypto								 v0.22.0 \
	golang.org/x/crypto								 v0.23.0 \
	golang.org/x/crypto								 v0.25.0 \
	golang.org/x/crypto								 v0.26.0 \
	golang.org/x/crypto								 v0.27.0 \
	golang.org/x/crypto								 v0.28.0 \
	golang.org/x/exp								 v0.0.0-20190121172915-509febef88a4 \
	golang.org/x/exp								 v0.0.0-20230725093048-515e97ebf090 \
	golang.org/x/lint								 v0.0.0-20181026193005-c67002cb31c3 \
	golang.org/x/lint								 v0.0.0-20190227174305-5b3e6a55c961 \
	golang.org/x/mod								 v0.12.0 \
	golang.org/x/mod								 v0.15.0 \
	golang.org/x/mod								 v0.16.0 \
	golang.org/x/mod								 v0.17.0 \
	golang.org/x/mod								 v0.18.0 \
	golang.org/x/mod								 v0.6.0-dev.0.20220419223038-86c51ed26bb4 \
	golang.org/x/mod								 v0.8.0 \
	golang.org/x/net								 v0.0.0-20180724234803-3673e40ba225 \
	golang.org/x/net								 v0.0.0-20180826012351-8a410e7b638d \
	golang.org/x/net								 v0.0.0-20190213061140-3a22650c66bd \
	golang.org/x/net								 v0.0.0-20190301231341-16b79f2e4e95 \
	golang.org/x/net								 v0.0.0-20190311183353-d8887717615a \
	golang.org/x/net								 v0.0.0-20190404232315-eb5bcb51f2a3 \
	golang.org/x/net								 v0.0.0-20190620200207-3b0461eec859 \
	golang.org/x/net								 v0.0.0-20200202094626-16171245cfb2 \
	golang.org/x/net								 v0.0.0-20201110031124-69a78807bb2b \
	golang.org/x/net								 v0.0.0-20210226172049-e18ecbb05110 \
	golang.org/x/net								 v0.0.0-20220425223048-2871e0cb64e4 \
	golang.org/x/net								 v0.0.0-20220722155237-a158d28d115b \
	golang.org/x/net								 v0.10.0 \
	golang.org/x/net								 v0.15.0 \
	golang.org/x/net								 v0.21.0 \
	golang.org/x/net								 v0.23.0 \
	golang.org/x/net								 v0.24.0 \
	golang.org/x/net								 v0.25.0 \
	golang.org/x/net								 v0.26.0 \
	golang.org/x/net								 v0.27.0 \
	golang.org/x/net								 v0.28.0 \
	golang.org/x/net								 v0.29.0 \
	golang.org/x/net								 v0.30.0 \
	golang.org/x/net								 v0.6.0 \
	golang.org/x/net								 v0.8.0 \
	golang.org/x/oauth2								 v0.0.0-20180821212333-d2e6202438be \
	golang.org/x/oauth2								 v0.19.0 \
	golang.org/x/oauth2								 v0.21.0 \
	golang.org/x/oauth2								 v0.22.0 \
	golang.org/x/oauth2								 v0.23.0 \
	golang.org/x/sync								 v0.0.0-20180314180146-1d60e4601c6f \
	golang.org/x/sync								 v0.0.0-20181108010431-42b317875d0f \
	golang.org/x/sync								 v0.0.0-20190423024810-112230192c58 \
	golang.org/x/sync								 v0.0.0-20220722155255-886fb9371eb4 \
	golang.org/x/sync								 v0.1.0 \
	golang.org/x/sync								 v0.3.0 \
	golang.org/x/sync								 v0.5.0 \
	golang.org/x/sync								 v0.6.0 \
	golang.org/x/sync								 v0.7.0 \
	golang.org/x/sync								 v0.8.0 \
	golang.org/x/sys								 v0.0.0-20180830151530-49385e6e1522 \
	golang.org/x/sys								 v0.0.0-20181122145206-62eef0e2fa9b \
	golang.org/x/sys								 v0.0.0-20181205085412-a5c9d58dba9a \
	golang.org/x/sys								 v0.0.0-20190215142949-d0b11bdaac8a \
	golang.org/x/sys								 v0.0.0-20190412213103-97732733099d \
	golang.org/x/sys								 v0.0.0-20190422165155-953cdadca894 \
	golang.org/x/sys								 v0.0.0-20190626221950-04f50cda93cb \
	golang.org/x/sys								 v0.0.0-20200930185726-fdedc70b468f \
	golang.org/x/sys								 v0.0.0-20201119102817-f84b799fce68 \
	golang.org/x/sys								 v0.0.0-20210615035016-665e8c7367d1 \
	golang.org/x/sys								 v0.0.0-20220310020820-b874c991c1a5 \
	golang.org/x/sys								 v0.0.0-20220520151302-bc2c85ada10a \
	golang.org/x/sys								 v0.0.0-20220715151400-c0bba94af5f8 \
	golang.org/x/sys								 v0.0.0-20220722155257-8c9f86f7a55f \
	golang.org/x/sys								 v0.0.0-20220811171246-fbc7d0a398ab \
	golang.org/x/sys								 v0.0.0-20221010170243-090e33056c14 \
	golang.org/x/sys								 v0.1.0 \
	golang.org/x/sys								 v0.10.0 \
	golang.org/x/sys								 v0.12.0 \
	golang.org/x/sys								 v0.15.0 \
	golang.org/x/sys								 v0.17.0 \
	golang.org/x/sys								 v0.18.0 \
	golang.org/x/sys								 v0.19.0 \
	golang.org/x/sys								 v0.20.0 \
	golang.org/x/sys								 v0.21.0 \
	golang.org/x/sys								 v0.22.0 \
	golang.org/x/sys								 v0.24.0 \
	golang.org/x/sys								 v0.25.0 \
	golang.org/x/sys								 v0.26.0 \
	golang.org/x/sys								 v0.4.0 \
	golang.org/x/sys								 v0.5.0 \
	golang.org/x/sys								 v0.6.0 \
	golang.org/x/sys								 v0.8.0 \
	golang.org/x/sys								 v0.9.0 \
	golang.org/x/term								 v0.0.0-20201126162022-7de9c90e9dd1 \
	golang.org/x/term								 v0.0.0-20210927222741-03fcf44c2211 \
	golang.org/x/term								 v0.12.0 \
	golang.org/x/term								 v0.17.0 \
	golang.org/x/term								 v0.20.0 \
	golang.org/x/term								 v0.23.0 \
	golang.org/x/term								 v0.24.0 \
	golang.org/x/term								 v0.5.0 \
	golang.org/x/term								 v0.8.0 \
	golang.org/x/text								 v0.13.0 \
	golang.org/x/text								 v0.14.0 \
	golang.org/x/text								 v0.15.0 \
	golang.org/x/text								 v0.16.0 \
	golang.org/x/text								 v0.17.0 \
	golang.org/x/text								 v0.18.0 \
	golang.org/x/text								 v0.19.0 \
	golang.org/x/text								 v0.3.0 \
	golang.org/x/text								 v0.3.3 \
	golang.org/x/text								 v0.3.7 \
	golang.org/x/text								 v0.7.0 \
	golang.org/x/text								 v0.8.0 \
	golang.org/x/text								 v0.9.0 \
	golang.org/x/time								 v0.5.0 \
	golang.org/x/time								 v0.6.0 \
	golang.org/x/time								 v0.7.0 \
	golang.org/x/tools								 v0.0.0-20180917221912-90fa682c2a6e \
	golang.org/x/tools								 v0.0.0-20190114222345-bf090417da8b \
	golang.org/x/tools								 v0.0.0-20190226205152-f727befe758c \
	golang.org/x/tools								 v0.0.0-20190311212946-11955173bddd \
	golang.org/x/tools								 v0.0.0-20190524140312-2c0ae7006135 \
	golang.org/x/tools								 v0.0.0-20191119224855-298f0cb1881e \
	golang.org/x/tools								 v0.1.12 \
	golang.org/x/tools								 v0.11.0 \
	golang.org/x/tools								 v0.13.0 \
	golang.org/x/tools								 v0.19.0 \
	golang.org/x/tools								 v0.21.1-0.20240508182429-e35e4ccd0d2d \
	golang.org/x/tools								 v0.22.0 \
	golang.org/x/tools								 v0.6.0 \
	golang.org/x/xerrors								 v0.0.0-20190717185122-a985d3407aa7 \
	golang.org/x/xerrors								 v0.0.0-20191204190536-9bdfabe68543 \
	google.golang.org/api								 v0.177.0 \
	google.golang.org/api								 v0.194.0 \
	google.golang.org/api								 v0.197.0 \
	google.golang.org/api								 v0.203.0 \
	google.golang.org/api								 v0.205.0 \
	google.golang.org/appengine							 v1.1.0 \
	google.golang.org/appengine							 v1.4.0 \
	google.golang.org/genproto							 v0.0.0-20180817151627-c66870c02cf8 \
	google.golang.org/genproto							 v0.0.0-20190819201941-24fa4b261c55 \
	google.golang.org/genproto							 v0.0.0-20200526211855-cb27e3aa2013 \
	google.golang.org/genproto							 v0.0.0-20240814211410-ddb44dafa142 \
	google.golang.org/genproto							 v0.0.0-20240903143218-8af14fe29dc1 \
	google.golang.org/genproto							 v0.0.0-20241015192408-796eee8c2d53 \
	google.golang.org/genproto							 v0.0.0-20241021214115-324edc3d5d38 \
	google.golang.org/genproto/googleapis/api					 v0.0.0-20240429193739-8cf5692501f6 \
	google.golang.org/genproto/googleapis/api					 v0.0.0-20240814211410-ddb44dafa142 \
	google.golang.org/genproto/googleapis/api					 v0.0.0-20240903143218-8af14fe29dc1 \
	google.golang.org/genproto/googleapis/api					 v0.0.0-20241007155032-5fefd90f89a9 \
	google.golang.org/genproto/googleapis/api					 v0.0.0-20241015192408-796eee8c2d53 \
	google.golang.org/genproto/googleapis/api					 v0.0.0-20241021214115-324edc3d5d38 \
	google.golang.org/genproto/googleapis/rpc					 v0.0.0-20240429193739-8cf5692501f6 \
	google.golang.org/genproto/googleapis/rpc					 v0.0.0-20240814211410-ddb44dafa142 \
	google.golang.org/genproto/googleapis/rpc					 v0.0.0-20240822170219-fc7c04adadcd \
	google.golang.org/genproto/googleapis/rpc					 v0.0.0-20240903143218-8af14fe29dc1 \
	google.golang.org/genproto/googleapis/rpc					 v0.0.0-20241015192408-796eee8c2d53 \
	google.golang.org/genproto/googleapis/rpc					 v0.0.0-20241021214115-324edc3d5d38 \
	google.golang.org/grpc								 v1.19.0 \
	google.golang.org/grpc								 v1.23.0 \
	google.golang.org/grpc								 v1.25.1 \
	google.golang.org/grpc								 v1.27.0 \
	google.golang.org/grpc								 v1.33.2 \
	google.golang.org/grpc								 v1.63.2 \
	google.golang.org/grpc								 v1.65.0 \
	google.golang.org/grpc								 v1.66.2 \
	google.golang.org/protobuf							 v0.0.0-20200109180630-ec00e32a8dfd \
	google.golang.org/protobuf							 v0.0.0-20200221191635-4d8936d0db64 \
	google.golang.org/protobuf							 v0.0.0-20200228230310-ab0ca4ff8a60 \
	google.golang.org/protobuf							 v1.20.1-0.20200309200217-e05f789c0967 \
	google.golang.org/protobuf							 v1.21.0 \
	google.golang.org/protobuf							 v1.22.0 \
	google.golang.org/protobuf							 v1.23.0 \
	google.golang.org/protobuf							 v1.23.1-0.20200526195155-81db48ad09cc \
	google.golang.org/protobuf							 v1.25.0 \
	google.golang.org/protobuf							 v1.31.0 \
	google.golang.org/protobuf							 v1.33.0 \
	google.golang.org/protobuf							 v1.34.2 \
	google.golang.org/protobuf							 v1.35.1 \
	gopkg.in/check.v1								 v0.0.0-20161208181325-20d25e280405 \
	gopkg.in/check.v1								 v1.0.0-20180628173108-788fd7840127 \
	gopkg.in/check.v1								 v1.0.0-20190902080502-41f04d3bba15 \
	gopkg.in/yaml.v2								 v2.2.2 \
	gopkg.in/yaml.v2								 v2.3.0 \
	gopkg.in/yaml.v3								 v3.0.0-20200313102051-9f266ea9e77c \
	gopkg.in/yaml.v3								 v3.0.0-20210107192922-496545a6307b \
	honnef.co/go/tools								 v0.0.0-20190102054323-c2f93a96b099
