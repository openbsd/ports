MODCARGO_CRATES +=	aho-corasick	0.7.18	# Unlicense/MIT
MODCARGO_CRATES +=	ansi-parser	0.6.5	# MPL-2.0
MODCARGO_CRATES +=	atk	0.8.0	# MIT
MODCARGO_CRATES +=	atk-sys	0.9.1	# MIT
MODCARGO_CRATES +=	autocfg	0.1.8	# Apache-2.0 OR MIT
MODCARGO_CRATES +=	autocfg	1.1.0	# Apache-2.0 OR MIT
MODCARGO_CRATES +=	bitflags	1.3.2	# MIT/Apache-2.0
MODCARGO_CRATES +=	cairo-rs	0.8.1	# MIT
MODCARGO_CRATES +=	cairo-sys-rs	0.9.2	# MIT
MODCARGO_CRATES +=	cc	1.0.73	# MIT/Apache-2.0
MODCARGO_CRATES +=	cfg-if	0.1.10	# MIT/Apache-2.0
MODCARGO_CRATES +=	cfg-if	1.0.0	# MIT/Apache-2.0
MODCARGO_CRATES +=	cloudabi	0.0.3	# BSD-2-Clause
MODCARGO_CRATES +=	core-foundation	0.7.0	# MIT / Apache-2.0
MODCARGO_CRATES +=	core-foundation-sys	0.7.0	# MIT / Apache-2.0
MODCARGO_CRATES +=	dirs	3.0.2	# MIT OR Apache-2.0
MODCARGO_CRATES +=	dirs-sys	0.3.7	# MIT OR Apache-2.0
MODCARGO_CRATES +=	foreign-types	0.3.2	# MIT/Apache-2.0
MODCARGO_CRATES +=	foreign-types-shared	0.1.1	# MIT/Apache-2.0
MODCARGO_CRATES +=	form_urlencoded	1.0.1	# MIT/Apache-2.0
MODCARGO_CRATES +=	fuchsia-cprng	0.1.1	# LICENSE
MODCARGO_CRATES +=	futures-channel	0.3.21	# MIT OR Apache-2.0
MODCARGO_CRATES +=	futures-core	0.3.21	# MIT OR Apache-2.0
MODCARGO_CRATES +=	futures-executor	0.3.21	# MIT OR Apache-2.0
MODCARGO_CRATES +=	futures-io	0.3.21	# MIT OR Apache-2.0
MODCARGO_CRATES +=	futures-macro	0.3.21	# MIT OR Apache-2.0
MODCARGO_CRATES +=	futures-task	0.3.21	# MIT OR Apache-2.0
MODCARGO_CRATES +=	futures-util	0.3.21	# MIT OR Apache-2.0
MODCARGO_CRATES +=	gdk	0.12.1	# MIT
MODCARGO_CRATES +=	gdk-pixbuf	0.8.0	# MIT
MODCARGO_CRATES +=	gdk-pixbuf-sys	0.9.1	# MIT
MODCARGO_CRATES +=	gdk-sys	0.9.1	# MIT
MODCARGO_CRATES +=	getrandom	0.2.6	# MIT OR Apache-2.0
MODCARGO_CRATES +=	gio	0.8.1	# MIT
MODCARGO_CRATES +=	gio-sys	0.9.1	# MIT
MODCARGO_CRATES +=	glib	0.9.3	# MIT
MODCARGO_CRATES +=	glib-sys	0.9.1	# MIT
MODCARGO_CRATES +=	gobject-sys	0.9.1	# MIT
MODCARGO_CRATES +=	gtk	0.8.1	# MIT
MODCARGO_CRATES +=	gtk-sys	0.9.2	# MIT
MODCARGO_CRATES +=	idna	0.2.3	# MIT/Apache-2.0
MODCARGO_CRATES +=	lazy_static	1.4.0	# MIT/Apache-2.0
MODCARGO_CRATES +=	libc	0.2.125	# MIT OR Apache-2.0
MODCARGO_CRATES +=	linkify	0.7.0	# MIT OR Apache-2.0
MODCARGO_CRATES +=	log	0.4.17	# MIT OR Apache-2.0
MODCARGO_CRATES +=	matches	0.1.9	# MIT
MODCARGO_CRATES +=	memchr	2.5.0	# Unlicense/MIT
MODCARGO_CRATES +=	native-tls	0.2.4	# MIT/Apache-2.0
MODCARGO_CRATES +=	nom	4.2.3	# MIT
MODCARGO_CRATES +=	once_cell	1.10.0	# MIT OR Apache-2.0
MODCARGO_CRATES +=	open	2.0.3	# MIT
MODCARGO_CRATES +=	openssl	0.10.40	# Apache-2.0
MODCARGO_CRATES +=	openssl-macros	0.1.0	# MIT/Apache-2.0
MODCARGO_CRATES +=	openssl-probe	0.1.5	# MIT/Apache-2.0
MODCARGO_CRATES +=	openssl-sys	0.9.73	# MIT
MODCARGO_CRATES +=	pango	0.8.0	# MIT
MODCARGO_CRATES +=	pango-sys	0.9.1	# MIT
MODCARGO_CRATES +=	pathdiff	0.2.1	# MIT/Apache-2.0
MODCARGO_CRATES +=	percent-encoding	2.1.0	# MIT/Apache-2.0
MODCARGO_CRATES +=	pin-project-lite	0.2.9	# Apache-2.0 OR MIT
MODCARGO_CRATES +=	pin-utils	0.1.0	# MIT OR Apache-2.0
MODCARGO_CRATES +=	pkg-config	0.3.25	# MIT OR Apache-2.0
MODCARGO_CRATES +=	proc-macro2	1.0.38	# MIT OR Apache-2.0
MODCARGO_CRATES +=	quote	1.0.18	# MIT OR Apache-2.0
MODCARGO_CRATES +=	rand	0.6.5	# MIT/Apache-2.0
MODCARGO_CRATES +=	rand_chacha	0.1.1	# MIT/Apache-2.0
MODCARGO_CRATES +=	rand_core	0.3.1	# MIT/Apache-2.0
MODCARGO_CRATES +=	rand_core	0.4.2	# MIT/Apache-2.0
MODCARGO_CRATES +=	rand_hc	0.1.0	# MIT/Apache-2.0
MODCARGO_CRATES +=	rand_isaac	0.1.1	# MIT/Apache-2.0
MODCARGO_CRATES +=	rand_jitter	0.1.4	# MIT OR Apache-2.0
MODCARGO_CRATES +=	rand_os	0.1.3	# MIT/Apache-2.0
MODCARGO_CRATES +=	rand_pcg	0.1.2	# MIT/Apache-2.0
MODCARGO_CRATES +=	rand_xorshift	0.1.1	# MIT/Apache-2.0
MODCARGO_CRATES +=	rdrand	0.4.0	# ISC
MODCARGO_CRATES +=	redox_syscall	0.1.57	# MIT
MODCARGO_CRATES +=	redox_syscall	0.2.13	# MIT
MODCARGO_CRATES +=	redox_users	0.4.3	# MIT
MODCARGO_CRATES +=	regex	1.5.5	# MIT OR Apache-2.0
MODCARGO_CRATES +=	regex-syntax	0.6.25	# MIT/Apache-2.0
MODCARGO_CRATES +=	remove_dir_all	0.5.3	# MIT/Apache-2.0
MODCARGO_CRATES +=	schannel	0.1.19	# MIT
MODCARGO_CRATES +=	security-framework	0.4.4	# MIT OR Apache-2.0
MODCARGO_CRATES +=	security-framework-sys	0.4.3	# MIT OR Apache-2.0
MODCARGO_CRATES +=	serde	1.0.137	# MIT OR Apache-2.0
MODCARGO_CRATES +=	serde_derive	1.0.137	# MIT OR Apache-2.0
MODCARGO_CRATES +=	slab	0.4.6	# MIT
MODCARGO_CRATES +=	smawk	0.3.1	# MIT
MODCARGO_CRATES +=	syn	1.0.94	# MIT OR Apache-2.0
MODCARGO_CRATES +=	tempfile	3.0.8	# MIT/Apache-2.0
MODCARGO_CRATES +=	textwrap	0.14.2	# MIT
MODCARGO_CRATES +=	thiserror	1.0.31	# MIT OR Apache-2.0
MODCARGO_CRATES +=	thiserror-impl	1.0.31	# MIT OR Apache-2.0
MODCARGO_CRATES +=	tinyvec	1.6.0	# Zlib OR Apache-2.0 OR MIT
MODCARGO_CRATES +=	tinyvec_macros	0.1.0	# MIT OR Apache-2.0 OR Zlib
MODCARGO_CRATES +=	toml	0.5.9	# MIT/Apache-2.0
MODCARGO_CRATES +=	unicode-bidi	0.3.8	# MIT OR Apache-2.0
MODCARGO_CRATES +=	unicode-linebreak	0.1.2	# Apache-2.0
MODCARGO_CRATES +=	unicode-normalization	0.1.19	# MIT/Apache-2.0
MODCARGO_CRATES +=	unicode-width	0.1.9	# MIT/Apache-2.0
MODCARGO_CRATES +=	unicode-xid	0.2.3	# MIT OR Apache-2.0
MODCARGO_CRATES +=	url	2.2.2	# MIT/Apache-2.0
MODCARGO_CRATES +=	vcpkg	0.2.15	# MIT/Apache-2.0
MODCARGO_CRATES +=	version_check	0.1.5	# MIT/Apache-2.0
MODCARGO_CRATES +=	wasi	0.10.2+wasi-snapshot-preview1	# Apache-2.0 WITH LLVM-exception OR Apache-2.0 OR MIT
MODCARGO_CRATES +=	winapi	0.3.9	# MIT/Apache-2.0
MODCARGO_CRATES +=	winapi-i686-pc-windows-gnu	0.4.0	# MIT/Apache-2.0
MODCARGO_CRATES +=	winapi-x86_64-pc-windows-gnu	0.4.0	# MIT/Apache-2.0
