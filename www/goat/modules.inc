MODGO_MODULES =	\
	github.com/!burnt!sushi/toml							 v0.3.1 \
	github.com/!data!dog/zstd							 v1.4.5 \
	github.com/!jorropo/jsync							 v1.0.1 \
	github.com/!puerkito!bio/purell							 v1.2.1 \
	github.com/!russell!luo/slidingwindow						 v0.0.0-20200528002341-535bb99d338b \
	github.com/adrg/xdg								 v0.5.3 \
	github.com/alecthomas/kingpin/v2						 v2.4.0 \
	github.com/alecthomas/units							 v0.0.0-20240927000941-0f3dac36c52b \
	github.com/alexbrainman/goissue34681						 v0.0.0-20191006012335-3fc7a47baff5 \
	github.com/araddon/dateparse							 v0.0.0-20210429162001-6b43995a97de \
	github.com/benbjohnson/clock							 v1.3.5 \
	github.com/beorn7/perks								 v1.0.1 \
	github.com/bluesky-social/indigo						 v0.0.0-20250813002524-42e2d5b7f598 \
	github.com/bradfitz/gomemcache							 v0.0.0-20230905024940-24af94b03874 \
	github.com/brianvoe/gofakeit/v6							 v6.25.0 \
	github.com/carlmjohnson/versioninfo						 v0.22.5 \
	github.com/cenkalti/backoff/v4							 v4.3.0 \
	github.com/cespare/xxhash/v2							 v2.3.0 \
	github.com/cockroachdb/errors							 v1.11.3 \
	github.com/cockroachdb/fifo							 v0.0.0-20240606204812-0bbfbd93a7ce \
	github.com/cockroachdb/logtags							 v0.0.0-20230118201751-21c54148d20b \
	github.com/cockroachdb/pebble							 v1.1.2 \
	github.com/cockroachdb/redact							 v1.1.5 \
	github.com/cockroachdb/tokenbucket						 v0.0.0-20230807174530-cc333fc44b06 \
	github.com/containerd/cgroups							 v1.1.0 \
	github.com/coreos/go-systemd/v22						 v22.5.0 \
	github.com/corpix/uarand							 v0.2.0 \
	github.com/cpuguy83/go-md2man/v2						 v2.0.3 \
	github.com/crackcomm/go-gitignore						 v0.0.0-20241020182519-7843d2ba8fdf \
	github.com/cskr/pubsub								 v1.0.2 \
	github.com/davecgh/go-spew							 v1.1.1 \
	github.com/davidlazar/go-crypto							 v0.0.0-20200604182044-b73af7476f6c \
	github.com/decred/dcrd/dcrec/secp256k1/v4					 v4.4.0 \
	github.com/dgryski/go-rendezvous						 v0.0.0-20200823014737-9f7001d12a5f \
	github.com/did-method-plc/go-didplc						 v0.0.0-20250730112407-6d84973a989b \
	github.com/docker/go-units							 v0.5.0 \
	github.com/dustin/go-humanize							 v1.0.1 \
	github.com/dustinkirkland/golang-petname					 v0.0.0-20231002161417-6a283f1aaaf2 \
	github.com/earthboundkid/versioninfo/v2						 v2.24.1 \
	github.com/elastic/gosigar							 v0.14.3 \
	github.com/felixge/httpsnoop							 v1.0.4 \
	github.com/filecoin-project/go-clock						 v0.1.0 \
	github.com/flosch/pongo2/v6							 v6.0.0 \
	github.com/flynn/noise								 v1.1.0 \
	github.com/francoispqt/gojay							 v1.2.13 \
	github.com/frankban/quicktest							 v1.14.6 \
	github.com/gabriel-vasile/mimetype						 v1.4.6 \
	github.com/gammazero/chanqueue							 v1.1.0 \
	github.com/gammazero/deque							 v1.0.0 \
	github.com/getsentry/sentry-go							 v0.27.0 \
	github.com/go-logr/logr								 v1.4.2 \
	github.com/go-logr/stdr								 v1.2.2 \
	github.com/go-redis/cache/v9							 v9.0.0 \
	github.com/go-redis/redis							 v6.15.9+incompatible \
	github.com/go-task/slim-sprig/v3						 v3.0.0 \
	github.com/go-yaml/yaml								 v2.1.0+incompatible \
	github.com/goccy/go-json							 v0.10.2 \
	github.com/gocql/gocql								 v1.7.0 \
	github.com/godbus/dbus/v5							 v5.1.0 \
	github.com/gogo/protobuf							 v1.3.2 \
	github.com/golang-jwt/jwt							 v3.2.2+incompatible \
	github.com/golang-jwt/jwt/v5							 v5.2.2 \
	github.com/golang/protobuf							 v1.5.3 \
	github.com/golang/snappy							 v0.0.4 \
	github.com/google/go-cmp							 v0.7.0 \
	github.com/google/go-querystring						 v1.1.0 \
	github.com/google/gopacket							 v1.1.19 \
	github.com/google/pprof								 v0.0.0-20250208200701-d0013a598941 \
	github.com/google/renameio							 v0.1.0 \
	github.com/google/uuid								 v1.6.0 \
	github.com/gopherjs/gopherjs							 v0.0.0-20190430165422-3e4dfb77656c \
	github.com/gorilla/mux								 v1.8.1 \
	github.com/gorilla/securecookie							 v1.1.1 \
	github.com/gorilla/sessions							 v1.2.1 \
	github.com/gorilla/websocket							 v1.5.3 \
	github.com/grpc-ecosystem/grpc-gateway/v2					 v2.22.0 \
	github.com/hailocab/go-hostpool							 v0.0.0-20160125115350-e80d13ce29ed \
	github.com/hashicorp/go-cleanhttp						 v0.5.2 \
	github.com/hashicorp/go-hclog							 v0.9.2 \
	github.com/hashicorp/go-retryablehttp						 v0.7.5 \
	github.com/hashicorp/golang-lru							 v1.0.2 \
	github.com/hashicorp/golang-lru/arc/v2						 v2.0.6 \
	github.com/hashicorp/golang-lru/v2						 v2.0.7 \
	github.com/huin/goupnp								 v1.3.0 \
	github.com/icrowley/fake							 v0.0.0-20221112152111-d7b7e2276db2 \
	github.com/ipfs/bbloom								 v0.0.4 \
	github.com/ipfs/boxo								 v0.32.0 \
	github.com/ipfs/go-bitfield							 v1.1.0 \
	github.com/ipfs/go-bitswap							 v0.11.0 \
	github.com/ipfs/go-block-format							 v0.2.2 \
	github.com/ipfs/go-blockservice							 v0.5.2 \
	github.com/ipfs/go-cid								 v0.5.0 \
	github.com/ipfs/go-cidutil							 v0.1.0 \
	github.com/ipfs/go-datastore							 v0.8.2 \
	github.com/ipfs/go-detect-race							 v0.0.1 \
	github.com/ipfs/go-ds-flatfs							 v0.5.1 \
	github.com/ipfs/go-ipfs-blockstore						 v1.3.1 \
	github.com/ipfs/go-ipfs-blocksutil						 v0.0.1 \
	github.com/ipfs/go-ipfs-delay							 v0.0.1 \
	github.com/ipfs/go-ipfs-ds-help							 v1.1.1 \
	github.com/ipfs/go-ipfs-exchange-interface					 v0.2.1 \
	github.com/ipfs/go-ipfs-exchange-offline					 v0.3.0 \
	github.com/ipfs/go-ipfs-pq							 v0.0.3 \
	github.com/ipfs/go-ipfs-redirects-file						 v0.1.2 \
	github.com/ipfs/go-ipfs-routing							 v0.3.0 \
	github.com/ipfs/go-ipfs-util							 v0.0.3 \
	github.com/ipfs/go-ipld-cbor							 v0.2.1 \
	github.com/ipfs/go-ipld-format							 v0.6.2 \
	github.com/ipfs/go-ipld-legacy							 v0.2.1 \
	github.com/ipfs/go-libipfs							 v0.7.0 \
	github.com/ipfs/go-log								 v1.0.5 \
	github.com/ipfs/go-log/v2							 v2.6.0 \
	github.com/ipfs/go-merkledag							 v0.11.0 \
	github.com/ipfs/go-metrics-interface						 v0.3.0 \
	github.com/ipfs/go-peertaskqueue						 v0.8.2 \
	github.com/ipfs/go-test								 v0.2.2 \
	github.com/ipfs/go-unixfsnode							 v1.10.1 \
	github.com/ipfs/go-verifcid							 v0.0.3 \
	github.com/ipld/go-car								 v0.6.1-0.20230509095817-92d28eb23ba4 \
	github.com/ipld/go-car/v2							 v2.14.3 \
	github.com/ipld/go-codec-dagpb							 v1.7.0 \
	github.com/ipld/go-ipld-prime							 v0.21.0 \
	github.com/jackc/pgpassfile							 v1.0.0 \
	github.com/jackc/pgservicefile							 v0.0.0-20221227161230-091c0ba34f0a \
	github.com/jackc/pgx/v5								 v5.5.0 \
	github.com/jackc/puddle/v2							 v2.2.1 \
	github.com/jackpal/go-nat-pmp							 v1.0.2 \
	github.com/jbenet/go-temp-err-catcher						 v0.1.0 \
	github.com/jbenet/goprocess							 v0.1.4 \
	github.com/jinzhu/inflection							 v1.0.0 \
	github.com/jinzhu/now								 v1.1.5 \
	github.com/joho/godotenv							 v1.5.1 \
	github.com/jpillora/backoff							 v1.0.0 \
	github.com/json-iterator/go							 v1.1.12 \
	github.com/jtolds/gls								 v4.20.0+incompatible \
	github.com/julienschmidt/httprouter						 v1.3.0 \
	github.com/kisielk/errcheck							 v1.5.0 \
	github.com/kisielk/gotool							 v1.0.0 \
	github.com/klauspost/compress							 v1.18.0 \
	github.com/klauspost/cpuid/v2							 v2.2.10 \
	github.com/koron/go-ssdp							 v0.0.5 \
	github.com/kr/pretty								 v0.3.1 \
	github.com/kr/pty								 v1.1.1 \
	github.com/kr/text								 v0.2.0 \
	github.com/kylelemons/godebug							 v1.1.0 \
	github.com/labstack/echo-contrib						 v0.15.0 \
	github.com/labstack/echo/v4							 v4.11.3 \
	github.com/labstack/gommon							 v0.4.1 \
	github.com/lestrrat-go/blackmagic						 v1.0.1 \
	github.com/lestrrat-go/httpcc							 v1.0.1 \
	github.com/lestrrat-go/httprc							 v1.0.4 \
	github.com/lestrrat-go/iter							 v1.0.2 \
	github.com/lestrrat-go/jwx/v2							 v2.0.12 \
	github.com/lestrrat-go/option							 v1.0.1 \
	github.com/lib/pq								 v1.10.9 \
	github.com/libp2p/go-buffer-pool						 v0.1.0 \
	github.com/libp2p/go-cidranger							 v1.1.0 \
	github.com/libp2p/go-doh-resolver						 v0.5.0 \
	github.com/libp2p/go-flow-metrics						 v0.2.0 \
	github.com/libp2p/go-libp2p							 v0.41.1 \
	github.com/libp2p/go-libp2p-asn-util						 v0.4.1 \
	github.com/libp2p/go-libp2p-kad-dht						 v0.33.1 \
	github.com/libp2p/go-libp2p-kbucket						 v0.7.0 \
	github.com/libp2p/go-libp2p-record						 v0.3.1 \
	github.com/libp2p/go-libp2p-routing-helpers					 v0.7.5 \
	github.com/libp2p/go-libp2p-testing						 v0.12.0 \
	github.com/libp2p/go-msgio							 v0.3.0 \
	github.com/libp2p/go-nat							 v0.1.0 \
	github.com/libp2p/go-netroute							 v0.2.2 \
	github.com/libp2p/go-openssl							 v0.1.0 \
	github.com/libp2p/go-reuseport							 v0.4.0 \
	github.com/libp2p/go-yamux/v5							 v5.0.0 \
	github.com/marten-seemann/tcp							 v0.0.0-20210406111302-dfbc87cc63fd \
	github.com/mattn/go-colorable							 v0.1.13 \
	github.com/mattn/go-isatty							 v0.0.20 \
	github.com/mattn/go-pointer							 v0.0.1 \
	github.com/mattn/go-sqlite3							 v1.14.22 \
	github.com/matttproud/golang_protobuf_extensions/v2				 v2.0.0 \
	github.com/miekg/dns								 v1.1.66 \
	github.com/mikioh/tcpinfo							 v0.0.0-20190314235526-30a79bb1804b \
	github.com/mikioh/tcpopt							 v0.0.0-20190314235656-172688c1accc \
	github.com/minio/blake2b-simd							 v0.0.0-20160723061019-3f5f724cb5b1 \
	github.com/minio/sha256-simd							 v1.0.1 \
	github.com/modern-go/concurrent							 v0.0.0-20180306012644-bacd9c7ef1dd \
	github.com/modern-go/reflect2							 v1.0.2 \
	github.com/mr-tron/base58							 v1.2.0 \
	github.com/multiformats/go-base32						 v0.1.0 \
	github.com/multiformats/go-base36						 v0.2.0 \
	github.com/multiformats/go-multiaddr						 v0.16.0 \
	github.com/multiformats/go-multiaddr-dns					 v0.4.1 \
	github.com/multiformats/go-multiaddr-fmt					 v0.1.0 \
	github.com/multiformats/go-multibase						 v0.2.0 \
	github.com/multiformats/go-multicodec						 v0.9.1 \
	github.com/multiformats/go-multihash						 v0.2.3 \
	github.com/multiformats/go-multistream						 v0.6.1 \
	github.com/multiformats/go-varint						 v0.0.7 \
	github.com/munnerz/goautoneg							 v0.0.0-20191010083416-a7dc8b61c822 \
	github.com/mwitkow/go-conntrack							 v0.0.0-20190716064945-2f068394615f \
	github.com/onsi/ginkgo/v2							 v2.22.2 \
	github.com/opencontainers/runtime-spec						 v1.2.0 \
	github.com/opensearch-project/opensearch-go/v2					 v2.3.0 \
	github.com/opentracing/opentracing-go						 v1.2.0 \
	github.com/openzipkin/zipkin-go							 v0.4.3 \
	github.com/orandin/slog-gorm							 v1.3.2 \
	github.com/pbnjay/memory							 v0.0.0-20210728143218-7b4eea64cf58 \
	github.com/petar/!go!l!l!r!b							 v0.0.0-20210522233825-ae3b015fd3e9 \
	github.com/pion/datachannel							 v1.5.10 \
	github.com/pion/dtls/v2								 v2.2.12 \
	github.com/pion/dtls/v3								 v3.0.4 \
	github.com/pion/ice/v4								 v4.0.8 \
	github.com/pion/interceptor							 v0.1.37 \
	github.com/pion/logging								 v0.2.3 \
	github.com/pion/mdns/v2								 v2.0.7 \
	github.com/pion/randutil							 v0.1.0 \
	github.com/pion/rtcp								 v1.2.15 \
	github.com/pion/rtp								 v1.8.11 \
	github.com/pion/sctp								 v1.8.37 \
	github.com/pion/sdp/v3								 v3.0.10 \
	github.com/pion/srtp/v3								 v3.0.4 \
	github.com/pion/stun								 v0.6.1 \
	github.com/pion/stun/v3								 v3.0.0 \
	github.com/pion/transport/v2							 v2.2.10 \
	github.com/pion/transport/v3							 v3.0.7 \
	github.com/pion/turn/v4								 v4.0.0 \
	github.com/pion/webrtc/v4							 v4.0.10 \
	github.com/pkg/errors								 v0.9.1 \
	github.com/pmezard/go-difflib							 v1.0.0 \
	github.com/polydawn/refmt							 v0.89.1-0.20221221234430-40501e09de1f \
	github.com/prometheus/client_golang						 v1.22.0 \
	github.com/prometheus/client_model						 v0.6.2 \
	github.com/prometheus/common							 v0.63.0 \
	github.com/prometheus/procfs							 v0.16.1 \
	github.com/puzpuzpuz/xsync/v3							 v3.0.2 \
	github.com/quic-go/qpack							 v0.5.1 \
	github.com/quic-go/quic-go							 v0.50.1 \
	github.com/quic-go/webtransport-go						 v0.8.1-0.20241018022711-4ac2c9250e66 \
	github.com/raulk/go-watchdog							 v1.3.0 \
	github.com/redis/go-redis/v9							 v9.3.0 \
	github.com/rivo/uniseg								 v0.1.0 \
	github.com/rogpeppe/go-internal							 v1.13.1 \
	github.com/russross/blackfriday/v2						 v2.1.0 \
	github.com/samber/lo								 v1.47.0 \
	github.com/samber/slog-echo							 v1.8.0 \
	github.com/segmentio/asm							 v1.2.0 \
	github.com/shurcoo!l/sanitized_anchor_name					 v1.0.0 \
	github.com/slok/go-http-metrics							 v0.12.0 \
	github.com/smartystreets/assertions						 v1.2.0 \
	github.com/smartystreets/goconvey						 v1.7.2 \
	github.com/spacemonkeygo/spacelog						 v0.0.0-20180420211403-2296661a0572 \
	github.com/spaolacci/murmur3							 v1.1.0 \
	github.com/stretchr/objx							 v0.5.2 \
	github.com/stretchr/testify							 v1.10.0 \
	github.com/ucarion/urlpath							 v0.0.0-20200424170820-7ccc79b76bbb \
	github.com/urfave/cli								 v1.22.10 \
	github.com/urfave/cli/v2							 v2.25.7 \
	github.com/urfave/cli/v3							 v3.4.1 \
	github.com/valyala/bytebufferpool						 v1.0.0 \
	github.com/valyala/fasttemplate							 v1.2.2 \
	github.com/vmihailenco/go-tinylfu						 v0.2.2 \
	github.com/vmihailenco/msgpack/v5						 v5.4.1 \
	github.com/vmihailenco/tagparser/v2						 v2.0.0 \
	github.com/warpfork/go-testmark							 v0.12.1 \
	github.com/warpfork/go-wish							 v0.0.0-20220906213052-39a1cc7a02d0 \
	github.com/whyrusleeping/base32							 v0.0.0-20170828182744-c30ac30633cc \
	github.com/whyrusleeping/cbor							 v0.0.0-20171005072247-63513f603b11 \
	github.com/whyrusleeping/cbor-gen						 v0.3.1 \
	github.com/whyrusleeping/chunker						 v0.0.0-20181014151217-fe64bd25879f \
	github.com/whyrusleeping/go-did							 v0.0.0-20230824162731-404d1707d5d6 \
	github.com/whyrusleeping/go-keyspace						 v0.0.0-20160322163242-5b898ac5add1 \
	github.com/whyrusleeping/go-logging						 v0.0.0-20170515211332-0457bb6b88fc \
	github.com/wlynxg/anet								 v0.0.5 \
	github.com/xhit/go-str2duration/v2						 v2.1.0 \
	github.com/xlab/treeprint							 v1.2.0 \
	github.com/xrash/smetrics							 v0.0.0-20201216005158-039620a65673 \
	github.com/yuin/goldmark							 v1.2.1 \
	gitlab.com/yawning/secp256k1-voi						 v0.0.0-20230925100816-f2616030848b \
	gitlab.com/yawning/tuplehash							 v0.0.0-20230713102510-df83abbf9a02 \
	go.opencensus.io								 v0.24.0 \
	go.opentelemetry.io/auto/sdk							 v1.1.0 \
	go.opentelemetry.io/contrib/instrumentation/github.com/labstack/echo/otelecho	 v0.45.0 \
	go.opentelemetry.io/contrib/instrumentation/net/http/otelhttp			 v0.56.0 \
	go.opentelemetry.io/otel							 v1.35.0 \
	go.opentelemetry.io/otel/exporters/jaeger					 v1.14.0 \
	go.opentelemetry.io/otel/exporters/otlp/otlptrace				 v1.31.0 \
	go.opentelemetry.io/otel/exporters/otlp/otlptrace/otlptracegrpc			 v1.31.0 \
	go.opentelemetry.io/otel/exporters/otlp/otlptrace/otlptracehttp			 v1.31.0 \
	go.opentelemetry.io/otel/exporters/stdout/stdouttrace				 v1.31.0 \
	go.opentelemetry.io/otel/exporters/zipkin					 v1.31.0 \
	go.opentelemetry.io/otel/metric							 v1.35.0 \
	go.opentelemetry.io/otel/sdk							 v1.31.0 \
	go.opentelemetry.io/otel/trace							 v1.35.0 \
	go.opentelemetry.io/proto/otlp							 v1.3.1 \
	go.uber.org/atomic								 v1.11.0 \
	go.uber.org/automaxprocs							 v1.5.3 \
	go.uber.org/dig									 v1.18.0 \
	go.uber.org/fx									 v1.23.0 \
	go.uber.org/goleak								 v1.3.0 \
	go.uber.org/mock								 v0.5.0 \
	go.uber.org/multierr								 v1.11.0 \
	go.uber.org/tools								 v0.0.0-20190618225709-2cfd321de3ee \
	go.uber.org/zap									 v1.27.0 \
	golang.org/x/crypto								 v0.39.0 \
	golang.org/x/exp								 v0.0.0-20250606033433-dcc06ee1d476 \
	golang.org/x/lint								 v0.0.0-20190930215403-16217165b5de \
	golang.org/x/mod								 v0.25.0 \
	golang.org/x/net								 v0.41.0 \
	golang.org/x/oauth2								 v0.25.0 \
	golang.org/x/sync								 v0.15.0 \
	golang.org/x/sys								 v0.33.0 \
	golang.org/x/term								 v0.32.0 \
	golang.org/x/text								 v0.26.0 \
	golang.org/x/time								 v0.3.0 \
	golang.org/x/tools								 v0.34.0 \
	golang.org/x/xerrors								 v0.0.0-20240903120638-7835f813f4da \
	gonum.org/v1/gonum								 v0.16.0 \
	google.golang.org/genproto/googleapis/api					 v0.0.0-20241007155032-5fefd90f89a9 \
	google.golang.org/genproto/googleapis/rpc					 v0.0.0-20241007155032-5fefd90f89a9 \
	google.golang.org/grpc								 v1.67.1 \
	google.golang.org/protobuf							 v1.36.6 \
	gopkg.in/check.v1								 v1.0.0-20201130134442-10cb98267c6c \
	gopkg.in/errgo.v2								 v2.1.0 \
	gopkg.in/inf.v0									 v0.9.1 \
	gopkg.in/yaml.v2								 v2.4.0 \
	gopkg.in/yaml.v3								 v3.0.1 \
	gorm.io/driver/postgres								 v1.5.7 \
	gorm.io/driver/sqlite								 v1.5.5 \
	gorm.io/gorm									 v1.25.9 \
	gorm.io/plugin/opentelemetry							 v0.1.3 \
	honnef.co/go/tools								 v0.0.1-2019.2.3 \
	lukechampine.com/blake3								 v1.4.1

MODGO_MODFILES =	\
	github.com/adrg/xdg						 v0.5.0 \
	github.com/alecthomas/units					 v0.0.0-20211218093645-b94a6e3cc137 \
	github.com/benbjohnson/clock					 v1.3.0 \
	github.com/bluesky-social/indigo				 v0.0.0-20250703203720-0f3058806983 \
	github.com/cenkalti/backoff/v4					 v4.2.1 \
	github.com/cespare/xxhash/v2					 v2.2.0 \
	github.com/cpuguy83/go-md2man/v2				 v2.0.0-20190314233015-f79a8a8ca69d \
	github.com/davecgh/go-spew					 v1.1.0 \
	github.com/decred/dcrd/dcrec/secp256k1/v4			 v4.1.0 \
	github.com/decred/dcrd/dcrec/secp256k1/v4			 v4.2.0 \
	github.com/did-method-plc/go-didplc				 v0.0.0-20250716171643-635da8b4e038 \
	github.com/go-logr/logr						 v1.2.2 \
	github.com/go-logr/logr						 v1.2.3 \
	github.com/go-logr/logr						 v1.4.1 \
	github.com/gogo/protobuf					 v1.2.1 \
	github.com/golang/protobuf					 v1.5.0 \
	github.com/google/go-cmp					 v0.4.0 \
	github.com/google/go-cmp					 v0.5.5 \
	github.com/google/go-cmp					 v0.5.9 \
	github.com/google/uuid						 v1.1.1 \
	github.com/google/uuid						 v1.3.0 \
	github.com/google/uuid						 v1.4.0 \
	github.com/gopherjs/gopherjs					 v0.0.0-20181017120253-0766667cb4d1 \
	github.com/gorilla/websocket					 v1.5.1 \
	github.com/grpc-ecosystem/grpc-gateway/v2			 v2.18.1 \
	github.com/hashicorp/golang-lru					 v0.5.4 \
	github.com/huin/goupnp						 v1.0.3 \
	github.com/ipfs/go-block-format					 v0.0.2 \
	github.com/ipfs/go-block-format					 v0.0.3 \
	github.com/ipfs/go-block-format					 v0.1.2 \
	github.com/ipfs/go-block-format					 v0.2.0 \
	github.com/ipfs/go-block-format					 v0.2.1 \
	github.com/ipfs/go-blockservice					 v0.5.0 \
	github.com/ipfs/go-cid						 v0.0.5 \
	github.com/ipfs/go-cid						 v0.0.6 \
	github.com/ipfs/go-cid						 v0.0.7 \
	github.com/ipfs/go-cid						 v0.2.0 \
	github.com/ipfs/go-cid						 v0.3.2 \
	github.com/ipfs/go-cid						 v0.4.1 \
	github.com/ipfs/go-datastore					 v0.5.0 \
	github.com/ipfs/go-datastore					 v0.6.0 \
	github.com/ipfs/go-ipfs-blockstore				 v1.2.0 \
	github.com/ipfs/go-ipfs-ds-help					 v1.1.0 \
	github.com/ipfs/go-ipfs-exchange-interface			 v0.2.0 \
	github.com/ipfs/go-ipfs-pq					 v0.0.2 \
	github.com/ipfs/go-ipfs-util					 v0.0.1 \
	github.com/ipfs/go-ipfs-util					 v0.0.2 \
	github.com/ipfs/go-ipld-cbor					 v0.0.6 \
	github.com/ipfs/go-ipld-cbor					 v0.1.0 \
	github.com/ipfs/go-ipld-cbor					 v0.2.0 \
	github.com/ipfs/go-ipld-format					 v0.2.0 \
	github.com/ipfs/go-ipld-format					 v0.3.0 \
	github.com/ipfs/go-ipld-format					 v0.4.0 \
	github.com/ipfs/go-ipld-format					 v0.5.0 \
	github.com/ipfs/go-ipld-format					 v0.6.0 \
	github.com/ipfs/go-ipld-format					 v0.6.1 \
	github.com/ipfs/go-ipld-legacy					 v0.1.1 \
	github.com/ipfs/go-log						 v0.0.1 \
	github.com/ipfs/go-log/v2					 v2.1.3 \
	github.com/ipfs/go-log/v2					 v2.5.1 \
	github.com/ipfs/go-merkledag					 v0.10.0 \
	github.com/ipfs/go-metrics-interface				 v0.0.1 \
	github.com/ipfs/go-peertaskqueue				 v0.8.0 \
	github.com/ipfs/go-verifcid					 v0.0.1 \
	github.com/ipfs/go-verifcid					 v0.0.2 \
	github.com/ipld/go-car/v2					 v2.13.1 \
	github.com/ipld/go-codec-dagpb					 v1.6.0 \
	github.com/ipld/go-ipld-prime					 v0.20.0 \
	github.com/ipld/go-ipld-prime					 v0.9.1-0.20210324083106-dc342a9917db \
	github.com/jtolds/gls						 v4.2.1+incompatible \
	github.com/klauspost/compress					 v1.17.3 \
	github.com/klauspost/cpuid/v2					 v2.0.4 \
	github.com/klauspost/cpuid/v2					 v2.0.9 \
	github.com/klauspost/cpuid/v2					 v2.1.0 \
	github.com/klauspost/cpuid/v2					 v2.2.3 \
	github.com/klauspost/cpuid/v2					 v2.2.7 \
	github.com/koron/go-ssdp					 v0.0.3 \
	github.com/kr/pretty						 v0.1.0 \
	github.com/kr/pretty						 v0.2.1 \
	github.com/kr/text						 v0.1.0 \
	github.com/libp2p/go-libp2p					 v0.22.0 \
	github.com/libp2p/go-libp2p-asn-util				 v0.2.0 \
	github.com/libp2p/go-libp2p-record				 v0.2.0 \
	github.com/libp2p/go-msgio					 v0.2.0 \
	github.com/libp2p/go-netroute					 v0.2.0 \
	github.com/mattn/go-colorable					 v0.1.1 \
	github.com/mattn/go-isatty					 v0.0.16 \
	github.com/mattn/go-isatty					 v0.0.17 \
	github.com/mattn/go-isatty					 v0.0.5 \
	github.com/miekg/dns						 v1.1.50 \
	github.com/minio/sha256-simd					 v0.1.1-0.20190913151208-6de447530771 \
	github.com/minio/sha256-simd					 v1.0.0 \
	github.com/mr-tron/base58					 v1.1.0 \
	github.com/mr-tron/base58					 v1.1.3 \
	github.com/multiformats/go-base32				 v0.0.3 \
	github.com/multiformats/go-base32				 v0.0.4 \
	github.com/multiformats/go-base36				 v0.1.0 \
	github.com/multiformats/go-multiaddr				 v0.7.0 \
	github.com/multiformats/go-multiaddr-dns			 v0.3.1 \
	github.com/multiformats/go-multibase				 v0.0.1 \
	github.com/multiformats/go-multibase				 v0.0.3 \
	github.com/multiformats/go-multibase				 v0.1.1 \
	github.com/multiformats/go-multicodec				 v0.5.0 \
	github.com/multiformats/go-multicodec				 v0.8.0 \
	github.com/multiformats/go-multicodec				 v0.9.0 \
	github.com/multiformats/go-multihash				 v0.0.13 \
	github.com/multiformats/go-multihash				 v0.0.14 \
	github.com/multiformats/go-multihash				 v0.0.15 \
	github.com/multiformats/go-multihash				 v0.2.1 \
	github.com/multiformats/go-multistream				 v0.3.3 \
	github.com/multiformats/go-varint				 v0.0.5 \
	github.com/multiformats/go-varint				 v0.0.6 \
	github.com/opentracing/opentracing-go				 v1.0.2 \
	github.com/pkg/errors						 v0.8.1 \
	github.com/polydawn/refmt					 v0.0.0-20190807091052-3d65705ee9f1 \
	github.com/polydawn/refmt					 v0.0.0-20201211092308-30ac6d18308e \
	github.com/polydawn/refmt					 v0.89.0 \
	github.com/prometheus/client_golang				 v1.17.0 \
	github.com/prometheus/client_golang				 v1.20.4 \
	github.com/prometheus/client_model				 v0.5.0 \
	github.com/prometheus/client_model				 v0.6.1 \
	github.com/prometheus/common					 v0.45.0 \
	github.com/prometheus/common					 v0.62.0 \
	github.com/prometheus/procfs					 v0.12.0 \
	github.com/prometheus/procfs					 v0.15.1 \
	github.com/rogpeppe/go-internal					 v1.10.0 \
	github.com/rogpeppe/go-internal					 v1.3.0 \
	github.com/rogpeppe/go-internal					 v1.9.0 \
	github.com/russross/blackfriday/v2				 v2.0.1 \
	github.com/samber/lo						 v1.38.1 \
	github.com/smartystreets/assertions				 v0.0.0-20180927180507-b2de0cb4f26d \
	github.com/stretchr/objx					 v0.1.0 \
	github.com/stretchr/testify					 v1.2.2 \
	github.com/stretchr/testify					 v1.3.0 \
	github.com/stretchr/testify					 v1.4.0 \
	github.com/stretchr/testify					 v1.7.0 \
	github.com/stretchr/testify					 v1.8.1 \
	github.com/stretchr/testify					 v1.8.2 \
	github.com/stretchr/testify					 v1.8.4 \
	github.com/stretchr/testify					 v1.9.0 \
	github.com/whyrusleeping/cbor-gen				 v0.0.0-20230126041949-52956bd4c9aa \
	github.com/whyrusleeping/cbor-gen				 v0.1.2 \
	github.com/whyrusleeping/cbor-gen				 v0.2.1-0.20241030202151-b7a6831be65e \
	github.com/yuin/goldmark					 v1.1.27 \
	go.opentelemetry.io/contrib/instrumentation/net/http/otelhttp	 v0.46.1 \
	go.opentelemetry.io/otel					 v1.13.0 \
	go.opentelemetry.io/otel					 v1.21.0 \
	go.opentelemetry.io/otel					 v1.31.0 \
	go.opentelemetry.io/otel					 v1.32.0 \
	go.opentelemetry.io/otel					 v1.34.0 \
	go.opentelemetry.io/otel					 v1.7.0 \
	go.opentelemetry.io/otel/exporters/otlp/otlptrace		 v1.21.0 \
	go.opentelemetry.io/otel/exporters/otlp/otlptrace/otlptracehttp	 v1.21.0 \
	go.opentelemetry.io/otel/metric					 v1.21.0 \
	go.opentelemetry.io/otel/metric					 v1.31.0 \
	go.opentelemetry.io/otel/metric					 v1.34.0 \
	go.opentelemetry.io/otel/sdk					 v1.21.0 \
	go.opentelemetry.io/otel/trace					 v1.13.0 \
	go.opentelemetry.io/otel/trace					 v1.21.0 \
	go.opentelemetry.io/otel/trace					 v1.31.0 \
	go.opentelemetry.io/otel/trace					 v1.32.0 \
	go.opentelemetry.io/otel/trace					 v1.34.0 \
	go.opentelemetry.io/otel/trace					 v1.7.0 \
	go.opentelemetry.io/proto/otlp					 v1.0.0 \
	go.uber.org/atomic						 v1.10.0 \
	go.uber.org/atomic						 v1.6.0 \
	go.uber.org/atomic						 v1.7.0 \
	go.uber.org/goleak						 v1.1.12 \
	go.uber.org/multierr						 v1.10.0 \
	go.uber.org/multierr						 v1.5.0 \
	go.uber.org/multierr						 v1.6.0 \
	go.uber.org/multierr						 v1.8.0 \
	go.uber.org/multierr						 v1.9.0 \
	go.uber.org/zap							 v1.16.0 \
	go.uber.org/zap							 v1.22.0 \
	go.uber.org/zap							 v1.24.0 \
	go.uber.org/zap							 v1.26.0 \
	golang.org/x/crypto						 v0.0.0-20190308221718-c2843e01d9a2 \
	golang.org/x/crypto						 v0.0.0-20190510104115-cbcb75029529 \
	golang.org/x/crypto						 v0.0.0-20190611184440-5c40567a22f8 \
	golang.org/x/crypto						 v0.0.0-20191011191535-87dc89f01550 \
	golang.org/x/crypto						 v0.0.0-20200622213623-75b288015ac9 \
	golang.org/x/crypto						 v0.0.0-20210220033148-5ea612d1eb83 \
	golang.org/x/crypto						 v0.0.0-20220525230936-793ad666bf5e \
	golang.org/x/crypto						 v0.1.0 \
	golang.org/x/crypto						 v0.11.0 \
	golang.org/x/crypto						 v0.21.0 \
	golang.org/x/crypto						 v0.31.0 \
	golang.org/x/crypto						 v0.6.0 \
	golang.org/x/exp						 v0.0.0-20231110203233-9a3e6036ecaa \
	golang.org/x/mod						 v0.0.0-20190513183733-4bf6d317e70e \
	golang.org/x/mod						 v0.14.0 \
	golang.org/x/mod						 v0.2.0 \
	golang.org/x/mod						 v0.3.0 \
	golang.org/x/mod						 v0.6.0-dev.0.20220419223038-86c51ed26bb4 \
	golang.org/x/net						 v0.0.0-20190311183353-d8887717615a \
	golang.org/x/net						 v0.0.0-20190404232315-eb5bcb51f2a3 \
	golang.org/x/net						 v0.0.0-20190620200207-3b0461eec859 \
	golang.org/x/net						 v0.0.0-20200226121028-0de0cce0169b \
	golang.org/x/net						 v0.0.0-20201021035429-f5854403a974 \
	golang.org/x/net						 v0.0.0-20220812174116-3211cb980234 \
	golang.org/x/net						 v0.21.0 \
	golang.org/x/net						 v0.23.0 \
	golang.org/x/net						 v0.33.0 \
	golang.org/x/net						 v0.35.0 \
	golang.org/x/net						 v0.7.0 \
	golang.org/x/oauth2						 v0.24.0 \
	golang.org/x/sync						 v0.0.0-20190423024810-112230192c58 \
	golang.org/x/sync						 v0.0.0-20190911185100-cd5d95a43a6e \
	golang.org/x/sync						 v0.0.0-20201020160332-67f06af15bc9 \
	golang.org/x/sync						 v0.0.0-20220722155255-886fb9371eb4 \
	golang.org/x/sync						 v0.13.0 \
	golang.org/x/sync						 v0.7.0 \
	golang.org/x/sys						 v0.0.0-20190215142949-d0b11bdaac8a \
	golang.org/x/sys						 v0.0.0-20190412213103-97732733099d \
	golang.org/x/sys						 v0.0.0-20200930185726-fdedc70b468f \
	golang.org/x/sys						 v0.0.0-20210309074719-68d13333faf2 \
	golang.org/x/sys						 v0.0.0-20210615035016-665e8c7367d1 \
	golang.org/x/sys						 v0.0.0-20220704084225-05e143d24a9e \
	golang.org/x/sys						 v0.0.0-20220811171246-fbc7d0a398ab \
	golang.org/x/sys						 v0.1.0 \
	golang.org/x/sys						 v0.10.0 \
	golang.org/x/sys						 v0.22.0 \
	golang.org/x/sys						 v0.26.0 \
	golang.org/x/sys						 v0.28.0 \
	golang.org/x/sys						 v0.30.0 \
	golang.org/x/sys						 v0.32.0 \
	golang.org/x/sys						 v0.5.0 \
	golang.org/x/sys						 v0.6.0 \
	golang.org/x/text						 v0.14.0 \
	golang.org/x/text						 v0.21.0 \
	golang.org/x/text						 v0.22.0 \
	golang.org/x/text						 v0.3.0 \
	golang.org/x/text						 v0.3.3 \
	golang.org/x/tools						 v0.0.0-20180917221912-90fa682c2a6e \
	golang.org/x/tools						 v0.0.0-20190311212946-11955173bddd \
	golang.org/x/tools						 v0.0.0-20190328211700-ab21143f2384 \
	golang.org/x/tools						 v0.0.0-20190621195816-6e04913cbbac \
	golang.org/x/tools						 v0.0.0-20191029041327-9cc4af7d6b2c \
	golang.org/x/tools						 v0.0.0-20191029190741-b9c20aec41a5 \
	golang.org/x/tools						 v0.0.0-20191119224855-298f0cb1881e \
	golang.org/x/tools						 v0.0.0-20200619180055-7c47624df98f \
	golang.org/x/tools						 v0.0.0-20210106214847-113979e3529a \
	golang.org/x/tools						 v0.1.12 \
	golang.org/x/tools						 v0.15.0 \
	golang.org/x/xerrors						 v0.0.0-20190717185122-a985d3407aa7 \
	golang.org/x/xerrors						 v0.0.0-20191011141410-1b5146add898 \
	golang.org/x/xerrors						 v0.0.0-20191204190536-9bdfabe68543 \
	golang.org/x/xerrors						 v0.0.0-20200804184101-5ec99f83aff1 \
	golang.org/x/xerrors						 v0.0.0-20220907171357-04be3eba64a2 \
	golang.org/x/xerrors						 v0.0.0-20231012003039-104605ab7028 \
	google.golang.org/genproto/googleapis/api			 v0.0.0-20231120223509-83a465c0220f \
	google.golang.org/genproto/googleapis/rpc			 v0.0.0-20231120223509-83a465c0220f \
	google.golang.org/grpc						 v1.59.0 \
	google.golang.org/protobuf					 v1.28.1 \
	google.golang.org/protobuf					 v1.33.0 \
	google.golang.org/protobuf					 v1.36.5 \
	gopkg.in/check.v1						 v0.0.0-20161208181325-20d25e280405 \
	gopkg.in/check.v1						 v1.0.0-20180628173108-788fd7840127 \
	gopkg.in/yaml.v2						 v2.2.2 \
	gopkg.in/yaml.v3						 v3.0.0-20200313102051-9f266ea9e77c \
	lukechampine.com/blake3						 v1.1.6 \
	lukechampine.com/blake3						 v1.1.7 \
	lukechampine.com/blake3						 v1.2.1

