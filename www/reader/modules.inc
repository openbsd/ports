MODGO_MODULES =	\
	ariga.io/atlas						 v0.25.0 \
	cloud.google.com/go					 v0.37.0 \
	dmitri.shuralyov.com/app/changes			 v0.0.0-20180602232624-0a106ad413e3 \
	dmitri.shuralyov.com/html/belt				 v0.0.0-20180602232347-f7d459c86be0 \
	dmitri.shuralyov.com/service/change			 v0.0.0-20181023043359-a85b471d5412 \
	dmitri.shuralyov.com/state				 v0.0.0-20180228185332-28bcc343414c \
	entgo.io/ent						 v0.13.1 \
	filippo.io/edwards25519					 v1.1.0 \
	git.apache.org/thrift.git				 v0.0.0-20180902110319-2566ecd5d999 \
	github.com/!burnt!sushi/toml				 v0.3.1 \
	github.com/!danny-!dasilva/!cycle!t!l!s/cycletls	 v1.0.26 \
	github.com/!danny-!dasilva/fhttp			 v0.0.0-20240217042913-eeeb0b347ce1 \
	github.com/!johannes!kaufmann/html-to-markdown		 v1.6.0 \
	github.com/!kyle!banks/depth				 v1.2.1 \
	github.com/!puerkito!bio/goquery			 v1.10.1 \
	github.com/!puerkito!bio/purell				 v1.2.1 \
	github.com/!puerkito!bio/urlesc				 v0.0.0-20170810143723-de5bf2ad4578 \
	github.com/agext/levenshtein				 v1.2.3 \
	github.com/alecthomas/assert/v2				 v2.11.0 \
	github.com/alecthomas/chroma/v2				 v2.15.0 \
	github.com/alecthomas/repr				 v0.4.0 \
	github.com/andybalholm/brotli				 v1.1.1 \
	github.com/andybalholm/cascadia				 v1.3.3 \
	github.com/anmitsu/go-shlex				 v0.0.0-20161002113705-648efa622239 \
	github.com/apparentlymart/go-textseg/v13		 v13.0.0 \
	github.com/apparentlymart/go-textseg/v15		 v15.0.0 \
	github.com/araddon/dateparse				 v0.0.0-20210429162001-6b43995a97de \
	github.com/aws/aws-lambda-go				 v1.47.0 \
	github.com/awslabs/aws-lambda-go-api-proxy		 v0.16.2 \
	github.com/aymanbagabas/go-osc52/v2			 v2.0.1 \
	github.com/aymanbagabas/go-udiff			 v0.2.0 \
	github.com/aymerick/douceur				 v0.2.0 \
	github.com/beorn7/perks					 v0.0.0-20180321164747-3a771d992973 \
	github.com/bradfitz/go-smtpd				 v0.0.0-20170404230938-deb6d6237625 \
	github.com/buger/jsonparser				 v0.0.0-20181115193947-bf1c66bbce23 \
	github.com/bwesterb/go-ristretto			 v1.2.3 \
	github.com/charmbracelet/glamour			 v0.8.0 \
	github.com/charmbracelet/lipgloss			 v1.0.0 \
	github.com/charmbracelet/x/ansi				 v0.8.0 \
	github.com/charmbracelet/x/exp/golden			 v0.0.0-20240806155701-69247e0abc2a \
	github.com/chzyer/logex					 v1.1.10 \
	github.com/chzyer/readline				 v0.0.0-20180603132655-2972be24d48e \
	github.com/chzyer/test					 v1.0.0 \
	github.com/client9/misspell				 v0.3.4 \
	github.com/cloudflare/circl				 v1.6.0 \
	github.com/coreos/go-systemd				 v0.0.0-20181012123002-c6f51f82210d \
	github.com/cpuguy83/go-md2man/v2			 v2.0.4 \
	github.com/davecgh/go-spew				 v1.1.1 \
	github.com/disintegration/imaging			 v1.6.2 \
	github.com/dlclark/regexp2				 v1.11.5 \
	github.com/dolmen-go/kittyimg				 v0.0.0-20220904140504-22f6493b700f \
	github.com/dustin/go-humanize				 v1.0.0 \
	github.com/eliukblau/pixterm				 v1.3.2 \
	github.com/flynn/go-shlex				 v0.0.0-20150515145356-3f9db97f8568 \
	github.com/francoispqt/gojay				 v1.2.13 \
	github.com/fsnotify/fsnotify				 v1.7.0 \
	github.com/gabriel-vasile/mimetype			 v1.4.4 \
	github.com/gaukas/godicttls				 v0.0.4 \
	github.com/ghodss/yaml					 v1.0.0 \
	github.com/gliderlabs/ssh				 v0.1.1 \
	github.com/go-errors/errors				 v1.0.1 \
	github.com/go-logr/logr					 v1.2.4 \
	github.com/go-openapi/inflect				 v0.21.0 \
	github.com/go-openapi/jsonpointer			 v0.21.0 \
	github.com/go-openapi/jsonreference			 v0.21.0 \
	github.com/go-openapi/spec				 v0.21.0 \
	github.com/go-openapi/swag				 v0.23.0 \
	github.com/go-playground/locales			 v0.14.1 \
	github.com/go-playground/universal-translator		 v0.18.1 \
	github.com/go-playground/validator/v10			 v10.22.0 \
	github.com/go-shiori/dom				 v0.0.0-20230515143342-73569d674e1c \
	github.com/go-shiori/go-readability			 v0.0.0-20241012063810-92284fa8a71f \
	github.com/go-sql-driver/mysql				 v1.8.1 \
	github.com/go-task/slim-sprig				 v0.0.0-20230315185526-52ccab3ef572 \
	github.com/gofiber/fiber/v2				 v2.52.5 \
	github.com/gofiber/template				 v1.7.5 \
	github.com/gogo/protobuf				 v1.1.1 \
	github.com/gogs/chardet					 v0.0.0-20211120154057-b7413eaefb8f \
	github.com/golang/glog					 v0.0.0-20160126235308-23def4e6c14b \
	github.com/golang/lint					 v0.0.0-20180702182130-06c8688daad7 \
	github.com/golang/mock					 v1.6.0 \
	github.com/golang/protobuf				 v1.5.3 \
	github.com/google/btree					 v0.0.0-20180813153112-4030bb1f1f0c \
	github.com/google/go-cmp				 v0.6.0 \
	github.com/google/go-github				 v17.0.0+incompatible \
	github.com/google/go-querystring			 v1.0.0 \
	github.com/google/gofuzz				 v1.0.0 \
	github.com/google/martian				 v2.1.0+incompatible \
	github.com/google/pprof					 v0.0.0-20210407192527-94a9f03dee38 \
	github.com/google/uuid					 v1.6.0 \
	github.com/googleapis/gax-go				 v2.0.0+incompatible \
	github.com/googleapis/gax-go/v2				 v2.0.3 \
	github.com/gopherjs/gopherjs				 v0.0.0-20181017120253-0766667cb4d1 \
	github.com/gorilla/css					 v1.0.1 \
	github.com/gorilla/websocket				 v1.5.3 \
	github.com/gregjones/httpcache				 v0.0.0-20180305231024-9cad4c3443a7 \
	github.com/grpc-ecosystem/grpc-gateway			 v1.5.0 \
	github.com/h12w/go-socks5				 v0.0.0-20200522160539-76189e178364 \
	github.com/hashicorp/hcl				 v1.0.0 \
	github.com/hashicorp/hcl/v2				 v2.21.0 \
	github.com/hexops/gotextdiff				 v1.0.3 \
	github.com/hpcloud/tail					 v1.0.0 \
	github.com/ianlancetaylor/demangle			 v0.0.0-20200824232613-28f6c0f3b639 \
	github.com/inconshreveable/mousetrap			 v1.1.0 \
	github.com/jellevandenhooff/dkim			 v0.0.0-20150330215556-f50fe3d243e1 \
	github.com/josharian/intern				 v1.0.0 \
	github.com/json-iterator/go				 v1.1.12 \
	github.com/jstemmer/go-junit-report			 v0.0.0-20190106144839-af01ea7f8024 \
	github.com/kisielk/gotool				 v1.0.0 \
	github.com/klauspost/compress				 v1.17.11 \
	github.com/kr/pretty					 v0.1.0 \
	github.com/kr/pty					 v1.1.3 \
	github.com/kr/text					 v0.2.0 \
	github.com/leodido/go-urn				 v1.4.0 \
	github.com/lib/pq					 v1.10.9 \
	github.com/lucasb-eyer/go-colorful			 v1.2.0 \
	github.com/lunixbochs/vtclean				 v1.0.0 \
	github.com/magiconair/properties			 v1.8.7 \
	github.com/mailru/easyjson				 v0.7.7 \
	github.com/mattn/go-colorable				 v0.1.13 \
	github.com/mattn/go-isatty				 v0.0.20 \
	github.com/mattn/go-runewidth				 v0.0.16 \
	github.com/mattn/go-sixel				 v0.0.5 \
	github.com/mattn/go-sqlite3				 v1.14.22 \
	github.com/matttproud/golang_protobuf_extensions	 v1.0.1 \
	github.com/memclutter/go-cloudflare-scraper		 v0.0.0-20220907170638-a1faa8b189bd \
	github.com/microcosm-cc/bluemonday			 v1.0.27 \
	github.com/mitchellh/go-wordwrap			 v1.0.1 \
	github.com/mitchellh/mapstructure			 v1.5.0 \
	github.com/mmcdole/gofeed				 v1.3.0 \
	github.com/mmcdole/goxpp				 v1.1.1 \
	github.com/modern-go/concurrent				 v0.0.0-20180306012644-bacd9c7ef1dd \
	github.com/modern-go/reflect2				 v1.0.2 \
	github.com/mrusme/journalist				 v1.0.1 \
	github.com/muesli/reflow				 v0.3.0 \
	github.com/muesli/termenv				 v0.15.3-0.20241212154518-8c990cd6cf4b \
	github.com/neelance/astrewrite				 v0.0.0-20160511093645-99348263ae86 \
	github.com/neelance/sourcemap				 v0.0.0-20151028013722-8c68805598ab \
	github.com/nxadm/tail					 v1.4.8 \
	github.com/olekukonko/tablewriter			 v0.0.5 \
	github.com/onsi/ginkgo					 v1.16.4 \
	github.com/onsi/ginkgo/v2				 v2.9.5 \
	github.com/onsi/gomega					 v1.27.6 \
	github.com/openzipkin/zipkin-go				 v0.1.1 \
	github.com/pelletier/go-toml/v2				 v2.2.2 \
	github.com/phayes/freeport				 v0.0.0-20180830031419-95f893ade6f2 \
	github.com/pkg/errors					 v0.8.1 \
	github.com/pmezard/go-difflib				 v1.0.0 \
	github.com/prometheus/client_golang			 v0.8.0 \
	github.com/prometheus/client_model			 v0.0.0-20180712105110-5c3871d89910 \
	github.com/prometheus/common				 v0.0.0-20180801064454-c7de2306084e \
	github.com/prometheus/procfs				 v0.0.0-20180725123919-05ee40e3a273 \
	github.com/quic-go/qpack				 v0.4.0 \
	github.com/quic-go/qtls-go1-20				 v0.3.1 \
	github.com/quic-go/quic-go				 v0.45.1 \
	github.com/refraction-networking/utls			 v1.6.7 \
	github.com/rivo/uniseg					 v0.4.7 \
	github.com/robertkrimen/otto				 v0.5.1 \
	github.com/russross/blackfriday				 v1.5.2 \
	github.com/russross/blackfriday/v2			 v2.1.0 \
	github.com/sagikazarmark/locafero			 v0.6.0 \
	github.com/sagikazarmark/slog-shim			 v0.1.0 \
	github.com/scylladb/termtables				 v0.0.0-20191203121021-c4c0b6d42ff4 \
	github.com/sebdah/goldie/v2				 v2.5.3 \
	github.com/sergi/go-diff				 v1.3.1 \
	github.com/shurcoo!l/component				 v0.0.0-20170202220835-f88ec8f54cc4 \
	github.com/shurcoo!l/events				 v0.0.0-20181021180414-410e4ca65f48 \
	github.com/shurcoo!l/github_flavored_markdown		 v0.0.0-20181002035957-2122de532470 \
	github.com/shurcoo!l/go					 v0.0.0-20180423040247-9e1955d9fb6e \
	github.com/shurcoo!l/go-goon				 v0.0.0-20170922171312-37c2f522c041 \
	github.com/shurcoo!l/gofontwoff				 v0.0.0-20180329035133-29b52fc0a18d \
	github.com/shurcoo!l/gopherjslib			 v0.0.0-20160914041154-feb6d3990c2c \
	github.com/shurcoo!l/highlight_diff			 v0.0.0-20170515013008-09bb4053de1b \
	github.com/shurcoo!l/highlight_go			 v0.0.0-20181028180052-98c3abbbae20 \
	github.com/shurcoo!l/home				 v0.0.0-20181020052607-80b7ffcb30f9 \
	github.com/shurcoo!l/htmlg				 v0.0.0-20170918183704-d01228ac9e50 \
	github.com/shurcoo!l/httperror				 v0.0.0-20170206035902-86b7830d14cc \
	github.com/shurcoo!l/httpfs				 v0.0.0-20171119174359-809beceb2371 \
	github.com/shurcoo!l/httpgzip				 v0.0.0-20180522190206-b1c53ac65af9 \
	github.com/shurcoo!l/issues				 v0.0.0-20181008053335-6292fdc1e191 \
	github.com/shurcoo!l/issuesapp				 v0.0.0-20180602232740-048589ce2241 \
	github.com/shurcoo!l/notifications			 v0.0.0-20181007000457-627ab5aea122 \
	github.com/shurcoo!l/octicon				 v0.0.0-20181028054416-fa4f57f9efb2 \
	github.com/shurcoo!l/reactions				 v0.0.0-20181006231557-f2e0b4ca5b82 \
	github.com/shurcoo!l/sanitized_anchor_name		 v1.0.0 \
	github.com/shurcoo!l/users				 v0.0.0-20180125191416-49c67e49c537 \
	github.com/shurcoo!l/webdavfs				 v0.0.0-20170829043945-18c3829fa133 \
	github.com/soniakeys/quant				 v1.0.0 \
	github.com/sourcegraph/annotate				 v0.0.0-20160123013949-f4cad6c6324d \
	github.com/sourcegraph/conc				 v0.3.0 \
	github.com/sourcegraph/syntaxhighlight			 v0.0.0-20170531221838-bd320f5d308e \
	github.com/spf13/afero					 v1.11.0 \
	github.com/spf13/cast					 v1.6.0 \
	github.com/spf13/cobra					 v1.8.1 \
	github.com/spf13/pflag					 v1.0.6 \
	github.com/spf13/viper					 v1.19.0 \
	github.com/stretchr/objx				 v0.1.0 \
	github.com/stretchr/testify				 v1.8.1 \
	github.com/subosito/gotenv				 v1.6.0 \
	github.com/swaggo/swag					 v1.16.3 \
	github.com/tarm/serial					 v0.0.0-20180830185346-98f6abe2eb07 \
	github.com/urfave/cli					 v1.22.3 \
	github.com/valyala/bytebufferpool			 v1.0.0 \
	github.com/valyala/fasthttp				 v1.55.0 \
	github.com/valyala/tcplisten				 v1.0.0 \
	github.com/viant/assertly				 v0.4.8 \
	github.com/viant/toolbox				 v0.24.0 \
	github.com/xyproto/randomstring				 v1.0.5 \
	github.com/yuin/goldmark				 v1.7.8 \
	github.com/yuin/goldmark-emoji				 v1.0.4 \
	github.com/zclconf/go-cty				 v1.15.0 \
	go.opencensus.io					 v0.18.0 \
	go.uber.org/goleak					 v1.3.0 \
	go.uber.org/multierr					 v1.11.0 \
	go.uber.org/zap						 v1.27.0 \
	go4.org							 v0.0.0-20180809161055-417644f6feb5 \
	golang.org/x/build					 v0.0.0-20190111050920-041ab4dc3f9d \
	golang.org/x/crypto					 v0.33.0 \
	golang.org/x/exp					 v0.0.0-20240719175910-8a7402abbf56 \
	golang.org/x/image					 v0.24.0 \
	golang.org/x/lint					 v0.0.0-20190227174305-5b3e6a55c961 \
	golang.org/x/mod					 v0.19.0 \
	golang.org/x/net					 v0.35.0 \
	golang.org/x/oauth2					 v0.0.0-20190226205417-e64efc72b421 \
	golang.org/x/perf					 v0.0.0-20180704124530-6e6d33e29852 \
	golang.org/x/sync					 v0.11.0 \
	golang.org/x/sys					 v0.30.0 \
	golang.org/x/telemetry					 v0.0.0-20240228155512-f48c80bd79b2 \
	golang.org/x/term					 v0.29.0 \
	golang.org/x/text					 v0.22.0 \
	golang.org/x/time					 v0.0.0-20181108054448-85acf8d2951c \
	golang.org/x/tools					 v0.23.0 \
	golang.org/x/xerrors					 v0.0.0-20200804184101-5ec99f83aff1 \
	google.golang.org/api					 v0.1.0 \
	google.golang.org/appengine				 v1.4.0 \
	google.golang.org/genproto				 v0.0.0-20190306203927-b5d61aea6440 \
	google.golang.org/grpc					 v1.19.0 \
	google.golang.org/protobuf				 v1.28.0 \
	gopkg.in/check.v1					 v1.0.0-20190902080502-41f04d3bba15 \
	gopkg.in/fsnotify.v1					 v1.4.7 \
	gopkg.in/inf.v0						 v0.9.1 \
	gopkg.in/ini.v1						 v1.67.0 \
	gopkg.in/readline.v1					 v1.0.0-20160726135117-62c6fe619375 \
	gopkg.in/sourcemap.v1					 v1.0.5 \
	gopkg.in/tomb.v1					 v1.0.0-20141024135613-dd632973f1e7 \
	gopkg.in/yaml.v2					 v2.4.0 \
	gopkg.in/yaml.v3					 v3.0.1 \
	grpc.go4.org						 v0.0.0-20170609214715-11d0a25b4919 \
	h12.io/socks						 v1.0.3 \
	honnef.co/go/tools					 v0.0.0-20190106161140-3f1c8253044a \
	sourcegraph.com/sourcegraph/go-diff			 v0.5.0 \
	sourcegraph.com/sqs/pbtypes				 v0.0.0-20180604144634-d3ebe8f20ae4

MODGO_MODFILES =	\
	cloud.google.com/go				 v0.26.0 \
	cloud.google.com/go				 v0.31.0 \
	cloud.google.com/go				 v0.34.0 \
	github.com/!puerkito!bio/goquery		 v1.8.0 \
	github.com/!puerkito!bio/goquery		 v1.9.2 \
	github.com/alecthomas/chroma/v2			 v2.14.0 \
	github.com/andybalholm/brotli			 v1.0.5 \
	github.com/andybalholm/brotli			 v1.0.6 \
	github.com/andybalholm/brotli			 v1.1.0 \
	github.com/andybalholm/cascadia			 v1.3.1 \
	github.com/andybalholm/cascadia			 v1.3.2 \
	github.com/charmbracelet/lipgloss		 v0.12.1 \
	github.com/charmbracelet/x/ansi			 v0.1.4 \
	github.com/charmbracelet/x/ansi			 v0.4.2 \
	github.com/charmbracelet/x/exp/golden		 v0.0.0-20240715153702-9ba8adf781c4 \
	github.com/chzyer/test				 v0.0.0-20180213035817-a1ea475d72b1 \
	github.com/cloudflare/circl			 v1.3.3 \
	github.com/cloudflare/circl			 v1.3.7 \
	github.com/cloudflare/circl			 v1.3.9 \
	github.com/cpuguy83/go-md2man/v2		 v2.0.0-20190314233015-f79a8a8ca69d \
	github.com/davecgh/go-spew			 v1.1.0 \
	github.com/dlclark/regexp2			 v1.11.0 \
	github.com/dlclark/regexp2			 v1.11.4 \
	github.com/fsnotify/fsnotify			 v1.4.7 \
	github.com/fsnotify/fsnotify			 v1.4.9 \
	github.com/go-logr/logr				 v1.2.3 \
	github.com/go-shiori/go-readability		 v0.0.0-20240701094332-1070de7e32ef \
	github.com/go-task/slim-sprig			 v0.0.0-20210107165309-348f09dbbbc0 \
	github.com/golang/mock				 v1.1.1 \
	github.com/golang/mock				 v1.2.0 \
	github.com/golang/protobuf			 v1.2.0 \
	github.com/golang/protobuf			 v1.3.1 \
	github.com/golang/protobuf			 v1.4.0 \
	github.com/golang/protobuf			 v1.4.0-rc.1 \
	github.com/golang/protobuf			 v1.4.0-rc.1.0.20200221234624-67d41d38c208 \
	github.com/golang/protobuf			 v1.4.0-rc.2 \
	github.com/golang/protobuf			 v1.4.0-rc.4.0.20200313231945-b860323f09d0 \
	github.com/golang/protobuf			 v1.4.2 \
	github.com/golang/protobuf			 v1.5.0 \
	github.com/golang/protobuf			 v1.5.2 \
	github.com/google/go-cmp			 v0.2.0 \
	github.com/google/go-cmp			 v0.3.0 \
	github.com/google/go-cmp			 v0.3.1 \
	github.com/google/go-cmp			 v0.4.0 \
	github.com/google/go-cmp			 v0.5.5 \
	github.com/google/go-cmp			 v0.5.8 \
	github.com/google/go-cmp			 v0.5.9 \
	github.com/google/pprof				 v0.0.0-20181206194817-3ea8567a2e57 \
	github.com/gorilla/websocket			 v1.5.1 \
	github.com/inconshreveable/mousetrap		 v1.0.0 \
	github.com/json-iterator/go			 v1.1.6 \
	github.com/klauspost/compress			 v1.16.7 \
	github.com/klauspost/compress			 v1.17.4 \
	github.com/klauspost/compress			 v1.17.6 \
	github.com/klauspost/compress			 v1.17.9 \
	github.com/kr/pty				 v1.1.1 \
	github.com/kr/text				 v0.1.0 \
	github.com/mailru/easyjson			 v0.0.0-20190312143242-1de009706dbe \
	github.com/mattn/go-isatty			 v0.0.19 \
	github.com/mattn/go-runewidth			 v0.0.10 \
	github.com/mattn/go-runewidth			 v0.0.12 \
	github.com/mattn/go-runewidth			 v0.0.15 \
	github.com/mattn/go-runewidth			 v0.0.9 \
	github.com/microcosm-cc/bluemonday		 v1.0.1 \
	github.com/mmcdole/goxpp			 v1.1.1-0.20240225020742-a0c311522b23 \
	github.com/modern-go/concurrent			 v0.0.0-20180228061459-e0a39a4cb421 \
	github.com/modern-go/reflect2			 v1.0.1 \
	github.com/muesli/termenv			 v0.15.2 \
	github.com/muesli/termenv			 v0.15.3-0.20240618155329-98d742f6907a \
	github.com/nxadm/tail				 v1.4.4 \
	github.com/onsi/ginkgo				 v1.12.1 \
	github.com/onsi/ginkgo				 v1.6.0 \
	github.com/onsi/ginkgo/v2			 v2.1.3 \
	github.com/onsi/ginkgo/v2			 v2.1.4 \
	github.com/onsi/ginkgo/v2			 v2.1.6 \
	github.com/onsi/ginkgo/v2			 v2.2.0 \
	github.com/onsi/ginkgo/v2			 v2.3.0 \
	github.com/onsi/ginkgo/v2			 v2.4.0 \
	github.com/onsi/ginkgo/v2			 v2.5.0 \
	github.com/onsi/ginkgo/v2			 v2.7.0 \
	github.com/onsi/ginkgo/v2			 v2.8.1 \
	github.com/onsi/ginkgo/v2			 v2.9.0 \
	github.com/onsi/ginkgo/v2			 v2.9.1 \
	github.com/onsi/ginkgo/v2			 v2.9.2 \
	github.com/onsi/gomega				 v1.10.1 \
	github.com/onsi/gomega				 v1.17.0 \
	github.com/onsi/gomega				 v1.19.0 \
	github.com/onsi/gomega				 v1.20.1 \
	github.com/onsi/gomega				 v1.21.1 \
	github.com/onsi/gomega				 v1.22.1 \
	github.com/onsi/gomega				 v1.24.0 \
	github.com/onsi/gomega				 v1.24.1 \
	github.com/onsi/gomega				 v1.26.0 \
	github.com/onsi/gomega				 v1.27.1 \
	github.com/onsi/gomega				 v1.27.3 \
	github.com/onsi/gomega				 v1.27.4 \
	github.com/onsi/gomega				 v1.7.1 \
	github.com/quic-go/quic-go			 v0.37.4 \
	github.com/quic-go/quic-go			 v0.41.0 \
	github.com/refraction-networking/utls		 v1.5.4 \
	github.com/refraction-networking/utls		 v1.6.2 \
	github.com/rivo/uniseg				 v0.1.0 \
	github.com/rivo/uniseg				 v0.2.0 \
	github.com/rivo/uniseg				 v0.4.4 \
	github.com/robertkrimen/otto			 v0.4.0 \
	github.com/russross/blackfriday/v2		 v2.0.1 \
	github.com/sergi/go-diff			 v1.0.0 \
	github.com/sergi/go-diff			 v1.1.0 \
	github.com/shurcoo!l/sanitized_anchor_name	 v0.0.0-20170918181015-86672fcb3f95 \
	github.com/spf13/cobra				 v1.0.0 \
	github.com/spf13/pflag				 v1.0.5 \
	github.com/stretchr/testify			 v1.2.2 \
	github.com/stretchr/testify			 v1.3.0 \
	github.com/stretchr/testify			 v1.4.0 \
	github.com/stretchr/testify			 v1.5.1 \
	github.com/stretchr/testify			 v1.6.1 \
	github.com/stretchr/testify			 v1.7.0 \
	github.com/yuin/goldmark			 v1.2.1 \
	github.com/yuin/goldmark			 v1.3.5 \
	github.com/yuin/goldmark			 v1.4.1 \
	github.com/yuin/goldmark			 v1.4.13 \
	github.com/yuin/goldmark			 v1.7.1 \
	github.com/yuin/goldmark			 v1.7.4 \
	github.com/yuin/goldmark-emoji			 v1.0.3 \
	go.uber.org/multierr				 v1.10.0 \
	golang.org/x/crypto				 v0.0.0-20181030102418-4d3f4d9ffa16 \
	golang.org/x/crypto				 v0.0.0-20190308221718-c2843e01d9a2 \
	golang.org/x/crypto				 v0.0.0-20190313024323-a1f597ede03a \
	golang.org/x/crypto				 v0.0.0-20191011191535-87dc89f01550 \
	golang.org/x/crypto				 v0.0.0-20200622213623-75b288015ac9 \
	golang.org/x/crypto				 v0.0.0-20210921155107-089bfa567519 \
	golang.org/x/crypto				 v0.1.0 \
	golang.org/x/crypto				 v0.11.1-0.20230711161743-2e82bdd1719d \
	golang.org/x/crypto				 v0.12.0 \
	golang.org/x/crypto				 v0.13.0 \
	golang.org/x/crypto				 v0.19.0 \
	golang.org/x/crypto				 v0.21.0 \
	golang.org/x/crypto				 v0.22.0 \
	golang.org/x/crypto				 v0.23.0 \
	golang.org/x/crypto				 v0.25.0 \
	golang.org/x/crypto				 v0.3.1-0.20221117191849-2c476679df9a \
	golang.org/x/crypto				 v0.31.0 \
	golang.org/x/crypto				 v0.4.0 \
	golang.org/x/exp				 v0.0.0-20190121172915-509febef88a4 \
	golang.org/x/exp				 v0.0.0-20221205204356-47842c84f3db \
	golang.org/x/image				 v0.0.0-20191009234506-e7c1f5e7dbb8 \
	golang.org/x/image				 v0.20.0 \
	golang.org/x/lint				 v0.0.0-20180702182130-06c8688daad7 \
	golang.org/x/lint				 v0.0.0-20181026193005-c67002cb31c3 \
	golang.org/x/mod				 v0.10.0 \
	golang.org/x/mod				 v0.12.0 \
	golang.org/x/mod				 v0.15.0 \
	golang.org/x/mod				 v0.17.0 \
	golang.org/x/mod				 v0.3.0 \
	golang.org/x/mod				 v0.4.2 \
	golang.org/x/mod				 v0.6.0 \
	golang.org/x/mod				 v0.6.0-dev.0.20220106191415-9b9b3d81d5e3 \
	golang.org/x/mod				 v0.6.0-dev.0.20220419223038-86c51ed26bb4 \
	golang.org/x/mod				 v0.7.0 \
	golang.org/x/mod				 v0.8.0 \
	golang.org/x/mod				 v0.9.0 \
	golang.org/x/net				 v0.0.0-20180724234803-3673e40ba225 \
	golang.org/x/net				 v0.0.0-20180826012351-8a410e7b638d \
	golang.org/x/net				 v0.0.0-20180906233101-161cd47e91fd \
	golang.org/x/net				 v0.0.0-20181029044818-c44066c5c816 \
	golang.org/x/net				 v0.0.0-20181106065722-10aee1819953 \
	golang.org/x/net				 v0.0.0-20190108225652-1e06a53dbb7e \
	golang.org/x/net				 v0.0.0-20190213061140-3a22650c66bd \
	golang.org/x/net				 v0.0.0-20190313220215-9f648a60d977 \
	golang.org/x/net				 v0.0.0-20190404232315-eb5bcb51f2a3 \
	golang.org/x/net				 v0.0.0-20190620200207-3b0461eec859 \
	golang.org/x/net				 v0.0.0-20200520004742-59133d7f0dd7 \
	golang.org/x/net				 v0.0.0-20201021035429-f5854403a974 \
	golang.org/x/net				 v0.0.0-20210226172049-e18ecbb05110 \
	golang.org/x/net				 v0.0.0-20210405180319-a5a99cb37ef4 \
	golang.org/x/net				 v0.0.0-20210428140749-89ef3d95e781 \
	golang.org/x/net				 v0.0.0-20211015210444-4f30a5c0130f \
	golang.org/x/net				 v0.0.0-20220225172249-27dd8689420f \
	golang.org/x/net				 v0.0.0-20220425223048-2871e0cb64e4 \
	golang.org/x/net				 v0.0.0-20220722155237-a158d28d115b \
	golang.org/x/net				 v0.1.0 \
	golang.org/x/net				 v0.10.0 \
	golang.org/x/net				 v0.14.0 \
	golang.org/x/net				 v0.15.0 \
	golang.org/x/net				 v0.2.0 \
	golang.org/x/net				 v0.21.0 \
	golang.org/x/net				 v0.23.0 \
	golang.org/x/net				 v0.24.0 \
	golang.org/x/net				 v0.25.0 \
	golang.org/x/net				 v0.26.0 \
	golang.org/x/net				 v0.27.0 \
	golang.org/x/net				 v0.29.0 \
	golang.org/x/net				 v0.3.0 \
	golang.org/x/net				 v0.33.0 \
	golang.org/x/net				 v0.4.0 \
	golang.org/x/net				 v0.5.0 \
	golang.org/x/net				 v0.6.0 \
	golang.org/x/net				 v0.7.0 \
	golang.org/x/net				 v0.8.0 \
	golang.org/x/net				 v0.9.0 \
	golang.org/x/oauth2				 v0.0.0-20180821212333-d2e6202438be \
	golang.org/x/oauth2				 v0.0.0-20181017192945-9dcd33a902f4 \
	golang.org/x/oauth2				 v0.0.0-20181203162652-d668ce993890 \
	golang.org/x/sync				 v0.0.0-20180314180146-1d60e4601c6f \
	golang.org/x/sync				 v0.0.0-20181108010431-42b317875d0f \
	golang.org/x/sync				 v0.0.0-20181221193216-37e7f081c4d4 \
	golang.org/x/sync				 v0.0.0-20190227155943-e225da77a7e6 \
	golang.org/x/sync				 v0.0.0-20190423024810-112230192c58 \
	golang.org/x/sync				 v0.0.0-20201020160332-67f06af15bc9 \
	golang.org/x/sync				 v0.0.0-20210220032951-036812b2e83c \
	golang.org/x/sync				 v0.0.0-20220722155255-886fb9371eb4 \
	golang.org/x/sync				 v0.1.0 \
	golang.org/x/sync				 v0.10.0 \
	golang.org/x/sync				 v0.2.0 \
	golang.org/x/sync				 v0.3.0 \
	golang.org/x/sync				 v0.6.0 \
	golang.org/x/sync				 v0.7.0 \
	golang.org/x/sys				 v0.0.0-20180830151530-49385e6e1522 \
	golang.org/x/sys				 v0.0.0-20180909124046-d0be0721c37e \
	golang.org/x/sys				 v0.0.0-20181029174526-d69651ed3497 \
	golang.org/x/sys				 v0.0.0-20190215142949-d0b11bdaac8a \
	golang.org/x/sys				 v0.0.0-20190316082340-a2f829d7f35f \
	golang.org/x/sys				 v0.0.0-20190412213103-97732733099d \
	golang.org/x/sys				 v0.0.0-20190904154756-749cb33beabd \
	golang.org/x/sys				 v0.0.0-20191005200804-aed5e4c7ecf9 \
	golang.org/x/sys				 v0.0.0-20191120155948-bd437916bb0e \
	golang.org/x/sys				 v0.0.0-20191204072324-ce4227a45e2e \
	golang.org/x/sys				 v0.0.0-20200323222414-85ca7c5b95cd \
	golang.org/x/sys				 v0.0.0-20200930185726-fdedc70b468f \
	golang.org/x/sys				 v0.0.0-20201119102817-f84b799fce68 \
	golang.org/x/sys				 v0.0.0-20210112080510-489259a85091 \
	golang.org/x/sys				 v0.0.0-20210330210617-4fbd30eecc44 \
	golang.org/x/sys				 v0.0.0-20210423082822-04245dca01da \
	golang.org/x/sys				 v0.0.0-20210510120138-977fb7262007 \
	golang.org/x/sys				 v0.0.0-20210615035016-665e8c7367d1 \
	golang.org/x/sys				 v0.0.0-20211019181941-9d821ace8654 \
	golang.org/x/sys				 v0.0.0-20211216021012-1d35b9e2eb4e \
	golang.org/x/sys				 v0.0.0-20220319134239-a9b59b0215f8 \
	golang.org/x/sys				 v0.0.0-20220422013727-9388b58f7150 \
	golang.org/x/sys				 v0.0.0-20220520151302-bc2c85ada10a \
	golang.org/x/sys				 v0.0.0-20220722155257-8c9f86f7a55f \
	golang.org/x/sys				 v0.1.0 \
	golang.org/x/sys				 v0.10.0 \
	golang.org/x/sys				 v0.11.0 \
	golang.org/x/sys				 v0.12.0 \
	golang.org/x/sys				 v0.17.0 \
	golang.org/x/sys				 v0.18.0 \
	golang.org/x/sys				 v0.19.0 \
	golang.org/x/sys				 v0.2.0 \
	golang.org/x/sys				 v0.20.0 \
	golang.org/x/sys				 v0.22.0 \
	golang.org/x/sys				 v0.25.0 \
	golang.org/x/sys				 v0.28.0 \
	golang.org/x/sys				 v0.3.0 \
	golang.org/x/sys				 v0.4.0 \
	golang.org/x/sys				 v0.5.0 \
	golang.org/x/sys				 v0.6.0 \
	golang.org/x/sys				 v0.7.0 \
	golang.org/x/sys				 v0.8.0 \
	golang.org/x/term				 v0.0.0-20201126162022-7de9c90e9dd1 \
	golang.org/x/term				 v0.0.0-20210927222741-03fcf44c2211 \
	golang.org/x/term				 v0.0.0-20220722155259-a9ba230a4035 \
	golang.org/x/term				 v0.1.0 \
	golang.org/x/term				 v0.11.0 \
	golang.org/x/term				 v0.12.0 \
	golang.org/x/term				 v0.17.0 \
	golang.org/x/term				 v0.19.0 \
	golang.org/x/term				 v0.2.0 \
	golang.org/x/term				 v0.20.0 \
	golang.org/x/term				 v0.22.0 \
	golang.org/x/term				 v0.24.0 \
	golang.org/x/term				 v0.27.0 \
	golang.org/x/term				 v0.3.0 \
	golang.org/x/term				 v0.4.0 \
	golang.org/x/term				 v0.5.0 \
	golang.org/x/term				 v0.6.0 \
	golang.org/x/term				 v0.7.0 \
	golang.org/x/term				 v0.8.0 \
	golang.org/x/text				 v0.12.0 \
	golang.org/x/text				 v0.13.0 \
	golang.org/x/text				 v0.14.0 \
	golang.org/x/text				 v0.15.0 \
	golang.org/x/text				 v0.16.0 \
	golang.org/x/text				 v0.18.0 \
	golang.org/x/text				 v0.21.0 \
	golang.org/x/text				 v0.3.0 \
	golang.org/x/text				 v0.3.1-0.20180807135948-17ff2d5776d2 \
	golang.org/x/text				 v0.3.3 \
	golang.org/x/text				 v0.3.6 \
	golang.org/x/text				 v0.3.7 \
	golang.org/x/text				 v0.4.0 \
	golang.org/x/text				 v0.5.0 \
	golang.org/x/text				 v0.6.0 \
	golang.org/x/text				 v0.7.0 \
	golang.org/x/text				 v0.8.0 \
	golang.org/x/text				 v0.9.0 \
	golang.org/x/time				 v0.0.0-20180412165947-fbb02b2291d2 \
	golang.org/x/tools				 v0.0.0-20180828015842-6cd1fcedba52 \
	golang.org/x/tools				 v0.0.0-20180917221912-90fa682c2a6e \
	golang.org/x/tools				 v0.0.0-20181030000716-a0a13e073c7b \
	golang.org/x/tools				 v0.0.0-20190114222345-bf090417da8b \
	golang.org/x/tools				 v0.0.0-20190226205152-f727befe758c \
	golang.org/x/tools				 v0.0.0-20191119224855-298f0cb1881e \
	golang.org/x/tools				 v0.0.0-20201224043029-2b0845dc783e \
	golang.org/x/tools				 v0.1.1 \
	golang.org/x/tools				 v0.1.10 \
	golang.org/x/tools				 v0.1.12 \
	golang.org/x/tools				 v0.13.0 \
	golang.org/x/tools				 v0.2.0 \
	golang.org/x/tools				 v0.21.1-0.20240508182429-e35e4ccd0d2d \
	golang.org/x/tools				 v0.4.0 \
	golang.org/x/tools				 v0.6.0 \
	golang.org/x/tools				 v0.7.0 \
	golang.org/x/tools				 v0.9.1 \
	golang.org/x/xerrors				 v0.0.0-20190717185122-a985d3407aa7 \
	golang.org/x/xerrors				 v0.0.0-20191011141410-1b5146add898 \
	golang.org/x/xerrors				 v0.0.0-20191204190536-9bdfabe68543 \
	google.golang.org/api				 v0.0.0-20180910000450-7ca32eb868bf \
	google.golang.org/api				 v0.0.0-20181030000543-1d582fd0359e \
	google.golang.org/appengine			 v1.1.0 \
	google.golang.org/appengine			 v1.2.0 \
	google.golang.org/appengine			 v1.3.0 \
	google.golang.org/genproto			 v0.0.0-20180817151627-c66870c02cf8 \
	google.golang.org/genproto			 v0.0.0-20180831171423-11092d34479b \
	google.golang.org/genproto			 v0.0.0-20181029155118-b69ba1387ce2 \
	google.golang.org/genproto			 v0.0.0-20181202183823-bd91e49a0898 \
	google.golang.org/grpc				 v1.14.0 \
	google.golang.org/grpc				 v1.16.0 \
	google.golang.org/grpc				 v1.17.0 \
	google.golang.org/protobuf			 v0.0.0-20200109180630-ec00e32a8dfd \
	google.golang.org/protobuf			 v0.0.0-20200221191635-4d8936d0db64 \
	google.golang.org/protobuf			 v0.0.0-20200228230310-ab0ca4ff8a60 \
	google.golang.org/protobuf			 v1.20.1-0.20200309200217-e05f789c0967 \
	google.golang.org/protobuf			 v1.21.0 \
	google.golang.org/protobuf			 v1.23.0 \
	google.golang.org/protobuf			 v1.26.0 \
	google.golang.org/protobuf			 v1.26.0-rc.1 \
	gopkg.in/check.v1				 v0.0.0-20161208181325-20d25e280405 \
	gopkg.in/check.v1				 v1.0.0-20180628173108-788fd7840127 \
	gopkg.in/yaml.v2				 v2.2.1 \
	gopkg.in/yaml.v2				 v2.2.2 \
	gopkg.in/yaml.v2				 v2.2.4 \
	gopkg.in/yaml.v2				 v2.3.0 \
	gopkg.in/yaml.v3				 v3.0.0-20200313102051-9f266ea9e77c \
	honnef.co/go/tools				 v0.0.0-20180728063816-88497007e858 \
	honnef.co/go/tools				 v0.0.0-20190102054323-c2f93a96b099

