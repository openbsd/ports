MODCARGO_CRATES +=	addr2line	0.25.1	# Apache-2.0 OR MIT
MODCARGO_CRATES +=	adler2	2.0.1	# 0BSD OR MIT OR Apache-2.0
MODCARGO_CRATES +=	ahash	0.8.12	# MIT OR Apache-2.0
MODCARGO_CRATES +=	aho-corasick	1.1.5	# Unlicense OR MIT
MODCARGO_CRATES +=	allocator-api2	0.2.21	# MIT OR Apache-2.0
MODCARGO_CRATES +=	android_system_properties	0.1.6	# MIT OR Apache-2.0
MODCARGO_CRATES +=	ansi_term	0.12.1	# MIT
MODCARGO_CRATES +=	anstream	1.0.0	# MIT OR Apache-2.0
MODCARGO_CRATES +=	anstyle	1.0.14	# MIT OR Apache-2.0
MODCARGO_CRATES +=	anstyle-parse	1.0.0	# MIT OR Apache-2.0
MODCARGO_CRATES +=	anstyle-query	1.1.5	# MIT OR Apache-2.0
MODCARGO_CRATES +=	anstyle-wincon	3.0.11	# MIT OR Apache-2.0
MODCARGO_CRATES +=	arcstr	1.2.0	# Apache-2.0 OR MIT OR Zlib
MODCARGO_CRATES +=	async-lock	3.4.2	# Apache-2.0 OR MIT
MODCARGO_CRATES +=	async-stream	0.3.6	# MIT
MODCARGO_CRATES +=	async-stream-impl	0.3.6	# MIT
MODCARGO_CRATES +=	atoi	0.3.3	# MIT
MODCARGO_CRATES +=	atoi	2.0.0	# MIT
MODCARGO_CRATES +=	atomic-waker	1.1.2	# Apache-2.0 OR MIT
MODCARGO_CRATES +=	atty	0.2.14	# MIT
MODCARGO_CRATES +=	autocfg	1.5.1	# Apache-2.0 OR MIT
MODCARGO_CRATES +=	aws-lc-rs	1.18.2	# ISC AND (Apache-2.0 OR ISC)
MODCARGO_CRATES +=	aws-lc-sys	0.46.0	# ISC AND (Apache-2.0 OR ISC) AND Apache-2.0 AND MIT AND BSD-3-Clause AND (Apache-2.0 OR ISC OR MIT) AND (Apache-2.0 OR ISC OR MIT-0)
MODCARGO_CRATES +=	backtrace	0.3.76	# MIT OR Apache-2.0
MODCARGO_CRATES +=	backtrace-ext	0.2.1	# MIT OR Apache-2.0
MODCARGO_CRATES +=	base64	0.21.7	# MIT OR Apache-2.0
MODCARGO_CRATES +=	base64	0.22.1	# MIT OR Apache-2.0
MODCARGO_CRATES +=	base64	0.23.1	# MIT OR Apache-2.0
MODCARGO_CRATES +=	beef	0.5.2	# MIT OR Apache-2.0
MODCARGO_CRATES +=	bitflags	1.3.2	# MIT/Apache-2.0
MODCARGO_CRATES +=	bitflags	2.13.2	# MIT OR Apache-2.0
MODCARGO_CRATES +=	block-buffer	0.10.4	# MIT OR Apache-2.0
MODCARGO_CRATES +=	block-buffer	0.12.1	# MIT OR Apache-2.0
MODCARGO_CRATES +=	bumpalo	3.20.3	# MIT OR Apache-2.0
MODCARGO_CRATES +=	byteorder	1.5.0	# Unlicense OR MIT
MODCARGO_CRATES +=	bytes	1.12.1	# MIT
MODCARGO_CRATES +=	cc	1.9.0	# MIT OR Apache-2.0
MODCARGO_CRATES +=	cfg-if	1.0.5	# MIT OR Apache-2.0
MODCARGO_CRATES +=	cfg_aliases	0.2.2	# MIT
MODCARGO_CRATES +=	chacha20	0.10.2	# MIT OR Apache-2.0
MODCARGO_CRATES +=	chrono	0.4.45	# MIT OR Apache-2.0
MODCARGO_CRATES +=	clap	2.34.0	# MIT
MODCARGO_CRATES +=	clap	4.6.7	# MIT OR Apache-2.0
MODCARGO_CRATES +=	clap_builder	4.6.7	# MIT OR Apache-2.0
MODCARGO_CRATES +=	clap_derive	4.6.7	# MIT OR Apache-2.0
MODCARGO_CRATES +=	clap_lex	1.1.1	# MIT OR Apache-2.0
MODCARGO_CRATES +=	cmake	0.1.58	# MIT OR Apache-2.0
MODCARGO_CRATES +=	cmov	0.5.4	# Apache-2.0 OR MIT
MODCARGO_CRATES +=	colorchoice	1.0.5	# MIT OR Apache-2.0
MODCARGO_CRATES +=	combine	4.6.9	# MIT
MODCARGO_CRATES +=	const-oid	0.10.2	# Apache-2.0 OR MIT
MODCARGO_CRATES +=	core-foundation	0.9.4	# MIT OR Apache-2.0
MODCARGO_CRATES +=	core-foundation	0.10.1	# MIT OR Apache-2.0
MODCARGO_CRATES +=	core-foundation-sys	0.8.7	# MIT OR Apache-2.0
MODCARGO_CRATES +=	core_detect	1.0.0	# MIT/Apache-2.0
MODCARGO_CRATES +=	cpufeatures	0.2.17	# MIT OR Apache-2.0
MODCARGO_CRATES +=	cpufeatures	0.3.1	# MIT OR Apache-2.0
MODCARGO_CRATES +=	crc	3.4.0	# MIT OR Apache-2.0
MODCARGO_CRATES +=	crc-catalog	2.5.0	# MIT OR Apache-2.0
MODCARGO_CRATES +=	crc16	0.4.0	# MIT
MODCARGO_CRATES +=	crc32fast	1.5.3	# MIT OR Apache-2.0
MODCARGO_CRATES +=	crossbeam-queue	0.3.14	# MIT OR Apache-2.0
MODCARGO_CRATES +=	crossbeam-utils	0.8.23	# MIT OR Apache-2.0
MODCARGO_CRATES +=	crypto-common	0.1.6	# MIT OR Apache-2.0
MODCARGO_CRATES +=	crypto-common	0.2.2	# MIT OR Apache-2.0
MODCARGO_CRATES +=	ctutils	0.4.3	# Apache-2.0 OR MIT
MODCARGO_CRATES +=	dashmap	6.2.1	# MIT
MODCARGO_CRATES +=	data-encoding	2.11.1	# MIT
MODCARGO_CRATES +=	digest	0.10.7	# MIT OR Apache-2.0
MODCARGO_CRATES +=	digest	0.11.3	# MIT OR Apache-2.0
MODCARGO_CRATES +=	displaydoc	0.2.7	# MIT OR Apache-2.0
MODCARGO_CRATES +=	dotenvy	0.15.7	# MIT
MODCARGO_CRATES +=	dunce	1.0.5	# CC0-1.0 OR MIT-0 OR Apache-2.0
MODCARGO_CRATES +=	either	1.19.0	# MIT OR Apache-2.0
MODCARGO_CRATES +=	encoding_rs	0.8.42	# (Apache-2.0 OR MIT) AND BSD-3-Clause
MODCARGO_CRATES +=	equivalent	1.0.3	# Apache-2.0 OR MIT
MODCARGO_CRATES +=	errno	0.3.14	# MIT OR Apache-2.0
MODCARGO_CRATES +=	etcetera	0.11.0	# MIT OR Apache-2.0
MODCARGO_CRATES +=	event-listener	5.4.2	# Apache-2.0 OR MIT
MODCARGO_CRATES +=	event-listener-strategy	0.5.4	# Apache-2.0 OR MIT
MODCARGO_CRATES +=	find-msvc-tools	0.1.15	# MIT OR Apache-2.0
MODCARGO_CRATES +=	flate2	1.1.10	# MIT OR Apache-2.0
MODCARGO_CRATES +=	flexi_logger	0.31.10	# MIT OR Apache-2.0
MODCARGO_CRATES +=	flume	0.12.0	# Apache-2.0/MIT
MODCARGO_CRATES +=	fnv	1.0.7	# Apache-2.0 / MIT
MODCARGO_CRATES +=	foldhash	0.2.0	# Zlib
MODCARGO_CRATES +=	form_urlencoded	1.2.2	# MIT OR Apache-2.0
MODCARGO_CRATES +=	fs_extra	1.3.0	# MIT
MODCARGO_CRATES +=	futures	0.3.34	# MIT OR Apache-2.0
MODCARGO_CRATES +=	futures-channel	0.3.34	# MIT OR Apache-2.0
MODCARGO_CRATES +=	futures-core	0.3.34	# MIT OR Apache-2.0
MODCARGO_CRATES +=	futures-executor	0.3.34	# MIT OR Apache-2.0
MODCARGO_CRATES +=	futures-intrusive	0.5.0	# MIT OR Apache-2.0
MODCARGO_CRATES +=	futures-io	0.3.34	# MIT OR Apache-2.0
MODCARGO_CRATES +=	futures-macro	0.3.34	# MIT OR Apache-2.0
MODCARGO_CRATES +=	futures-sink	0.3.34	# MIT OR Apache-2.0
MODCARGO_CRATES +=	futures-task	0.3.34	# MIT OR Apache-2.0
MODCARGO_CRATES +=	futures-util	0.3.34	# MIT OR Apache-2.0
MODCARGO_CRATES +=	generic-array	0.14.9	# MIT
MODCARGO_CRATES +=	getrandom	0.2.17	# MIT OR Apache-2.0
MODCARGO_CRATES +=	getrandom	0.3.4	# MIT OR Apache-2.0
MODCARGO_CRATES +=	getrandom	0.4.3	# MIT OR Apache-2.0
MODCARGO_CRATES +=	gimli	0.32.3	# MIT OR Apache-2.0
MODCARGO_CRATES +=	h2	0.3.27	# MIT
MODCARGO_CRATES +=	h2	0.4.20	# MIT
MODCARGO_CRATES +=	hashbrown	0.14.5	# MIT OR Apache-2.0
MODCARGO_CRATES +=	hashbrown	0.16.1	# MIT OR Apache-2.0
MODCARGO_CRATES +=	hashbrown	0.17.1	# MIT OR Apache-2.0
MODCARGO_CRATES +=	hashlink	0.11.1	# MIT OR Apache-2.0
MODCARGO_CRATES +=	headers	0.3.9	# MIT
MODCARGO_CRATES +=	headers-core	0.2.0	# MIT
MODCARGO_CRATES +=	heck	0.3.3	# MIT OR Apache-2.0
MODCARGO_CRATES +=	heck	0.5.0	# MIT OR Apache-2.0
MODCARGO_CRATES +=	hermit-abi	0.1.19	# MIT/Apache-2.0
MODCARGO_CRATES +=	hex	0.4.3	# MIT OR Apache-2.0
MODCARGO_CRATES +=	hkdf	0.13.0	# MIT OR Apache-2.0
MODCARGO_CRATES +=	hmac	0.13.0	# MIT OR Apache-2.0
MODCARGO_CRATES +=	http	0.2.12	# MIT OR Apache-2.0
MODCARGO_CRATES +=	http	1.5.0	# MIT OR Apache-2.0
MODCARGO_CRATES +=	http-auth-basic	0.3.7	# MIT OR Apache-2.0
MODCARGO_CRATES +=	http-body	0.4.6	# MIT
MODCARGO_CRATES +=	http-body	1.1.0	# MIT
MODCARGO_CRATES +=	http-body-util	0.1.5	# MIT
MODCARGO_CRATES +=	httparse	1.10.1	# MIT OR Apache-2.0
MODCARGO_CRATES +=	httpdate	1.0.3	# MIT OR Apache-2.0
MODCARGO_CRATES +=	hybrid-array	0.4.15	# MIT OR Apache-2.0
MODCARGO_CRATES +=	hyper	0.14.32	# MIT
MODCARGO_CRATES +=	hyper	1.12.0	# MIT
MODCARGO_CRATES +=	hyper-rustls	0.27.10	# Apache-2.0 OR ISC OR MIT
MODCARGO_CRATES +=	hyper-util	0.1.21	# MIT
MODCARGO_CRATES +=	iana-time-zone	0.1.65	# MIT OR Apache-2.0
MODCARGO_CRATES +=	iana-time-zone-haiku	0.1.2	# MIT OR Apache-2.0
MODCARGO_CRATES +=	icu_collections	2.3.0	# Unicode-3.0
MODCARGO_CRATES +=	icu_locale_core	2.3.0	# Unicode-3.0
MODCARGO_CRATES +=	icu_locale_fallback	2.3.0	# Unicode-3.0
MODCARGO_CRATES +=	icu_locale_fallback_data	2.3.0	# Unicode-3.0
MODCARGO_CRATES +=	icu_normalizer	2.3.0	# Unicode-3.0
MODCARGO_CRATES +=	icu_normalizer_data	2.3.0	# Unicode-3.0
MODCARGO_CRATES +=	icu_properties	2.3.0	# Unicode-3.0
MODCARGO_CRATES +=	icu_properties_data	2.3.0	# Unicode-3.0
MODCARGO_CRATES +=	icu_provider	2.3.1	# Unicode-3.0
MODCARGO_CRATES +=	icu_segmenter	2.3.0	# Unicode-3.0
MODCARGO_CRATES +=	icu_segmenter_data	2.3.0	# Unicode-3.0
MODCARGO_CRATES +=	idna	1.1.0	# MIT OR Apache-2.0
MODCARGO_CRATES +=	idna_adapter	1.2.2	# Apache-2.0 OR MIT
MODCARGO_CRATES +=	indexmap	2.14.2	# Apache-2.0 OR MIT
MODCARGO_CRATES +=	ipnet	2.12.2	# MIT OR Apache-2.0
MODCARGO_CRATES +=	is_ci	1.2.0	# ISC
MODCARGO_CRATES +=	is_terminal_polyfill	1.70.2	# MIT OR Apache-2.0
MODCARGO_CRATES +=	itertools	0.15.0	# MIT OR Apache-2.0
MODCARGO_CRATES +=	itoa	1.0.18	# MIT OR Apache-2.0
MODCARGO_CRATES +=	jni	0.22.4	# MIT OR Apache-2.0
MODCARGO_CRATES +=	jni-macros	0.22.4	# MIT OR Apache-2.0
MODCARGO_CRATES +=	jni-sys	0.4.1	# MIT OR Apache-2.0
MODCARGO_CRATES +=	jni-sys-macros	0.4.1	# MIT OR Apache-2.0
MODCARGO_CRATES +=	jobserver	0.1.35	# MIT OR Apache-2.0
MODCARGO_CRATES +=	js-sys	0.3.106	# MIT OR Apache-2.0
MODCARGO_CRATES +=	lazy_static	1.5.1	# MIT OR Apache-2.0
MODCARGO_CRATES +=	libc	0.2.191	# MIT OR Apache-2.0
MODCARGO_CRATES +=	libredox	0.1.25	# MIT
MODCARGO_CRATES +=	libsqlite3-sys	0.37.0	# MIT
MODCARGO_CRATES +=	linux-raw-sys	0.12.1	# Apache-2.0 WITH LLVM-exception OR Apache-2.0 OR MIT
MODCARGO_CRATES +=	litemap	0.8.3	# Unicode-3.0
MODCARGO_CRATES +=	lock_api	0.4.14	# MIT OR Apache-2.0
MODCARGO_CRATES +=	log	0.4.33	# MIT OR Apache-2.0
MODCARGO_CRATES +=	logos	0.14.4	# MIT OR Apache-2.0
MODCARGO_CRATES +=	logos-codegen	0.14.4	# MIT OR Apache-2.0
MODCARGO_CRATES +=	logos-derive	0.14.4	# MIT OR Apache-2.0
MODCARGO_CRATES +=	lru-slab	0.1.3	# MIT OR Apache-2.0 OR Zlib
MODCARGO_CRATES +=	matchers	0.0.1	# MIT
MODCARGO_CRATES +=	md-5	0.11.0	# MIT OR Apache-2.0
MODCARGO_CRATES +=	memchr	2.8.3	# Unlicense OR MIT
MODCARGO_CRATES +=	miette	7.6.0	# Apache-2.0
MODCARGO_CRATES +=	miette-derive	7.6.0	# Apache-2.0
MODCARGO_CRATES +=	mime	0.3.17	# MIT OR Apache-2.0
MODCARGO_CRATES +=	mime_guess	2.0.5	# MIT
MODCARGO_CRATES +=	mini-redis	0.4.1	# MIT
MODCARGO_CRATES +=	miniz_oxide	0.8.9	# MIT OR Zlib OR Apache-2.0
MODCARGO_CRATES +=	miniz_oxide	0.9.1	# MIT OR Zlib OR Apache-2.0
MODCARGO_CRATES +=	mio	1.2.4	# MIT
MODCARGO_CRATES +=	multer	2.1.0	# MIT
MODCARGO_CRATES +=	multiversion_no_op	1.0.0	# Apache-2.0 OR MIT
MODCARGO_CRATES +=	nextcloud-config-parser	0.15.4	# MIT OR Apache-2.0
MODCARGO_CRATES +=	nextcloud_appinfo	0.6.0	# GPL-3.0
MODCARGO_CRATES +=	nu-ansi-term	0.50.3	# MIT
MODCARGO_CRATES +=	num-traits	0.2.19	# MIT OR Apache-2.0
MODCARGO_CRATES +=	objc2-core-foundation	0.3.2	# Zlib OR Apache-2.0 OR MIT
MODCARGO_CRATES +=	objc2-system-configuration	0.3.2	# Zlib OR Apache-2.0 OR MIT
MODCARGO_CRATES +=	object	0.37.3	# Apache-2.0 OR MIT
MODCARGO_CRATES +=	once_cell	1.21.4	# MIT OR Apache-2.0
MODCARGO_CRATES +=	once_cell_polyfill	1.70.2	# MIT OR Apache-2.0
MODCARGO_CRATES +=	openssl-probe	0.2.1	# MIT OR Apache-2.0
MODCARGO_CRATES +=	owo-colors	4.4.0	# MIT
MODCARGO_CRATES +=	parking	2.2.1	# Apache-2.0 OR MIT
MODCARGO_CRATES +=	parking_lot	0.12.5	# MIT OR Apache-2.0
MODCARGO_CRATES +=	parking_lot_core	0.9.12	# MIT OR Apache-2.0
MODCARGO_CRATES +=	parse-display	0.9.1	# MIT OR Apache-2.0
MODCARGO_CRATES +=	parse-display	0.11.0	# MIT OR Apache-2.0
MODCARGO_CRATES +=	parse-display-derive	0.9.1	# MIT OR Apache-2.0
MODCARGO_CRATES +=	parse-display-derive	0.11.0	# MIT OR Apache-2.0
MODCARGO_CRATES +=	percent-encoding	2.3.2	# MIT OR Apache-2.0
MODCARGO_CRATES +=	peresil	0.3.0	# MIT
MODCARGO_CRATES +=	php-literal-parser	0.7.1	# MIT OR Apache-2.0
MODCARGO_CRATES +=	pin-project	1.1.13	# Apache-2.0 OR MIT
MODCARGO_CRATES +=	pin-project-internal	1.1.13	# Apache-2.0 OR MIT
MODCARGO_CRATES +=	pin-project-lite	0.2.17	# Apache-2.0 OR MIT
MODCARGO_CRATES +=	pkg-config	0.3.34	# MIT OR Apache-2.0
MODCARGO_CRATES +=	potential_utf	0.1.6	# Unicode-3.0
MODCARGO_CRATES +=	ppv-lite86	0.2.21	# MIT OR Apache-2.0
MODCARGO_CRATES +=	proc-macro-error	1.0.4	# MIT OR Apache-2.0
MODCARGO_CRATES +=	proc-macro-error-attr	1.0.4	# MIT OR Apache-2.0
MODCARGO_CRATES +=	proc-macro2	1.0.107	# MIT OR Apache-2.0
MODCARGO_CRATES +=	quick-error	1.2.3	# MIT/Apache-2.0
MODCARGO_CRATES +=	quinn	0.11.12	# MIT OR Apache-2.0
MODCARGO_CRATES +=	quinn-proto	0.11.19	# MIT OR Apache-2.0
MODCARGO_CRATES +=	quinn-udp	0.5.16	# MIT OR Apache-2.0
MODCARGO_CRATES +=	quote	1.0.47	# MIT OR Apache-2.0
MODCARGO_CRATES +=	r-efi	5.3.0	# MIT OR Apache-2.0 OR LGPL-2.1-or-later
MODCARGO_CRATES +=	r-efi	6.0.0	# MIT OR Apache-2.0 OR LGPL-2.1-or-later
MODCARGO_CRATES +=	rand	0.8.8	# MIT OR Apache-2.0
MODCARGO_CRATES +=	rand	0.10.3	# MIT OR Apache-2.0
MODCARGO_CRATES +=	rand_chacha	0.3.1	# MIT OR Apache-2.0
MODCARGO_CRATES +=	rand_core	0.6.4	# MIT OR Apache-2.0
MODCARGO_CRATES +=	rand_core	0.10.1	# MIT OR Apache-2.0
MODCARGO_CRATES +=	rand_pcg	0.10.2	# MIT OR Apache-2.0
MODCARGO_CRATES +=	redis	1.7.1	# BSD-3-Clause
MODCARGO_CRATES +=	redox_syscall	0.5.18	# MIT
MODCARGO_CRATES +=	regex	1.13.1	# MIT OR Apache-2.0
MODCARGO_CRATES +=	regex-automata	0.1.10	# Unlicense/MIT
MODCARGO_CRATES +=	regex-automata	0.4.18	# MIT OR Apache-2.0
MODCARGO_CRATES +=	regex-syntax	0.6.29	# MIT OR Apache-2.0
MODCARGO_CRATES +=	regex-syntax	0.8.11	# MIT OR Apache-2.0
MODCARGO_CRATES +=	reqwest	0.13.5	# MIT OR Apache-2.0
MODCARGO_CRATES +=	rfc7239	0.1.3	# MIT OR Apache-2.0
MODCARGO_CRATES +=	ring	0.17.14	# Apache-2.0 AND ISC
MODCARGO_CRATES +=	rustc-demangle	0.1.28	# MIT/Apache-2.0
MODCARGO_CRATES +=	rustc-hash	2.1.3	# Apache-2.0 OR MIT
MODCARGO_CRATES +=	rustc_version	0.4.1	# MIT OR Apache-2.0
MODCARGO_CRATES +=	rustix	1.1.5	# Apache-2.0 WITH LLVM-exception OR Apache-2.0 OR MIT
MODCARGO_CRATES +=	rustls	0.22.4	# Apache-2.0 OR ISC OR MIT
MODCARGO_CRATES +=	rustls	0.23.46	# Apache-2.0 OR ISC OR MIT
MODCARGO_CRATES +=	rustls-native-certs	0.8.5	# Apache-2.0 OR ISC OR MIT
MODCARGO_CRATES +=	rustls-pemfile	2.2.0	# Apache-2.0 OR ISC OR MIT
MODCARGO_CRATES +=	rustls-pki-types	1.15.1	# MIT OR Apache-2.0
MODCARGO_CRATES +=	rustls-platform-verifier	0.7.1	# MIT OR Apache-2.0
MODCARGO_CRATES +=	rustls-platform-verifier-android	0.2.0	# MIT OR Apache-2.0
MODCARGO_CRATES +=	rustls-webpki	0.102.8	# ISC
MODCARGO_CRATES +=	rustls-webpki	0.103.16	# ISC
MODCARGO_CRATES +=	rustversion	1.0.23	# MIT OR Apache-2.0
MODCARGO_CRATES +=	ryu	1.0.23	# Apache-2.0 OR BSL-1.0
MODCARGO_CRATES +=	same-file	1.0.6	# Unlicense/MIT
MODCARGO_CRATES +=	schannel	0.1.30	# MIT
MODCARGO_CRATES +=	scoped-tls	1.0.1	# MIT/Apache-2.0
MODCARGO_CRATES +=	scopeguard	1.2.0	# MIT OR Apache-2.0
MODCARGO_CRATES +=	sd-notify	0.5.0	# MIT OR Apache-2.0
MODCARGO_CRATES +=	security-framework	3.7.0	# MIT OR Apache-2.0
MODCARGO_CRATES +=	security-framework-sys	2.17.0	# MIT OR Apache-2.0
MODCARGO_CRATES +=	semver	0.10.0	# MIT/Apache-2.0
MODCARGO_CRATES +=	semver	1.0.28	# MIT OR Apache-2.0
MODCARGO_CRATES +=	semver-parser	0.7.0	# MIT/Apache-2.0
MODCARGO_CRATES +=	serde	1.0.229	# MIT OR Apache-2.0
MODCARGO_CRATES +=	serde_core	1.0.229	# MIT OR Apache-2.0
MODCARGO_CRATES +=	serde_derive	1.0.229	# MIT OR Apache-2.0
MODCARGO_CRATES +=	serde_json	1.0.154	# MIT OR Apache-2.0
MODCARGO_CRATES +=	serde_urlencoded	0.7.1	# MIT/Apache-2.0
MODCARGO_CRATES +=	sha1	0.10.7	# MIT OR Apache-2.0
MODCARGO_CRATES +=	sha1	0.11.0	# MIT OR Apache-2.0
MODCARGO_CRATES +=	sha2	0.10.9	# MIT OR Apache-2.0
MODCARGO_CRATES +=	sha2	0.11.1	# MIT OR Apache-2.0
MODCARGO_CRATES +=	sharded-slab	0.1.7	# MIT
MODCARGO_CRATES +=	shlex	2.0.1	# MIT OR Apache-2.0
MODCARGO_CRATES +=	signal-hook-registry	1.4.8	# MIT OR Apache-2.0
MODCARGO_CRATES +=	simd-adler32	0.3.10	# MIT
MODCARGO_CRATES +=	simd_cesu8	1.2.0	# Apache-2.0 OR MIT
MODCARGO_CRATES +=	simdutf8	0.1.5	# MIT OR Apache-2.0
MODCARGO_CRATES +=	slab	0.4.12	# MIT
MODCARGO_CRATES +=	smallvec	1.16.3	# MIT OR Apache-2.0
MODCARGO_CRATES +=	socket2	0.5.10	# MIT OR Apache-2.0
MODCARGO_CRATES +=	socket2	0.6.5	# MIT OR Apache-2.0
MODCARGO_CRATES +=	spin	0.9.9	# MIT
MODCARGO_CRATES +=	sqlx	0.9.0	# MIT OR Apache-2.0
MODCARGO_CRATES +=	sqlx-core	0.9.0	# MIT OR Apache-2.0
MODCARGO_CRATES +=	sqlx-macros	0.9.0	# MIT OR Apache-2.0
MODCARGO_CRATES +=	sqlx-macros-core	0.9.0	# MIT OR Apache-2.0
MODCARGO_CRATES +=	sqlx-mysql	0.9.0	# MIT OR Apache-2.0
MODCARGO_CRATES +=	sqlx-postgres	0.9.0	# MIT OR Apache-2.0
MODCARGO_CRATES +=	sqlx-sqlite	0.9.0	# MIT OR Apache-2.0
MODCARGO_CRATES +=	stable_deref_trait	1.2.1	# MIT OR Apache-2.0
MODCARGO_CRATES +=	stringprep	0.1.5	# MIT/Apache-2.0
MODCARGO_CRATES +=	strsim	0.8.0	# MIT
MODCARGO_CRATES +=	strsim	0.11.1	# MIT
MODCARGO_CRATES +=	structmeta	0.3.0	# MIT OR Apache-2.0
MODCARGO_CRATES +=	structmeta-derive	0.3.0	# MIT OR Apache-2.0
MODCARGO_CRATES +=	structopt	0.3.26	# Apache-2.0 OR MIT
MODCARGO_CRATES +=	structopt-derive	0.4.18	# Apache-2.0/MIT
MODCARGO_CRATES +=	subtle	2.6.1	# BSD-3-Clause
MODCARGO_CRATES +=	supports-color	3.0.2	# Apache-2.0
MODCARGO_CRATES +=	supports-hyperlinks	3.2.0	# Apache-2.0
MODCARGO_CRATES +=	supports-unicode	3.0.0	# Apache-2.0
MODCARGO_CRATES +=	sxd-document	0.3.2	# MIT
MODCARGO_CRATES +=	sxd-xpath	0.4.2	# MIT/Apache-2.0
MODCARGO_CRATES +=	syn	1.0.109	# MIT OR Apache-2.0
MODCARGO_CRATES +=	syn	2.0.119	# MIT OR Apache-2.0
MODCARGO_CRATES +=	syn	3.0.9	# MIT OR Apache-2.0
MODCARGO_CRATES +=	sync_wrapper	1.0.2	# Apache-2.0
MODCARGO_CRATES +=	synstructure	0.14.0	# MIT
MODCARGO_CRATES +=	system-configuration	0.7.0	# MIT OR Apache-2.0
MODCARGO_CRATES +=	system-configuration-sys	0.6.0	# MIT OR Apache-2.0
MODCARGO_CRATES +=	terminal_size	0.4.4	# MIT OR Apache-2.0
MODCARGO_CRATES +=	textwrap	0.11.0	# MIT
MODCARGO_CRATES +=	textwrap	0.16.4	# MIT
MODCARGO_CRATES +=	thiserror	1.0.69	# MIT OR Apache-2.0
MODCARGO_CRATES +=	thiserror	2.0.21	# MIT OR Apache-2.0
MODCARGO_CRATES +=	thiserror-impl	1.0.69	# MIT OR Apache-2.0
MODCARGO_CRATES +=	thiserror-impl	2.0.21	# MIT OR Apache-2.0
MODCARGO_CRATES +=	thread_local	1.1.10	# MIT OR Apache-2.0
MODCARGO_CRATES +=	tinystr	0.8.4	# Unicode-3.0
MODCARGO_CRATES +=	tinyvec	1.13.3	# Zlib OR Apache-2.0 OR MIT
MODCARGO_CRATES +=	tokio	1.54.0	# MIT
MODCARGO_CRATES +=	tokio-macros	2.7.2	# MIT
MODCARGO_CRATES +=	tokio-rustls	0.25.0	# MIT/Apache-2.0
MODCARGO_CRATES +=	tokio-rustls	0.26.6	# MIT OR Apache-2.0
MODCARGO_CRATES +=	tokio-stream	0.1.19	# MIT
MODCARGO_CRATES +=	tokio-tungstenite	0.21.0	# MIT
MODCARGO_CRATES +=	tokio-tungstenite	0.30.0	# MIT
MODCARGO_CRATES +=	tokio-util	0.7.20	# MIT
MODCARGO_CRATES +=	tower	0.5.3	# MIT
MODCARGO_CRATES +=	tower-http	0.6.11	# MIT
MODCARGO_CRATES +=	tower-layer	0.3.3	# MIT
MODCARGO_CRATES +=	tower-service	0.3.3	# MIT
MODCARGO_CRATES +=	tracing	0.1.44	# MIT
MODCARGO_CRATES +=	tracing-attributes	0.1.31	# MIT
MODCARGO_CRATES +=	tracing-core	0.1.36	# MIT
MODCARGO_CRATES +=	tracing-futures	0.2.5	# MIT
MODCARGO_CRATES +=	tracing-log	0.1.4	# MIT
MODCARGO_CRATES +=	tracing-serde	0.1.3	# MIT
MODCARGO_CRATES +=	tracing-subscriber	0.2.25	# MIT
MODCARGO_CRATES +=	try-lock	0.2.5	# MIT
MODCARGO_CRATES +=	tungstenite	0.21.0	# MIT OR Apache-2.0
MODCARGO_CRATES +=	tungstenite	0.30.0	# MIT OR Apache-2.0
MODCARGO_CRATES +=	typed-arena	1.7.0	# MIT
MODCARGO_CRATES +=	typenum	1.20.1	# MIT OR Apache-2.0
MODCARGO_CRATES +=	uncased	0.9.10	# MIT OR Apache-2.0
MODCARGO_CRATES +=	unicase	2.10.0	# MIT OR Apache-2.0
MODCARGO_CRATES +=	unicode-bidi	0.3.18	# MIT OR Apache-2.0
MODCARGO_CRATES +=	unicode-ident	1.0.27	# (MIT OR Apache-2.0) AND Unicode-3.0
MODCARGO_CRATES +=	unicode-normalization	0.1.26	# (MIT OR Apache-2.0) AND Unicode-3.0
MODCARGO_CRATES +=	unicode-properties	0.1.4	# MIT/Apache-2.0
MODCARGO_CRATES +=	unicode-segmentation	1.13.3	# MIT OR Apache-2.0
MODCARGO_CRATES +=	unicode-width	0.1.14	# MIT OR Apache-2.0
MODCARGO_CRATES +=	unicode-width	0.2.2	# MIT OR Apache-2.0
MODCARGO_CRATES +=	untrusted	0.9.0	# ISC
MODCARGO_CRATES +=	ureq	3.4.2	# MIT OR Apache-2.0
MODCARGO_CRATES +=	ureq-proto	0.6.5	# MIT OR Apache-2.0
MODCARGO_CRATES +=	url	2.5.8	# MIT OR Apache-2.0
MODCARGO_CRATES +=	urlencoding	2.1.3	# MIT
MODCARGO_CRATES +=	utf-8	0.7.6	# MIT OR Apache-2.0
MODCARGO_CRATES +=	utf8-zero	0.8.1	# MIT OR Apache-2.0
MODCARGO_CRATES +=	utf8_iter	1.0.4	# Apache-2.0 OR MIT
MODCARGO_CRATES +=	utf8parse	0.2.2	# Apache-2.0 OR MIT
MODCARGO_CRATES +=	valuable	0.1.1	# MIT
MODCARGO_CRATES +=	vcpkg	0.2.15	# MIT/Apache-2.0
MODCARGO_CRATES +=	vec_map	0.8.2	# MIT/Apache-2.0
MODCARGO_CRATES +=	version_check	0.9.5	# MIT/Apache-2.0
MODCARGO_CRATES +=	walkdir	2.5.0	# Unlicense/MIT
MODCARGO_CRATES +=	want	0.3.2	# MIT
MODCARGO_CRATES +=	warp	0.3.7	# MIT
MODCARGO_CRATES +=	warp-real-ip	0.2.0	# MIT OR Apache-2.0
MODCARGO_CRATES +=	wasi	0.11.1+wasi-snapshot-preview1	# Apache-2.0 WITH LLVM-exception OR Apache-2.0 OR MIT
MODCARGO_CRATES +=	wasip2	1.0.4+wasi-0.2.12	# Apache-2.0 WITH LLVM-exception OR Apache-2.0 OR MIT
MODCARGO_CRATES +=	wasm-bindgen	0.2.129	# MIT OR Apache-2.0
MODCARGO_CRATES +=	wasm-bindgen-futures	0.4.79	# MIT OR Apache-2.0
MODCARGO_CRATES +=	wasm-bindgen-macro	0.2.129	# MIT OR Apache-2.0
MODCARGO_CRATES +=	wasm-bindgen-macro-support	0.2.129	# MIT OR Apache-2.0
MODCARGO_CRATES +=	wasm-bindgen-shared	0.2.129	# MIT OR Apache-2.0
MODCARGO_CRATES +=	web-sys	0.3.106	# MIT OR Apache-2.0
MODCARGO_CRATES +=	web-time	1.1.0	# MIT OR Apache-2.0
MODCARGO_CRATES +=	webpki-root-certs	1.0.10	# CDLA-Permissive-2.0
MODCARGO_CRATES +=	webpki-roots	0.26.11	# CDLA-Permissive-2.0
MODCARGO_CRATES +=	webpki-roots	1.0.10	# CDLA-Permissive-2.0
MODCARGO_CRATES +=	whoami	2.1.3	# Apache-2.0 OR BSL-1.0 OR MIT
MODCARGO_CRATES +=	winapi	0.3.9	# MIT/Apache-2.0
MODCARGO_CRATES +=	winapi-i686-pc-windows-gnu	0.4.0	# MIT/Apache-2.0
MODCARGO_CRATES +=	winapi-util	0.1.11	# Unlicense OR MIT
MODCARGO_CRATES +=	winapi-x86_64-pc-windows-gnu	0.4.0	# MIT/Apache-2.0
MODCARGO_CRATES +=	windows-core	0.62.2	# MIT OR Apache-2.0
MODCARGO_CRATES +=	windows-implement	0.60.2	# MIT OR Apache-2.0
MODCARGO_CRATES +=	windows-interface	0.59.3	# MIT OR Apache-2.0
MODCARGO_CRATES +=	windows-link	0.2.1	# MIT OR Apache-2.0
MODCARGO_CRATES +=	windows-registry	0.6.1	# MIT OR Apache-2.0
MODCARGO_CRATES +=	windows-result	0.4.1	# MIT OR Apache-2.0
MODCARGO_CRATES +=	windows-strings	0.5.1	# MIT OR Apache-2.0
MODCARGO_CRATES +=	windows-sys	0.52.0	# MIT OR Apache-2.0
MODCARGO_CRATES +=	windows-sys	0.61.2	# MIT OR Apache-2.0
MODCARGO_CRATES +=	windows-targets	0.52.6	# MIT OR Apache-2.0
MODCARGO_CRATES +=	windows_aarch64_gnullvm	0.52.6	# MIT OR Apache-2.0
MODCARGO_CRATES +=	windows_aarch64_msvc	0.52.6	# MIT OR Apache-2.0
MODCARGO_CRATES +=	windows_i686_gnu	0.52.6	# MIT OR Apache-2.0
MODCARGO_CRATES +=	windows_i686_gnullvm	0.52.6	# MIT OR Apache-2.0
MODCARGO_CRATES +=	windows_i686_msvc	0.52.6	# MIT OR Apache-2.0
MODCARGO_CRATES +=	windows_x86_64_gnu	0.52.6	# MIT OR Apache-2.0
MODCARGO_CRATES +=	windows_x86_64_gnullvm	0.52.6	# MIT OR Apache-2.0
MODCARGO_CRATES +=	windows_x86_64_msvc	0.52.6	# MIT OR Apache-2.0
MODCARGO_CRATES +=	wit-bindgen	0.57.1	# Apache-2.0 WITH LLVM-exception OR Apache-2.0 OR MIT
MODCARGO_CRATES +=	writeable	0.6.4	# Unicode-3.0
MODCARGO_CRATES +=	xpath_reader	0.5.3	# Apache-2.0
MODCARGO_CRATES +=	xxhash-rust	0.8.19	# BSL-1.0
MODCARGO_CRATES +=	yoke	0.8.3	# Unicode-3.0
MODCARGO_CRATES +=	yoke-derive	0.8.4	# Unicode-3.0
MODCARGO_CRATES +=	zerocopy	0.8.63	# BSD-2-Clause OR Apache-2.0 OR MIT
MODCARGO_CRATES +=	zerocopy-derive	0.8.63	# BSD-2-Clause OR Apache-2.0 OR MIT
MODCARGO_CRATES +=	zerofrom	0.1.8	# Unicode-3.0
MODCARGO_CRATES +=	zerofrom-derive	0.1.8	# Unicode-3.0
MODCARGO_CRATES +=	zeroize	1.9.1	# Apache-2.0 OR MIT
MODCARGO_CRATES +=	zerotrie	0.2.5	# Unicode-3.0
MODCARGO_CRATES +=	zerovec	0.11.8	# Unicode-3.0
MODCARGO_CRATES +=	zerovec-derive	0.11.6	# Unicode-3.0
MODCARGO_CRATES +=	zlib-rs	0.6.8	# Zlib
MODCARGO_CRATES +=	zmij	1.0.23	# MIT
