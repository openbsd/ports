MODGO_MODULES =	\
	cloud.google.com/go								 v0.112.1 \
	cloud.google.com/go/bigquery							 v1.8.0 \
	cloud.google.com/go/compute							 v1.24.0 \
	cloud.google.com/go/compute/metadata						 v0.3.0 \
	cloud.google.com/go/datastore							 v1.1.0 \
	cloud.google.com/go/firestore							 v1.15.0 \
	cloud.google.com/go/iam								 v1.1.5 \
	cloud.google.com/go/longrunning							 v0.5.5 \
	cloud.google.com/go/pubsub							 v1.3.1 \
	cloud.google.com/go/storage							 v1.35.1 \
	codeberg.org/gruf/go-atomics							 v1.1.0 \
	codeberg.org/gruf/go-bitutil							 v1.1.0 \
	codeberg.org/gruf/go-buf							 v1.0.0 \
	codeberg.org/gruf/go-bytes							 v1.0.2 \
	codeberg.org/gruf/go-bytesize							 v1.0.2 \
	codeberg.org/gruf/go-byteutil							 v1.2.0 \
	codeberg.org/gruf/go-cache/v3							 v3.5.7 \
	codeberg.org/gruf/go-ctx							 v1.0.2 \
	codeberg.org/gruf/go-debug							 v1.3.0 \
	codeberg.org/gruf/go-errors/v2							 v2.3.1 \
	codeberg.org/gruf/go-fastcopy							 v1.1.2 \
	codeberg.org/gruf/go-fastpath/v2						 v2.0.0 \
	codeberg.org/gruf/go-iotools							 v0.0.0-20230811115124-5d4223615a7f \
	codeberg.org/gruf/go-kv								 v1.6.4 \
	codeberg.org/gruf/go-list							 v0.0.0-20240425093752-494db03d641f \
	codeberg.org/gruf/go-log							 v1.0.5 \
	codeberg.org/gruf/go-logger/v2							 v2.2.1 \
	codeberg.org/gruf/go-loosy							 v0.0.0-20231007123304-bb910d1ab5c4 \
	codeberg.org/gruf/go-mangler							 v1.3.0 \
	codeberg.org/gruf/go-maps							 v1.0.3 \
	codeberg.org/gruf/go-mempool							 v0.0.0-20240507125005-cef10d64a760 \
	codeberg.org/gruf/go-middleware							 v1.1.0 \
	codeberg.org/gruf/go-mutexes							 v1.5.0 \
	codeberg.org/gruf/go-rtutil/v2							 v2.0.2 \
	codeberg.org/gruf/go-runners							 v1.6.2 \
	codeberg.org/gruf/go-sched							 v1.2.3 \
	codeberg.org/gruf/go-storage							 v0.1.1 \
	codeberg.org/gruf/go-structr							 v0.8.5 \
	codeberg.org/gruf/go-ulid							 v1.0.0 \
	codeberg.org/superseriousbusiness/exif-terminator				 v0.7.0 \
	dmitri.shuralyov.com/gpu/mtl							 v0.0.0-20190408044501-666a987793e9 \
	github.com/!burnt!sushi/toml							 v0.3.1 \
	github.com/!burnt!sushi/xgb							 v0.0.0-20160522181843-27f122750802 \
	github.com/!dmitriy!v!titov/size						 v1.5.0 \
	github.com/!kim!machine!gun/automemlimit					 v0.6.1 \
	github.com/!masterminds/goutils							 v1.1.1 \
	github.com/!masterminds/semver/v3						 v3.2.1 \
	github.com/!masterminds/sprig/v3						 v3.2.3 \
	github.com/!puerkito!bio/goquery						 v1.8.1 \
	github.com/abema/go-mp4								 v1.2.0 \
	github.com/ajg/form								 v1.5.1 \
	github.com/alecthomas/kingpin/v2						 v2.4.0 \
	github.com/alecthomas/units							 v0.0.0-20211218093645-b94a6e3cc137 \
	github.com/andybalholm/brotli							 v1.0.5 \
	github.com/andybalholm/cascadia							 v1.3.2 \
	github.com/antihax/optional							 v1.0.0 \
	github.com/antonlindstrom/pgstore						 v0.0.0-20220421113606-e3a6e3fed12a \
	github.com/armon/go-metrics							 v0.4.1 \
	github.com/asaskevich/govalidator						 v0.0.0-20230301143203-a9d515a09cc2 \
	github.com/aymerick/douceur							 v0.2.0 \
	github.com/beorn7/perks								 v1.0.1 \
	github.com/boj/redistore							 v0.0.0-20180917114910-cd5dcc76aeff \
	github.com/bos-hieu/mongostore							 v0.0.3 \
	github.com/bradfitz/gomemcache							 v0.0.0-20230905024940-24af94b03874 \
	github.com/bradleypeabody/gorilla-sessions-memcache				 v0.0.0-20181103040241-659414f458e1 \
	github.com/buckket/go-blurhash							 v1.1.0 \
	github.com/bytedance/sonic							 v1.11.6 \
	github.com/bytedance/sonic/loader						 v0.1.1 \
	github.com/cenkalti/backoff/v4							 v4.3.0 \
	github.com/census-instrumentation/opencensus-proto				 v0.4.1 \
	github.com/cespare/xxhash/v2							 v2.2.0 \
	github.com/cheekybits/is							 v0.0.0-20150225183255-68e9c0620927 \
	github.com/chenzhuoyu/base64x							 v0.0.0-20230717121745-296ad89f973d \
	github.com/chenzhuoyu/iasm							 v0.9.1 \
	github.com/chzyer/logex								 v1.1.10 \
	github.com/chzyer/readline							 v0.0.0-20180603132655-2972be24d48e \
	github.com/chzyer/test								 v0.0.0-20180213035817-a1ea475d72b1 \
	github.com/cilium/ebpf								 v0.9.1 \
	github.com/client9/misspell							 v0.3.4 \
	github.com/cloudwego/base64x							 v0.1.4 \
	github.com/cloudwego/iasm							 v0.2.0 \
	github.com/cncf/udpa/go								 v0.0.0-20191209042840-269d4d468f6f \
	github.com/cncf/xds/go								 v0.0.0-20231128003011-0fa0005c9caa \
	github.com/cnf/structhash							 v0.0.0-20201127153200-e1b16c1ebc08 \
	github.com/containerd/cgroups/v3						 v3.0.1 \
	github.com/coreos/go-oidc/v3							 v3.10.0 \
	github.com/coreos/go-semver							 v0.3.0 \
	github.com/coreos/go-systemd/v22						 v22.3.2 \
	github.com/cpuguy83/go-md2man/v2						 v2.0.3 \
	github.com/creack/pty								 v1.1.9 \
	github.com/dave/jennifer							 v1.5.0 \
	github.com/davecgh/go-spew							 v1.1.2-0.20180830191138-d8f796af33cc \
	github.com/dgryski/go-rendezvous						 v0.0.0-20200823014737-9f7001d12a5f \
	github.com/disintegration/imaging						 v1.6.2 \
	github.com/djherbis/atime							 v1.1.0 \
	github.com/docker/go-units							 v0.5.0 \
	github.com/dolthub/maphash							 v0.1.0 \
	github.com/dolthub/swiss							 v0.2.1 \
	github.com/dsoprea/go-exif/v2							 v2.0.0-20200321225314-640175a69fe4 \
	github.com/dsoprea/go-exif/v3							 v3.0.0-20210625224831-a6301f85c82b \
	github.com/dsoprea/go-iptc							 v0.0.0-20200610044640-bc9ca208b413 \
	github.com/dsoprea/go-logging							 v0.0.0-20200710184922-b02d349568dd \
	github.com/dsoprea/go-photoshop-info-format					 v0.0.0-20200610045659-121dd752914d \
	github.com/dsoprea/go-utility							 v0.0.0-20200711062821-fab8125e9bdf \
	github.com/dsoprea/go-utility/v2						 v2.0.0-20200717064901-2fccff4aa15e \
	github.com/dustin/go-humanize							 v1.0.1 \
	github.com/envoyproxy/go-control-plane						 v0.12.0 \
	github.com/envoyproxy/protoc-gen-validate					 v1.0.4 \
	github.com/fasthttp-contrib/websocket						 v0.0.0-20160511215533-1f3b11f56072 \
	github.com/fatih/color								 v1.14.1 \
	github.com/fatih/structs							 v1.1.0 \
	github.com/felixge/httpsnoop							 v1.0.4 \
	github.com/frankban/quicktest							 v1.14.6 \
	github.com/fsnotify/fsnotify							 v1.7.0 \
	github.com/fxamacker/cbor							 v1.5.1 \
	github.com/gabriel-vasile/mimetype						 v1.4.3 \
	github.com/gavv/httpexpect							 v2.0.0+incompatible \
	github.com/gin-contrib/cors							 v1.7.2 \
	github.com/gin-contrib/gzip							 v1.0.1 \
	github.com/gin-contrib/sessions							 v1.0.1 \
	github.com/gin-contrib/sse							 v0.1.0 \
	github.com/gin-gonic/gin							 v1.10.0 \
	github.com/globalsign/mgo							 v0.0.0-20181015135952-eeefdecb41b8 \
	github.com/go-errors/errors							 v1.4.1 \
	github.com/go-fed/httpsig							 v1.1.0 \
	github.com/go-gl/glfw								 v0.0.0-20190409004039-e6da0acd62b1 \
	github.com/go-gl/glfw/v3.3/glfw							 v0.0.0-20200222043503-6f7a984d4dc4 \
	github.com/go-jose/go-jose/v4							 v4.0.1 \
	github.com/go-kit/log								 v0.2.1 \
	github.com/go-logfmt/logfmt							 v0.5.1 \
	github.com/go-logr/logr								 v1.4.1 \
	github.com/go-logr/stdr								 v1.2.2 \
	github.com/go-openapi/analysis							 v0.23.0 \
	github.com/go-openapi/errors							 v0.22.0 \
	github.com/go-openapi/inflect							 v0.21.0 \
	github.com/go-openapi/jsonpointer						 v0.21.0 \
	github.com/go-openapi/jsonreference						 v0.21.0 \
	github.com/go-openapi/loads							 v0.22.0 \
	github.com/go-openapi/runtime							 v0.28.0 \
	github.com/go-openapi/spec							 v0.21.0 \
	github.com/go-openapi/strfmt							 v0.23.0 \
	github.com/go-openapi/swag							 v0.23.0 \
	github.com/go-openapi/validate							 v0.24.0 \
	github.com/go-playground/assert/v2						 v2.2.0 \
	github.com/go-playground/form/v4						 v4.2.1 \
	github.com/go-playground/locales						 v0.14.1 \
	github.com/go-playground/universal-translator					 v0.18.1 \
	github.com/go-playground/validator/v10						 v10.20.0 \
	github.com/go-session/session							 v3.1.2+incompatible \
	github.com/go-swagger/go-swagger						 v0.31.0 \
	github.com/go-swagger/scan-repo-boundary					 v0.0.0-20180623220736-973b3573c013 \
	github.com/go-test/deep								 v1.0.8 \
	github.com/go-xmlfmt/xmlfmt							 v0.0.0-20211206191508-7fd73a941850 \
	github.com/goccy/go-json							 v0.10.2 \
	github.com/godbus/dbus/v5							 v5.0.4 \
	github.com/gogo/protobuf							 v1.3.2 \
	github.com/golang-jwt/jwt							 v3.2.2+incompatible \
	github.com/golang-jwt/jwt/v5							 v5.2.1 \
	github.com/golang/geo								 v0.0.0-20210211234256-740aa86cb551 \
	github.com/golang/glog								 v1.2.0 \
	github.com/golang/groupcache							 v0.0.0-20210331224755-41bb18bfe9da \
	github.com/golang/mock								 v1.6.0 \
	github.com/golang/protobuf							 v1.5.4 \
	github.com/golang/snappy							 v0.0.4 \
	github.com/gomodule/redigo							 v2.0.0+incompatible \
	github.com/google/btree								 v1.0.0 \
	github.com/google/go-cmp							 v0.6.0 \
	github.com/google/go-querystring						 v1.0.0 \
	github.com/google/gofuzz							 v1.2.0 \
	github.com/google/martian							 v2.1.0+incompatible \
	github.com/google/martian/v3							 v3.0.0 \
	github.com/google/pprof								 v0.0.0-20240409012703-83162a5b38cd \
	github.com/google/renameio							 v0.1.0 \
	github.com/google/s2a-go							 v0.1.7 \
	github.com/google/uuid								 v1.6.0 \
	github.com/googleapis/enterprise-certificate-proxy				 v0.3.2 \
	github.com/googleapis/gax-go/v2							 v2.12.3 \
	github.com/googleapis/google-cloud-go-testing					 v0.0.0-20210719221736-1c9a4c676720 \
	github.com/gopherjs/gopherjs							 v0.0.0-20181017120253-0766667cb4d1 \
	github.com/gorilla/context							 v1.1.2 \
	github.com/gorilla/css								 v1.0.0 \
	github.com/gorilla/feeds							 v1.1.2 \
	github.com/gorilla/handlers							 v1.5.2 \
	github.com/gorilla/securecookie							 v1.1.2 \
	github.com/gorilla/sessions							 v1.2.2 \
	github.com/gorilla/websocket							 v1.5.2 \
	github.com/grpc-ecosystem/grpc-gateway/v2					 v2.19.1 \
	github.com/h2non/filetype							 v1.1.3 \
	github.com/hashicorp/consul/api							 v1.28.2 \
	github.com/hashicorp/errwrap							 v1.1.0 \
	github.com/hashicorp/go-cleanhttp						 v0.5.2 \
	github.com/hashicorp/go-hclog							 v1.5.0 \
	github.com/hashicorp/go-immutable-radix						 v1.3.1 \
	github.com/hashicorp/go-multierror						 v1.1.1 \
	github.com/hashicorp/go-rootcerts						 v1.0.2 \
	github.com/hashicorp/golang-lru							 v0.5.4 \
	github.com/hashicorp/golang-lru/v2						 v2.0.7 \
	github.com/hashicorp/hcl							 v1.0.0 \
	github.com/hashicorp/serf							 v0.10.1 \
	github.com/hpcloud/tail								 v1.0.0 \
	github.com/huandu/xstrings							 v1.4.0 \
	github.com/ianlancetaylor/demangle						 v0.0.0-20181102032728-5e5cf60278f6 \
	github.com/imdario/mergo							 v0.3.16 \
	github.com/imkira/go-interpol							 v1.1.0 \
	github.com/inconshreveable/mousetrap						 v1.1.0 \
	github.com/jackc/pgpassfile							 v1.0.0 \
	github.com/jackc/pgservicefile							 v0.0.0-20221227161230-091c0ba34f0a \
	github.com/jackc/pgx/v5								 v5.6.0 \
	github.com/jackc/puddle/v2							 v2.2.1 \
	github.com/jessevdk/go-flags							 v1.5.0 \
	github.com/jinzhu/inflection							 v1.0.0 \
	github.com/jinzhu/now								 v1.1.5 \
	github.com/josharian/intern							 v1.0.0 \
	github.com/jpillora/backoff							 v1.0.0 \
	github.com/json-iterator/go							 v1.1.12 \
	github.com/jstemmer/go-junit-report						 v0.9.1 \
	github.com/jtolds/gls								 v4.20.0+incompatible \
	github.com/julienschmidt/httprouter						 v1.3.0 \
	github.com/k0kubun/colorstring							 v0.0.0-20150214042306-9440f1994b88 \
	github.com/kballard/go-shellquote						 v0.0.0-20180428030007-95032a82bc51 \
	github.com/kidstuff/mongostore							 v0.0.0-20181113001930-e650cd85ee4b \
	github.com/kisielk/gotool							 v1.0.0 \
	github.com/klauspost/compress							 v1.17.8 \
	github.com/klauspost/cpuid/v2							 v2.2.7 \
	github.com/knz/go-libedit							 v1.10.1 \
	github.com/kr/fs								 v0.1.0 \
	github.com/kr/pretty								 v0.3.1 \
	github.com/kr/pty								 v1.1.8 \
	github.com/kr/text								 v0.2.0 \
	github.com/leodido/go-urn							 v1.4.0 \
	github.com/lib/pq								 v1.10.9 \
	github.com/magiconair/properties						 v1.8.7 \
	github.com/mailru/easyjson							 v0.7.7 \
	github.com/matryer/try								 v0.0.0-20161228173917-9ac251b645a2 \
	github.com/mattn/go-colorable							 v0.1.13 \
	github.com/mattn/go-isatty							 v0.0.20 \
	github.com/mattn/go-sqlite3							 v1.14.16 \
	github.com/matttproud/golang_protobuf_extensions/v2				 v2.0.0 \
	github.com/memcachier/mc							 v2.0.1+incompatible \
	github.com/microcosm-cc/bluemonday						 v1.0.26 \
	github.com/miekg/dns								 v1.1.59 \
	github.com/minio/md5-simd							 v1.1.2 \
	github.com/minio/minio-go/v7							 v7.0.71 \
	github.com/mitchellh/copystructure						 v1.2.0 \
	github.com/mitchellh/go-homedir							 v1.1.0 \
	github.com/mitchellh/hashstructure/v2						 v2.0.2 \
	github.com/mitchellh/mapstructure						 v1.5.0 \
	github.com/mitchellh/reflectwalk						 v1.0.2 \
	github.com/modern-go/concurrent							 v0.0.0-20180306012644-bacd9c7ef1dd \
	github.com/modern-go/reflect2							 v1.0.2 \
	github.com/montanaflynn/stats							 v0.7.1 \
	github.com/moul/http2curl							 v1.0.0 \
	github.com/mwitkow/go-conntrack							 v0.0.0-20190716064945-2f068394615f \
	github.com/nats-io/nats.go							 v1.34.0 \
	github.com/nats-io/nkeys							 v0.4.7 \
	github.com/nats-io/nuid								 v1.0.1 \
	github.com/ncruces/go-sqlite3							 v0.16.2 \
	github.com/ncruces/go-strftime							 v0.1.9 \
	github.com/ncruces/julianday							 v1.0.0 \
	github.com/ncruces/sort								 v0.1.2 \
	github.com/niemeyer/pretty							 v0.0.0-20200227124842-a10e7caefd8e \
	github.com/nxadm/tail								 v1.4.4 \
	github.com/oklog/ulid								 v1.3.1 \
	github.com/onsi/ginkgo								 v1.13.0 \
	github.com/onsi/gomega								 v1.10.1 \
	github.com/opencontainers/runtime-spec						 v1.0.2 \
	github.com/opentracing/opentracing-go						 v1.2.0 \
	github.com/orcaman/writerseeker							 v0.0.0-20200621085525-1d3f536ff85e \
	github.com/pbnjay/memory							 v0.0.0-20210728143218-7b4eea64cf58 \
	github.com/pelletier/go-toml/v2							 v2.2.2 \
	github.com/pkg/diff								 v0.0.0-20210226163009-20ebb0f2a09e \
	github.com/pkg/errors								 v0.9.1 \
	github.com/pkg/sftp								 v1.13.6 \
	github.com/pmezard/go-difflib							 v1.0.1-0.20181226105442-5d4384ee4fb2 \
	github.com/prashantv/gostub							 v1.1.0 \
	github.com/prometheus/client_golang						 v1.19.1 \
	github.com/prometheus/client_model						 v0.6.0 \
	github.com/prometheus/common							 v0.48.0 \
	github.com/prometheus/procfs							 v0.12.0 \
	github.com/psanford/httpreadat							 v0.1.0 \
	github.com/quasoft/memstore							 v0.0.0-20191010062613-2bce066d2b0b \
	github.com/redis/go-redis/v9							 v9.0.4 \
	github.com/remyoudompheng/bigfft						 v0.0.0-20230129092748-24d4a6f8daec \
	github.com/rogpeppe/fastuuid							 v1.2.0 \
	github.com/rogpeppe/go-internal							 v1.12.0 \
	github.com/rs/xid								 v1.5.0 \
	github.com/rs/zerolog								 v1.32.0 \
	github.com/russross/blackfriday/v2						 v2.1.0 \
	github.com/sagikazarmark/crypt							 v0.19.0 \
	github.com/sagikazarmark/locafero						 v0.4.0 \
	github.com/sagikazarmark/slog-shim						 v0.1.0 \
	github.com/sclevine/agouti							 v3.0.0+incompatible \
	github.com/sergi/go-diff							 v1.1.0 \
	github.com/shopspring/decimal							 v1.3.1 \
	github.com/sirupsen/logrus							 v1.9.3 \
	github.com/smartystreets/assertions						 v0.0.0-20180927180507-b2de0cb4f26d \
	github.com/smartystreets/goconvey						 v1.6.4 \
	github.com/sourcegraph/conc							 v0.3.0 \
	github.com/spf13/afero								 v1.11.0 \
	github.com/spf13/cast								 v1.6.0 \
	github.com/spf13/cobra								 v1.8.0 \
	github.com/spf13/pflag								 v1.0.5 \
	github.com/spf13/viper								 v1.19.0 \
	github.com/stretchr/objx							 v0.5.2 \
	github.com/stretchr/testify							 v1.9.0 \
	github.com/subosito/gotenv							 v1.6.0 \
	github.com/sunfish-shogi/bufseekio						 v0.0.0-20210207115823-a4185644b365 \
	github.com/superseriousbusiness/activity					 v1.6.0-gts.0.20240408131430-247f7f7110f0 \
	github.com/superseriousbusiness/go-jpeg-image-structure/v2			 v2.0.0-20220321154430-d89a106fdabe \
	github.com/superseriousbusiness/go-png-image-structure/v2			 v2.0.1-!s!s!b \
	github.com/superseriousbusiness/httpsig						 v1.2.0-!s!s!b \
	github.com/superseriousbusiness/oauth2/v4					 v4.3.2-!s!s!b.0.20230227143000-f4900831d6c8 \
	github.com/tdewolff/argp							 v0.0.0-20240126212256-acdb2fb50090 \
	github.com/tdewolff/minify/v2							 v2.20.33 \
	github.com/tdewolff/parse/v2							 v2.7.14 \
	github.com/tdewolff/test							 v1.0.11-0.20240106005702-7de5f7df4739 \
	github.com/technologize/otel-go-contrib						 v1.1.1 \
	github.com/tetratelabs/wazero							 v1.7.3 \
	github.com/tidwall/btree							 v0.0.0-20191029221954-400434d76274 \
	github.com/tidwall/buntdb							 v1.1.2 \
	github.com/tidwall/gjson							 v1.6.0 \
	github.com/tidwall/grect							 v0.0.0-20161006141115-ba9a043346eb \
	github.com/tidwall/match							 v1.0.1 \
	github.com/tidwall/pretty							 v1.0.1 \
	github.com/tidwall/rtree							 v0.0.0-20180113144539-6cd427091e0e \
	github.com/tidwall/tinyqueue							 v0.0.0-20180302190814-1e39f5511563 \
	github.com/tmthrgd/go-hex							 v0.0.0-20190904060850-447a3041c3bc \
	github.com/tomnomnom/linkheader							 v0.0.0-20180905144013-02ca5825eb80 \
	github.com/toqueteos/webbrowser							 v1.2.0 \
	github.com/twitchyliquid64/golang-asm						 v0.15.1 \
	github.com/ugorji/go/codec							 v1.2.12 \
	github.com/ulule/limiter/v3							 v3.11.2 \
	github.com/uptrace/bun								 v1.2.1 \
	github.com/uptrace/bun/dialect/pgdialect					 v1.2.1 \
	github.com/uptrace/bun/dialect/sqlitedialect					 v1.2.1 \
	github.com/uptrace/bun/extra/bunotel						 v1.2.1 \
	github.com/uptrace/opentelemetry-go-extra/otelsql				 v0.2.4 \
	github.com/valyala/bytebufferpool						 v1.0.0 \
	github.com/valyala/fasthttp							 v1.47.0 \
	github.com/valyala/tcplisten							 v0.0.0-20161114210144-ceec8f93295a \
	github.com/vmihailenco/msgpack/v5						 v5.4.1 \
	github.com/vmihailenco/tagparser/v2						 v2.0.0 \
	github.com/wader/gormstore/v2							 v2.0.3 \
	github.com/wagslane/go-password-validator					 v0.3.0 \
	github.com/x448/float16								 v0.8.4 \
	github.com/xdg-go/pbkdf2							 v1.0.0 \
	github.com/xdg-go/scram								 v1.1.2 \
	github.com/xdg-go/stringprep							 v1.0.4 \
	github.com/xeipuuv/gojsonpointer						 v0.0.0-20180127040702-4e3ac2762d5f \
	github.com/xeipuuv/gojsonreference						 v0.0.0-20180127040603-bd5ef7bd5415 \
	github.com/xeipuuv/gojsonschema							 v1.2.0 \
	github.com/xhit/go-str2duration/v2						 v2.1.0 \
	github.com/yalp/jsonpath							 v0.0.0-20180802001716-5cc68e5049a0 \
	github.com/youmark/pkcs8							 v0.0.0-20201027041543-1326539a0a0a \
	github.com/yudai/gojsondiff							 v1.0.0 \
	github.com/yudai/golcs								 v0.0.0-20170316035057-ecda9a501e82 \
	github.com/yudai/pp								 v2.0.1+incompatible \
	github.com/yuin/goldmark							 v1.7.1 \
	gitlab.com/!nyaaa!whats!up!doc/sqlite						 v1.29.9-concurrency-workaround \
	go.etcd.io/etcd/api/v3								 v3.5.12 \
	go.etcd.io/etcd/client/pkg/v3							 v3.5.12 \
	go.etcd.io/etcd/client/v2							 v2.305.12 \
	go.etcd.io/etcd/client/v3							 v3.5.12 \
	go.mongodb.org/mongo-driver							 v1.14.0 \
	go.opencensus.io								 v0.24.0 \
	go.opentelemetry.io/contrib/instrumentation/google.golang.org/grpc/otelgrpc	 v0.49.0 \
	go.opentelemetry.io/contrib/instrumentation/net/http/otelhttp			 v0.49.0 \
	go.opentelemetry.io/otel							 v1.26.0 \
	go.opentelemetry.io/otel/exporters/otlp/otlptrace				 v1.26.0 \
	go.opentelemetry.io/otel/exporters/otlp/otlptrace/otlptracegrpc			 v1.26.0 \
	go.opentelemetry.io/otel/exporters/otlp/otlptrace/otlptracehttp			 v1.24.0 \
	go.opentelemetry.io/otel/exporters/prometheus					 v0.46.0 \
	go.opentelemetry.io/otel/metric							 v1.26.0 \
	go.opentelemetry.io/otel/sdk							 v1.26.0 \
	go.opentelemetry.io/otel/sdk/metric						 v1.24.0 \
	go.opentelemetry.io/otel/trace							 v1.26.0 \
	go.opentelemetry.io/proto/otlp							 v1.2.0 \
	go.uber.org/atomic								 v1.9.0 \
	go.uber.org/automaxprocs							 v1.5.3 \
	go.uber.org/goleak								 v1.3.0 \
	go.uber.org/multierr								 v1.11.0 \
	go.uber.org/zap									 v1.21.0 \
	golang.org/x/arch								 v0.8.0 \
	golang.org/x/crypto								 v0.24.0 \
	golang.org/x/exp								 v0.0.0-20240222234643-814bf88cf225 \
	golang.org/x/image								 v0.17.0 \
	golang.org/x/lint								 v0.0.0-20200302205851-738671d3881b \
	golang.org/x/mobile								 v0.0.0-20190719004257-d2bd2a29d028 \
	golang.org/x/mod								 v0.17.0 \
	golang.org/x/net								 v0.26.0 \
	golang.org/x/oauth2								 v0.20.0 \
	golang.org/x/sync								 v0.7.0 \
	golang.org/x/sys								 v0.21.0 \
	golang.org/x/telemetry								 v0.0.0-20240228155512-f48c80bd79b2 \
	golang.org/x/term								 v0.21.0 \
	golang.org/x/text								 v0.16.0 \
	golang.org/x/time								 v0.5.0 \
	golang.org/x/tools								 v0.21.1-0.20240508182429-e35e4ccd0d2d \
	golang.org/x/xerrors								 v0.0.0-20220907171357-04be3eba64a2 \
	google.golang.org/api								 v0.171.0 \
	google.golang.org/appengine							 v1.6.8 \
	google.golang.org/genproto							 v0.0.0-20240227224415-6ceb2ff114de \
	google.golang.org/genproto/googleapis/api					 v0.0.0-20240311132316-a219d84964c2 \
	google.golang.org/genproto/googleapis/rpc					 v0.0.0-20240401170217-c3f982113cda \
	google.golang.org/grpc								 v1.63.2 \
	google.golang.org/protobuf							 v1.34.1 \
	gopkg.in/check.v1								 v1.0.0-20201130134442-10cb98267c6c \
	gopkg.in/errgo.v2								 v2.1.0 \
	gopkg.in/fsnotify.v1								 v1.4.7 \
	gopkg.in/ini.v1									 v1.67.0 \
	gopkg.in/mcuadros/go-syslog.v2							 v2.3.0 \
	gopkg.in/src-d/go-billy.v4							 v4.3.2 \
	gopkg.in/tomb.v1								 v1.0.0-20141024135613-dd632973f1e7 \
	gopkg.in/yaml.v2								 v2.4.0 \
	gopkg.in/yaml.v3								 v3.0.1 \
	gorm.io/driver/sqlite								 v1.4.4 \
	gorm.io/gorm									 v1.25.8 \
	honnef.co/go/tools								 v0.0.1-2020.1.4 \
	lukechampine.com/adiantum							 v1.1.1 \
	lukechampine.com/uint128							 v1.2.0 \
	modernc.org/cc/v3								 v3.41.0 \
	modernc.org/cc/v4								 v4.20.0 \
	modernc.org/ccgo/v3								 v3.17.0 \
	modernc.org/ccgo/v4								 v4.16.0 \
	modernc.org/fileutil								 v1.3.0 \
	modernc.org/gc/v2								 v2.4.1 \
	modernc.org/gc/v3								 v3.0.0-20240107210532-573471604cb6 \
	modernc.org/libc								 v1.49.3 \
	modernc.org/mathutil								 v1.6.0 \
	modernc.org/memory								 v1.8.0 \
	modernc.org/opt									 v0.1.3 \
	modernc.org/sortutil								 v1.2.0 \
	modernc.org/strutil								 v1.2.0 \
	modernc.org/token								 v1.1.0 \
	mvdan.cc/xurls/v2								 v2.5.0 \
	nullprogram.com/x/optparse							 v1.0.0 \
	rsc.io/binaryregexp								 v0.2.0 \
	rsc.io/pdf									 v0.1.1 \
	rsc.io/quote/v3									 v3.1.0 \
	rsc.io/sampler									 v1.3.0

MODGO_MODFILES =	\
	cloud.google.com/go					 v0.110.10 \
	cloud.google.com/go					 v0.26.0 \
	cloud.google.com/go					 v0.34.0 \
	cloud.google.com/go					 v0.38.0 \
	cloud.google.com/go					 v0.44.1 \
	cloud.google.com/go					 v0.44.2 \
	cloud.google.com/go					 v0.45.1 \
	cloud.google.com/go					 v0.46.3 \
	cloud.google.com/go					 v0.50.0 \
	cloud.google.com/go					 v0.52.0 \
	cloud.google.com/go					 v0.53.0 \
	cloud.google.com/go					 v0.54.0 \
	cloud.google.com/go					 v0.56.0 \
	cloud.google.com/go					 v0.57.0 \
	cloud.google.com/go					 v0.62.0 \
	cloud.google.com/go					 v0.65.0 \
	cloud.google.com/go/bigquery				 v1.0.1 \
	cloud.google.com/go/bigquery				 v1.3.0 \
	cloud.google.com/go/bigquery				 v1.4.0 \
	cloud.google.com/go/bigquery				 v1.5.0 \
	cloud.google.com/go/bigquery				 v1.7.0 \
	cloud.google.com/go/compute				 v1.23.3 \
	cloud.google.com/go/compute/metadata			 v0.2.3 \
	cloud.google.com/go/datastore				 v1.0.0 \
	cloud.google.com/go/pubsub				 v1.0.1 \
	cloud.google.com/go/pubsub				 v1.1.0 \
	cloud.google.com/go/pubsub				 v1.2.0 \
	cloud.google.com/go/storage				 v1.0.0 \
	cloud.google.com/go/storage				 v1.10.0 \
	cloud.google.com/go/storage				 v1.5.0 \
	cloud.google.com/go/storage				 v1.6.0 \
	cloud.google.com/go/storage				 v1.8.0 \
	codeberg.org/gruf/go-bitutil				 v1.0.0 \
	codeberg.org/gruf/go-bitutil				 v1.0.1 \
	codeberg.org/gruf/go-byteutil				 v1.0.2 \
	codeberg.org/gruf/go-byteutil				 v1.1.2 \
	codeberg.org/gruf/go-errors/v2				 v2.0.0 \
	codeberg.org/gruf/go-errors/v2				 v2.0.2 \
	codeberg.org/gruf/go-kv					 v1.5.1 \
	codeberg.org/gruf/go-kv					 v1.5.2 \
	codeberg.org/gruf/go-mangler				 v1.2.3 \
	codeberg.org/gruf/go-runners				 v1.5.0 \
	codeberg.org/gruf/go-runners				 v1.6.1 \
	github.com/!masterminds/semver/v3			 v3.2.0 \
	github.com/andybalholm/brotli				 v1.0.0 \
	github.com/bytedance/sonic				 v1.11.3 \
	github.com/bytedance/sonic				 v1.8.0 \
	github.com/cenkalti/backoff/v4				 v4.2.1 \
	github.com/census-instrumentation/opencensus-proto	 v0.2.1 \
	github.com/chenzhuoyu/base64x				 v0.0.0-20221115062448-fe3a3abad311 \
	github.com/creack/pty					 v1.1.7 \
	github.com/davecgh/go-spew				 v1.1.0 \
	github.com/davecgh/go-spew				 v1.1.1 \
	github.com/docker/go-units				 v0.4.0 \
	github.com/dsoprea/go-exif/v3				 v3.0.0-20200717053412-08f1b6708903 \
	github.com/dsoprea/go-exif/v3				 v3.0.0-20210428042052-dca55bf8ca15 \
	github.com/dsoprea/go-iptc				 v0.0.0-20200609062250-162ae6b44feb \
	github.com/dsoprea/go-logging				 v0.0.0-20190624164917-c4f10aab7696 \
	github.com/dsoprea/go-logging				 v0.0.0-20200517223158-a10564966e9d \
	github.com/dsoprea/go-photoshop-info-format		 v0.0.0-20200609050348-3db9b63b202c \
	github.com/envoyproxy/go-control-plane			 v0.9.0 \
	github.com/envoyproxy/go-control-plane			 v0.9.1-0.20191026205805-5f8ba28d4473 \
	github.com/envoyproxy/go-control-plane			 v0.9.4 \
	github.com/envoyproxy/protoc-gen-validate		 v0.1.0 \
	github.com/felixge/httpsnoop				 v1.0.2 \
	github.com/felixge/httpsnoop				 v1.0.3 \
	github.com/frankban/quicktest				 v1.14.0 \
	github.com/fsnotify/fsnotify				 v1.4.7 \
	github.com/fsnotify/fsnotify				 v1.4.9 \
	github.com/gin-gonic/gin				 v1.8.1 \
	github.com/gin-gonic/gin				 v1.9.0 \
	github.com/gin-gonic/gin				 v1.9.1 \
	github.com/go-errors/errors				 v1.0.1 \
	github.com/go-errors/errors				 v1.0.2 \
	github.com/go-errors/errors				 v1.1.1 \
	github.com/go-gl/glfw/v3.3/glfw				 v0.0.0-20191125211704-12ad95a8df72 \
	github.com/go-logr/logr					 v1.2.2 \
	github.com/go-logr/logr					 v1.2.4 \
	github.com/go-playground/assert/v2			 v2.0.1 \
	github.com/go-playground/locales			 v0.14.0 \
	github.com/go-playground/universal-translator		 v0.18.0 \
	github.com/go-playground/validator/v10			 v10.11.1 \
	github.com/go-playground/validator/v10			 v10.11.2 \
	github.com/go-playground/validator/v10			 v10.19.0 \
	github.com/go-xmlfmt/xmlfmt				 v0.0.0-20191208150333-d5b6f63a941b \
	github.com/goccy/go-json				 v0.10.0 \
	github.com/goccy/go-json				 v0.9.11 \
	github.com/golang-jwt/jwt				 v3.2.1+incompatible \
	github.com/golang/geo					 v0.0.0-20190916061304-5b978397cfec \
	github.com/golang/geo					 v0.0.0-20200319012246-673a6f80352d \
	github.com/golang/glog					 v0.0.0-20160126235308-23def4e6c14b \
	github.com/golang/groupcache				 v0.0.0-20190702054246-869f871628b6 \
	github.com/golang/groupcache				 v0.0.0-20191227052852-215e87163ea7 \
	github.com/golang/groupcache				 v0.0.0-20200121045136-8c9f03a8e57e \
	github.com/golang/mock					 v1.1.1 \
	github.com/golang/mock					 v1.2.0 \
	github.com/golang/mock					 v1.3.1 \
	github.com/golang/mock					 v1.4.0 \
	github.com/golang/mock					 v1.4.1 \
	github.com/golang/mock					 v1.4.3 \
	github.com/golang/mock					 v1.4.4 \
	github.com/golang/protobuf				 v1.2.0 \
	github.com/golang/protobuf				 v1.3.1 \
	github.com/golang/protobuf				 v1.3.2 \
	github.com/golang/protobuf				 v1.3.3 \
	github.com/golang/protobuf				 v1.3.4 \
	github.com/golang/protobuf				 v1.3.5 \
	github.com/golang/protobuf				 v1.4.0 \
	github.com/golang/protobuf				 v1.4.0-rc.1 \
	github.com/golang/protobuf				 v1.4.0-rc.1.0.20200221234624-67d41d38c208 \
	github.com/golang/protobuf				 v1.4.0-rc.2 \
	github.com/golang/protobuf				 v1.4.0-rc.4.0.20200313231945-b860323f09d0 \
	github.com/golang/protobuf				 v1.4.1 \
	github.com/golang/protobuf				 v1.4.2 \
	github.com/golang/protobuf				 v1.5.0 \
	github.com/golang/protobuf				 v1.5.3 \
	github.com/golang/snappy				 v0.0.1 \
	github.com/google/btree					 v0.0.0-20180813153112-4030bb1f1f0c \
	github.com/google/go-cmp				 v0.2.0 \
	github.com/google/go-cmp				 v0.3.0 \
	github.com/google/go-cmp				 v0.3.1 \
	github.com/google/go-cmp				 v0.4.0 \
	github.com/google/go-cmp				 v0.4.1 \
	github.com/google/go-cmp				 v0.5.0 \
	github.com/google/go-cmp				 v0.5.1 \
	github.com/google/go-cmp				 v0.5.2 \
	github.com/google/go-cmp				 v0.5.5 \
	github.com/google/go-cmp				 v0.5.6 \
	github.com/google/go-cmp				 v0.5.8 \
	github.com/google/go-cmp				 v0.5.9 \
	github.com/google/gofuzz				 v1.0.0 \
	github.com/google/pprof					 v0.0.0-20181206194817-3ea8567a2e57 \
	github.com/google/pprof					 v0.0.0-20190515194954-54271f7e092f \
	github.com/google/pprof					 v0.0.0-20191218002539-d4f498aebedc \
	github.com/google/pprof					 v0.0.0-20200212024743-f11f1df84d12 \
	github.com/google/pprof					 v0.0.0-20200229191704-1ebb73c60ed3 \
	github.com/google/pprof					 v0.0.0-20200430221834-fc25d7d30c6d \
	github.com/google/pprof					 v0.0.0-20200708004538-1a94d8640e99 \
	github.com/google/uuid					 v1.1.1 \
	github.com/google/uuid					 v1.1.2 \
	github.com/google/uuid					 v1.4.0 \
	github.com/googleapis/gax-go/v2				 v2.0.4 \
	github.com/googleapis/gax-go/v2				 v2.0.5 \
	github.com/googleapis/gax-go/v2				 v2.12.0 \
	github.com/gorilla/websocket				 v1.4.2 \
	github.com/grpc-ecosystem/grpc-gateway/v2		 v2.19.0 \
	github.com/hashicorp/golang-lru				 v0.5.0 \
	github.com/hashicorp/golang-lru				 v0.5.1 \
	github.com/huandu/xstrings				 v1.3.3 \
	github.com/imdario/mergo				 v0.3.11 \
	github.com/jessevdk/go-flags				 v1.4.0 \
	github.com/jstemmer/go-junit-report			 v0.0.0-20190106144839-af01ea7f8024 \
	github.com/klauspost/compress				 v1.10.10 \
	github.com/klauspost/compress				 v1.10.4 \
	github.com/klauspost/compress				 v1.13.6 \
	github.com/klauspost/compress				 v1.16.3 \
	github.com/klauspost/compress				 v1.17.2 \
	github.com/klauspost/compress				 v1.17.6 \
	github.com/klauspost/compress				 v1.17.7 \
	github.com/klauspost/cpuid/v2				 v2.0.1 \
	github.com/klauspost/cpuid/v2				 v2.0.9 \
	github.com/klauspost/cpuid/v2				 v2.2.6 \
	github.com/kr/pretty					 v0.1.0 \
	github.com/kr/pretty					 v0.3.0 \
	github.com/kr/pty					 v1.1.1 \
	github.com/kr/text					 v0.1.0 \
	github.com/leodido/go-urn				 v1.2.1 \
	github.com/mattn/go-colorable				 v0.1.7 \
	github.com/mattn/go-isatty				 v0.0.12 \
	github.com/mattn/go-isatty				 v0.0.16 \
	github.com/mattn/go-isatty				 v0.0.17 \
	github.com/minio/minio-go/v7				 v7.0.70 \
	github.com/mitchellh/copystructure			 v1.0.0 \
	github.com/mitchellh/reflectwalk			 v1.0.0 \
	github.com/modern-go/concurrent				 v0.0.0-20180228061459-e0a39a4cb421 \
	github.com/montanaflynn/stats				 v0.0.0-20171201202039-1bf9dbcd8cbe \
	github.com/onsi/ginkgo					 v1.12.1 \
	github.com/onsi/ginkgo					 v1.6.0 \
	github.com/onsi/gomega					 v1.7.1 \
	github.com/pelletier/go-toml/v2				 v2.0.5 \
	github.com/pelletier/go-toml/v2				 v2.0.6 \
	github.com/pelletier/go-toml/v2				 v2.1.1 \
	github.com/pelletier/go-toml/v2				 v2.2.0 \
	github.com/pelletier/go-toml/v2				 v2.2.1 \
	github.com/pmezard/go-difflib				 v1.0.0 \
	github.com/prometheus/client_golang			 v1.18.0 \
	github.com/prometheus/client_model			 v0.0.0-20190812154241-14fe0d1b01d4 \
	github.com/prometheus/client_model			 v0.5.0 \
	github.com/prometheus/common				 v0.45.0 \
	github.com/rogpeppe/go-internal				 v1.10.0 \
	github.com/rogpeppe/go-internal				 v1.11.0 \
	github.com/rogpeppe/go-internal				 v1.3.0 \
	github.com/rogpeppe/go-internal				 v1.6.1 \
	github.com/rogpeppe/go-internal				 v1.8.0 \
	github.com/rogpeppe/go-internal				 v1.9.0 \
	github.com/shopspring/decimal				 v1.2.0 \
	github.com/sirupsen/logrus				 v1.8.1 \
	github.com/spf13/cast					 v1.3.1 \
	github.com/spf13/viper					 v1.18.2 \
	github.com/stretchr/objx				 v0.1.0 \
	github.com/stretchr/objx				 v0.4.0 \
	github.com/stretchr/objx				 v0.5.0 \
	github.com/stretchr/testify				 v1.2.2 \
	github.com/stretchr/testify				 v1.3.0 \
	github.com/stretchr/testify				 v1.4.0 \
	github.com/stretchr/testify				 v1.5.1 \
	github.com/stretchr/testify				 v1.6.1 \
	github.com/stretchr/testify				 v1.7.0 \
	github.com/stretchr/testify				 v1.7.1 \
	github.com/stretchr/testify				 v1.7.5 \
	github.com/stretchr/testify				 v1.8.0 \
	github.com/stretchr/testify				 v1.8.1 \
	github.com/stretchr/testify				 v1.8.2 \
	github.com/stretchr/testify				 v1.8.3 \
	github.com/stretchr/testify				 v1.8.4 \
	github.com/tdewolff/test				 v1.0.11-0.20231101010635-f1265d231d52 \
	github.com/tidwall/gjson				 v1.3.4 \
	github.com/tidwall/pretty				 v1.0.0 \
	github.com/ugorji/go/codec				 v1.2.7 \
	github.com/ugorji/go/codec				 v1.2.9 \
	github.com/valyala/fasthttp				 v1.14.0 \
	github.com/youmark/pkcs8				 v0.0.0-20181117223130-1be2e3e5546d \
	github.com/yuin/goldmark				 v1.1.25 \
	github.com/yuin/goldmark				 v1.1.27 \
	github.com/yuin/goldmark				 v1.1.32 \
	github.com/yuin/goldmark				 v1.4.13 \
	go.opencensus.io					 v0.21.0 \
	go.opencensus.io					 v0.22.0 \
	go.opencensus.io					 v0.22.2 \
	go.opencensus.io					 v0.22.3 \
	go.opencensus.io					 v0.22.4 \
	go.opentelemetry.io/otel				 v1.18.0 \
	go.opentelemetry.io/otel				 v1.24.0 \
	go.opentelemetry.io/otel/exporters/otlp/otlptrace	 v1.24.0 \
	go.opentelemetry.io/otel/metric				 v1.18.0 \
	go.opentelemetry.io/otel/metric				 v1.24.0 \
	go.opentelemetry.io/otel/sdk				 v1.24.0 \
	go.opentelemetry.io/otel/trace				 v1.18.0 \
	go.opentelemetry.io/otel/trace				 v1.24.0 \
	go.opentelemetry.io/proto/otlp				 v1.1.0 \
	go.uber.org/atomic					 v1.7.0 \
	go.uber.org/goleak					 v1.1.12 \
	go.uber.org/multierr					 v1.9.0 \
	golang.org/x/arch					 v0.0.0-20210923205945-b76863e36670 \
	golang.org/x/arch					 v0.7.0 \
	golang.org/x/crypto					 v0.0.0-20190308221718-c2843e01d9a2 \
	golang.org/x/crypto					 v0.0.0-20190510104115-cbcb75029529 \
	golang.org/x/crypto					 v0.0.0-20190605123033-f99c8df09eb5 \
	golang.org/x/crypto					 v0.0.0-20191011191535-87dc89f01550 \
	golang.org/x/crypto					 v0.0.0-20200622213623-75b288015ac9 \
	golang.org/x/crypto					 v0.0.0-20210921155107-089bfa567519 \
	golang.org/x/crypto					 v0.16.0 \
	golang.org/x/crypto					 v0.17.0 \
	golang.org/x/crypto					 v0.18.0 \
	golang.org/x/crypto					 v0.19.0 \
	golang.org/x/crypto					 v0.2.0 \
	golang.org/x/crypto					 v0.21.0 \
	golang.org/x/crypto					 v0.22.0 \
	golang.org/x/crypto					 v0.23.0 \
	golang.org/x/crypto					 v0.3.0 \
	golang.org/x/crypto					 v0.7.0 \
	golang.org/x/exp					 v0.0.0-20190121172915-509febef88a4 \
	golang.org/x/exp					 v0.0.0-20190306152737-a1d7652674e8 \
	golang.org/x/exp					 v0.0.0-20190510132918-efd6b22b2522 \
	golang.org/x/exp					 v0.0.0-20190829153037-c13cbed26979 \
	golang.org/x/exp					 v0.0.0-20191030013958-a1ab85dbe136 \
	golang.org/x/exp					 v0.0.0-20191129062945-2f5052295587 \
	golang.org/x/exp					 v0.0.0-20191227195350-da58074b4299 \
	golang.org/x/exp					 v0.0.0-20200119233911-0405dc783f0a \
	golang.org/x/exp					 v0.0.0-20200207192155-f17229e696bd \
	golang.org/x/exp					 v0.0.0-20200224162631-6cc2880d07d6 \
	golang.org/x/exp					 v0.0.0-20230905200255-921286631fa9 \
	golang.org/x/exp					 v0.0.0-20231108232855-2478ac86f678 \
	golang.org/x/image					 v0.0.0-20190227222117-0694c2d4d067 \
	golang.org/x/image					 v0.0.0-20190802002840-cff245a6509b \
	golang.org/x/image					 v0.0.0-20191009234506-e7c1f5e7dbb8 \
	golang.org/x/image					 v0.1.0 \
	golang.org/x/lint					 v0.0.0-20181026193005-c67002cb31c3 \
	golang.org/x/lint					 v0.0.0-20190227174305-5b3e6a55c961 \
	golang.org/x/lint					 v0.0.0-20190301231843-5614ed5bae6f \
	golang.org/x/lint					 v0.0.0-20190313153728-d0100b6bd8b3 \
	golang.org/x/lint					 v0.0.0-20190409202823-959b441ac422 \
	golang.org/x/lint					 v0.0.0-20190909230951-414d861bb4ac \
	golang.org/x/lint					 v0.0.0-20190930215403-16217165b5de \
	golang.org/x/lint					 v0.0.0-20191125180803-fdd1cda4f05f \
	golang.org/x/lint					 v0.0.0-20200130185559-910be7a94367 \
	golang.org/x/mobile					 v0.0.0-20190312151609-d3739f865fa6 \
	golang.org/x/mod					 v0.0.0-20190513183733-4bf6d317e70e \
	golang.org/x/mod					 v0.1.0 \
	golang.org/x/mod					 v0.1.1-0.20191105210325-c90efee705ee \
	golang.org/x/mod					 v0.1.1-0.20191107180719-034126e5016b \
	golang.org/x/mod					 v0.10.0 \
	golang.org/x/mod					 v0.14.0 \
	golang.org/x/mod					 v0.15.0 \
	golang.org/x/mod					 v0.16.0 \
	golang.org/x/mod					 v0.2.0 \
	golang.org/x/mod					 v0.3.0 \
	golang.org/x/mod					 v0.6.0-dev.0.20220419223038-86c51ed26bb4 \
	golang.org/x/mod					 v0.9.0 \
	golang.org/x/net					 v0.0.0-20180724234803-3673e40ba225 \
	golang.org/x/net					 v0.0.0-20180826012351-8a410e7b638d \
	golang.org/x/net					 v0.0.0-20180906233101-161cd47e91fd \
	golang.org/x/net					 v0.0.0-20190108225652-1e06a53dbb7e \
	golang.org/x/net					 v0.0.0-20190213061140-3a22650c66bd \
	golang.org/x/net					 v0.0.0-20190311183353-d8887717615a \
	golang.org/x/net					 v0.0.0-20190404232315-eb5bcb51f2a3 \
	golang.org/x/net					 v0.0.0-20190501004415-9ce7a6920f09 \
	golang.org/x/net					 v0.0.0-20190503192946-f4e77d36d62c \
	golang.org/x/net					 v0.0.0-20190603091049-60506f45cf65 \
	golang.org/x/net					 v0.0.0-20190620200207-3b0461eec859 \
	golang.org/x/net					 v0.0.0-20190628185345-da137c7871d7 \
	golang.org/x/net					 v0.0.0-20190724013045-ca1201d0de80 \
	golang.org/x/net					 v0.0.0-20191209160850-c0dbc17a3553 \
	golang.org/x/net					 v0.0.0-20200114155413-6afb5195e5aa \
	golang.org/x/net					 v0.0.0-20200202094626-16171245cfb2 \
	golang.org/x/net					 v0.0.0-20200222125558-5a598a2470a0 \
	golang.org/x/net					 v0.0.0-20200226121028-0de0cce0169b \
	golang.org/x/net					 v0.0.0-20200301022130-244492dfa37a \
	golang.org/x/net					 v0.0.0-20200320220750-118fecf932d8 \
	golang.org/x/net					 v0.0.0-20200324143707-d3edc9973b7e \
	golang.org/x/net					 v0.0.0-20200501053045-e0ff5e5a1de5 \
	golang.org/x/net					 v0.0.0-20200506145744-7e3656a0809f \
	golang.org/x/net					 v0.0.0-20200513185701-a91f0712d120 \
	golang.org/x/net					 v0.0.0-20200520004742-59133d7f0dd7 \
	golang.org/x/net					 v0.0.0-20200520182314-0ba52f642ac2 \
	golang.org/x/net					 v0.0.0-20200625001655-4c5254603344 \
	golang.org/x/net					 v0.0.0-20200707034311-ab3426394381 \
	golang.org/x/net					 v0.0.0-20200822124328-c89045814202 \
	golang.org/x/net					 v0.0.0-20210226172049-e18ecbb05110 \
	golang.org/x/net					 v0.0.0-20220722155237-a158d28d115b \
	golang.org/x/net					 v0.17.0 \
	golang.org/x/net					 v0.19.0 \
	golang.org/x/net					 v0.2.0 \
	golang.org/x/net					 v0.20.0 \
	golang.org/x/net					 v0.21.0 \
	golang.org/x/net					 v0.22.0 \
	golang.org/x/net					 v0.23.0 \
	golang.org/x/net					 v0.24.0 \
	golang.org/x/net					 v0.25.0 \
	golang.org/x/net					 v0.8.0 \
	golang.org/x/oauth2					 v0.0.0-20180821212333-d2e6202438be \
	golang.org/x/oauth2					 v0.0.0-20190226205417-e64efc72b421 \
	golang.org/x/oauth2					 v0.0.0-20190604053449-0f29369cfe45 \
	golang.org/x/oauth2					 v0.0.0-20191202225959-858c2ad4c8b6 \
	golang.org/x/oauth2					 v0.0.0-20200107190931-bf48bf16ab8d \
	golang.org/x/oauth2					 v0.0.0-20210819190943-2bc19b11175f \
	golang.org/x/oauth2					 v0.13.0 \
	golang.org/x/oauth2					 v0.15.0 \
	golang.org/x/oauth2					 v0.16.0 \
	golang.org/x/oauth2					 v0.17.0 \
	golang.org/x/oauth2					 v0.18.0 \
	golang.org/x/sync					 v0.0.0-20180314180146-1d60e4601c6f \
	golang.org/x/sync					 v0.0.0-20181108010431-42b317875d0f \
	golang.org/x/sync					 v0.0.0-20181221193216-37e7f081c4d4 \
	golang.org/x/sync					 v0.0.0-20190227155943-e225da77a7e6 \
	golang.org/x/sync					 v0.0.0-20190423024810-112230192c58 \
	golang.org/x/sync					 v0.0.0-20190911185100-cd5d95a43a6e \
	golang.org/x/sync					 v0.0.0-20200317015054-43a5402ce75a \
	golang.org/x/sync					 v0.0.0-20200625203802-6e8e738ad208 \
	golang.org/x/sync					 v0.0.0-20220722155255-886fb9371eb4 \
	golang.org/x/sync					 v0.1.0 \
	golang.org/x/sync					 v0.3.0 \
	golang.org/x/sync					 v0.5.0 \
	golang.org/x/sync					 v0.6.0 \
	golang.org/x/sys					 v0.0.0-20180830151530-49385e6e1522 \
	golang.org/x/sys					 v0.0.0-20180909124046-d0be0721c37e \
	golang.org/x/sys					 v0.0.0-20190215142949-d0b11bdaac8a \
	golang.org/x/sys					 v0.0.0-20190312061237-fead79001313 \
	golang.org/x/sys					 v0.0.0-20190412213103-97732733099d \
	golang.org/x/sys					 v0.0.0-20190502145724-3ef323f4f1fd \
	golang.org/x/sys					 v0.0.0-20190507160741-ecd444e8653b \
	golang.org/x/sys					 v0.0.0-20190606165138-5da285871e9c \
	golang.org/x/sys					 v0.0.0-20190624142023-c5567b49c5d0 \
	golang.org/x/sys					 v0.0.0-20190726091711-fc99dfbffb4e \
	golang.org/x/sys					 v0.0.0-20190904154756-749cb33beabd \
	golang.org/x/sys					 v0.0.0-20191001151750-bb3f8db39f24 \
	golang.org/x/sys					 v0.0.0-20191005200804-aed5e4c7ecf9 \
	golang.org/x/sys					 v0.0.0-20191026070338-33540a1f6037 \
	golang.org/x/sys					 v0.0.0-20191120155948-bd437916bb0e \
	golang.org/x/sys					 v0.0.0-20191204072324-ce4227a45e2e \
	golang.org/x/sys					 v0.0.0-20191228213918-04cbcbbfeed8 \
	golang.org/x/sys					 v0.0.0-20200113162924-86b910548bc1 \
	golang.org/x/sys					 v0.0.0-20200116001909-b77594299b42 \
	golang.org/x/sys					 v0.0.0-20200122134326-e047566fdf82 \
	golang.org/x/sys					 v0.0.0-20200202164722-d101bd2416d5 \
	golang.org/x/sys					 v0.0.0-20200212091648-12a6c2dcc1e4 \
	golang.org/x/sys					 v0.0.0-20200223170610-d5e6a3e2c0ae \
	golang.org/x/sys					 v0.0.0-20200302150141-5c8b2ff67527 \
	golang.org/x/sys					 v0.0.0-20200323222414-85ca7c5b95cd \
	golang.org/x/sys					 v0.0.0-20200331124033-c3d80250170d \
	golang.org/x/sys					 v0.0.0-20200501052902-10377860bb8e \
	golang.org/x/sys					 v0.0.0-20200511232937-7e40ca221e25 \
	golang.org/x/sys					 v0.0.0-20200515095857-1151b9dac4a9 \
	golang.org/x/sys					 v0.0.0-20200519105757-fe76b779f299 \
	golang.org/x/sys					 v0.0.0-20200523222454-059865788121 \
	golang.org/x/sys					 v0.0.0-20200803210538-64077c9b5642 \
	golang.org/x/sys					 v0.0.0-20201119102817-f84b799fce68 \
	golang.org/x/sys					 v0.0.0-20210320140829-1e4c9ba3b0c4 \
	golang.org/x/sys					 v0.0.0-20210615035016-665e8c7367d1 \
	golang.org/x/sys					 v0.0.0-20210906170528-6f6e22806c34 \
	golang.org/x/sys					 v0.0.0-20211019181941-9d821ace8654 \
	golang.org/x/sys					 v0.0.0-20220520151302-bc2c85ada10a \
	golang.org/x/sys					 v0.0.0-20220715151400-c0bba94af5f8 \
	golang.org/x/sys					 v0.0.0-20220722155257-8c9f86f7a55f \
	golang.org/x/sys					 v0.12.0 \
	golang.org/x/sys					 v0.14.0 \
	golang.org/x/sys					 v0.15.0 \
	golang.org/x/sys					 v0.16.0 \
	golang.org/x/sys					 v0.17.0 \
	golang.org/x/sys					 v0.18.0 \
	golang.org/x/sys					 v0.19.0 \
	golang.org/x/sys					 v0.2.0 \
	golang.org/x/sys					 v0.20.0 \
	golang.org/x/sys					 v0.4.0 \
	golang.org/x/sys					 v0.5.0 \
	golang.org/x/sys					 v0.6.0 \
	golang.org/x/term					 v0.0.0-20201126162022-7de9c90e9dd1 \
	golang.org/x/term					 v0.0.0-20210927222741-03fcf44c2211 \
	golang.org/x/term					 v0.2.0 \
	golang.org/x/text					 v0.0.0-20170915032832-14c0d48ead0c \
	golang.org/x/text					 v0.12.0 \
	golang.org/x/text					 v0.14.0 \
	golang.org/x/text					 v0.15.0 \
	golang.org/x/text					 v0.3.0 \
	golang.org/x/text					 v0.3.1-0.20180807135948-17ff2d5776d2 \
	golang.org/x/text					 v0.3.2 \
	golang.org/x/text					 v0.3.3 \
	golang.org/x/text					 v0.3.7 \
	golang.org/x/text					 v0.3.8 \
	golang.org/x/text					 v0.4.0 \
	golang.org/x/text					 v0.8.0 \
	golang.org/x/time					 v0.0.0-20181108054448-85acf8d2951c \
	golang.org/x/time					 v0.0.0-20190308202827-9d24e82272b4 \
	golang.org/x/time					 v0.0.0-20191024005414-555d28b269f0 \
	golang.org/x/tools					 v0.0.0-20180917221912-90fa682c2a6e \
	golang.org/x/tools					 v0.0.0-20190114222345-bf090417da8b \
	golang.org/x/tools					 v0.0.0-20190226205152-f727befe758c \
	golang.org/x/tools					 v0.0.0-20190311212946-11955173bddd \
	golang.org/x/tools					 v0.0.0-20190312151545-0bb0c0a6e846 \
	golang.org/x/tools					 v0.0.0-20190312170243-e65039ee4138 \
	golang.org/x/tools					 v0.0.0-20190328211700-ab21143f2384 \
	golang.org/x/tools					 v0.0.0-20190425150028-36563e24a262 \
	golang.org/x/tools					 v0.0.0-20190506145303-2d16b83fe98c \
	golang.org/x/tools					 v0.0.0-20190524140312-2c0ae7006135 \
	golang.org/x/tools					 v0.0.0-20190606124116-d0a3d012864b \
	golang.org/x/tools					 v0.0.0-20190621195816-6e04913cbbac \
	golang.org/x/tools					 v0.0.0-20190628153133-6cdbf07be9d0 \
	golang.org/x/tools					 v0.0.0-20190816200558-6889da9d5479 \
	golang.org/x/tools					 v0.0.0-20190911174233-4f2ddba30aff \
	golang.org/x/tools					 v0.0.0-20191012152004-8de300cfc20a \
	golang.org/x/tools					 v0.0.0-20191113191852-77e3bb0ad9e7 \
	golang.org/x/tools					 v0.0.0-20191115202509-3a792d9c32b2 \
	golang.org/x/tools					 v0.0.0-20191119224855-298f0cb1881e \
	golang.org/x/tools					 v0.0.0-20191125144606-a911d9008d1f \
	golang.org/x/tools					 v0.0.0-20191130070609-6e064ea0cf2d \
	golang.org/x/tools					 v0.0.0-20191216173652-a0e659d51361 \
	golang.org/x/tools					 v0.0.0-20191227053925-7b8e75db28f4 \
	golang.org/x/tools					 v0.0.0-20200117161641-43d50277825c \
	golang.org/x/tools					 v0.0.0-20200122220014-bf1340f18c4a \
	golang.org/x/tools					 v0.0.0-20200130002326-2f3ba24bd6e7 \
	golang.org/x/tools					 v0.0.0-20200204074204-1cc6d1ef6c74 \
	golang.org/x/tools					 v0.0.0-20200207183749-b753a1ba74fa \
	golang.org/x/tools					 v0.0.0-20200212150539-ea181f53ac56 \
	golang.org/x/tools					 v0.0.0-20200224181240-023911ca70b2 \
	golang.org/x/tools					 v0.0.0-20200227222343-706bc42d1f0d \
	golang.org/x/tools					 v0.0.0-20200304193943-95d2e580d8eb \
	golang.org/x/tools					 v0.0.0-20200312045724-11d5b4c81c7d \
	golang.org/x/tools					 v0.0.0-20200331025713-a30bf2db82d4 \
	golang.org/x/tools					 v0.0.0-20200501065659-ab2804fb9c9d \
	golang.org/x/tools					 v0.0.0-20200512131952-2bc93b1c0c88 \
	golang.org/x/tools					 v0.0.0-20200515010526-7d3b6ebf133d \
	golang.org/x/tools					 v0.0.0-20200618134242-20370b0cb4b2 \
	golang.org/x/tools					 v0.0.0-20200729194436-6467de6f59a7 \
	golang.org/x/tools					 v0.0.0-20200804011535-6c149bb5ef0d \
	golang.org/x/tools					 v0.0.0-20200825202427-b303f430e36d \
	golang.org/x/tools					 v0.1.12 \
	golang.org/x/tools					 v0.13.0 \
	golang.org/x/tools					 v0.15.0 \
	golang.org/x/tools					 v0.18.0 \
	golang.org/x/tools					 v0.19.0 \
	golang.org/x/tools					 v0.21.0 \
	golang.org/x/xerrors					 v0.0.0-20190717185122-a985d3407aa7 \
	golang.org/x/xerrors					 v0.0.0-20191011141410-1b5146add898 \
	golang.org/x/xerrors					 v0.0.0-20191204190536-9bdfabe68543 \
	golang.org/x/xerrors					 v0.0.0-20200804184101-5ec99f83aff1 \
	google.golang.org/api					 v0.13.0 \
	google.golang.org/api					 v0.14.0 \
	google.golang.org/api					 v0.15.0 \
	google.golang.org/api					 v0.152.0 \
	google.golang.org/api					 v0.17.0 \
	google.golang.org/api					 v0.18.0 \
	google.golang.org/api					 v0.19.0 \
	google.golang.org/api					 v0.20.0 \
	google.golang.org/api					 v0.22.0 \
	google.golang.org/api					 v0.24.0 \
	google.golang.org/api					 v0.28.0 \
	google.golang.org/api					 v0.29.0 \
	google.golang.org/api					 v0.30.0 \
	google.golang.org/api					 v0.4.0 \
	google.golang.org/api					 v0.7.0 \
	google.golang.org/api					 v0.8.0 \
	google.golang.org/api					 v0.9.0 \
	google.golang.org/appengine				 v1.1.0 \
	google.golang.org/appengine				 v1.4.0 \
	google.golang.org/appengine				 v1.5.0 \
	google.golang.org/appengine				 v1.6.1 \
	google.golang.org/appengine				 v1.6.5 \
	google.golang.org/appengine				 v1.6.6 \
	google.golang.org/appengine				 v1.6.7 \
	google.golang.org/genproto				 v0.0.0-20180817151627-c66870c02cf8 \
	google.golang.org/genproto				 v0.0.0-20190307195333-5fe7a883aa19 \
	google.golang.org/genproto				 v0.0.0-20190418145605-e7d98fc518a7 \
	google.golang.org/genproto				 v0.0.0-20190425155659-357c62f0e4bb \
	google.golang.org/genproto				 v0.0.0-20190502173448-54afdca5d873 \
	google.golang.org/genproto				 v0.0.0-20190801165951-fa694d86fc64 \
	google.golang.org/genproto				 v0.0.0-20190819201941-24fa4b261c55 \
	google.golang.org/genproto				 v0.0.0-20190911173649-1774047e7e51 \
	google.golang.org/genproto				 v0.0.0-20191108220845-16a3f7862a1a \
	google.golang.org/genproto				 v0.0.0-20191115194625-c23dd37a84c9 \
	google.golang.org/genproto				 v0.0.0-20191216164720-4f79533eabd1 \
	google.golang.org/genproto				 v0.0.0-20191230161307-f3c370f40bfb \
	google.golang.org/genproto				 v0.0.0-20200115191322-ca5a22157cba \
	google.golang.org/genproto				 v0.0.0-20200122232147-0452cf42e150 \
	google.golang.org/genproto				 v0.0.0-20200204135345-fa8e72b47b90 \
	google.golang.org/genproto				 v0.0.0-20200212174721-66ed5ce911ce \
	google.golang.org/genproto				 v0.0.0-20200224152610-e50cd9704f63 \
	google.golang.org/genproto				 v0.0.0-20200228133532-8c2c7df3a383 \
	google.golang.org/genproto				 v0.0.0-20200305110556-506484158171 \
	google.golang.org/genproto				 v0.0.0-20200312145019-da6875a35672 \
	google.golang.org/genproto				 v0.0.0-20200331122359-1ee6d9798940 \
	google.golang.org/genproto				 v0.0.0-20200430143042-b979b6f78d84 \
	google.golang.org/genproto				 v0.0.0-20200511104702-f5ebc3bea380 \
	google.golang.org/genproto				 v0.0.0-20200515170657-fc4c6c6a6587 \
	google.golang.org/genproto				 v0.0.0-20200526211855-cb27e3aa2013 \
	google.golang.org/genproto				 v0.0.0-20200618031413-b414f8b61790 \
	google.golang.org/genproto				 v0.0.0-20200729003335-053ba62fc06f \
	google.golang.org/genproto				 v0.0.0-20200804131852-c06518451d9c \
	google.golang.org/genproto				 v0.0.0-20200825200019-8632dd797987 \
	google.golang.org/genproto				 v0.0.0-20231106174013-bbf56f31fb17 \
	google.golang.org/genproto				 v0.0.0-20240116215550-a9fa1716bcac \
	google.golang.org/genproto				 v0.0.0-20240213162025-012b6fc9bca9 \
	google.golang.org/genproto/googleapis/api		 v0.0.0-20231106174013-bbf56f31fb17 \
	google.golang.org/genproto/googleapis/api		 v0.0.0-20240102182953-50ed04b92917 \
	google.golang.org/genproto/googleapis/api		 v0.0.0-20240125205218-1f4bbc51befe \
	google.golang.org/genproto/googleapis/api		 v0.0.0-20240227224415-6ceb2ff114de \
	google.golang.org/genproto/googleapis/rpc		 v0.0.0-20231120223509-83a465c0220f \
	google.golang.org/genproto/googleapis/rpc		 v0.0.0-20240102182953-50ed04b92917 \
	google.golang.org/genproto/googleapis/rpc		 v0.0.0-20240125205218-1f4bbc51befe \
	google.golang.org/genproto/googleapis/rpc		 v0.0.0-20240227224415-6ceb2ff114de \
	google.golang.org/genproto/googleapis/rpc		 v0.0.0-20240228224816-df926f6c8641 \
	google.golang.org/genproto/googleapis/rpc		 v0.0.0-20240314234333-6e1732d8331c \
	google.golang.org/grpc					 v1.19.0 \
	google.golang.org/grpc					 v1.20.1 \
	google.golang.org/grpc					 v1.21.1 \
	google.golang.org/grpc					 v1.23.0 \
	google.golang.org/grpc					 v1.25.1 \
	google.golang.org/grpc					 v1.26.0 \
	google.golang.org/grpc					 v1.27.0 \
	google.golang.org/grpc					 v1.27.1 \
	google.golang.org/grpc					 v1.28.0 \
	google.golang.org/grpc					 v1.29.1 \
	google.golang.org/grpc					 v1.30.0 \
	google.golang.org/grpc					 v1.31.0 \
	google.golang.org/grpc					 v1.59.0 \
	google.golang.org/grpc					 v1.61.0 \
	google.golang.org/grpc					 v1.61.1 \
	google.golang.org/grpc					 v1.62.0 \
	google.golang.org/grpc					 v1.62.1 \
	google.golang.org/grpc					 v1.63.0 \
	google.golang.org/protobuf				 v0.0.0-20200109180630-ec00e32a8dfd \
	google.golang.org/protobuf				 v0.0.0-20200221191635-4d8936d0db64 \
	google.golang.org/protobuf				 v0.0.0-20200228230310-ab0ca4ff8a60 \
	google.golang.org/protobuf				 v1.20.1-0.20200309200217-e05f789c0967 \
	google.golang.org/protobuf				 v1.21.0 \
	google.golang.org/protobuf				 v1.22.0 \
	google.golang.org/protobuf				 v1.23.0 \
	google.golang.org/protobuf				 v1.23.1-0.20200526195155-81db48ad09cc \
	google.golang.org/protobuf				 v1.24.0 \
	google.golang.org/protobuf				 v1.25.0 \
	google.golang.org/protobuf				 v1.27.1 \
	google.golang.org/protobuf				 v1.28.1 \
	google.golang.org/protobuf				 v1.31.0 \
	google.golang.org/protobuf				 v1.32.0 \
	google.golang.org/protobuf				 v1.33.0 \
	google.golang.org/protobuf				 v1.34.0 \
	gopkg.in/check.v1					 v0.0.0-20161208181325-20d25e280405 \
	gopkg.in/check.v1					 v1.0.0-20180628173108-788fd7840127 \
	gopkg.in/check.v1					 v1.0.0-20190902080502-41f04d3bba15 \
	gopkg.in/check.v1					 v1.0.0-20200227125254-8fa46927fb4f \
	gopkg.in/yaml.v2					 v2.2.2 \
	gopkg.in/yaml.v2					 v2.2.4 \
	gopkg.in/yaml.v2					 v2.2.7 \
	gopkg.in/yaml.v2					 v2.2.8 \
	gopkg.in/yaml.v2					 v2.3.0 \
	gopkg.in/yaml.v3					 v3.0.0-20200313102051-9f266ea9e77c \
	gopkg.in/yaml.v3					 v3.0.0-20200615113413-eeeca48fe776 \
	honnef.co/go/tools					 v0.0.0-20190102054323-c2f93a96b099 \
	honnef.co/go/tools					 v0.0.0-20190106161140-3f1c8253044a \
	honnef.co/go/tools					 v0.0.0-20190418001031-e561f6794a2a \
	honnef.co/go/tools					 v0.0.0-20190523083050-ea95bdfd59fc \
	honnef.co/go/tools					 v0.0.1-2019.2.3 \
	honnef.co/go/tools					 v0.0.1-2020.1.3

