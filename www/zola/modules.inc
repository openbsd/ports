MODCARGO_CRATES +=	adler	1.0.2	# 0BSD OR MIT OR Apache-2.0
MODCARGO_CRATES +=	ahash	0.7.6	# MIT OR Apache-2.0
MODCARGO_CRATES +=	ahash	0.8.3	# MIT OR Apache-2.0
MODCARGO_CRATES +=	aho-corasick	0.7.20	# Unlicense OR MIT
MODCARGO_CRATES +=	ammonia	3.3.0	# MIT OR Apache-2.0
MODCARGO_CRATES +=	android_system_properties	0.1.5	# MIT/Apache-2.0
MODCARGO_CRATES +=	any_ascii	0.1.7	# ISC
MODCARGO_CRATES +=	anyhow	1.0.69	# MIT OR Apache-2.0
MODCARGO_CRATES +=	arrayvec	0.5.2	# MIT/Apache-2.0
MODCARGO_CRATES +=	arrayvec	0.7.2	# MIT OR Apache-2.0
MODCARGO_CRATES +=	assert-json-diff	2.0.2	# MIT
MODCARGO_CRATES +=	atty	0.2.14	# MIT
MODCARGO_CRATES +=	autocfg	1.1.0	# Apache-2.0 OR MIT
MODCARGO_CRATES +=	base64	0.21.0	# MIT OR Apache-2.0
MODCARGO_CRATES +=	bincode	1.3.3	# MIT
MODCARGO_CRATES +=	bit_field	0.10.2	# Apache-2.0/MIT
MODCARGO_CRATES +=	bitflags	1.3.2	# MIT/Apache-2.0
MODCARGO_CRATES +=	block-buffer	0.7.3	# MIT OR Apache-2.0
MODCARGO_CRATES +=	block-buffer	0.10.4	# MIT OR Apache-2.0
MODCARGO_CRATES +=	block-padding	0.1.5	# MIT OR Apache-2.0
MODCARGO_CRATES +=	bstr	1.3.0	# MIT OR Apache-2.0
MODCARGO_CRATES +=	build_const	0.2.2	# MIT
MODCARGO_CRATES +=	bumpalo	3.12.0	# MIT/Apache-2.0
MODCARGO_CRATES +=	byte-tools	0.3.1	# MIT OR Apache-2.0
MODCARGO_CRATES +=	bytecount	0.3.2	# Apache-2.0/MIT
MODCARGO_CRATES +=	bytecount	0.6.3	# Apache-2.0/MIT
MODCARGO_CRATES +=	bytemuck	1.13.1	# Zlib OR Apache-2.0 OR MIT
MODCARGO_CRATES +=	byteorder	1.4.3	# Unlicense OR MIT
MODCARGO_CRATES +=	bytes	0.4.12	# MIT
MODCARGO_CRATES +=	bytes	1.4.0	# MIT
MODCARGO_CRATES +=	camino	1.1.4	# MIT OR Apache-2.0
MODCARGO_CRATES +=	cargo-platform	0.1.2	# MIT OR Apache-2.0
MODCARGO_CRATES +=	cargo_metadata	0.14.2	# MIT
MODCARGO_CRATES +=	cc	1.0.79	# MIT OR Apache-2.0
MODCARGO_CRATES +=	cedarwood	0.4.6	# BSD-2-Clause
MODCARGO_CRATES +=	cfg-if	0.1.10	# MIT/Apache-2.0
MODCARGO_CRATES +=	cfg-if	1.0.0	# MIT/Apache-2.0
MODCARGO_CRATES +=	chrono	0.4.24	# MIT/Apache-2.0
MODCARGO_CRATES +=	chrono-tz	0.6.1	# MIT/Apache-2.0
MODCARGO_CRATES +=	chrono-tz-build	0.0.2	# MIT/Apache-2.0
MODCARGO_CRATES +=	clap	3.2.23	# MIT OR Apache-2.0
MODCARGO_CRATES +=	clap	4.1.8	# MIT OR Apache-2.0
MODCARGO_CRATES +=	clap_complete	4.1.4	# MIT OR Apache-2.0
MODCARGO_CRATES +=	clap_derive	3.2.18	# MIT OR Apache-2.0
MODCARGO_CRATES +=	clap_derive	4.1.8	# MIT OR Apache-2.0
MODCARGO_CRATES +=	clap_lex	0.2.4	# MIT OR Apache-2.0
MODCARGO_CRATES +=	clap_lex	0.3.2	# MIT OR Apache-2.0
MODCARGO_CRATES +=	codemap	0.1.3	# MIT/Apache-2.0
MODCARGO_CRATES +=	codespan-reporting	0.11.1	# Apache-2.0
MODCARGO_CRATES +=	color_quant	1.1.0	# MIT
MODCARGO_CRATES +=	colored	2.0.0	# MPL-2.0
MODCARGO_CRATES +=	console	0.15.5	# MIT
MODCARGO_CRATES +=	convert_case	0.4.0	# MIT
MODCARGO_CRATES +=	core-foundation	0.9.3	# MIT / Apache-2.0
MODCARGO_CRATES +=	core-foundation-sys	0.8.3	# MIT / Apache-2.0
MODCARGO_CRATES +=	cpufeatures	0.2.5	# MIT OR Apache-2.0
MODCARGO_CRATES +=	crc	1.8.1	# MIT OR Apache-2.0
MODCARGO_CRATES +=	crc32fast	1.3.2	# MIT OR Apache-2.0
MODCARGO_CRATES +=	crossbeam-channel	0.5.7	# MIT OR Apache-2.0
MODCARGO_CRATES +=	crossbeam-deque	0.8.3	# MIT OR Apache-2.0
MODCARGO_CRATES +=	crossbeam-epoch	0.9.14	# MIT OR Apache-2.0
MODCARGO_CRATES +=	crossbeam-utils	0.8.15	# MIT OR Apache-2.0
MODCARGO_CRATES +=	crunchy	0.2.2	# MIT
MODCARGO_CRATES +=	crypto-common	0.1.6	# MIT OR Apache-2.0
MODCARGO_CRATES +=	css-minify	0.3.1	# Apache-2.0/MIT
MODCARGO_CRATES +=	csv	1.2.1	# Unlicense/MIT
MODCARGO_CRATES +=	csv-core	0.1.10	# Unlicense/MIT
MODCARGO_CRATES +=	ctrlc	3.2.5	# MIT/Apache-2.0
MODCARGO_CRATES +=	cxx	1.0.92	# MIT OR Apache-2.0
MODCARGO_CRATES +=	cxx-build	1.0.92	# MIT OR Apache-2.0
MODCARGO_CRATES +=	cxxbridge-flags	1.0.92	# MIT OR Apache-2.0
MODCARGO_CRATES +=	cxxbridge-macro	1.0.92	# MIT OR Apache-2.0
MODCARGO_CRATES +=	derive_more	0.99.17	# MIT
MODCARGO_CRATES +=	deunicode	0.4.3	# BSD-3-Clause
MODCARGO_CRATES +=	digest	0.8.1	# MIT OR Apache-2.0
MODCARGO_CRATES +=	digest	0.10.6	# MIT OR Apache-2.0
MODCARGO_CRATES +=	displaydoc	0.2.3	# MIT OR Apache-2.0
MODCARGO_CRATES +=	doc-comment	0.3.3	# MIT
MODCARGO_CRATES +=	either	1.8.1	# MIT OR Apache-2.0
MODCARGO_CRATES +=	elasticlunr-rs	3.0.1	# MIT/Apache-2.0
MODCARGO_CRATES +=	encode_unicode	0.3.6	# MIT/Apache-2.0
MODCARGO_CRATES +=	encoding	0.2.33	# MIT
MODCARGO_CRATES +=	encoding-index-japanese	1.20141219.5	# CC0-1.0
MODCARGO_CRATES +=	encoding-index-korean	1.20141219.5	# CC0-1.0
MODCARGO_CRATES +=	encoding-index-simpchinese	1.20141219.5	# CC0-1.0
MODCARGO_CRATES +=	encoding-index-singlebyte	1.20141219.5	# CC0-1.0
MODCARGO_CRATES +=	encoding-index-tradchinese	1.20141219.5	# CC0-1.0
MODCARGO_CRATES +=	encoding_index_tests	0.1.4	# CC0-1.0
MODCARGO_CRATES +=	encoding_rs	0.8.32	# (Apache-2.0 OR MIT) AND BSD-3-Clause
MODCARGO_CRATES +=	env_logger	0.9.3	# MIT OR Apache-2.0
MODCARGO_CRATES +=	errno	0.2.8	# MIT/Apache-2.0
MODCARGO_CRATES +=	errno-dragonfly	0.1.2	# MIT
MODCARGO_CRATES +=	error-chain	0.12.4	# MIT/Apache-2.0
MODCARGO_CRATES +=	exr	1.6.3	# BSD-3-Clause
MODCARGO_CRATES +=	fake-simd	0.1.2	# MIT/Apache-2.0
MODCARGO_CRATES +=	fastrand	1.9.0	# Apache-2.0 OR MIT
MODCARGO_CRATES +=	filetime	0.2.20	# MIT/Apache-2.0
MODCARGO_CRATES +=	flate2	1.0.25	# MIT OR Apache-2.0
MODCARGO_CRATES +=	flume	0.10.14	# Apache-2.0/MIT
MODCARGO_CRATES +=	fnv	1.0.7	# Apache-2.0 / MIT
MODCARGO_CRATES +=	foreign-types	0.3.2	# MIT/Apache-2.0
MODCARGO_CRATES +=	foreign-types-shared	0.1.1	# MIT/Apache-2.0
MODCARGO_CRATES +=	form_urlencoded	1.1.0	# MIT OR Apache-2.0
MODCARGO_CRATES +=	fsevent	0.4.0	# MIT
MODCARGO_CRATES +=	fsevent-sys	2.0.1	# MIT
MODCARGO_CRATES +=	fuchsia-zircon	0.3.3	# BSD-3-Clause
MODCARGO_CRATES +=	fuchsia-zircon-sys	0.3.3	# BSD-3-Clause
MODCARGO_CRATES +=	futf	0.1.5	# MIT / Apache-2.0
MODCARGO_CRATES +=	futures-channel	0.3.27	# MIT OR Apache-2.0
MODCARGO_CRATES +=	futures-core	0.3.27	# MIT OR Apache-2.0
MODCARGO_CRATES +=	futures-io	0.3.27	# MIT OR Apache-2.0
MODCARGO_CRATES +=	futures-sink	0.3.27	# MIT OR Apache-2.0
MODCARGO_CRATES +=	futures-task	0.3.27	# MIT OR Apache-2.0
MODCARGO_CRATES +=	futures-util	0.3.27	# MIT OR Apache-2.0
MODCARGO_CRATES +=	fxhash	0.2.1	# Apache-2.0/MIT
MODCARGO_CRATES +=	generic-array	0.12.4	# MIT
MODCARGO_CRATES +=	generic-array	0.14.6	# MIT
MODCARGO_CRATES +=	getrandom	0.1.16	# MIT OR Apache-2.0
MODCARGO_CRATES +=	getrandom	0.2.8	# MIT OR Apache-2.0
MODCARGO_CRATES +=	gh-emoji	1.0.7	# MIT
MODCARGO_CRATES +=	gif	0.11.4	# MIT/Apache-2.0
MODCARGO_CRATES +=	glob	0.3.1	# MIT OR Apache-2.0
MODCARGO_CRATES +=	globset	0.4.10	# Unlicense OR MIT
MODCARGO_CRATES +=	globwalk	0.8.1	# MIT
MODCARGO_CRATES +=	grass	0.12.3	# MIT
MODCARGO_CRATES +=	grass_compiler	0.12.3	# MIT
MODCARGO_CRATES +=	h2	0.3.16	# MIT
MODCARGO_CRATES +=	half	2.2.1	# MIT OR Apache-2.0
MODCARGO_CRATES +=	hashbrown	0.11.2	# Apache-2.0/MIT
MODCARGO_CRATES +=	hashbrown	0.12.3	# MIT OR Apache-2.0
MODCARGO_CRATES +=	heck	0.4.1	# MIT OR Apache-2.0
MODCARGO_CRATES +=	hermit-abi	0.1.19	# MIT/Apache-2.0
MODCARGO_CRATES +=	hermit-abi	0.2.6	# MIT/Apache-2.0
MODCARGO_CRATES +=	hermit-abi	0.3.1	# MIT OR Apache-2.0
MODCARGO_CRATES +=	html5ever	0.26.0	# MIT OR Apache-2.0
MODCARGO_CRATES +=	http	0.2.9	# MIT OR Apache-2.0
MODCARGO_CRATES +=	http-body	0.4.5	# MIT
MODCARGO_CRATES +=	httparse	1.8.0	# MIT/Apache-2.0
MODCARGO_CRATES +=	httpdate	1.0.2	# MIT/Apache-2.0
MODCARGO_CRATES +=	humansize	2.1.3	# MIT/Apache-2.0
MODCARGO_CRATES +=	humantime	2.1.0	# MIT/Apache-2.0
MODCARGO_CRATES +=	hyper	0.14.25	# MIT
MODCARGO_CRATES +=	hyper-rustls	0.23.2	# Apache-2.0/ISC/MIT
MODCARGO_CRATES +=	hyper-tls	0.5.0	# MIT/Apache-2.0
MODCARGO_CRATES +=	iana-time-zone	0.1.53	# MIT OR Apache-2.0
MODCARGO_CRATES +=	iana-time-zone-haiku	0.1.1	# MIT OR Apache-2.0
MODCARGO_CRATES +=	idna	0.3.0	# MIT OR Apache-2.0
MODCARGO_CRATES +=	ignore	0.4.20	# Unlicense OR MIT
MODCARGO_CRATES +=	image	0.24.5	# MIT
MODCARGO_CRATES +=	indexmap	1.9.2	# Apache-2.0 OR MIT
MODCARGO_CRATES +=	inotify	0.7.1	# ISC
MODCARGO_CRATES +=	inotify-sys	0.1.5	# ISC
MODCARGO_CRATES +=	insta	1.28.0	# Apache-2.0
MODCARGO_CRATES +=	instant	0.1.12	# BSD-3-Clause
MODCARGO_CRATES +=	io-lifetimes	1.0.6	# Apache-2.0 WITH LLVM-exception OR Apache-2.0 OR MIT
MODCARGO_CRATES +=	iovec	0.1.4	# MIT/Apache-2.0
MODCARGO_CRATES +=	ipnet	2.7.1	# MIT OR Apache-2.0
MODCARGO_CRATES +=	is-terminal	0.4.4	# MIT
MODCARGO_CRATES +=	itoa	1.0.6	# MIT OR Apache-2.0
MODCARGO_CRATES +=	jieba-rs	0.6.7	# MIT
MODCARGO_CRATES +=	jobserver	0.1.26	# MIT/Apache-2.0
MODCARGO_CRATES +=	jpeg-decoder	0.3.0	# MIT / Apache-2.0
MODCARGO_CRATES +=	js-sys	0.3.61	# MIT/Apache-2.0
MODCARGO_CRATES +=	kamadak-exif	0.5.5	# BSD-2-Clause
MODCARGO_CRATES +=	kernel32-sys	0.2.2	# MIT
MODCARGO_CRATES +=	lasso	0.6.0	# MIT OR Apache-2.0
MODCARGO_CRATES +=	lazy_static	1.4.0	# MIT/Apache-2.0
MODCARGO_CRATES +=	lazycell	1.3.0	# MIT/Apache-2.0
MODCARGO_CRATES +=	lebe	0.5.2	# BSD-3-Clause
MODCARGO_CRATES +=	lexical-core	0.7.6	# MIT/Apache-2.0
MODCARGO_CRATES +=	lexical-sort	0.3.1	# MIT OR Apache-2.0
MODCARGO_CRATES +=	libc	0.2.140	# MIT OR Apache-2.0
MODCARGO_CRATES +=	libm	0.2.6	# MIT OR Apache-2.0
MODCARGO_CRATES +=	libwebp-sys	0.4.2	# MIT
MODCARGO_CRATES +=	lindera	0.14.0	# MIT
MODCARGO_CRATES +=	lindera-cc-cedict-builder	0.13.5	# MIT
MODCARGO_CRATES +=	lindera-core	0.13.5	# MIT
MODCARGO_CRATES +=	lindera-decompress	0.13.5	# MIT
MODCARGO_CRATES +=	lindera-dictionary	0.13.5	# MIT
MODCARGO_CRATES +=	lindera-ipadic	0.13.5	# MIT
MODCARGO_CRATES +=	lindera-ipadic-builder	0.13.5	# MIT
MODCARGO_CRATES +=	lindera-ko-dic-builder	0.13.5	# MIT
MODCARGO_CRATES +=	lindera-unidic-builder	0.13.5	# MIT
MODCARGO_CRATES +=	line-wrap	0.1.1	# Apache-2.0
MODCARGO_CRATES +=	link-cplusplus	1.0.8	# MIT OR Apache-2.0
MODCARGO_CRATES +=	linked-hash-map	0.5.6	# MIT/Apache-2.0
MODCARGO_CRATES +=	linux-raw-sys	0.1.4	# Apache-2.0 WITH LLVM-exception OR Apache-2.0 OR MIT
MODCARGO_CRATES +=	lock_api	0.4.9	# MIT OR Apache-2.0
MODCARGO_CRATES +=	log	0.4.17	# MIT OR Apache-2.0
MODCARGO_CRATES +=	lzma-rs	0.2.0	# MIT
MODCARGO_CRATES +=	mac	0.1.1	# MIT/Apache-2.0
MODCARGO_CRATES +=	maplit	1.0.2	# MIT/Apache-2.0
MODCARGO_CRATES +=	markup5ever	0.11.0	# MIT OR Apache-2.0
MODCARGO_CRATES +=	memchr	2.5.0	# Unlicense/MIT
MODCARGO_CRATES +=	memoffset	0.8.0	# MIT
MODCARGO_CRATES +=	mime	0.3.16	# MIT/Apache-2.0
MODCARGO_CRATES +=	mime_guess	2.0.4	# MIT
MODCARGO_CRATES +=	minidom	0.12.0	# MPL-2.0
MODCARGO_CRATES +=	minify-html	0.10.8	# MIT
MODCARGO_CRATES +=	minify-js	0.4.3	# Apache-2.0
MODCARGO_CRATES +=	minimal-lexical	0.2.1	# MIT/Apache-2.0
MODCARGO_CRATES +=	miniz_oxide	0.6.2	# MIT OR Zlib OR Apache-2.0
MODCARGO_CRATES +=	mio	0.6.23	# MIT
MODCARGO_CRATES +=	mio	0.8.6	# MIT
MODCARGO_CRATES +=	mio-extras	2.0.6	# MIT OR Apache-2.0
MODCARGO_CRATES +=	miow	0.2.2	# MIT/Apache-2.0
MODCARGO_CRATES +=	mockito	0.31.1	# MIT
MODCARGO_CRATES +=	mutate_once	0.1.1	# BSD-2-Clause
MODCARGO_CRATES +=	nanorand	0.7.0	# Zlib
MODCARGO_CRATES +=	native-tls	0.2.11	# MIT/Apache-2.0
MODCARGO_CRATES +=	net2	0.2.38	# MIT/Apache-2.0
MODCARGO_CRATES +=	new_debug_unreachable	1.0.4	# MIT
MODCARGO_CRATES +=	nix	0.26.2	# MIT
MODCARGO_CRATES +=	nom	5.1.2	# MIT
MODCARGO_CRATES +=	nom	7.1.3	# MIT
MODCARGO_CRATES +=	nom-bibtex	0.3.0	# MIT
MODCARGO_CRATES +=	nom-tracable	0.5.2	# MIT OR Apache-2.0
MODCARGO_CRATES +=	nom-tracable-macros	0.5.2	# MIT OR Apache-2.0
MODCARGO_CRATES +=	nom_locate	1.0.0	# MIT
MODCARGO_CRATES +=	nom_locate	2.1.0	# MIT
MODCARGO_CRATES +=	notify	4.0.17	# CC0-1.0
MODCARGO_CRATES +=	num-format	0.4.4	# MIT/Apache-2.0
MODCARGO_CRATES +=	num-integer	0.1.45	# MIT OR Apache-2.0
MODCARGO_CRATES +=	num-rational	0.4.1	# MIT OR Apache-2.0
MODCARGO_CRATES +=	num-traits	0.2.15	# MIT OR Apache-2.0
MODCARGO_CRATES +=	num_cpus	1.15.0	# MIT OR Apache-2.0
MODCARGO_CRATES +=	num_threads	0.1.6	# MIT OR Apache-2.0
MODCARGO_CRATES +=	once_cell	1.17.1	# MIT OR Apache-2.0
MODCARGO_CRATES +=	onig	6.4.0	# MIT
MODCARGO_CRATES +=	onig_sys	69.8.1	# MIT
MODCARGO_CRATES +=	opaque-debug	0.2.3	# MIT OR Apache-2.0
MODCARGO_CRATES +=	open	3.4.0	# MIT
MODCARGO_CRATES +=	openssl	0.10.46	# Apache-2.0
MODCARGO_CRATES +=	openssl-macros	0.1.0	# MIT/Apache-2.0
MODCARGO_CRATES +=	openssl-probe	0.1.5	# MIT/Apache-2.0
MODCARGO_CRATES +=	openssl-sys	0.9.81	# MIT
MODCARGO_CRATES +=	os_str_bytes	6.4.1	# MIT OR Apache-2.0
MODCARGO_CRATES +=	parking_lot	0.12.1	# MIT OR Apache-2.0
MODCARGO_CRATES +=	parking_lot_core	0.9.7	# MIT OR Apache-2.0
MODCARGO_CRATES +=	parse-js	0.10.3	# Apache-2.0
MODCARGO_CRATES +=	parse-zoneinfo	0.3.0	# MIT
MODCARGO_CRATES +=	path-slash	0.2.1	# MIT
MODCARGO_CRATES +=	pathdiff	0.2.1	# MIT/Apache-2.0
MODCARGO_CRATES +=	percent-encoding	2.2.0	# MIT OR Apache-2.0
MODCARGO_CRATES +=	pest	2.5.6	# MIT/Apache-2.0
MODCARGO_CRATES +=	pest_derive	2.5.6	# MIT/Apache-2.0
MODCARGO_CRATES +=	pest_generator	2.5.6	# MIT/Apache-2.0
MODCARGO_CRATES +=	pest_meta	2.5.6	# MIT/Apache-2.0
MODCARGO_CRATES +=	phf	0.10.1	# MIT
MODCARGO_CRATES +=	phf	0.11.1	# MIT
MODCARGO_CRATES +=	phf_codegen	0.10.0	# MIT
MODCARGO_CRATES +=	phf_codegen	0.11.1	# MIT
MODCARGO_CRATES +=	phf_generator	0.10.0	# MIT
MODCARGO_CRATES +=	phf_generator	0.11.1	# MIT
MODCARGO_CRATES +=	phf_macros	0.10.0	# MIT
MODCARGO_CRATES +=	phf_shared	0.10.0	# MIT
MODCARGO_CRATES +=	phf_shared	0.11.1	# MIT
MODCARGO_CRATES +=	pin-project	1.0.12	# Apache-2.0 OR MIT
MODCARGO_CRATES +=	pin-project-internal	1.0.12	# Apache-2.0 OR MIT
MODCARGO_CRATES +=	pin-project-lite	0.2.9	# Apache-2.0 OR MIT
MODCARGO_CRATES +=	pin-utils	0.1.0	# MIT OR Apache-2.0
MODCARGO_CRATES +=	pkg-config	0.3.26	# MIT OR Apache-2.0
MODCARGO_CRATES +=	plist	1.4.2	# MIT
MODCARGO_CRATES +=	png	0.17.7	# MIT OR Apache-2.0
MODCARGO_CRATES +=	ppv-lite86	0.2.17	# MIT/Apache-2.0
MODCARGO_CRATES +=	precomputed-hash	0.1.1	# MIT
MODCARGO_CRATES +=	proc-macro-error	1.0.4	# MIT OR Apache-2.0
MODCARGO_CRATES +=	proc-macro-error-attr	1.0.4	# MIT OR Apache-2.0
MODCARGO_CRATES +=	proc-macro-hack	0.5.20+deprecated	# MIT OR Apache-2.0
MODCARGO_CRATES +=	proc-macro2	1.0.52	# MIT OR Apache-2.0
MODCARGO_CRATES +=	pulldown-cmark	0.9.2	# MIT
MODCARGO_CRATES +=	pure-rust-locales	0.5.6	# MIT OR Apache-2.0
MODCARGO_CRATES +=	quick-error	1.2.3	# MIT/Apache-2.0
MODCARGO_CRATES +=	quick-xml	0.17.2	# MIT
MODCARGO_CRATES +=	quick-xml	0.27.1	# MIT
MODCARGO_CRATES +=	quickxml_to_serde	0.5.0	# MIT
MODCARGO_CRATES +=	quote	1.0.26	# MIT OR Apache-2.0
MODCARGO_CRATES +=	rand	0.7.3	# MIT OR Apache-2.0
MODCARGO_CRATES +=	rand	0.8.5	# MIT OR Apache-2.0
MODCARGO_CRATES +=	rand_chacha	0.2.2	# MIT OR Apache-2.0
MODCARGO_CRATES +=	rand_chacha	0.3.1	# MIT OR Apache-2.0
MODCARGO_CRATES +=	rand_core	0.5.1	# MIT OR Apache-2.0
MODCARGO_CRATES +=	rand_core	0.6.4	# MIT OR Apache-2.0
MODCARGO_CRATES +=	rand_hc	0.2.0	# MIT/Apache-2.0
MODCARGO_CRATES +=	rayon	1.7.0	# MIT OR Apache-2.0
MODCARGO_CRATES +=	rayon-core	1.11.0	# MIT OR Apache-2.0
MODCARGO_CRATES +=	redox_syscall	0.2.16	# MIT
MODCARGO_CRATES +=	regex	1.7.1	# MIT OR Apache-2.0
MODCARGO_CRATES +=	regex-syntax	0.6.28	# MIT OR Apache-2.0
MODCARGO_CRATES +=	relative-path	1.8.0	# MIT/Apache-2.0
MODCARGO_CRATES +=	reqwest	0.11.14	# MIT OR Apache-2.0
MODCARGO_CRATES +=	ring	0.16.20	# LICENSE
MODCARGO_CRATES +=	roxmltree	0.18.0	# MIT OR Apache-2.0
MODCARGO_CRATES +=	rust-stemmers	1.2.0	# MIT/BSD-3-Clause
MODCARGO_CRATES +=	rustc-hash	1.1.0	# Apache-2.0/MIT
MODCARGO_CRATES +=	rustc_version	0.4.0	# MIT/Apache-2.0
MODCARGO_CRATES +=	rustix	0.36.9	# Apache-2.0 WITH LLVM-exception OR Apache-2.0 OR MIT
MODCARGO_CRATES +=	rustls	0.20.8	# Apache-2.0/ISC/MIT
MODCARGO_CRATES +=	rustls-pemfile	1.0.2	# Apache-2.0 OR ISC OR MIT
MODCARGO_CRATES +=	ryu	1.0.13	# Apache-2.0 OR BSL-1.0
MODCARGO_CRATES +=	safemem	0.3.3	# MIT/Apache-2.0
MODCARGO_CRATES +=	same-file	1.0.6	# Unlicense/MIT
MODCARGO_CRATES +=	schannel	0.1.21	# MIT
MODCARGO_CRATES +=	scoped_threadpool	0.1.9	# MIT
MODCARGO_CRATES +=	scopeguard	1.1.0	# MIT/Apache-2.0
MODCARGO_CRATES +=	scratch	1.0.5	# MIT OR Apache-2.0
MODCARGO_CRATES +=	sct	0.7.0	# Apache-2.0/ISC/MIT
MODCARGO_CRATES +=	security-framework	2.8.2	# MIT OR Apache-2.0
MODCARGO_CRATES +=	security-framework-sys	2.8.0	# MIT OR Apache-2.0
MODCARGO_CRATES +=	semver	1.0.17	# MIT OR Apache-2.0
MODCARGO_CRATES +=	serde	1.0.156	# MIT OR Apache-2.0
MODCARGO_CRATES +=	serde_derive	1.0.156	# MIT OR Apache-2.0
MODCARGO_CRATES +=	serde_json	1.0.94	# MIT OR Apache-2.0
MODCARGO_CRATES +=	serde_spanned	0.6.1	# MIT OR Apache-2.0
MODCARGO_CRATES +=	serde_urlencoded	0.7.1	# MIT/Apache-2.0
MODCARGO_CRATES +=	serde_yaml	0.9.19	# MIT OR Apache-2.0
MODCARGO_CRATES +=	sha-1	0.8.2	# MIT OR Apache-2.0
MODCARGO_CRATES +=	sha2	0.10.6	# MIT OR Apache-2.0
MODCARGO_CRATES +=	simd-adler32	0.3.5	# MIT
MODCARGO_CRATES +=	similar	2.2.1	# Apache-2.0
MODCARGO_CRATES +=	siphasher	0.3.10	# MIT/Apache-2.0
MODCARGO_CRATES +=	skeptic	0.13.7	# MIT/Apache-2.0
MODCARGO_CRATES +=	slab	0.4.8	# MIT
MODCARGO_CRATES +=	slug	0.1.4	# MIT/Apache-2.0
MODCARGO_CRATES +=	smallvec	1.10.0	# MIT OR Apache-2.0
MODCARGO_CRATES +=	socket2	0.4.9	# MIT OR Apache-2.0
MODCARGO_CRATES +=	spin	0.5.2	# MIT
MODCARGO_CRATES +=	spin	0.9.6	# MIT
MODCARGO_CRATES +=	static_assertions	1.1.0	# MIT OR Apache-2.0
MODCARGO_CRATES +=	string_cache	0.8.7	# MIT OR Apache-2.0
MODCARGO_CRATES +=	string_cache_codegen	0.5.2	# MIT OR Apache-2.0
MODCARGO_CRATES +=	strsim	0.10.0	# MIT
MODCARGO_CRATES +=	svg_metadata	0.4.4	# Apache-2.0/MIT
MODCARGO_CRATES +=	syn	1.0.109	# MIT OR Apache-2.0
MODCARGO_CRATES +=	syntect	5.0.0	# MIT
MODCARGO_CRATES +=	tar	0.4.38	# MIT/Apache-2.0
MODCARGO_CRATES +=	tempfile	3.4.0	# MIT OR Apache-2.0
MODCARGO_CRATES +=	tendril	0.4.3	# MIT/Apache-2.0
MODCARGO_CRATES +=	tera	1.18.1	# MIT
MODCARGO_CRATES +=	termcolor	1.2.0	# Unlicense OR MIT
MODCARGO_CRATES +=	test-case	3.0.0	# MIT
MODCARGO_CRATES +=	test-case-core	3.0.0	# MIT
MODCARGO_CRATES +=	test-case-macros	3.0.0	# MIT
MODCARGO_CRATES +=	textwrap	0.16.0	# MIT
MODCARGO_CRATES +=	thiserror	1.0.39	# MIT OR Apache-2.0
MODCARGO_CRATES +=	thiserror-impl	1.0.39	# MIT OR Apache-2.0
MODCARGO_CRATES +=	thread_local	1.1.4	# Apache-2.0/MIT
MODCARGO_CRATES +=	tiff	0.8.1	# MIT
MODCARGO_CRATES +=	time	0.3.20	# MIT OR Apache-2.0
MODCARGO_CRATES +=	time-core	0.1.0	# MIT OR Apache-2.0
MODCARGO_CRATES +=	time-macros	0.2.8	# MIT OR Apache-2.0
MODCARGO_CRATES +=	tinystr	0.7.1	# Unicode-DFS-2016
MODCARGO_CRATES +=	tinyvec	1.6.0	# Zlib OR Apache-2.0 OR MIT
MODCARGO_CRATES +=	tinyvec_macros	0.1.1	# MIT OR Apache-2.0 OR Zlib
MODCARGO_CRATES +=	tokio	1.26.0	# MIT
MODCARGO_CRATES +=	tokio-native-tls	0.3.1	# MIT
MODCARGO_CRATES +=	tokio-rustls	0.23.4	# MIT/Apache-2.0
MODCARGO_CRATES +=	tokio-util	0.7.7	# MIT
MODCARGO_CRATES +=	toml	0.5.11	# MIT/Apache-2.0
MODCARGO_CRATES +=	toml	0.7.3	# MIT OR Apache-2.0
MODCARGO_CRATES +=	toml_datetime	0.6.1	# MIT OR Apache-2.0
MODCARGO_CRATES +=	toml_edit	0.19.7	# MIT OR Apache-2.0
MODCARGO_CRATES +=	tower-service	0.3.2	# MIT
MODCARGO_CRATES +=	tracing	0.1.37	# MIT
MODCARGO_CRATES +=	tracing-core	0.1.30	# MIT
MODCARGO_CRATES +=	try-lock	0.2.4	# MIT
MODCARGO_CRATES +=	typenum	1.16.0	# MIT OR Apache-2.0
MODCARGO_CRATES +=	ucd-trie	0.1.5	# MIT OR Apache-2.0
MODCARGO_CRATES +=	uncased	0.9.7	# MIT OR Apache-2.0
MODCARGO_CRATES +=	unic-char-property	0.9.0	# MIT/Apache-2.0
MODCARGO_CRATES +=	unic-char-range	0.9.0	# MIT/Apache-2.0
MODCARGO_CRATES +=	unic-common	0.9.0	# MIT/Apache-2.0
MODCARGO_CRATES +=	unic-langid	0.9.1	# MIT/Apache-2.0
MODCARGO_CRATES +=	unic-langid-impl	0.9.1	# MIT/Apache-2.0
MODCARGO_CRATES +=	unic-segment	0.9.0	# MIT/Apache-2.0
MODCARGO_CRATES +=	unic-ucd-segment	0.9.0	# MIT/Apache-2.0
MODCARGO_CRATES +=	unic-ucd-version	0.9.0	# MIT/Apache-2.0
MODCARGO_CRATES +=	unicase	2.6.0	# MIT/Apache-2.0
MODCARGO_CRATES +=	unicode-bidi	0.3.11	# MIT OR Apache-2.0
MODCARGO_CRATES +=	unicode-ident	1.0.8	# (MIT OR Apache-2.0) AND Unicode-DFS-2016
MODCARGO_CRATES +=	unicode-normalization	0.1.22	# MIT/Apache-2.0
MODCARGO_CRATES +=	unicode-segmentation	1.10.1	# MIT/Apache-2.0
MODCARGO_CRATES +=	unicode-width	0.1.10	# MIT/Apache-2.0
MODCARGO_CRATES +=	unsafe-libyaml	0.2.7	# MIT
MODCARGO_CRATES +=	untrusted	0.7.1	# ISC
MODCARGO_CRATES +=	url	2.3.1	# MIT OR Apache-2.0
MODCARGO_CRATES +=	utf-8	0.7.6	# MIT OR Apache-2.0
MODCARGO_CRATES +=	vcpkg	0.2.15	# MIT/Apache-2.0
MODCARGO_CRATES +=	version_check	0.9.4	# MIT/Apache-2.0
MODCARGO_CRATES +=	walkdir	2.3.2	# Unlicense/MIT
MODCARGO_CRATES +=	want	0.3.0	# MIT
MODCARGO_CRATES +=	wasi	0.9.0+wasi-snapshot-preview1	# Apache-2.0 WITH LLVM-exception OR Apache-2.0 OR MIT
MODCARGO_CRATES +=	wasi	0.11.0+wasi-snapshot-preview1	# Apache-2.0 WITH LLVM-exception OR Apache-2.0 OR MIT
MODCARGO_CRATES +=	wasm-bindgen	0.2.84	# MIT/Apache-2.0
MODCARGO_CRATES +=	wasm-bindgen-backend	0.2.84	# MIT/Apache-2.0
MODCARGO_CRATES +=	wasm-bindgen-futures	0.4.34	# MIT/Apache-2.0
MODCARGO_CRATES +=	wasm-bindgen-macro	0.2.84	# MIT/Apache-2.0
MODCARGO_CRATES +=	wasm-bindgen-macro-support	0.2.84	# MIT/Apache-2.0
MODCARGO_CRATES +=	wasm-bindgen-shared	0.2.84	# MIT/Apache-2.0
MODCARGO_CRATES +=	web-sys	0.3.61	# MIT/Apache-2.0
MODCARGO_CRATES +=	webp	0.2.2	# MIT OR Apache-2.0
MODCARGO_CRATES +=	webpki	0.22.0	# LICENSE
MODCARGO_CRATES +=	webpki-roots	0.22.6	# MPL-2.0
MODCARGO_CRATES +=	weezl	0.1.7	# MIT OR Apache-2.0
MODCARGO_CRATES +=	winapi	0.2.8	# MIT
MODCARGO_CRATES +=	winapi	0.3.9	# MIT/Apache-2.0
MODCARGO_CRATES +=	winapi-build	0.1.1	# MIT
MODCARGO_CRATES +=	winapi-i686-pc-windows-gnu	0.4.0	# MIT/Apache-2.0
MODCARGO_CRATES +=	winapi-util	0.1.5	# Unlicense/MIT
MODCARGO_CRATES +=	winapi-x86_64-pc-windows-gnu	0.4.0	# MIT/Apache-2.0
MODCARGO_CRATES +=	windows-sys	0.42.0	# MIT OR Apache-2.0
MODCARGO_CRATES +=	windows-sys	0.45.0	# MIT OR Apache-2.0
MODCARGO_CRATES +=	windows-targets	0.42.2	# MIT OR Apache-2.0
MODCARGO_CRATES +=	windows_aarch64_gnullvm	0.42.2	# MIT OR Apache-2.0
MODCARGO_CRATES +=	windows_aarch64_msvc	0.42.2	# MIT OR Apache-2.0
MODCARGO_CRATES +=	windows_i686_gnu	0.42.2	# MIT OR Apache-2.0
MODCARGO_CRATES +=	windows_i686_msvc	0.42.2	# MIT OR Apache-2.0
MODCARGO_CRATES +=	windows_x86_64_gnu	0.42.2	# MIT OR Apache-2.0
MODCARGO_CRATES +=	windows_x86_64_gnullvm	0.42.2	# MIT OR Apache-2.0
MODCARGO_CRATES +=	windows_x86_64_msvc	0.42.2	# MIT OR Apache-2.0
MODCARGO_CRATES +=	winnow	0.3.6	# MIT
MODCARGO_CRATES +=	winreg	0.10.1	# MIT
MODCARGO_CRATES +=	winres	0.1.12	# MIT
MODCARGO_CRATES +=	ws	0.9.2	# MIT
MODCARGO_CRATES +=	ws2_32-sys	0.2.1	# MIT
MODCARGO_CRATES +=	xattr	0.2.3	# MIT/Apache-2.0
MODCARGO_CRATES +=	xmlparser	0.13.5	# MIT/Apache-2.0
MODCARGO_CRATES +=	yada	0.5.0	# MIT OR Apache-2.0
MODCARGO_CRATES +=	yaml-rust	0.4.5	# MIT/Apache-2.0
MODCARGO_CRATES +=	zune-inflate	0.2.51	# MIT OR Apache-2.0
