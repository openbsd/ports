MODCARGO_CRATES +=	adler	1.0.2	# 0BSD OR MIT OR Apache-2.0
MODCARGO_CRATES +=	aho-corasick	0.7.18	# Unlicense/MIT
MODCARGO_CRATES +=	autocfg	1.1.0	# Apache-2.0 OR MIT
MODCARGO_CRATES +=	base64	0.10.1	# MIT/Apache-2.0
MODCARGO_CRATES +=	base64	0.12.3	# MIT/Apache-2.0
MODCARGO_CRATES +=	base64	0.13.0	# MIT/Apache-2.0
MODCARGO_CRATES +=	bitflags	1.3.2	# MIT/Apache-2.0
MODCARGO_CRATES +=	block-buffer	0.10.2	# MIT OR Apache-2.0
MODCARGO_CRATES +=	byteorder	1.4.3	# Unlicense OR MIT
MODCARGO_CRATES +=	bytes	0.5.6	# MIT
MODCARGO_CRATES +=	bytes	1.1.0	# MIT
MODCARGO_CRATES +=	cfg-if	0.1.10	# MIT/Apache-2.0
MODCARGO_CRATES +=	cfg-if	1.0.0	# MIT/Apache-2.0
MODCARGO_CRATES +=	chrono	0.4.19	# MIT/Apache-2.0
MODCARGO_CRATES +=	clap	3.1.8	# MIT OR Apache-2.0
MODCARGO_CRATES +=	cookie	0.12.0	# MIT/Apache-2.0
MODCARGO_CRATES +=	cpufeatures	0.2.2	# MIT OR Apache-2.0
MODCARGO_CRATES +=	crc32fast	1.3.2	# MIT OR Apache-2.0
MODCARGO_CRATES +=	crypto-common	0.1.3	# MIT OR Apache-2.0
MODCARGO_CRATES +=	digest	0.10.3	# MIT OR Apache-2.0
MODCARGO_CRATES +=	dirs	2.0.2	# MIT OR Apache-2.0
MODCARGO_CRATES +=	dirs-sys	0.3.7	# MIT OR Apache-2.0
MODCARGO_CRATES +=	dtoa	0.4.8	# MIT OR Apache-2.0
MODCARGO_CRATES +=	fastrand	1.7.0	# Apache-2.0 OR MIT
MODCARGO_CRATES +=	flate2	1.0.22	# MIT/Apache-2.0
MODCARGO_CRATES +=	fnv	1.0.7	# Apache-2.0 / MIT
MODCARGO_CRATES +=	form_urlencoded	1.0.1	# MIT/Apache-2.0
MODCARGO_CRATES +=	fuchsia-zircon	0.3.3	# BSD-3-Clause
MODCARGO_CRATES +=	fuchsia-zircon-sys	0.3.3	# BSD-3-Clause
MODCARGO_CRATES +=	futures	0.3.21	# MIT OR Apache-2.0
MODCARGO_CRATES +=	futures-channel	0.3.21	# MIT OR Apache-2.0
MODCARGO_CRATES +=	futures-core	0.3.21	# MIT OR Apache-2.0
MODCARGO_CRATES +=	futures-io	0.3.21	# MIT OR Apache-2.0
MODCARGO_CRATES +=	futures-sink	0.3.21	# MIT OR Apache-2.0
MODCARGO_CRATES +=	futures-task	0.3.21	# MIT OR Apache-2.0
MODCARGO_CRATES +=	futures-util	0.3.21	# MIT OR Apache-2.0
MODCARGO_CRATES +=	generic-array	0.14.5	# MIT
MODCARGO_CRATES +=	getrandom	0.2.6	# MIT OR Apache-2.0
MODCARGO_CRATES +=	h2	0.2.7	# MIT
MODCARGO_CRATES +=	hashbrown	0.11.2	# Apache-2.0/MIT
MODCARGO_CRATES +=	headers	0.3.7	# MIT
MODCARGO_CRATES +=	headers-core	0.2.0	# MIT
MODCARGO_CRATES +=	http	0.2.6	# MIT/Apache-2.0
MODCARGO_CRATES +=	http-body	0.3.1	# MIT
MODCARGO_CRATES +=	httparse	1.6.0	# MIT/Apache-2.0
MODCARGO_CRATES +=	httpdate	0.3.2	# MIT/Apache-2.0
MODCARGO_CRATES +=	httpdate	1.0.2	# MIT/Apache-2.0
MODCARGO_CRATES +=	hyper	0.13.10	# MIT
MODCARGO_CRATES +=	idna	0.2.3	# MIT/Apache-2.0
MODCARGO_CRATES +=	indexmap	1.8.1	# Apache-2.0/MIT
MODCARGO_CRATES +=	instant	0.1.12	# BSD-3-Clause
MODCARGO_CRATES +=	iovec	0.1.4	# MIT/Apache-2.0
MODCARGO_CRATES +=	itoa	0.4.8	# MIT OR Apache-2.0
MODCARGO_CRATES +=	itoa	1.0.1	# MIT OR Apache-2.0
MODCARGO_CRATES +=	kernel32-sys	0.2.2	# MIT
MODCARGO_CRATES +=	lazy_static	1.4.0	# MIT/Apache-2.0
MODCARGO_CRATES +=	libc	0.2.122	# MIT OR Apache-2.0
MODCARGO_CRATES +=	line-wrap	0.1.1	# Apache-2.0
MODCARGO_CRATES +=	linked-hash-map	0.5.4	# MIT/Apache-2.0
MODCARGO_CRATES +=	log	0.4.16	# MIT OR Apache-2.0
MODCARGO_CRATES +=	marionette	0.2.0	# MPL-2.0
MODCARGO_CRATES +=	matches	0.1.9	# MIT
MODCARGO_CRATES +=	memchr	2.4.1	# Unlicense/MIT
MODCARGO_CRATES +=	mime	0.3.16	# MIT/Apache-2.0
MODCARGO_CRATES +=	mime_guess	2.0.4	# MIT
MODCARGO_CRATES +=	miniz_oxide	0.4.4	# MIT OR Zlib OR Apache-2.0
MODCARGO_CRATES +=	mio	0.6.23	# MIT
MODCARGO_CRATES +=	miow	0.2.2	# MIT/Apache-2.0
MODCARGO_CRATES +=	mozdevice	0.5.0	# MPL-2.0
MODCARGO_CRATES +=	mozprofile	0.8.0	# MPL-2.0
MODCARGO_CRATES +=	mozrunner	0.14.0	# MPL-2.0
MODCARGO_CRATES +=	mozversion	0.4.3	# MPL-2.0
MODCARGO_CRATES +=	msdos_time	0.1.6	# MIT OR Apache-2.0
MODCARGO_CRATES +=	net2	0.2.37	# MIT/Apache-2.0
MODCARGO_CRATES +=	num-integer	0.1.44	# MIT OR Apache-2.0
MODCARGO_CRATES +=	num-traits	0.2.14	# MIT OR Apache-2.0
MODCARGO_CRATES +=	once_cell	1.10.0	# MIT OR Apache-2.0
MODCARGO_CRATES +=	os_str_bytes	6.0.0	# MIT OR Apache-2.0
MODCARGO_CRATES +=	percent-encoding	2.1.0	# MIT/Apache-2.0
MODCARGO_CRATES +=	pin-project	0.4.29	# Apache-2.0 OR MIT
MODCARGO_CRATES +=	pin-project	1.0.10	# Apache-2.0 OR MIT
MODCARGO_CRATES +=	pin-project-internal	0.4.29	# Apache-2.0 OR MIT
MODCARGO_CRATES +=	pin-project-internal	1.0.10	# Apache-2.0 OR MIT
MODCARGO_CRATES +=	pin-project-lite	0.1.12	# Apache-2.0 OR MIT
MODCARGO_CRATES +=	pin-project-lite	0.2.8	# Apache-2.0 OR MIT
MODCARGO_CRATES +=	pin-utils	0.1.0	# MIT OR Apache-2.0
MODCARGO_CRATES +=	plist	0.5.5	# MIT
MODCARGO_CRATES +=	podio	0.1.7	# MIT OR Apache-2.0
MODCARGO_CRATES +=	proc-macro2	1.0.37	# MIT OR Apache-2.0
MODCARGO_CRATES +=	quote	1.0.17	# MIT OR Apache-2.0
MODCARGO_CRATES +=	redox_syscall	0.2.13	# MIT
MODCARGO_CRATES +=	redox_users	0.4.3	# MIT
MODCARGO_CRATES +=	regex	1.5.5	# MIT OR Apache-2.0
MODCARGO_CRATES +=	regex-syntax	0.6.25	# MIT/Apache-2.0
MODCARGO_CRATES +=	remove_dir_all	0.5.3	# MIT/Apache-2.0
MODCARGO_CRATES +=	rust-ini	0.10.3	# MIT
MODCARGO_CRATES +=	ryu	1.0.9	# Apache-2.0 OR BSL-1.0
MODCARGO_CRATES +=	safemem	0.3.3	# MIT/Apache-2.0
MODCARGO_CRATES +=	same-file	1.0.6	# Unlicense/MIT
MODCARGO_CRATES +=	scoped-tls	1.0.0	# MIT/Apache-2.0
MODCARGO_CRATES +=	semver	0.9.0	# MIT/Apache-2.0
MODCARGO_CRATES +=	semver-parser	0.7.0	# MIT/Apache-2.0
MODCARGO_CRATES +=	serde	1.0.136	# MIT OR Apache-2.0
MODCARGO_CRATES +=	serde_derive	1.0.136	# MIT OR Apache-2.0
MODCARGO_CRATES +=	serde_json	1.0.79	# MIT OR Apache-2.0
MODCARGO_CRATES +=	serde_repr	0.1.7	# MIT OR Apache-2.0
MODCARGO_CRATES +=	serde_urlencoded	0.6.1	# MIT/Apache-2.0
MODCARGO_CRATES +=	serde_yaml	0.8.23	# MIT OR Apache-2.0
MODCARGO_CRATES +=	sha-1	0.10.0	# MIT OR Apache-2.0
MODCARGO_CRATES +=	slab	0.4.6	# MIT
MODCARGO_CRATES +=	socket2	0.3.19	# MIT/Apache-2.0
MODCARGO_CRATES +=	strsim	0.10.0	# MIT
MODCARGO_CRATES +=	syn	1.0.91	# MIT OR Apache-2.0
MODCARGO_CRATES +=	tempfile	3.3.0	# MIT OR Apache-2.0
MODCARGO_CRATES +=	terminal_size	0.1.17	# MIT OR Apache-2.0
MODCARGO_CRATES +=	textwrap	0.15.0	# MIT
MODCARGO_CRATES +=	thiserror	1.0.30	# MIT OR Apache-2.0
MODCARGO_CRATES +=	thiserror-impl	1.0.30	# MIT OR Apache-2.0
MODCARGO_CRATES +=	time	0.1.43	# MIT/Apache-2.0
MODCARGO_CRATES +=	tinyvec	1.5.1	# Zlib OR Apache-2.0 OR MIT
MODCARGO_CRATES +=	tinyvec_macros	0.1.0	# MIT OR Apache-2.0 OR Zlib
MODCARGO_CRATES +=	tokio	0.2.25	# MIT
MODCARGO_CRATES +=	tokio-util	0.3.1	# MIT
MODCARGO_CRATES +=	tower-service	0.3.1	# MIT
MODCARGO_CRATES +=	tracing	0.1.32	# MIT
MODCARGO_CRATES +=	tracing-core	0.1.24	# MIT
MODCARGO_CRATES +=	tracing-futures	0.2.5	# MIT
MODCARGO_CRATES +=	try-lock	0.2.3	# MIT
MODCARGO_CRATES +=	typenum	1.15.0	# MIT OR Apache-2.0
MODCARGO_CRATES +=	unicase	2.6.0	# MIT/Apache-2.0
MODCARGO_CRATES +=	unicode-bidi	0.3.7	# MIT / Apache-2.0
MODCARGO_CRATES +=	unicode-normalization	0.1.19	# MIT/Apache-2.0
MODCARGO_CRATES +=	unicode-segmentation	1.9.0	# MIT/Apache-2.0
MODCARGO_CRATES +=	unicode-xid	0.2.2	# MIT OR Apache-2.0
MODCARGO_CRATES +=	unix_path	1.0.1	# MIT OR Apache-2.0
MODCARGO_CRATES +=	unix_str	1.0.0	# MIT OR Apache-2.0
MODCARGO_CRATES +=	url	2.2.2	# MIT/Apache-2.0
MODCARGO_CRATES +=	urlencoding	1.3.3	# MIT
MODCARGO_CRATES +=	uuid	0.8.2	# Apache-2.0 OR MIT
MODCARGO_CRATES +=	version_check	0.9.4	# MIT/Apache-2.0
MODCARGO_CRATES +=	walkdir	2.3.2	# Unlicense/MIT
MODCARGO_CRATES +=	want	0.3.0	# MIT
MODCARGO_CRATES +=	warp	0.2.5	# MIT
MODCARGO_CRATES +=	wasi	0.10.2+wasi-snapshot-preview1	# Apache-2.0 WITH LLVM-exception OR Apache-2.0 OR MIT
MODCARGO_CRATES +=	webdriver	0.45.0	# MPL-2.0
MODCARGO_CRATES +=	winapi	0.2.8	# MIT
MODCARGO_CRATES +=	winapi	0.3.9	# MIT/Apache-2.0
MODCARGO_CRATES +=	winapi-build	0.1.1	# MIT
MODCARGO_CRATES +=	winapi-i686-pc-windows-gnu	0.4.0	# MIT/Apache-2.0
MODCARGO_CRATES +=	winapi-util	0.1.5	# Unlicense/MIT
MODCARGO_CRATES +=	winapi-x86_64-pc-windows-gnu	0.4.0	# MIT/Apache-2.0
MODCARGO_CRATES +=	winreg	0.5.1	# MIT
MODCARGO_CRATES +=	ws2_32-sys	0.2.1	# MIT
MODCARGO_CRATES +=	xml-rs	0.8.4	# MIT
MODCARGO_CRATES +=	yaml-rust	0.4.5	# MIT/Apache-2.0
MODCARGO_CRATES +=	zip	0.4.2	# MIT
