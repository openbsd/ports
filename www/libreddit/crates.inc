MODCARGO_CRATES +=	adler32	1.2.0	# Zlib
MODCARGO_CRATES +=	aho-corasick	0.7.20	# Unlicense OR MIT
MODCARGO_CRATES +=	alloc-no-stdlib	2.0.4	# BSD-3-Clause
MODCARGO_CRATES +=	alloc-stdlib	0.2.2	# BSD-3-Clause
MODCARGO_CRATES +=	askama	0.11.1	# MIT OR Apache-2.0
MODCARGO_CRATES +=	askama_derive	0.11.2	# MIT/Apache-2.0
MODCARGO_CRATES +=	askama_escape	0.10.3	# MIT OR Apache-2.0
MODCARGO_CRATES +=	askama_shared	0.12.2	# MIT/Apache-2.0
MODCARGO_CRATES +=	async-trait	0.1.61	# MIT OR Apache-2.0
MODCARGO_CRATES +=	async_once	0.2.6	# MIT OR Apache-2.0
MODCARGO_CRATES +=	autocfg	1.1.0	# Apache-2.0 OR MIT
MODCARGO_CRATES +=	base64	0.21.0	# MIT OR Apache-2.0
MODCARGO_CRATES +=	bitflags	1.3.2	# MIT/Apache-2.0
MODCARGO_CRATES +=	block-buffer	0.10.3	# MIT OR Apache-2.0
MODCARGO_CRATES +=	brotli	3.3.4	# BSD-3-Clause/MIT
MODCARGO_CRATES +=	brotli-decompressor	2.3.4	# BSD-3-Clause/MIT
MODCARGO_CRATES +=	bstr	1.1.0	# MIT OR Apache-2.0
MODCARGO_CRATES +=	build_html	2.2.0	# MIT
MODCARGO_CRATES +=	bumpalo	3.12.0	# MIT/Apache-2.0
MODCARGO_CRATES +=	bytes	1.3.0	# MIT
MODCARGO_CRATES +=	cached	0.42.0	# MIT
MODCARGO_CRATES +=	cached_proc_macro	0.16.0	# MIT
MODCARGO_CRATES +=	cached_proc_macro_types	0.1.0	# MIT
MODCARGO_CRATES +=	cc	1.0.78	# MIT OR Apache-2.0
MODCARGO_CRATES +=	cfg-if	1.0.0	# MIT/Apache-2.0
MODCARGO_CRATES +=	clap	4.1.1	# MIT OR Apache-2.0
MODCARGO_CRATES +=	clap_lex	0.3.1	# MIT OR Apache-2.0
MODCARGO_CRATES +=	cookie	0.16.2	# MIT OR Apache-2.0
MODCARGO_CRATES +=	core-foundation	0.9.3	# MIT / Apache-2.0
MODCARGO_CRATES +=	core-foundation-sys	0.8.3	# MIT / Apache-2.0
MODCARGO_CRATES +=	cpufeatures	0.2.5	# MIT OR Apache-2.0
MODCARGO_CRATES +=	crc32fast	1.3.2	# MIT OR Apache-2.0
MODCARGO_CRATES +=	crypto-common	0.1.6	# MIT OR Apache-2.0
MODCARGO_CRATES +=	darling	0.14.2	# MIT
MODCARGO_CRATES +=	darling_core	0.14.2	# MIT
MODCARGO_CRATES +=	darling_macro	0.14.2	# MIT
MODCARGO_CRATES +=	digest	0.10.6	# MIT OR Apache-2.0
MODCARGO_CRATES +=	errno	0.2.8	# MIT/Apache-2.0
MODCARGO_CRATES +=	errno-dragonfly	0.1.2	# MIT
MODCARGO_CRATES +=	fastrand	1.8.0	# Apache-2.0 OR MIT
MODCARGO_CRATES +=	fnv	1.0.7	# Apache-2.0 / MIT
MODCARGO_CRATES +=	form_urlencoded	1.1.0	# MIT OR Apache-2.0
MODCARGO_CRATES +=	fs_extra	1.2.0	# MIT
MODCARGO_CRATES +=	futures	0.3.25	# MIT OR Apache-2.0
MODCARGO_CRATES +=	futures-channel	0.3.25	# MIT OR Apache-2.0
MODCARGO_CRATES +=	futures-core	0.3.25	# MIT OR Apache-2.0
MODCARGO_CRATES +=	futures-io	0.3.25	# MIT OR Apache-2.0
MODCARGO_CRATES +=	futures-lite	1.12.0	# Apache-2.0 OR MIT
MODCARGO_CRATES +=	futures-sink	0.3.25	# MIT OR Apache-2.0
MODCARGO_CRATES +=	futures-task	0.3.25	# MIT OR Apache-2.0
MODCARGO_CRATES +=	futures-util	0.3.25	# MIT OR Apache-2.0
MODCARGO_CRATES +=	generic-array	0.14.6	# MIT
MODCARGO_CRATES +=	getrandom	0.2.8	# MIT OR Apache-2.0
MODCARGO_CRATES +=	globset	0.4.10	# Unlicense OR MIT
MODCARGO_CRATES +=	h2	0.3.15	# MIT
MODCARGO_CRATES +=	hashbrown	0.12.3	# MIT OR Apache-2.0
MODCARGO_CRATES +=	hashbrown	0.13.2	# MIT OR Apache-2.0
MODCARGO_CRATES +=	hermit-abi	0.2.6	# MIT/Apache-2.0
MODCARGO_CRATES +=	http	0.2.8	# MIT OR Apache-2.0
MODCARGO_CRATES +=	http-body	0.4.5	# MIT
MODCARGO_CRATES +=	httparse	1.8.0	# MIT/Apache-2.0
MODCARGO_CRATES +=	httpdate	1.0.2	# MIT/Apache-2.0
MODCARGO_CRATES +=	hyper	0.14.23	# MIT
MODCARGO_CRATES +=	hyper-rustls	0.23.2	# Apache-2.0/ISC/MIT
MODCARGO_CRATES +=	ident_case	1.0.1	# MIT/Apache-2.0
MODCARGO_CRATES +=	idna	0.3.0	# MIT OR Apache-2.0
MODCARGO_CRATES +=	indexmap	1.9.2	# Apache-2.0 OR MIT
MODCARGO_CRATES +=	instant	0.1.12	# BSD-3-Clause
MODCARGO_CRATES +=	io-lifetimes	1.0.5	# Apache-2.0 WITH LLVM-exception OR Apache-2.0 OR MIT
MODCARGO_CRATES +=	itoa	1.0.5	# MIT OR Apache-2.0
MODCARGO_CRATES +=	js-sys	0.3.60	# MIT/Apache-2.0
MODCARGO_CRATES +=	lazy_static	1.4.0	# MIT/Apache-2.0
MODCARGO_CRATES +=	libc	0.2.139	# MIT OR Apache-2.0
MODCARGO_CRATES +=	libflate	1.2.0	# MIT
MODCARGO_CRATES +=	libflate_lz77	1.1.0	# MIT
MODCARGO_CRATES +=	linux-raw-sys	0.1.4	# Apache-2.0 WITH LLVM-exception OR Apache-2.0 OR MIT
MODCARGO_CRATES +=	lipsum	0.8.2	# MIT
MODCARGO_CRATES +=	lock_api	0.4.9	# MIT OR Apache-2.0
MODCARGO_CRATES +=	log	0.4.17	# MIT OR Apache-2.0
MODCARGO_CRATES +=	memchr	2.5.0	# Unlicense/MIT
MODCARGO_CRATES +=	mime	0.3.16	# MIT/Apache-2.0
MODCARGO_CRATES +=	mime_guess	2.0.4	# MIT
MODCARGO_CRATES +=	minimal-lexical	0.2.1	# MIT/Apache-2.0
MODCARGO_CRATES +=	mio	0.8.5	# MIT
MODCARGO_CRATES +=	nom	7.1.3	# MIT
MODCARGO_CRATES +=	num_cpus	1.15.0	# MIT OR Apache-2.0
MODCARGO_CRATES +=	num_threads	0.1.6	# MIT OR Apache-2.0
MODCARGO_CRATES +=	once_cell	1.17.0	# MIT OR Apache-2.0
MODCARGO_CRATES +=	openssl-probe	0.1.5	# MIT/Apache-2.0
MODCARGO_CRATES +=	os_str_bytes	6.4.1	# MIT OR Apache-2.0
MODCARGO_CRATES +=	parking	2.0.0	# Apache-2.0 OR MIT
MODCARGO_CRATES +=	parking_lot	0.12.1	# MIT OR Apache-2.0
MODCARGO_CRATES +=	parking_lot_core	0.9.6	# MIT OR Apache-2.0
MODCARGO_CRATES +=	percent-encoding	2.2.0	# MIT OR Apache-2.0
MODCARGO_CRATES +=	pin-project-lite	0.2.9	# Apache-2.0 OR MIT
MODCARGO_CRATES +=	pin-utils	0.1.0	# MIT OR Apache-2.0
MODCARGO_CRATES +=	ppv-lite86	0.2.17	# MIT/Apache-2.0
MODCARGO_CRATES +=	proc-macro2	1.0.50	# MIT OR Apache-2.0
MODCARGO_CRATES +=	quick-error	1.2.3	# MIT/Apache-2.0
MODCARGO_CRATES +=	quote	1.0.23	# MIT OR Apache-2.0
MODCARGO_CRATES +=	rand	0.8.5	# MIT OR Apache-2.0
MODCARGO_CRATES +=	rand_chacha	0.3.1	# MIT OR Apache-2.0
MODCARGO_CRATES +=	rand_core	0.6.4	# MIT OR Apache-2.0
MODCARGO_CRATES +=	redox_syscall	0.2.16	# MIT
MODCARGO_CRATES +=	regex	1.7.1	# MIT OR Apache-2.0
MODCARGO_CRATES +=	regex-syntax	0.6.28	# MIT OR Apache-2.0
MODCARGO_CRATES +=	ring	0.16.20	# LICENSE
MODCARGO_CRATES +=	rle-decode-fast	1.0.3	# MIT OR Apache-2.0
MODCARGO_CRATES +=	route-recognizer	0.3.1	# MIT
MODCARGO_CRATES +=	rust-embed	6.4.2	# MIT
MODCARGO_CRATES +=	rust-embed-impl	6.3.1	# MIT
MODCARGO_CRATES +=	rust-embed-utils	7.3.0	# MIT
MODCARGO_CRATES +=	rustix	0.36.8	# Apache-2.0 WITH LLVM-exception OR Apache-2.0 OR MIT
MODCARGO_CRATES +=	rustls	0.20.8	# Apache-2.0/ISC/MIT
MODCARGO_CRATES +=	rustls-native-certs	0.6.2	# Apache-2.0/ISC/MIT
MODCARGO_CRATES +=	rustls-pemfile	1.0.2	# Apache-2.0 OR ISC OR MIT
MODCARGO_CRATES +=	rusty-forkfork	0.4.0	# MIT/Apache-2.0
MODCARGO_CRATES +=	ryu	1.0.12	# Apache-2.0 OR BSL-1.0
MODCARGO_CRATES +=	same-file	1.0.6	# Unlicense/MIT
MODCARGO_CRATES +=	schannel	0.1.21	# MIT
MODCARGO_CRATES +=	scopeguard	1.1.0	# MIT/Apache-2.0
MODCARGO_CRATES +=	sct	0.7.0	# Apache-2.0/ISC/MIT
MODCARGO_CRATES +=	sealed_test	1.0.0	# MIT
MODCARGO_CRATES +=	sealed_test_derive	1.0.0	# MIT
MODCARGO_CRATES +=	security-framework	2.7.0	# MIT OR Apache-2.0
MODCARGO_CRATES +=	security-framework-sys	2.6.1	# MIT OR Apache-2.0
MODCARGO_CRATES +=	serde	1.0.152	# MIT OR Apache-2.0
MODCARGO_CRATES +=	serde_derive	1.0.152	# MIT OR Apache-2.0
MODCARGO_CRATES +=	serde_json	1.0.91	# MIT OR Apache-2.0
MODCARGO_CRATES +=	serde_yaml	0.9.17	# MIT OR Apache-2.0
MODCARGO_CRATES +=	sha2	0.10.6	# MIT OR Apache-2.0
MODCARGO_CRATES +=	signal-hook-registry	1.4.0	# Apache-2.0/MIT
MODCARGO_CRATES +=	slab	0.4.7	# MIT
MODCARGO_CRATES +=	smallvec	1.10.0	# MIT OR Apache-2.0
MODCARGO_CRATES +=	socket2	0.4.7	# MIT OR Apache-2.0
MODCARGO_CRATES +=	spin	0.5.2	# MIT
MODCARGO_CRATES +=	strsim	0.10.0	# MIT
MODCARGO_CRATES +=	syn	1.0.107	# MIT OR Apache-2.0
MODCARGO_CRATES +=	tempfile	3.4.0	# MIT OR Apache-2.0
MODCARGO_CRATES +=	thiserror	1.0.38	# MIT OR Apache-2.0
MODCARGO_CRATES +=	thiserror-impl	1.0.38	# MIT OR Apache-2.0
MODCARGO_CRATES +=	time	0.3.17	# MIT OR Apache-2.0
MODCARGO_CRATES +=	time-core	0.1.0	# MIT OR Apache-2.0
MODCARGO_CRATES +=	time-macros	0.2.6	# MIT OR Apache-2.0
MODCARGO_CRATES +=	tinyvec	1.6.0	# Zlib OR Apache-2.0 OR MIT
MODCARGO_CRATES +=	tinyvec_macros	0.1.0	# MIT OR Apache-2.0 OR Zlib
MODCARGO_CRATES +=	tokio	1.24.2	# MIT
MODCARGO_CRATES +=	tokio-macros	1.8.2	# MIT
MODCARGO_CRATES +=	tokio-rustls	0.23.4	# MIT/Apache-2.0
MODCARGO_CRATES +=	tokio-util	0.7.4	# MIT
MODCARGO_CRATES +=	toml	0.5.10	# MIT/Apache-2.0
MODCARGO_CRATES +=	tower-service	0.3.2	# MIT
MODCARGO_CRATES +=	tracing	0.1.37	# MIT
MODCARGO_CRATES +=	tracing-core	0.1.30	# MIT
MODCARGO_CRATES +=	try-lock	0.2.4	# MIT
MODCARGO_CRATES +=	typenum	1.16.0	# MIT OR Apache-2.0
MODCARGO_CRATES +=	unicase	2.6.0	# MIT/Apache-2.0
MODCARGO_CRATES +=	unicode-bidi	0.3.8	# MIT OR Apache-2.0
MODCARGO_CRATES +=	unicode-ident	1.0.6	# (MIT OR Apache-2.0) AND Unicode-DFS-2016
MODCARGO_CRATES +=	unicode-normalization	0.1.22	# MIT/Apache-2.0
MODCARGO_CRATES +=	unsafe-libyaml	0.2.5	# MIT
MODCARGO_CRATES +=	untrusted	0.7.1	# ISC
MODCARGO_CRATES +=	url	2.3.1	# MIT OR Apache-2.0
MODCARGO_CRATES +=	version_check	0.9.4	# MIT/Apache-2.0
MODCARGO_CRATES +=	wait-timeout	0.2.0	# MIT/Apache-2.0
MODCARGO_CRATES +=	waker-fn	1.1.0	# Apache-2.0 OR MIT
MODCARGO_CRATES +=	walkdir	2.3.2	# Unlicense/MIT
MODCARGO_CRATES +=	want	0.3.0	# MIT
MODCARGO_CRATES +=	wasi	0.11.0+wasi-snapshot-preview1	# Apache-2.0 WITH LLVM-exception OR Apache-2.0 OR MIT
MODCARGO_CRATES +=	wasm-bindgen	0.2.83	# MIT/Apache-2.0
MODCARGO_CRATES +=	wasm-bindgen-backend	0.2.83	# MIT/Apache-2.0
MODCARGO_CRATES +=	wasm-bindgen-macro	0.2.83	# MIT/Apache-2.0
MODCARGO_CRATES +=	wasm-bindgen-macro-support	0.2.83	# MIT/Apache-2.0
MODCARGO_CRATES +=	wasm-bindgen-shared	0.2.83	# MIT/Apache-2.0
MODCARGO_CRATES +=	web-sys	0.3.60	# MIT/Apache-2.0
MODCARGO_CRATES +=	webpki	0.22.0	# LICENSE
MODCARGO_CRATES +=	winapi	0.3.9	# MIT/Apache-2.0
MODCARGO_CRATES +=	winapi-i686-pc-windows-gnu	0.4.0	# MIT/Apache-2.0
MODCARGO_CRATES +=	winapi-util	0.1.5	# Unlicense/MIT
MODCARGO_CRATES +=	winapi-x86_64-pc-windows-gnu	0.4.0	# MIT/Apache-2.0
MODCARGO_CRATES +=	windows-sys	0.42.0	# MIT OR Apache-2.0
MODCARGO_CRATES +=	windows-sys	0.45.0	# MIT OR Apache-2.0
MODCARGO_CRATES +=	windows-targets	0.42.1	# MIT OR Apache-2.0
MODCARGO_CRATES +=	windows_aarch64_gnullvm	0.42.1	# MIT OR Apache-2.0
MODCARGO_CRATES +=	windows_aarch64_msvc	0.42.1	# MIT OR Apache-2.0
MODCARGO_CRATES +=	windows_i686_gnu	0.42.1	# MIT OR Apache-2.0
MODCARGO_CRATES +=	windows_i686_msvc	0.42.1	# MIT OR Apache-2.0
MODCARGO_CRATES +=	windows_x86_64_gnu	0.42.1	# MIT OR Apache-2.0
MODCARGO_CRATES +=	windows_x86_64_gnullvm	0.42.1	# MIT OR Apache-2.0
MODCARGO_CRATES +=	windows_x86_64_msvc	0.42.1	# MIT OR Apache-2.0
