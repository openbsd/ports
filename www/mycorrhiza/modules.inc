MODGO_MODULES =	\
	git.sr.ht/~bouncepaw/mycomarkup/v5	 v5.6.0 \
	github.com/andybalholm/brotli		 v1.0.3 \
	github.com/davecgh/go-spew		 v1.1.0 \
	github.com/go-ini/ini			 v1.67.0 \
	github.com/golang/snappy		 v0.0.3 \
	github.com/gorilla/feeds		 v1.2.0 \
	github.com/gorilla/mux			 v1.8.1 \
	github.com/klauspost/compress		 v1.13.5 \
	github.com/kr/pretty			 v0.3.1 \
	github.com/kr/text			 v0.2.0 \
	github.com/pmezard/go-difflib		 v1.0.0 \
	github.com/rogpeppe/go-internal		 v1.9.0 \
	github.com/stretchr/objx		 v0.1.0 \
	github.com/stretchr/testify		 v1.7.0 \
	github.com/valyala/bytebufferpool	 v1.0.0 \
	github.com/valyala/fasthttp		 v1.30.0 \
	github.com/valyala/quicktemplate	 v1.7.0 \
	github.com/valyala/tcplisten		 v1.0.0 \
	golang.org/x/crypto			 v0.27.0 \
	golang.org/x/mod			 v0.17.0 \
	golang.org/x/net			 v0.21.0 \
	golang.org/x/sync			 v0.8.0 \
	golang.org/x/sys			 v0.25.0 \
	golang.org/x/term			 v0.24.0 \
	golang.org/x/text			 v0.18.0 \
	golang.org/x/tools			 v0.21.1-0.20240508182429-e35e4ccd0d2d \
	gopkg.in/check.v1			 v0.0.0-20161208181325-20d25e280405 \
	gopkg.in/yaml.v3			 v3.0.0-20200313102051-9f266ea9e77c

MODGO_MODFILES =	\
	github.com/andybalholm/brotli	 v1.0.2 \
	github.com/klauspost/compress	 v1.13.4 \
	golang.org/x/crypto		 v0.0.0-20210513164829-c07d793c2f9a \
	golang.org/x/net		 v0.0.0-20210226172049-e18ecbb05110 \
	golang.org/x/net		 v0.0.0-20210510120150-4163338589ed \
	golang.org/x/sys		 v0.0.0-20201119102817-f84b799fce68 \
	golang.org/x/sys		 v0.0.0-20210423082822-04245dca01da \
	golang.org/x/sys		 v0.0.0-20210514084401-e8d321eab015 \
	golang.org/x/term		 v0.0.0-20201126162022-7de9c90e9dd1 \
	golang.org/x/text		 v0.3.3 \
	golang.org/x/text		 v0.3.6 \
	golang.org/x/tools		 v0.0.0-20180917221912-90fa682c2a6e

