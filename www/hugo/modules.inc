MODGO_MODULES =	\
	cel.dev/expr										 v0.24.0 \
	cloud.google.com/go									 v0.121.6 \
	cloud.google.com/go/accessapproval							 v1.8.7 \
	cloud.google.com/go/accesscontextmanager						 v1.9.6 \
	cloud.google.com/go/aiplatform								 v1.93.0 \
	cloud.google.com/go/analytics								 v0.29.0 \
	cloud.google.com/go/apigateway								 v1.7.7 \
	cloud.google.com/go/apigeeconnect							 v1.7.7 \
	cloud.google.com/go/apigeeregistry							 v0.9.6 \
	cloud.google.com/go/appengine								 v1.9.7 \
	cloud.google.com/go/area120								 v0.9.7 \
	cloud.google.com/go/artifactregistry							 v1.17.1 \
	cloud.google.com/go/asset								 v1.21.1 \
	cloud.google.com/go/assuredworkloads							 v1.12.6 \
	cloud.google.com/go/auth								 v0.17.0 \
	cloud.google.com/go/auth/oauth2adapt							 v0.2.8 \
	cloud.google.com/go/automl								 v1.14.7 \
	cloud.google.com/go/baremetalsolution							 v1.3.6 \
	cloud.google.com/go/batch								 v1.12.2 \
	cloud.google.com/go/beyondcorp								 v1.1.6 \
	cloud.google.com/go/bigquery								 v1.69.0 \
	cloud.google.com/go/bigtable								 v1.38.0 \
	cloud.google.com/go/billing								 v1.20.4 \
	cloud.google.com/go/binaryauthorization							 v1.9.5 \
	cloud.google.com/go/certificatemanager							 v1.9.5 \
	cloud.google.com/go/channel								 v1.20.0 \
	cloud.google.com/go/cloudbuild								 v1.22.2 \
	cloud.google.com/go/clouddms								 v1.8.7 \
	cloud.google.com/go/cloudtasks								 v1.13.6 \
	cloud.google.com/go/compute								 v1.40.0 \
	cloud.google.com/go/compute/metadata							 v0.9.0 \
	cloud.google.com/go/contactcenterinsights						 v1.17.3 \
	cloud.google.com/go/container								 v1.43.0 \
	cloud.google.com/go/containeranalysis							 v0.14.1 \
	cloud.google.com/go/datacatalog								 v1.26.0 \
	cloud.google.com/go/dataflow								 v0.11.0 \
	cloud.google.com/go/dataform								 v0.12.0 \
	cloud.google.com/go/datafusion								 v1.8.6 \
	cloud.google.com/go/datalabeling							 v0.9.6 \
	cloud.google.com/go/dataplex								 v1.26.0 \
	cloud.google.com/go/dataproc/v2								 v2.14.0 \
	cloud.google.com/go/dataqna								 v0.9.7 \
	cloud.google.com/go/datastore								 v1.20.0 \
	cloud.google.com/go/datastream								 v1.14.1 \
	cloud.google.com/go/deploy								 v1.27.2 \
	cloud.google.com/go/dialogflow								 v1.69.0 \
	cloud.google.com/go/dlp									 v1.24.0 \
	cloud.google.com/go/documentai								 v1.37.0 \
	cloud.google.com/go/domains								 v0.10.6 \
	cloud.google.com/go/edgecontainer							 v1.4.3 \
	cloud.google.com/go/errorreporting							 v0.3.2 \
	cloud.google.com/go/essentialcontacts							 v1.7.6 \
	cloud.google.com/go/eventarc								 v1.15.5 \
	cloud.google.com/go/filestore								 v1.10.2 \
	cloud.google.com/go/firestore								 v1.18.0 \
	cloud.google.com/go/functions								 v1.19.6 \
	cloud.google.com/go/gkebackup								 v1.8.0 \
	cloud.google.com/go/gkeconnect								 v0.12.4 \
	cloud.google.com/go/gkehub								 v0.15.6 \
	cloud.google.com/go/gkemulticloud							 v1.5.3 \
	cloud.google.com/go/gsuiteaddons							 v1.7.7 \
	cloud.google.com/go/iam									 v1.5.2 \
	cloud.google.com/go/iap									 v1.11.2 \
	cloud.google.com/go/ids									 v1.5.6 \
	cloud.google.com/go/iot									 v1.8.6 \
	cloud.google.com/go/kms									 v1.22.0 \
	cloud.google.com/go/language								 v1.14.5 \
	cloud.google.com/go/lifesciences							 v0.10.6 \
	cloud.google.com/go/logging								 v1.13.0 \
	cloud.google.com/go/longrunning								 v0.6.7 \
	cloud.google.com/go/managedidentities							 v1.7.6 \
	cloud.google.com/go/maps								 v1.21.1 \
	cloud.google.com/go/mediatranslation							 v0.9.6 \
	cloud.google.com/go/memcache								 v1.11.6 \
	cloud.google.com/go/metastore								 v1.14.7 \
	cloud.google.com/go/monitoring								 v1.24.2 \
	cloud.google.com/go/networkconnectivity							 v1.17.1 \
	cloud.google.com/go/networkmanagement							 v1.19.1 \
	cloud.google.com/go/networksecurity							 v0.10.6 \
	cloud.google.com/go/notebooks								 v1.12.6 \
	cloud.google.com/go/optimization							 v1.7.6 \
	cloud.google.com/go/orchestration							 v1.11.9 \
	cloud.google.com/go/orgpolicy								 v1.15.0 \
	cloud.google.com/go/osconfig								 v1.14.6 \
	cloud.google.com/go/oslogin								 v1.14.6 \
	cloud.google.com/go/phishingprotection							 v0.9.6 \
	cloud.google.com/go/policytroubleshooter						 v1.11.6 \
	cloud.google.com/go/privatecatalog							 v0.10.7 \
	cloud.google.com/go/pubsub								 v1.50.0 \
	cloud.google.com/go/pubsub/v2								 v2.2.1 \
	cloud.google.com/go/pubsublite								 v1.8.2 \
	cloud.google.com/go/recaptchaenterprise/v2						 v2.20.4 \
	cloud.google.com/go/recommendationengine						 v0.9.6 \
	cloud.google.com/go/recommender								 v1.13.5 \
	cloud.google.com/go/redis								 v1.18.2 \
	cloud.google.com/go/resourcemanager							 v1.10.6 \
	cloud.google.com/go/resourcesettings							 v1.8.3 \
	cloud.google.com/go/retail								 v1.22.0 \
	cloud.google.com/go/run									 v1.10.1 \
	cloud.google.com/go/scheduler								 v1.11.7 \
	cloud.google.com/go/secretmanager							 v1.15.0 \
	cloud.google.com/go/security								 v1.19.0 \
	cloud.google.com/go/securitycenter							 v1.37.0 \
	cloud.google.com/go/servicedirectory							 v1.12.6 \
	cloud.google.com/go/shell								 v1.8.6 \
	cloud.google.com/go/spanner								 v1.83.0 \
	cloud.google.com/go/speech								 v1.28.0 \
	cloud.google.com/go/storage								 v1.56.0 \
	cloud.google.com/go/storagetransfer							 v1.13.0 \
	cloud.google.com/go/talent								 v1.8.3 \
	cloud.google.com/go/texttospeech							 v1.13.0 \
	cloud.google.com/go/tpu									 v1.8.3 \
	cloud.google.com/go/trace								 v1.11.6 \
	cloud.google.com/go/translate								 v1.12.6 \
	cloud.google.com/go/video								 v1.24.0 \
	cloud.google.com/go/videointelligence							 v1.12.6 \
	cloud.google.com/go/vision/v2								 v2.9.5 \
	cloud.google.com/go/vmmigration								 v1.8.6 \
	cloud.google.com/go/vmwareengine							 v1.3.5 \
	cloud.google.com/go/vpcaccess								 v1.8.6 \
	cloud.google.com/go/webrisk								 v1.11.1 \
	cloud.google.com/go/websecurityscanner							 v1.7.6 \
	cloud.google.com/go/workflows								 v1.14.2 \
	dmitri.shuralyov.com/gpu/mtl								 v0.0.0-20190408044501-666a987793e9 \
	filippo.io/edwards25519									 v1.1.0 \
	github.com/!azure!a!d/microsoft-authentication-extensions-for-go/cache			 v0.1.1 \
	github.com/!azure!a!d/microsoft-authentication-library-for-go				 v1.4.2 \
	github.com/!azure/azure-amqp-common-go/v3						 v3.2.3 \
	github.com/!azure/azure-sdk-for-go/sdk/azcore						 v1.18.1 \
	github.com/!azure/azure-sdk-for-go/sdk/azidentity					 v1.10.1 \
	github.com/!azure/azure-sdk-for-go/sdk/azidentity/cache					 v0.3.2 \
	github.com/!azure/azure-sdk-for-go/sdk/internal						 v1.11.1 \
	github.com/!azure/azure-sdk-for-go/sdk/keyvault/azkeys					 v0.10.0 \
	github.com/!azure/azure-sdk-for-go/sdk/keyvault/internal				 v0.7.1 \
	github.com/!azure/azure-sdk-for-go/sdk/messaging/azservicebus				 v1.9.1 \
	github.com/!azure/azure-sdk-for-go/sdk/resourcemanager/storage/armstorage		 v1.8.0 \
	github.com/!azure/azure-sdk-for-go/sdk/storage/azblob					 v1.6.1 \
	github.com/!azure/go-amqp								 v1.4.0 \
	github.com/!azure/go-autorest								 v14.2.0+incompatible \
	github.com/!azure/go-autorest/autorest/to						 v0.4.1 \
	github.com/!burnt!sushi/locker								 v0.0.0-20171006230638-a6e239ea1c69 \
	github.com/!burnt!sushi/toml								 v1.5.0 \
	github.com/!burnt!sushi/xgb								 v0.0.0-20160522181843-27f122750802 \
	github.com/!google!cloud!platform/cloudsql-proxy					 v1.37.8 \
	github.com/!google!cloud!platform/opentelemetry-operations-go/detectors/gcp		 v1.29.0 \
	github.com/!google!cloud!platform/opentelemetry-operations-go/exporter/metric		 v0.53.0 \
	github.com/!google!cloud!platform/opentelemetry-operations-go/exporter/trace		 v1.29.0 \
	github.com/!google!cloud!platform/opentelemetry-operations-go/internal/cloudmock	 v0.53.0 \
	github.com/!google!cloud!platform/opentelemetry-operations-go/internal/resourcemapping	 v0.53.0 \
	github.com/!google!cloud!platform/opentelemetry-operations-go/propagator		 v0.53.0 \
	github.com/!johannes!kaufmann/dom							 v0.2.0 \
	github.com/!johannes!kaufmann/html-to-markdown/v2					 v2.5.0 \
	github.com/!microsoft/go-winio								 v0.6.2 \
	github.com/!x!s!a!m/otelsql								 v0.39.0 \
	github.com/agnivade/levenshtein								 v1.2.1 \
	github.com/alecthomas/assert/v2								 v2.11.0 \
	github.com/alecthomas/chroma/v2								 v2.21.1 \
	github.com/alecthomas/repr								 v0.5.2 \
	github.com/andybalholm/cascadia								 v1.3.3 \
	github.com/aws/aws-sdk-go								 v1.55.7 \
	github.com/aws/aws-sdk-go-v2								 v1.41.0 \
	github.com/aws/aws-sdk-go-v2/aws/protocol/eventstream					 v1.7.3 \
	github.com/aws/aws-sdk-go-v2/config							 v1.31.17 \
	github.com/aws/aws-sdk-go-v2/credentials						 v1.18.21 \
	github.com/aws/aws-sdk-go-v2/feature/dynamodb/attributevalue				 v1.19.5 \
	github.com/aws/aws-sdk-go-v2/feature/dynamodb/expression				 v1.7.87 \
	github.com/aws/aws-sdk-go-v2/feature/ec2/imds						 v1.18.13 \
	github.com/aws/aws-sdk-go-v2/feature/rds/auth						 v1.5.13 \
	github.com/aws/aws-sdk-go-v2/feature/s3/manager						 v1.20.3 \
	github.com/aws/aws-sdk-go-v2/internal/configsources					 v1.4.16 \
	github.com/aws/aws-sdk-go-v2/internal/endpoints/v2					 v2.7.16 \
	github.com/aws/aws-sdk-go-v2/internal/ini						 v1.8.4 \
	github.com/aws/aws-sdk-go-v2/internal/v4a						 v1.4.13 \
	github.com/aws/aws-sdk-go-v2/service/cloudfront						 v1.58.3 \
	github.com/aws/aws-sdk-go-v2/service/dynamodb						 v1.44.0 \
	github.com/aws/aws-sdk-go-v2/service/dynamodbstreams					 v1.26.0 \
	github.com/aws/aws-sdk-go-v2/service/internal/accept-encoding				 v1.13.3 \
	github.com/aws/aws-sdk-go-v2/service/internal/checksum					 v1.9.4 \
	github.com/aws/aws-sdk-go-v2/service/internal/endpoint-discovery			 v1.10.17 \
	github.com/aws/aws-sdk-go-v2/service/internal/presigned-url				 v1.13.13 \
	github.com/aws/aws-sdk-go-v2/service/internal/s3shared					 v1.19.13 \
	github.com/aws/aws-sdk-go-v2/service/kms						 v1.41.2 \
	github.com/aws/aws-sdk-go-v2/service/s3							 v1.89.2 \
	github.com/aws/aws-sdk-go-v2/service/secretsmanager					 v1.35.7 \
	github.com/aws/aws-sdk-go-v2/service/sns						 v1.34.7 \
	github.com/aws/aws-sdk-go-v2/service/sqs						 v1.38.8 \
	github.com/aws/aws-sdk-go-v2/service/ssm						 v1.60.1 \
	github.com/aws/aws-sdk-go-v2/service/sso						 v1.30.1 \
	github.com/aws/aws-sdk-go-v2/service/ssooidc						 v1.35.5 \
	github.com/aws/aws-sdk-go-v2/service/sts						 v1.39.1 \
	github.com/aws/smithy-go								 v1.24.0 \
	github.com/aymanbagabas/go-osc52/v2							 v2.0.1 \
	github.com/aymerick/douceur								 v0.2.0 \
	github.com/bep/clocks									 v0.5.0 \
	github.com/bep/debounce									 v1.2.0 \
	github.com/bep/gitmap									 v1.9.0 \
	github.com/bep/goat									 v0.5.0 \
	github.com/bep/godartsass/v2								 v2.5.0 \
	github.com/bep/golibsass								 v1.2.0 \
	github.com/bep/goportabletext								 v0.1.0 \
	github.com/bep/helpers									 v0.6.0 \
	github.com/bep/imagemeta								 v0.12.0 \
	github.com/bep/lazycache								 v0.8.0 \
	github.com/bep/logg									 v0.4.0 \
	github.com/bep/mclib									 v1.20400.20402 \
	github.com/bep/overlayfs								 v0.10.0 \
	github.com/bep/simplecobra								 v0.6.1 \
	github.com/bep/textandbinarywriter							 v0.0.0-20251212174530-cd9f0732f60f \
	github.com/bep/tmc									 v0.5.1 \
	github.com/bep/workers									 v1.0.0 \
	github.com/bits-and-blooms/bitset							 v1.24.4 \
	github.com/bmatcuk/doublestar/v4							 v4.9.1 \
	github.com/cenkalti/backoff/v5								 v5.0.2 \
	github.com/census-instrumentation/opencensus-proto					 v0.2.1 \
	github.com/cespare/xxhash/v2								 v2.3.0 \
	github.com/chzyer/logex									 v1.1.10 \
	github.com/chzyer/readline								 v0.0.0-20180603132655-2972be24d48e \
	github.com/chzyer/test									 v0.0.0-20180213035817-a1ea475d72b1 \
	github.com/clbanning/mxj/v2								 v2.7.0 \
	github.com/client9/misspell								 v0.3.4 \
	github.com/clipperhouse/displaywidth							 v0.6.0 \
	github.com/clipperhouse/stringish							 v0.1.1 \
	github.com/clipperhouse/uax29/v2							 v2.3.0 \
	github.com/cncf/udpa/go									 v0.0.0-20201120205902-5459f2c99403 \
	github.com/cncf/xds/go									 v0.0.0-20250501225837-2ac532fd4443 \
	github.com/cpuguy83/go-md2man/v2							 v2.0.6 \
	github.com/creack/pty									 v1.1.9 \
	github.com/davecgh/go-spew								 v1.1.2-0.20180830191138-d8f796af33cc \
	github.com/dgryski/go-rendezvous							 v0.0.0-20200823014737-9f7001d12a5f \
	github.com/disintegration/gift								 v1.2.1 \
	github.com/djherbis/atime								 v1.1.0 \
	github.com/dlclark/regexp2								 v1.11.5 \
	github.com/dustin/go-humanize								 v1.0.1 \
	github.com/envoyproxy/go-control-plane							 v0.13.4 \
	github.com/envoyproxy/go-control-plane/envoy						 v1.32.4 \
	github.com/envoyproxy/go-control-plane/ratelimit					 v0.1.0 \
	github.com/envoyproxy/protoc-gen-validate						 v1.2.1 \
	github.com/evanw/esbuild								 v0.27.2 \
	github.com/fatih/color									 v1.18.0 \
	github.com/felixge/httpsnoop								 v1.0.4 \
	github.com/fortytw2/leaktest								 v1.3.0 \
	github.com/frankban/quicktest								 v1.14.6 \
	github.com/fsnotify/fsnotify								 v1.9.0 \
	github.com/getkin/kin-openapi								 v0.133.0 \
	github.com/go-gl/glfw									 v0.0.0-20190409004039-e6da0acd62b1 \
	github.com/go-gl/glfw/v3.3/glfw								 v0.0.0-20200222043503-6f7a984d4dc4 \
	github.com/go-jose/go-jose/v4								 v4.1.2 \
	github.com/go-logr/logr									 v1.4.3 \
	github.com/go-logr/stdr									 v1.2.2 \
	github.com/go-openapi/jsonpointer							 v0.21.0 \
	github.com/go-openapi/swag								 v0.23.0 \
	github.com/go-quicktest/qt								 v1.101.0 \
	github.com/go-sql-driver/mysql								 v1.9.3 \
	github.com/go-test/deep									 v1.0.8 \
	github.com/gobuffalo/flect								 v1.0.3 \
	github.com/gobwas/glob									 v0.2.3 \
	github.com/goccy/go-yaml								 v1.19.1 \
	github.com/gohugoio/go-i18n/v2								 v2.1.3-0.20251018145728-cfcc22d823c6 \
	github.com/gohugoio/go-radix								 v1.2.0 \
	github.com/gohugoio/hashstructure							 v0.6.0 \
	github.com/gohugoio/httpcache								 v0.8.0 \
	github.com/gohugoio/hugo-goldmark-extensions/extras					 v0.5.0 \
	github.com/gohugoio/hugo-goldmark-extensions/passthrough				 v0.3.1 \
	github.com/gohugoio/locales								 v0.14.0 \
	github.com/gohugoio/localescompressed							 v1.0.1 \
	github.com/golang-jwt/jwt/v5								 v5.2.3 \
	github.com/golang/glog									 v1.2.5 \
	github.com/golang/groupcache								 v0.0.0-20210331224755-41bb18bfe9da \
	github.com/golang/mock									 v1.4.4 \
	github.com/golang/protobuf								 v1.5.4 \
	github.com/golang/snappy								 v0.0.4 \
	github.com/google/btree									 v1.0.0 \
	github.com/google/go-cmp								 v0.7.0 \
	github.com/google/go-pkcs11								 v0.3.0 \
	github.com/google/go-replayers/grpcreplay						 v1.3.0 \
	github.com/google/go-replayers/httpreplay						 v1.2.0 \
	github.com/google/martian								 v2.1.0+incompatible \
	github.com/google/martian/v3								 v3.3.3 \
	github.com/google/pprof									 v0.0.0-20201218002935-b9804c9f04c2 \
	github.com/google/renameio								 v0.1.0 \
	github.com/google/s2a-go								 v0.1.9 \
	github.com/google/subcommands								 v1.2.0 \
	github.com/google/uuid									 v1.6.0 \
	github.com/google/wire									 v0.7.0 \
	github.com/googleapis/enterprise-certificate-proxy					 v0.3.6 \
	github.com/googleapis/gax-go/v2								 v2.15.0 \
	github.com/googleapis/google-cloud-go-testing						 v0.0.0-20200911160855-bcd43fbb19e8 \
	github.com/gorilla/css									 v1.0.1 \
	github.com/gorilla/mux									 v1.8.0 \
	github.com/gorilla/websocket								 v1.5.3 \
	github.com/grpc-ecosystem/grpc-gateway/v2						 v2.27.1 \
	github.com/hairyhenderson/go-codeowners							 v0.7.0 \
	github.com/hashicorp/golang-lru								 v0.5.1 \
	github.com/hashicorp/golang-lru/v2							 v2.0.7 \
	github.com/hexops/gotextdiff								 v1.0.3 \
	github.com/iancoleman/strcase								 v0.3.0 \
	github.com/ianlancetaylor/demangle							 v0.0.0-20200824232613-28f6c0f3b639 \
	github.com/inconshreveable/mousetrap							 v1.1.0 \
	github.com/jdkato/prose									 v1.2.1 \
	github.com/jessevdk/go-flags								 v1.4.0 \
	github.com/jmespath/go-jmespath								 v0.4.0 \
	github.com/jmoiron/sqlx									 v1.4.0 \
	github.com/josharian/intern								 v1.0.0 \
	github.com/jstemmer/go-junit-report							 v0.9.1 \
	github.com/keybase/go-keychain								 v0.0.1 \
	github.com/kisielk/gotool								 v1.0.0 \
	github.com/kr/fs									 v0.1.0 \
	github.com/kr/pretty									 v0.3.1 \
	github.com/kr/pty									 v1.1.1 \
	github.com/kr/text									 v0.2.0 \
	github.com/kylelemons/godebug								 v1.1.0 \
	github.com/kyokomi/emoji/v2								 v2.2.13 \
	github.com/lib/pq									 v1.10.9 \
	github.com/lucasb-eyer/go-colorful							 v1.3.0 \
	github.com/lyft/protoc-gen-star/v2							 v2.0.4-0.20230330145011-496ad1ac90a4 \
	github.com/magefile/mage								 v1.15.0 \
	github.com/mailru/easyjson								 v0.7.7 \
	github.com/makeworld-the-better-one/dither/v2						 v2.4.0 \
	github.com/marekm4/color-extractor							 v1.2.1 \
	github.com/mattn/go-colorable								 v0.1.13 \
	github.com/mattn/go-isatty								 v0.0.20 \
	github.com/mattn/go-runewidth								 v0.0.19 \
	github.com/microcosm-cc/bluemonday							 v1.0.27 \
	github.com/mitchellh/mapstructure							 v1.5.1-0.20231216201459-8508981c8b6c \
	github.com/mohae/deepcopy								 v0.0.0-20170929034955-c48cc78d4826 \
	github.com/montanaflynn/stats								 v0.7.0 \
	github.com/muesli/smartcrop								 v0.3.0 \
	github.com/muesli/termenv								 v0.16.0 \
	github.com/neurosnap/sentences								 v1.0.6 \
	github.com/nfnt/resize									 v0.0.0-20180221191011-83c6a9932646 \
	github.com/niklasfasching/go-org							 v1.9.1 \
	github.com/oasdiff/yaml									 v0.0.0-20250309154309-f31be36b4037 \
	github.com/oasdiff/yaml3								 v0.0.0-20250309153720-d2182401db90 \
	github.com/olekukonko/cat								 v0.0.0-20250911104152-50322a0618f6 \
	github.com/olekukonko/errors								 v1.1.0 \
	github.com/olekukonko/ll								 v0.1.3 \
	github.com/olekukonko/tablewriter							 v1.1.2 \
	github.com/olekukonko/ts								 v0.0.0-20171002115256-78ecb04241c0 \
	github.com/pbnjay/memory								 v0.0.0-20210728143218-7b4eea64cf58 \
	github.com/pelletier/go-toml								 v1.9.5 \
	github.com/pelletier/go-toml/v2								 v2.2.4 \
	github.com/perimeterx/marshmallow							 v1.1.5 \
	github.com/pkg/browser									 v0.0.0-20240102092130-5ac0b6a4141c \
	github.com/pkg/diff									 v0.0.0-20210226163009-20ebb0f2a09e \
	github.com/pkg/errors									 v0.9.1 \
	github.com/pkg/sftp									 v1.13.1 \
	github.com/planetscale/vtprotobuf							 v0.6.1-0.20240319094008-0393e58bdf10 \
	github.com/pmezard/go-difflib								 v1.0.1-0.20181226105442-5d4384ee4fb2 \
	github.com/prashantv/gostub								 v1.1.0 \
	github.com/prometheus/client_model							 v0.6.1 \
	github.com/redis/go-redis/v9								 v9.8.0 \
	github.com/rivo/uniseg									 v0.4.7 \
	github.com/rogpeppe/go-internal								 v1.14.1 \
	github.com/russross/blackfriday/v2							 v2.1.0 \
	github.com/rwcarlsen/goexif								 v0.0.0-20190401172101-9e8deecbddbd \
	github.com/sebdah/goldie/v2								 v2.8.0 \
	github.com/sergi/go-diff								 v1.4.0 \
	github.com/shogo82148/go-shuffle							 v0.0.0-20180218125048-27e6095f230d \
	github.com/spf13/afero									 v1.15.0 \
	github.com/spf13/cast									 v1.10.0 \
	github.com/spf13/cobra									 v1.10.2 \
	github.com/spf13/fsync									 v0.10.1 \
	github.com/spf13/pflag									 v1.0.9 \
	github.com/spiffe/go-spiffe/v2								 v2.5.0 \
	github.com/stretchr/objx								 v0.5.0 \
	github.com/stretchr/testify								 v1.10.0 \
	github.com/tdewolff/argp								 v0.0.0-20250430135133-0f54527d2b1e \
	github.com/tdewolff/minify/v2								 v2.24.8 \
	github.com/tdewolff/parse/v2								 v2.8.5 \
	github.com/tdewolff/test								 v1.0.11 \
	github.com/tetratelabs/wazero								 v1.10.1 \
	github.com/ugorji/go/codec								 v1.2.7 \
	github.com/woodsbury/decimal128								 v1.3.0 \
	github.com/yuin/goldmark								 v1.7.13 \
	github.com/yuin/goldmark-emoji								 v1.0.6 \
	github.com/zeebo/errs									 v1.4.0 \
	go.opencensus.io									 v0.24.0 \
	go.opentelemetry.io/auto/sdk								 v1.1.0 \
	go.opentelemetry.io/contrib/detectors/aws/ec2						 v1.37.0 \
	go.opentelemetry.io/contrib/detectors/gcp						 v1.37.0 \
	go.opentelemetry.io/contrib/instrumentation/google.golang.org/grpc/otelgrpc		 v0.62.0 \
	go.opentelemetry.io/contrib/instrumentation/net/http/otelhttp				 v0.62.0 \
	go.opentelemetry.io/contrib/propagators/aws						 v1.37.0 \
	go.opentelemetry.io/otel								 v1.37.0 \
	go.opentelemetry.io/otel/exporters/otlp/otlpmetric/otlpmetricgrpc			 v1.37.0 \
	go.opentelemetry.io/otel/exporters/otlp/otlptrace					 v1.37.0 \
	go.opentelemetry.io/otel/exporters/otlp/otlptrace/otlptracegrpc				 v1.37.0 \
	go.opentelemetry.io/otel/exporters/stdout/stdoutmetric					 v1.37.0 \
	go.opentelemetry.io/otel/metric								 v1.37.0 \
	go.opentelemetry.io/otel/sdk								 v1.37.0 \
	go.opentelemetry.io/otel/sdk/metric							 v1.37.0 \
	go.opentelemetry.io/otel/trace								 v1.37.0 \
	go.opentelemetry.io/proto/otlp								 v1.7.0 \
	go.uber.org/automaxprocs								 v1.5.3 \
	go.uber.org/goleak									 v1.3.0 \
	go.uber.org/multierr									 v1.11.0 \
	go.uber.org/zap										 v1.27.0 \
	go.yaml.in/yaml/v3									 v3.0.4 \
	gocloud.dev										 v0.44.0 \
	golang.org/x/crypto									 v0.46.0 \
	golang.org/x/exp									 v0.0.0-20200224162631-6cc2880d07d6 \
	golang.org/x/image									 v0.34.0 \
	golang.org/x/lint									 v0.0.0-20201208152925-83fdc39ff7b5 \
	golang.org/x/mobile									 v0.0.0-20190719004257-d2bd2a29d028 \
	golang.org/x/mod									 v0.31.0 \
	golang.org/x/net									 v0.48.0 \
	golang.org/x/oauth2									 v0.32.0 \
	golang.org/x/sync									 v0.19.0 \
	golang.org/x/sys									 v0.39.0 \
	golang.org/x/telemetry									 v0.0.0-20251203150158-8fff8a5912fc \
	golang.org/x/term									 v0.38.0 \
	golang.org/x/text									 v0.32.0 \
	golang.org/x/time									 v0.14.0 \
	golang.org/x/tools									 v0.40.0 \
	golang.org/x/xerrors									 v0.0.0-20240903120638-7835f813f4da \
	gonum.org/v1/gonum									 v0.16.0 \
	google.golang.org/api									 v0.255.0 \
	google.golang.org/appengine								 v1.6.8 \
	google.golang.org/genproto								 v0.0.0-20250715232539-7130f93afb79 \
	google.golang.org/genproto/googleapis/api						 v0.0.0-20250818200422-3122310a409c \
	google.golang.org/genproto/googleapis/bytestream					 v0.0.0-20251029180050-ab9386a59fda \
	google.golang.org/genproto/googleapis/rpc						 v0.0.0-20251029180050-ab9386a59fda \
	google.golang.org/grpc									 v1.76.0 \
	google.golang.org/grpc/examples								 v0.0.0-20230224211313-3775f633ce20 \
	google.golang.org/protobuf								 v1.36.10 \
	gopkg.in/check.v1									 v1.0.0-20201130134442-10cb98267c6c \
	gopkg.in/errgo.v2									 v2.1.0 \
	gopkg.in/neurosnap/sentences.v1								 v1.0.6 \
	gopkg.in/yaml.v1									 v1.0.0-20140924161607-9f9df34309c0 \
	gopkg.in/yaml.v2									 v2.4.0 \
	gopkg.in/yaml.v3									 v3.0.1 \
	honnef.co/go/tools									 v0.0.1-2020.1.4 \
	howett.net/plist									 v1.0.0 \
	rsc.io/binaryregexp									 v0.2.0 \
	rsc.io/qr										 v0.2.0 \
	rsc.io/quote/v3										 v3.1.0 \
	rsc.io/sampler										 v1.3.0 \
	software.sslmate.com/src/go-pkcs12							 v0.2.0

MODGO_MODFILES =	\
	cel.dev/expr									 v0.15.0 \
	cel.dev/expr									 v0.19.0 \
	cloud.google.com/go								 v0.112.2 \
	cloud.google.com/go								 v0.118.3 \
	cloud.google.com/go								 v0.120.0 \
	cloud.google.com/go								 v0.121.4 \
	cloud.google.com/go								 v0.26.0 \
	cloud.google.com/go								 v0.34.0 \
	cloud.google.com/go								 v0.38.0 \
	cloud.google.com/go								 v0.44.1 \
	cloud.google.com/go								 v0.44.2 \
	cloud.google.com/go								 v0.44.3 \
	cloud.google.com/go								 v0.45.1 \
	cloud.google.com/go								 v0.46.3 \
	cloud.google.com/go								 v0.50.0 \
	cloud.google.com/go								 v0.52.0 \
	cloud.google.com/go								 v0.53.0 \
	cloud.google.com/go								 v0.54.0 \
	cloud.google.com/go								 v0.56.0 \
	cloud.google.com/go								 v0.57.0 \
	cloud.google.com/go								 v0.62.0 \
	cloud.google.com/go								 v0.65.0 \
	cloud.google.com/go								 v0.72.0 \
	cloud.google.com/go								 v0.74.0 \
	cloud.google.com/go								 v0.75.0 \
	cloud.google.com/go/auth							 v0.15.0 \
	cloud.google.com/go/auth							 v0.16.0 \
	cloud.google.com/go/auth							 v0.16.1 \
	cloud.google.com/go/auth							 v0.16.3 \
	cloud.google.com/go/auth							 v0.16.4 \
	cloud.google.com/go/auth							 v0.3.0 \
	cloud.google.com/go/auth/oauth2adapt						 v0.2.2 \
	cloud.google.com/go/bigquery							 v1.0.1 \
	cloud.google.com/go/bigquery							 v1.3.0 \
	cloud.google.com/go/bigquery							 v1.4.0 \
	cloud.google.com/go/bigquery							 v1.5.0 \
	cloud.google.com/go/bigquery							 v1.7.0 \
	cloud.google.com/go/bigquery							 v1.8.0 \
	cloud.google.com/go/compute/metadata						 v0.3.0 \
	cloud.google.com/go/compute/metadata						 v0.6.0 \
	cloud.google.com/go/compute/metadata						 v0.7.0 \
	cloud.google.com/go/compute/metadata						 v0.8.0 \
	cloud.google.com/go/datastore							 v1.0.0 \
	cloud.google.com/go/datastore							 v1.1.0 \
	cloud.google.com/go/longrunning							 v0.5.6 \
	cloud.google.com/go/longrunning							 v0.6.6 \
	cloud.google.com/go/pubsub							 v1.0.1 \
	cloud.google.com/go/pubsub							 v1.1.0 \
	cloud.google.com/go/pubsub							 v1.2.0 \
	cloud.google.com/go/pubsub							 v1.3.1 \
	cloud.google.com/go/pubsub							 v1.49.0 \
	cloud.google.com/go/storage							 v1.0.0 \
	cloud.google.com/go/storage							 v1.10.0 \
	cloud.google.com/go/storage							 v1.14.0 \
	cloud.google.com/go/storage							 v1.5.0 \
	cloud.google.com/go/storage							 v1.6.0 \
	cloud.google.com/go/storage							 v1.8.0 \
	cloud.google.com/go/translate							 v1.10.3 \
	github.com/!azure/azure-sdk-for-go/sdk/azcore					 v1.17.1 \
	github.com/!azure/azure-sdk-for-go/sdk/azcore					 v1.18.0 \
	github.com/!azure/azure-sdk-for-go/sdk/azidentity				 v1.8.2 \
	github.com/!azure/azure-sdk-for-go/sdk/azidentity				 v1.9.0 \
	github.com/!azure/azure-sdk-for-go/sdk/internal					 v1.11.0 \
	github.com/!burnt!sushi/toml							 v0.3.1 \
	github.com/!google!cloud!platform/opentelemetry-operations-go/detectors/gcp	 v1.27.0 \
	github.com/alecthomas/chroma/v2							 v2.5.0 \
	github.com/aws/aws-sdk-go-v2							 v1.39.6 \
	github.com/aws/aws-sdk-go-v2/internal/configsources				 v1.4.13 \
	github.com/aws/aws-sdk-go-v2/internal/endpoints/v2				 v2.7.13 \
	github.com/aws/smithy-go							 v1.23.2 \
	github.com/bep/helpers								 v0.4.0 \
	github.com/clipperhouse/uax29/v2						 v2.2.0 \
	github.com/cncf/udpa/go								 v0.0.0-20191209042840-269d4d468f6f \
	github.com/cncf/udpa/go								 v0.0.0-20200629203442-efcf912fb354 \
	github.com/cncf/xds/go								 v0.0.0-20240905190251-b4127c9b8d78 \
	github.com/davecgh/go-spew							 v1.1.0 \
	github.com/davecgh/go-spew							 v1.1.1 \
	github.com/dlclark/regexp2							 v1.4.0 \
	github.com/envoyproxy/go-control-plane						 v0.9.0 \
	github.com/envoyproxy/go-control-plane						 v0.9.1-0.20191026205805-5f8ba28d4473 \
	github.com/envoyproxy/go-control-plane						 v0.9.4 \
	github.com/envoyproxy/go-control-plane						 v0.9.7 \
	github.com/envoyproxy/go-control-plane						 v0.9.9-0.20201210154907-fd9021fe5dad \
	github.com/envoyproxy/protoc-gen-validate					 v0.1.0 \
	github.com/envoyproxy/protoc-gen-validate					 v1.0.4 \
	github.com/fatih/color								 v1.13.0 \
	github.com/fatih/color								 v1.15.0 \
	github.com/frankban/quicktest							 v1.13.0 \
	github.com/frankban/quicktest							 v1.14.2 \
	github.com/frankban/quicktest							 v1.14.3 \
	github.com/frankban/quicktest							 v1.14.5 \
	github.com/frankban/quicktest							 v1.4.1 \
	github.com/frankban/quicktest							 v1.7.2 \
	github.com/go-gl/glfw/v3.3/glfw							 v0.0.0-20191125211704-12ad95a8df72 \
	github.com/go-jose/go-jose/v4							 v4.0.4 \
	github.com/go-jose/go-jose/v4							 v4.0.5 \
	github.com/go-jose/go-jose/v4							 v4.1.1 \
	github.com/go-logr/logr								 v1.2.2 \
	github.com/go-logr/logr								 v1.4.1 \
	github.com/go-logr/logr								 v1.4.2 \
	github.com/golang-jwt/jwt/v5							 v5.0.0 \
	github.com/golang-jwt/jwt/v5							 v5.2.2 \
	github.com/golang/glog								 v0.0.0-20160126235308-23def4e6c14b \
	github.com/golang/groupcache							 v0.0.0-20190702054246-869f871628b6 \
	github.com/golang/groupcache							 v0.0.0-20191227052852-215e87163ea7 \
	github.com/golang/groupcache							 v0.0.0-20200121045136-8c9f03a8e57e \
	github.com/golang/mock								 v1.1.1 \
	github.com/golang/mock								 v1.2.0 \
	github.com/golang/mock								 v1.3.1 \
	github.com/golang/mock								 v1.4.0 \
	github.com/golang/mock								 v1.4.1 \
	github.com/golang/mock								 v1.4.3 \
	github.com/golang/protobuf							 v1.2.0 \
	github.com/golang/protobuf							 v1.3.1 \
	github.com/golang/protobuf							 v1.3.2 \
	github.com/golang/protobuf							 v1.3.3 \
	github.com/golang/protobuf							 v1.3.4 \
	github.com/golang/protobuf							 v1.3.5 \
	github.com/golang/protobuf							 v1.4.0 \
	github.com/golang/protobuf							 v1.4.0-rc.1 \
	github.com/golang/protobuf							 v1.4.0-rc.1.0.20200221234624-67d41d38c208 \
	github.com/golang/protobuf							 v1.4.0-rc.2 \
	github.com/golang/protobuf							 v1.4.0-rc.4.0.20200313231945-b860323f09d0 \
	github.com/golang/protobuf							 v1.4.1 \
	github.com/golang/protobuf							 v1.4.2 \
	github.com/golang/protobuf							 v1.4.3 \
	github.com/golang/protobuf							 v1.5.0 \
	github.com/golang/protobuf							 v1.5.3 \
	github.com/google/btree								 v0.0.0-20180813153112-4030bb1f1f0c \
	github.com/google/go-cmp							 v0.2.0 \
	github.com/google/go-cmp							 v0.3.0 \
	github.com/google/go-cmp							 v0.3.1 \
	github.com/google/go-cmp							 v0.4.0 \
	github.com/google/go-cmp							 v0.4.1 \
	github.com/google/go-cmp							 v0.5.0 \
	github.com/google/go-cmp							 v0.5.1 \
	github.com/google/go-cmp							 v0.5.2 \
	github.com/google/go-cmp							 v0.5.4 \
	github.com/google/go-cmp							 v0.5.5 \
	github.com/google/go-cmp							 v0.5.7 \
	github.com/google/go-cmp							 v0.5.8 \
	github.com/google/go-cmp							 v0.5.9 \
	github.com/google/go-cmp							 v0.6.0 \
	github.com/google/martian/v3							 v3.0.0 \
	github.com/google/martian/v3							 v3.1.0 \
	github.com/google/pprof								 v0.0.0-20181206194817-3ea8567a2e57 \
	github.com/google/pprof								 v0.0.0-20190515194954-54271f7e092f \
	github.com/google/pprof								 v0.0.0-20191218002539-d4f498aebedc \
	github.com/google/pprof								 v0.0.0-20200212024743-f11f1df84d12 \
	github.com/google/pprof								 v0.0.0-20200229191704-1ebb73c60ed3 \
	github.com/google/pprof								 v0.0.0-20200430221834-fc25d7d30c6d \
	github.com/google/pprof								 v0.0.0-20200708004538-1a94d8640e99 \
	github.com/google/pprof								 v0.0.0-20201023163331-3e6fc7fc9c4c \
	github.com/google/pprof								 v0.0.0-20201203190320-1bf35d6f28c2 \
	github.com/google/uuid								 v1.1.2 \
	github.com/google/uuid								 v1.3.0 \
	github.com/googleapis/enterprise-certificate-proxy				 v0.3.2 \
	github.com/googleapis/enterprise-certificate-proxy				 v0.3.5 \
	github.com/googleapis/gax-go/v2							 v2.0.4 \
	github.com/googleapis/gax-go/v2							 v2.0.5 \
	github.com/googleapis/gax-go/v2							 v2.12.3 \
	github.com/googleapis/gax-go/v2							 v2.14.1 \
	github.com/googleapis/gax-go/v2							 v2.14.2 \
	github.com/hashicorp/golang-lru							 v0.5.0 \
	github.com/ianlancetaylor/demangle						 v0.0.0-20181102032728-5e5cf60278f6 \
	github.com/jstemmer/go-junit-report						 v0.0.0-20190106144839-af01ea7f8024 \
	github.com/kr/pretty								 v0.1.0 \
	github.com/kr/pretty								 v0.2.1 \
	github.com/kr/pretty								 v0.3.0 \
	github.com/kr/text								 v0.1.0 \
	github.com/mattn/go-colorable							 v0.1.12 \
	github.com/mattn/go-isatty							 v0.0.14 \
	github.com/mattn/go-isatty							 v0.0.16 \
	github.com/mattn/go-isatty							 v0.0.19 \
	github.com/mitchellh/mapstructure						 v1.5.0 \
	github.com/montanaflynn/stats							 v0.6.3 \
	github.com/olekukonko/cat							 v0.0.0-20250908003013-b0de306c343b \
	github.com/pkg/browser								 v0.0.0-20210911075715-681adbf594b8 \
	github.com/pmezard/go-difflib							 v1.0.0 \
	github.com/prometheus/client_model						 v0.0.0-20190812154241-14fe0d1b01d4 \
	github.com/rogpeppe/go-internal							 v1.10.0 \
	github.com/rogpeppe/go-internal							 v1.11.0 \
	github.com/rogpeppe/go-internal							 v1.12.0 \
	github.com/rogpeppe/go-internal							 v1.13.1 \
	github.com/rogpeppe/go-internal							 v1.3.0 \
	github.com/rogpeppe/go-internal							 v1.6.1 \
	github.com/rogpeppe/go-internal							 v1.8.1 \
	github.com/rogpeppe/go-internal							 v1.9.0 \
	github.com/spf13/afero								 v1.10.0 \
	github.com/spf13/afero								 v1.9.0 \
	github.com/spf13/afero								 v1.9.2 \
	github.com/spf13/cobra								 v1.9.1 \
	github.com/spf13/pflag								 v1.0.7 \
	github.com/stretchr/objx							 v0.1.0 \
	github.com/stretchr/objx							 v0.4.0 \
	github.com/stretchr/testify							 v1.4.0 \
	github.com/stretchr/testify							 v1.5.1 \
	github.com/stretchr/testify							 v1.6.1 \
	github.com/stretchr/testify							 v1.7.0 \
	github.com/stretchr/testify							 v1.7.1 \
	github.com/stretchr/testify							 v1.8.0 \
	github.com/stretchr/testify							 v1.8.1 \
	github.com/stretchr/testify							 v1.8.4 \
	github.com/stretchr/testify							 v1.9.0 \
	github.com/yuin/goldmark							 v1.1.25 \
	github.com/yuin/goldmark							 v1.1.27 \
	github.com/yuin/goldmark							 v1.1.32 \
	github.com/yuin/goldmark							 v1.2.1 \
	github.com/yuin/goldmark							 v1.3.5 \
	github.com/yuin/goldmark							 v1.4.13 \
	github.com/yuin/goldmark							 v1.7.10 \
	github.com/yuin/goldmark							 v1.7.12 \
	github.com/yuin/goldmark							 v1.7.8 \
	go.opencensus.io								 v0.21.0 \
	go.opencensus.io								 v0.22.0 \
	go.opencensus.io								 v0.22.2 \
	go.opencensus.io								 v0.22.3 \
	go.opencensus.io								 v0.22.4 \
	go.opencensus.io								 v0.22.5 \
	go.opentelemetry.io/contrib/detectors/gcp					 v1.36.0 \
	go.opentelemetry.io/contrib/instrumentation/google.golang.org/grpc/otelgrpc	 v0.49.0 \
	go.opentelemetry.io/contrib/instrumentation/google.golang.org/grpc/otelgrpc	 v0.60.0 \
	go.opentelemetry.io/contrib/instrumentation/google.golang.org/grpc/otelgrpc	 v0.61.0 \
	go.opentelemetry.io/contrib/instrumentation/net/http/otelhttp			 v0.49.0 \
	go.opentelemetry.io/contrib/instrumentation/net/http/otelhttp			 v0.60.0 \
	go.opentelemetry.io/contrib/instrumentation/net/http/otelhttp			 v0.61.0 \
	go.opentelemetry.io/otel							 v1.24.0 \
	go.opentelemetry.io/otel							 v1.32.0 \
	go.opentelemetry.io/otel							 v1.35.0 \
	go.opentelemetry.io/otel							 v1.36.0 \
	go.opentelemetry.io/otel/exporters/stdout/stdoutmetric				 v1.36.0 \
	go.opentelemetry.io/otel/metric							 v1.24.0 \
	go.opentelemetry.io/otel/metric							 v1.35.0 \
	go.opentelemetry.io/otel/metric							 v1.36.0 \
	go.opentelemetry.io/otel/sdk							 v1.35.0 \
	go.opentelemetry.io/otel/sdk							 v1.36.0 \
	go.opentelemetry.io/otel/sdk/metric						 v1.36.0 \
	go.opentelemetry.io/otel/trace							 v1.24.0 \
	go.opentelemetry.io/otel/trace							 v1.32.0 \
	go.opentelemetry.io/otel/trace							 v1.35.0 \
	go.opentelemetry.io/otel/trace							 v1.36.0 \
	go.opentelemetry.io/proto/otlp							 v1.0.0 \
	golang.org/x/crypto								 v0.0.0-20190308221718-c2843e01d9a2 \
	golang.org/x/crypto								 v0.0.0-20190510104115-cbcb75029529 \
	golang.org/x/crypto								 v0.0.0-20190605123033-f99c8df09eb5 \
	golang.org/x/crypto								 v0.0.0-20191011191535-87dc89f01550 \
	golang.org/x/crypto								 v0.0.0-20200622213623-75b288015ac9 \
	golang.org/x/crypto								 v0.0.0-20210421170649-83a5a9bb288b \
	golang.org/x/crypto								 v0.0.0-20211108221036-ceb1ce70b4fa \
	golang.org/x/crypto								 v0.0.0-20220331220935-ae2d96664a29 \
	golang.org/x/crypto								 v0.31.0 \
	golang.org/x/crypto								 v0.35.0 \
	golang.org/x/crypto								 v0.36.0 \
	golang.org/x/crypto								 v0.37.0 \
	golang.org/x/crypto								 v0.38.0 \
	golang.org/x/crypto								 v0.39.0 \
	golang.org/x/crypto								 v0.40.0 \
	golang.org/x/crypto								 v0.41.0 \
	golang.org/x/crypto								 v0.43.0 \
	golang.org/x/exp								 v0.0.0-20190121172915-509febef88a4 \
	golang.org/x/exp								 v0.0.0-20190306152737-a1d7652674e8 \
	golang.org/x/exp								 v0.0.0-20190510132918-efd6b22b2522 \
	golang.org/x/exp								 v0.0.0-20190829153037-c13cbed26979 \
	golang.org/x/exp								 v0.0.0-20191030013958-a1ab85dbe136 \
	golang.org/x/exp								 v0.0.0-20191129062945-2f5052295587 \
	golang.org/x/exp								 v0.0.0-20191227195350-da58074b4299 \
	golang.org/x/exp								 v0.0.0-20200119233911-0405dc783f0a \
	golang.org/x/exp								 v0.0.0-20200207192155-f17229e696bd \
	golang.org/x/image								 v0.0.0-20190227222117-0694c2d4d067 \
	golang.org/x/image								 v0.0.0-20190802002840-cff245a6509b \
	golang.org/x/lint								 v0.0.0-20181026193005-c67002cb31c3 \
	golang.org/x/lint								 v0.0.0-20190227174305-5b3e6a55c961 \
	golang.org/x/lint								 v0.0.0-20190301231843-5614ed5bae6f \
	golang.org/x/lint								 v0.0.0-20190313153728-d0100b6bd8b3 \
	golang.org/x/lint								 v0.0.0-20190409202823-959b441ac422 \
	golang.org/x/lint								 v0.0.0-20190909230951-414d861bb4ac \
	golang.org/x/lint								 v0.0.0-20190930215403-16217165b5de \
	golang.org/x/lint								 v0.0.0-20191125180803-fdd1cda4f05f \
	golang.org/x/lint								 v0.0.0-20200130185559-910be7a94367 \
	golang.org/x/lint								 v0.0.0-20200302205851-738671d3881b \
	golang.org/x/mobile								 v0.0.0-20190312151609-d3739f865fa6 \
	golang.org/x/mod								 v0.0.0-20190513183733-4bf6d317e70e \
	golang.org/x/mod								 v0.1.0 \
	golang.org/x/mod								 v0.1.1-0.20191105210325-c90efee705ee \
	golang.org/x/mod								 v0.1.1-0.20191107180719-034126e5016b \
	golang.org/x/mod								 v0.17.0 \
	golang.org/x/mod								 v0.2.0 \
	golang.org/x/mod								 v0.20.0 \
	golang.org/x/mod								 v0.21.0 \
	golang.org/x/mod								 v0.3.0 \
	golang.org/x/mod								 v0.30.0 \
	golang.org/x/mod								 v0.4.0 \
	golang.org/x/mod								 v0.4.1 \
	golang.org/x/mod								 v0.4.2 \
	golang.org/x/net								 v0.0.0-20180724234803-3673e40ba225 \
	golang.org/x/net								 v0.0.0-20180826012351-8a410e7b638d \
	golang.org/x/net								 v0.0.0-20190108225652-1e06a53dbb7e \
	golang.org/x/net								 v0.0.0-20190213061140-3a22650c66bd \
	golang.org/x/net								 v0.0.0-20190311183353-d8887717615a \
	golang.org/x/net								 v0.0.0-20190404232315-eb5bcb51f2a3 \
	golang.org/x/net								 v0.0.0-20190501004415-9ce7a6920f09 \
	golang.org/x/net								 v0.0.0-20190503192946-f4e77d36d62c \
	golang.org/x/net								 v0.0.0-20190603091049-60506f45cf65 \
	golang.org/x/net								 v0.0.0-20190620200207-3b0461eec859 \
	golang.org/x/net								 v0.0.0-20190628185345-da137c7871d7 \
	golang.org/x/net								 v0.0.0-20190724013045-ca1201d0de80 \
	golang.org/x/net								 v0.0.0-20191209160850-c0dbc17a3553 \
	golang.org/x/net								 v0.0.0-20200114155413-6afb5195e5aa \
	golang.org/x/net								 v0.0.0-20200202094626-16171245cfb2 \
	golang.org/x/net								 v0.0.0-20200222125558-5a598a2470a0 \
	golang.org/x/net								 v0.0.0-20200226121028-0de0cce0169b \
	golang.org/x/net								 v0.0.0-20200301022130-244492dfa37a \
	golang.org/x/net								 v0.0.0-20200324143707-d3edc9973b7e \
	golang.org/x/net								 v0.0.0-20200501053045-e0ff5e5a1de5 \
	golang.org/x/net								 v0.0.0-20200506145744-7e3656a0809f \
	golang.org/x/net								 v0.0.0-20200513185701-a91f0712d120 \
	golang.org/x/net								 v0.0.0-20200520182314-0ba52f642ac2 \
	golang.org/x/net								 v0.0.0-20200625001655-4c5254603344 \
	golang.org/x/net								 v0.0.0-20200707034311-ab3426394381 \
	golang.org/x/net								 v0.0.0-20200822124328-c89045814202 \
	golang.org/x/net								 v0.0.0-20201021035429-f5854403a974 \
	golang.org/x/net								 v0.0.0-20201031054903-ff519b6c9102 \
	golang.org/x/net								 v0.0.0-20201209123823-ac852fbbde11 \
	golang.org/x/net								 v0.0.0-20201224014010-6772e930b67b \
	golang.org/x/net								 v0.0.0-20210226172049-e18ecbb05110 \
	golang.org/x/net								 v0.0.0-20210405180319-a5a99cb37ef4 \
	golang.org/x/net								 v0.0.0-20211112202133-69e39bad7dc2 \
	golang.org/x/net								 v0.10.0 \
	golang.org/x/net								 v0.14.0 \
	golang.org/x/net								 v0.20.0 \
	golang.org/x/net								 v0.26.0 \
	golang.org/x/net								 v0.33.0 \
	golang.org/x/net								 v0.34.0 \
	golang.org/x/net								 v0.37.0 \
	golang.org/x/net								 v0.38.0 \
	golang.org/x/net								 v0.39.0 \
	golang.org/x/net								 v0.40.0 \
	golang.org/x/net								 v0.41.0 \
	golang.org/x/net								 v0.42.0 \
	golang.org/x/net								 v0.43.0 \
	golang.org/x/net								 v0.46.0 \
	golang.org/x/net								 v0.47.0 \
	golang.org/x/oauth2								 v0.0.0-20180821212333-d2e6202438be \
	golang.org/x/oauth2								 v0.0.0-20190226205417-e64efc72b421 \
	golang.org/x/oauth2								 v0.0.0-20190604053449-0f29369cfe45 \
	golang.org/x/oauth2								 v0.0.0-20191202225959-858c2ad4c8b6 \
	golang.org/x/oauth2								 v0.0.0-20200107190931-bf48bf16ab8d \
	golang.org/x/oauth2								 v0.0.0-20200902213428-5d25da1a8d43 \
	golang.org/x/oauth2								 v0.0.0-20201109201403-9fd604954f58 \
	golang.org/x/oauth2								 v0.0.0-20201208152858-08078c50e5b5 \
	golang.org/x/oauth2								 v0.0.0-20210218202405-ba52d332ba99 \
	golang.org/x/oauth2								 v0.19.0 \
	golang.org/x/oauth2								 v0.28.0 \
	golang.org/x/oauth2								 v0.29.0 \
	golang.org/x/oauth2								 v0.30.0 \
	golang.org/x/sync								 v0.0.0-20180314180146-1d60e4601c6f \
	golang.org/x/sync								 v0.0.0-20181108010431-42b317875d0f \
	golang.org/x/sync								 v0.0.0-20181221193216-37e7f081c4d4 \
	golang.org/x/sync								 v0.0.0-20190227155943-e225da77a7e6 \
	golang.org/x/sync								 v0.0.0-20190423024810-112230192c58 \
	golang.org/x/sync								 v0.0.0-20190911185100-cd5d95a43a6e \
	golang.org/x/sync								 v0.0.0-20200317015054-43a5402ce75a \
	golang.org/x/sync								 v0.0.0-20200625203802-6e8e738ad208 \
	golang.org/x/sync								 v0.0.0-20201020160332-67f06af15bc9 \
	golang.org/x/sync								 v0.0.0-20201207232520-09787c993a3a \
	golang.org/x/sync								 v0.0.0-20210220032951-036812b2e83c \
	golang.org/x/sync								 v0.10.0 \
	golang.org/x/sync								 v0.13.0 \
	golang.org/x/sync								 v0.14.0 \
	golang.org/x/sync								 v0.16.0 \
	golang.org/x/sync								 v0.17.0 \
	golang.org/x/sync								 v0.7.0 \
	golang.org/x/sync								 v0.8.0 \
	golang.org/x/sys								 v0.0.0-20180830151530-49385e6e1522 \
	golang.org/x/sys								 v0.0.0-20190215142949-d0b11bdaac8a \
	golang.org/x/sys								 v0.0.0-20190312061237-fead79001313 \
	golang.org/x/sys								 v0.0.0-20190412213103-97732733099d \
	golang.org/x/sys								 v0.0.0-20190502145724-3ef323f4f1fd \
	golang.org/x/sys								 v0.0.0-20190507160741-ecd444e8653b \
	golang.org/x/sys								 v0.0.0-20190606165138-5da285871e9c \
	golang.org/x/sys								 v0.0.0-20190624142023-c5567b49c5d0 \
	golang.org/x/sys								 v0.0.0-20190726091711-fc99dfbffb4e \
	golang.org/x/sys								 v0.0.0-20191001151750-bb3f8db39f24 \
	golang.org/x/sys								 v0.0.0-20191204072324-ce4227a45e2e \
	golang.org/x/sys								 v0.0.0-20191228213918-04cbcbbfeed8 \
	golang.org/x/sys								 v0.0.0-20200113162924-86b910548bc1 \
	golang.org/x/sys								 v0.0.0-20200122134326-e047566fdf82 \
	golang.org/x/sys								 v0.0.0-20200202164722-d101bd2416d5 \
	golang.org/x/sys								 v0.0.0-20200212091648-12a6c2dcc1e4 \
	golang.org/x/sys								 v0.0.0-20200223170610-d5e6a3e2c0ae \
	golang.org/x/sys								 v0.0.0-20200302150141-5c8b2ff67527 \
	golang.org/x/sys								 v0.0.0-20200323222414-85ca7c5b95cd \
	golang.org/x/sys								 v0.0.0-20200331124033-c3d80250170d \
	golang.org/x/sys								 v0.0.0-20200501052902-10377860bb8e \
	golang.org/x/sys								 v0.0.0-20200511232937-7e40ca221e25 \
	golang.org/x/sys								 v0.0.0-20200515095857-1151b9dac4a9 \
	golang.org/x/sys								 v0.0.0-20200523222454-059865788121 \
	golang.org/x/sys								 v0.0.0-20200803210538-64077c9b5642 \
	golang.org/x/sys								 v0.0.0-20200905004654-be1d3432aa8f \
	golang.org/x/sys								 v0.0.0-20200930185726-fdedc70b468f \
	golang.org/x/sys								 v0.0.0-20201119102817-f84b799fce68 \
	golang.org/x/sys								 v0.0.0-20201201145000-ef89a241ccb3 \
	golang.org/x/sys								 v0.0.0-20210104204734-6f8348627aad \
	golang.org/x/sys								 v0.0.0-20210119212857-b64e53b001e4 \
	golang.org/x/sys								 v0.0.0-20210225134936-a50acf3fe073 \
	golang.org/x/sys								 v0.0.0-20210330210617-4fbd30eecc44 \
	golang.org/x/sys								 v0.0.0-20210423082822-04245dca01da \
	golang.org/x/sys								 v0.0.0-20210423185535-09eb48e85fd7 \
	golang.org/x/sys								 v0.0.0-20210510120138-977fb7262007 \
	golang.org/x/sys								 v0.0.0-20210615035016-665e8c7367d1 \
	golang.org/x/sys								 v0.0.0-20220715151400-c0bba94af5f8 \
	golang.org/x/sys								 v0.0.0-20220804214406-8e32c043e418 \
	golang.org/x/sys								 v0.0.0-20220811171246-fbc7d0a398ab \
	golang.org/x/sys								 v0.1.0 \
	golang.org/x/sys								 v0.11.0 \
	golang.org/x/sys								 v0.12.0 \
	golang.org/x/sys								 v0.13.0 \
	golang.org/x/sys								 v0.16.0 \
	golang.org/x/sys								 v0.25.0 \
	golang.org/x/sys								 v0.26.0 \
	golang.org/x/sys								 v0.28.0 \
	golang.org/x/sys								 v0.29.0 \
	golang.org/x/sys								 v0.30.0 \
	golang.org/x/sys								 v0.31.0 \
	golang.org/x/sys								 v0.32.0 \
	golang.org/x/sys								 v0.33.0 \
	golang.org/x/sys								 v0.34.0 \
	golang.org/x/sys								 v0.35.0 \
	golang.org/x/sys								 v0.37.0 \
	golang.org/x/sys								 v0.38.0 \
	golang.org/x/sys								 v0.5.0 \
	golang.org/x/sys								 v0.6.0 \
	golang.org/x/term								 v0.0.0-20201126162022-7de9c90e9dd1 \
	golang.org/x/text								 v0.0.0-20170915032832-14c0d48ead0c \
	golang.org/x/text								 v0.12.0 \
	golang.org/x/text								 v0.14.0 \
	golang.org/x/text								 v0.16.0 \
	golang.org/x/text								 v0.21.0 \
	golang.org/x/text								 v0.23.0 \
	golang.org/x/text								 v0.24.0 \
	golang.org/x/text								 v0.25.0 \
	golang.org/x/text								 v0.26.0 \
	golang.org/x/text								 v0.27.0 \
	golang.org/x/text								 v0.28.0 \
	golang.org/x/text								 v0.29.0 \
	golang.org/x/text								 v0.3.0 \
	golang.org/x/text								 v0.3.1-0.20180807135948-17ff2d5776d2 \
	golang.org/x/text								 v0.3.2 \
	golang.org/x/text								 v0.3.3 \
	golang.org/x/text								 v0.3.4 \
	golang.org/x/text								 v0.3.6 \
	golang.org/x/text								 v0.3.7 \
	golang.org/x/text								 v0.30.0 \
	golang.org/x/text								 v0.9.0 \
	golang.org/x/time								 v0.0.0-20181108054448-85acf8d2951c \
	golang.org/x/time								 v0.0.0-20190308202827-9d24e82272b4 \
	golang.org/x/time								 v0.0.0-20191024005414-555d28b269f0 \
	golang.org/x/time								 v0.11.0 \
	golang.org/x/time								 v0.12.0 \
	golang.org/x/time								 v0.5.0 \
	golang.org/x/tools								 v0.0.0-20180917221912-90fa682c2a6e \
	golang.org/x/tools								 v0.0.0-20190114222345-bf090417da8b \
	golang.org/x/tools								 v0.0.0-20190226205152-f727befe758c \
	golang.org/x/tools								 v0.0.0-20190311212946-11955173bddd \
	golang.org/x/tools								 v0.0.0-20190312151545-0bb0c0a6e846 \
	golang.org/x/tools								 v0.0.0-20190312170243-e65039ee4138 \
	golang.org/x/tools								 v0.0.0-20190425150028-36563e24a262 \
	golang.org/x/tools								 v0.0.0-20190506145303-2d16b83fe98c \
	golang.org/x/tools								 v0.0.0-20190524140312-2c0ae7006135 \
	golang.org/x/tools								 v0.0.0-20190606124116-d0a3d012864b \
	golang.org/x/tools								 v0.0.0-20190621195816-6e04913cbbac \
	golang.org/x/tools								 v0.0.0-20190628153133-6cdbf07be9d0 \
	golang.org/x/tools								 v0.0.0-20190816200558-6889da9d5479 \
	golang.org/x/tools								 v0.0.0-20190911174233-4f2ddba30aff \
	golang.org/x/tools								 v0.0.0-20191012152004-8de300cfc20a \
	golang.org/x/tools								 v0.0.0-20191113191852-77e3bb0ad9e7 \
	golang.org/x/tools								 v0.0.0-20191115202509-3a792d9c32b2 \
	golang.org/x/tools								 v0.0.0-20191119224855-298f0cb1881e \
	golang.org/x/tools								 v0.0.0-20191125144606-a911d9008d1f \
	golang.org/x/tools								 v0.0.0-20191130070609-6e064ea0cf2d \
	golang.org/x/tools								 v0.0.0-20191216173652-a0e659d51361 \
	golang.org/x/tools								 v0.0.0-20191227053925-7b8e75db28f4 \
	golang.org/x/tools								 v0.0.0-20200117161641-43d50277825c \
	golang.org/x/tools								 v0.0.0-20200122220014-bf1340f18c4a \
	golang.org/x/tools								 v0.0.0-20200130002326-2f3ba24bd6e7 \
	golang.org/x/tools								 v0.0.0-20200204074204-1cc6d1ef6c74 \
	golang.org/x/tools								 v0.0.0-20200207183749-b753a1ba74fa \
	golang.org/x/tools								 v0.0.0-20200212150539-ea181f53ac56 \
	golang.org/x/tools								 v0.0.0-20200224181240-023911ca70b2 \
	golang.org/x/tools								 v0.0.0-20200227222343-706bc42d1f0d \
	golang.org/x/tools								 v0.0.0-20200304193943-95d2e580d8eb \
	golang.org/x/tools								 v0.0.0-20200312045724-11d5b4c81c7d \
	golang.org/x/tools								 v0.0.0-20200331025713-a30bf2db82d4 \
	golang.org/x/tools								 v0.0.0-20200501065659-ab2804fb9c9d \
	golang.org/x/tools								 v0.0.0-20200512131952-2bc93b1c0c88 \
	golang.org/x/tools								 v0.0.0-20200515010526-7d3b6ebf133d \
	golang.org/x/tools								 v0.0.0-20200618134242-20370b0cb4b2 \
	golang.org/x/tools								 v0.0.0-20200729194436-6467de6f59a7 \
	golang.org/x/tools								 v0.0.0-20200804011535-6c149bb5ef0d \
	golang.org/x/tools								 v0.0.0-20200825202427-b303f430e36d \
	golang.org/x/tools								 v0.0.0-20200904185747-39188db58858 \
	golang.org/x/tools								 v0.0.0-20201110124207-079ba7bd75cd \
	golang.org/x/tools								 v0.0.0-20201201161351-ac6f37ff4c2a \
	golang.org/x/tools								 v0.0.0-20201208233053-a543418bbed2 \
	golang.org/x/tools								 v0.0.0-20210105154028-b0ab187a4818 \
	golang.org/x/tools								 v0.0.0-20210108195828-e2f9c7f1fc8e \
	golang.org/x/tools								 v0.1.0 \
	golang.org/x/tools								 v0.1.5 \
	golang.org/x/tools								 v0.21.1-0.20240508182429-e35e4ccd0d2d \
	golang.org/x/tools								 v0.24.1 \
	golang.org/x/tools								 v0.26.0 \
	golang.org/x/tools								 v0.39.0 \
	golang.org/x/xerrors								 v0.0.0-20190717185122-a985d3407aa7 \
	golang.org/x/xerrors								 v0.0.0-20191011141410-1b5146add898 \
	golang.org/x/xerrors								 v0.0.0-20191204190536-9bdfabe68543 \
	golang.org/x/xerrors								 v0.0.0-20200804184101-5ec99f83aff1 \
	google.golang.org/api								 v0.13.0 \
	google.golang.org/api								 v0.14.0 \
	google.golang.org/api								 v0.15.0 \
	google.golang.org/api								 v0.17.0 \
	google.golang.org/api								 v0.177.0 \
	google.golang.org/api								 v0.18.0 \
	google.golang.org/api								 v0.19.0 \
	google.golang.org/api								 v0.20.0 \
	google.golang.org/api								 v0.22.0 \
	google.golang.org/api								 v0.229.0 \
	google.golang.org/api								 v0.234.0 \
	google.golang.org/api								 v0.239.0 \
	google.golang.org/api								 v0.24.0 \
	google.golang.org/api								 v0.243.0 \
	google.golang.org/api								 v0.246.0 \
	google.golang.org/api								 v0.247.0 \
	google.golang.org/api								 v0.28.0 \
	google.golang.org/api								 v0.29.0 \
	google.golang.org/api								 v0.30.0 \
	google.golang.org/api								 v0.35.0 \
	google.golang.org/api								 v0.36.0 \
	google.golang.org/api								 v0.4.0 \
	google.golang.org/api								 v0.40.0 \
	google.golang.org/api								 v0.7.0 \
	google.golang.org/api								 v0.8.0 \
	google.golang.org/api								 v0.9.0 \
	google.golang.org/appengine							 v1.1.0 \
	google.golang.org/appengine							 v1.4.0 \
	google.golang.org/appengine							 v1.5.0 \
	google.golang.org/appengine							 v1.6.1 \
	google.golang.org/appengine							 v1.6.5 \
	google.golang.org/appengine							 v1.6.6 \
	google.golang.org/appengine							 v1.6.7 \
	google.golang.org/genproto							 v0.0.0-20180817151627-c66870c02cf8 \
	google.golang.org/genproto							 v0.0.0-20190307195333-5fe7a883aa19 \
	google.golang.org/genproto							 v0.0.0-20190418145605-e7d98fc518a7 \
	google.golang.org/genproto							 v0.0.0-20190425155659-357c62f0e4bb \
	google.golang.org/genproto							 v0.0.0-20190502173448-54afdca5d873 \
	google.golang.org/genproto							 v0.0.0-20190801165951-fa694d86fc64 \
	google.golang.org/genproto							 v0.0.0-20190819201941-24fa4b261c55 \
	google.golang.org/genproto							 v0.0.0-20190911173649-1774047e7e51 \
	google.golang.org/genproto							 v0.0.0-20191108220845-16a3f7862a1a \
	google.golang.org/genproto							 v0.0.0-20191115194625-c23dd37a84c9 \
	google.golang.org/genproto							 v0.0.0-20191216164720-4f79533eabd1 \
	google.golang.org/genproto							 v0.0.0-20191230161307-f3c370f40bfb \
	google.golang.org/genproto							 v0.0.0-20200115191322-ca5a22157cba \
	google.golang.org/genproto							 v0.0.0-20200122232147-0452cf42e150 \
	google.golang.org/genproto							 v0.0.0-20200204135345-fa8e72b47b90 \
	google.golang.org/genproto							 v0.0.0-20200212174721-66ed5ce911ce \
	google.golang.org/genproto							 v0.0.0-20200224152610-e50cd9704f63 \
	google.golang.org/genproto							 v0.0.0-20200228133532-8c2c7df3a383 \
	google.golang.org/genproto							 v0.0.0-20200305110556-506484158171 \
	google.golang.org/genproto							 v0.0.0-20200312145019-da6875a35672 \
	google.golang.org/genproto							 v0.0.0-20200331122359-1ee6d9798940 \
	google.golang.org/genproto							 v0.0.0-20200430143042-b979b6f78d84 \
	google.golang.org/genproto							 v0.0.0-20200511104702-f5ebc3bea380 \
	google.golang.org/genproto							 v0.0.0-20200515170657-fc4c6c6a6587 \
	google.golang.org/genproto							 v0.0.0-20200526211855-cb27e3aa2013 \
	google.golang.org/genproto							 v0.0.0-20200618031413-b414f8b61790 \
	google.golang.org/genproto							 v0.0.0-20200729003335-053ba62fc06f \
	google.golang.org/genproto							 v0.0.0-20200804131852-c06518451d9c \
	google.golang.org/genproto							 v0.0.0-20200825200019-8632dd797987 \
	google.golang.org/genproto							 v0.0.0-20200904004341-0bd0a958aa1d \
	google.golang.org/genproto							 v0.0.0-20201109203340-2640f1f9cdfb \
	google.golang.org/genproto							 v0.0.0-20201201144952-b05cb90ed32e \
	google.golang.org/genproto							 v0.0.0-20201210142538-e3217bee35cc \
	google.golang.org/genproto							 v0.0.0-20201214200347-8c77b98c765d \
	google.golang.org/genproto							 v0.0.0-20210108203827-ffc7fda8c3d7 \
	google.golang.org/genproto							 v0.0.0-20210226172003-ab064af71705 \
	google.golang.org/genproto							 v0.0.0-20250303144028-a0af3efb3deb \
	google.golang.org/genproto							 v0.0.0-20250505200425-f936aa4a68b2 \
	google.golang.org/genproto							 v0.0.0-20250603155806-513f23925822 \
	google.golang.org/genproto/googleapis/api					 v0.0.0-20230822172742-b8732ec3820d \
	google.golang.org/genproto/googleapis/api					 v0.0.0-20240429193739-8cf5692501f6 \
	google.golang.org/genproto/googleapis/api					 v0.0.0-20241202173237-19429a94021a \
	google.golang.org/genproto/googleapis/api					 v0.0.0-20250414145226-207652e42e2e \
	google.golang.org/genproto/googleapis/api					 v0.0.0-20250505200425-f936aa4a68b2 \
	google.golang.org/genproto/googleapis/api					 v0.0.0-20250603155806-513f23925822 \
	google.golang.org/genproto/googleapis/api					 v0.0.0-20250707201910-8d1bb00bc6a7 \
	google.golang.org/genproto/googleapis/api					 v0.0.0-20250721164621-a45f3dfb1074 \
	google.golang.org/genproto/googleapis/api					 v0.0.0-20250804133106-a7a43d27e69b \
	google.golang.org/genproto/googleapis/rpc					 v0.0.0-20230822172742-b8732ec3820d \
	google.golang.org/genproto/googleapis/rpc					 v0.0.0-20240318140521-94a12d6c2237 \
	google.golang.org/genproto/googleapis/rpc					 v0.0.0-20240429193739-8cf5692501f6 \
	google.golang.org/genproto/googleapis/rpc					 v0.0.0-20240826202546-f6391c0de4c7 \
	google.golang.org/genproto/googleapis/rpc					 v0.0.0-20241202173237-19429a94021a \
	google.golang.org/genproto/googleapis/rpc					 v0.0.0-20250227231956-55c901821b1e \
	google.golang.org/genproto/googleapis/rpc					 v0.0.0-20250414145226-207652e42e2e \
	google.golang.org/genproto/googleapis/rpc					 v0.0.0-20250519155744-55703ea1f237 \
	google.golang.org/genproto/googleapis/rpc					 v0.0.0-20250603155806-513f23925822 \
	google.golang.org/genproto/googleapis/rpc					 v0.0.0-20250707201910-8d1bb00bc6a7 \
	google.golang.org/genproto/googleapis/rpc					 v0.0.0-20250721164621-a45f3dfb1074 \
	google.golang.org/genproto/googleapis/rpc					 v0.0.0-20250804133106-a7a43d27e69b \
	google.golang.org/genproto/googleapis/rpc					 v0.0.0-20250811230008-5f3141c8851a \
	google.golang.org/grpc								 v1.19.0 \
	google.golang.org/grpc								 v1.20.1 \
	google.golang.org/grpc								 v1.21.1 \
	google.golang.org/grpc								 v1.23.0 \
	google.golang.org/grpc								 v1.25.1 \
	google.golang.org/grpc								 v1.26.0 \
	google.golang.org/grpc								 v1.27.0 \
	google.golang.org/grpc								 v1.27.1 \
	google.golang.org/grpc								 v1.28.0 \
	google.golang.org/grpc								 v1.29.1 \
	google.golang.org/grpc								 v1.30.0 \
	google.golang.org/grpc								 v1.31.0 \
	google.golang.org/grpc								 v1.31.1 \
	google.golang.org/grpc								 v1.33.2 \
	google.golang.org/grpc								 v1.34.0 \
	google.golang.org/grpc								 v1.35.0 \
	google.golang.org/grpc								 v1.58.2 \
	google.golang.org/grpc								 v1.59.0 \
	google.golang.org/grpc								 v1.63.2 \
	google.golang.org/grpc								 v1.70.0 \
	google.golang.org/grpc								 v1.71.0 \
	google.golang.org/grpc								 v1.71.1 \
	google.golang.org/grpc								 v1.72.2 \
	google.golang.org/grpc								 v1.73.0 \
	google.golang.org/grpc								 v1.74.2 \
	google.golang.org/protobuf							 v0.0.0-20200109180630-ec00e32a8dfd \
	google.golang.org/protobuf							 v0.0.0-20200221191635-4d8936d0db64 \
	google.golang.org/protobuf							 v0.0.0-20200228230310-ab0ca4ff8a60 \
	google.golang.org/protobuf							 v1.20.1-0.20200309200217-e05f789c0967 \
	google.golang.org/protobuf							 v1.21.0 \
	google.golang.org/protobuf							 v1.22.0 \
	google.golang.org/protobuf							 v1.23.0 \
	google.golang.org/protobuf							 v1.23.1-0.20200526195155-81db48ad09cc \
	google.golang.org/protobuf							 v1.24.0 \
	google.golang.org/protobuf							 v1.25.0 \
	google.golang.org/protobuf							 v1.31.0 \
	google.golang.org/protobuf							 v1.33.0 \
	google.golang.org/protobuf							 v1.34.2 \
	google.golang.org/protobuf							 v1.35.2 \
	google.golang.org/protobuf							 v1.36.1 \
	google.golang.org/protobuf							 v1.36.3 \
	google.golang.org/protobuf							 v1.36.4 \
	google.golang.org/protobuf							 v1.36.6 \
	google.golang.org/protobuf							 v1.36.7 \
	gopkg.in/check.v1								 v0.0.0-20161208181325-20d25e280405 \
	gopkg.in/check.v1								 v1.0.0-20180628173108-788fd7840127 \
	gopkg.in/yaml.v2								 v2.2.2 \
	gopkg.in/yaml.v3								 v3.0.0-20200313102051-9f266ea9e77c \
	honnef.co/go/tools								 v0.0.0-20190102054323-c2f93a96b099 \
	honnef.co/go/tools								 v0.0.0-20190106161140-3f1c8253044a \
	honnef.co/go/tools								 v0.0.0-20190418001031-e561f6794a2a \
	honnef.co/go/tools								 v0.0.0-20190523083050-ea95bdfd59fc \
	honnef.co/go/tools								 v0.0.1-2019.2.3 \
	honnef.co/go/tools								 v0.0.1-2020.1.3

