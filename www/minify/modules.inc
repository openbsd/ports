MODGO_MODULES =	\
	filippo.io/edwards25519		 v1.1.0 \
	github.com/djherbis/atime	 v1.1.0 \
	github.com/fsnotify/fsnotify	 v1.9.0 \
	github.com/go-sql-driver/mysql	 v1.8.1 \
	github.com/jmoiron/sqlx		 v1.4.0 \
	github.com/lib/pq		 v1.10.9 \
	github.com/mattn/go-sqlite3	 v1.14.22 \
	github.com/pelletier/go-toml	 v1.9.5 \
	github.com/tdewolff/argp	 v0.0.0-20260424074207-decde4f86440 \
	github.com/tdewolff/parse/v2	 v2.8.12 \
	github.com/tdewolff/test	 v1.0.12 \
	golang.org/x/sys		 v0.43.0 \
	gopkg.in/check.v1		 v0.0.0-20161208181325-20d25e280405 \
	gopkg.in/yaml.v3		 v3.0.1

MODGO_MODFILES =	\
	github.com/tdewolff/test	 v1.0.11 \
	golang.org/x/sys		 v0.13.0

