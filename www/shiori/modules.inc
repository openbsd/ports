MODGO_MODULES =	\
	cel.dev/expr										 v0.16.2 \
	cloud.google.com/go									 v0.116.0 \
	cloud.google.com/go/auth								 v0.13.0 \
	cloud.google.com/go/auth/oauth2adapt							 v0.2.6 \
	cloud.google.com/go/compute/metadata							 v0.6.0 \
	cloud.google.com/go/iam									 v1.2.2 \
	cloud.google.com/go/monitoring								 v1.21.2 \
	cloud.google.com/go/storage								 v1.49.0 \
	dario.cat/mergo										 v1.0.1 \
	filippo.io/edwards25519									 v1.1.0 \
	git.sr.ht/~emersion/go-sqlite3-fts5							 v0.0.0-20240124102820-f3a72e8b79b1 \
	github.com/!ada!logics/go-fuzz-headers							 v0.0.0-20230811130428-ced1acdcaa24 \
	github.com/!azure/go-ansiterm								 v0.0.0-20250102033503-faa5f7b0171c \
	github.com/!google!cloud!platform/opentelemetry-operations-go/detectors/gcp		 v1.25.0 \
	github.com/!google!cloud!platform/opentelemetry-operations-go/exporter/metric		 v0.48.1 \
	github.com/!google!cloud!platform/opentelemetry-operations-go/internal/resourcemapping	 v0.48.1 \
	github.com/!kyle!banks/depth								 v1.2.1 \
	github.com/!microsoft/go-winio								 v0.6.2 \
	github.com/!puerkito!bio/goquery							 v1.10.2 \
	github.com/!puerkito!bio/purell								 v1.1.1 \
	github.com/!puerkito!bio/urlesc								 v0.0.0-20170810143723-de5bf2ad4578 \
	github.com/andybalholm/cascadia								 v1.3.3 \
	github.com/araddon/dateparse								 v0.0.0-20210429162001-6b43995a97de \
	github.com/blang/semver									 v3.5.1+incompatible \
	github.com/cenkalti/backoff/v4								 v4.3.0 \
	github.com/census-instrumentation/opencensus-proto					 v0.4.1 \
	github.com/cespare/xxhash/v2								 v2.3.0 \
	github.com/cncf/xds/go									 v0.0.0-20240905190251-b4127c9b8d78 \
	github.com/coder/websocket								 v1.8.12 \
	github.com/containerd/containerd							 v1.7.18 \
	github.com/containerd/log								 v0.1.0 \
	github.com/containerd/platforms								 v0.2.1 \
	github.com/cpuguy83/dockercfg								 v0.3.2 \
	github.com/cpuguy83/go-md2man/v2							 v2.0.6 \
	github.com/creack/pty									 v1.1.18 \
	github.com/davecgh/go-spew								 v1.1.1 \
	github.com/deckarep/golang-set/v2							 v2.7.0 \
	github.com/disintegration/imaging							 v1.6.2 \
	github.com/distribution/reference							 v0.6.0 \
	github.com/docker/docker								 v28.0.1+incompatible \
	github.com/docker/go-connections							 v0.5.0 \
	github.com/docker/go-units								 v0.5.0 \
	github.com/dustin/go-humanize								 v1.0.1 \
	github.com/envoyproxy/go-control-plane							 v0.13.1 \
	github.com/envoyproxy/protoc-gen-validate						 v1.1.0 \
	github.com/fatih/color									 v1.18.0 \
	github.com/felixge/httpsnoop								 v1.0.4 \
	github.com/gabriel-vasile/mimetype							 v1.4.8 \
	github.com/go-jose/go-jose/v3								 v3.0.4 \
	github.com/go-logr/logr									 v1.4.2 \
	github.com/go-logr/stdr									 v1.2.2 \
	github.com/go-ole/go-ole								 v1.3.0 \
	github.com/go-openapi/jsonpointer							 v0.21.0 \
	github.com/go-openapi/jsonreference							 v0.21.0 \
	github.com/go-openapi/spec								 v0.21.0 \
	github.com/go-openapi/swag								 v0.23.0 \
	github.com/go-shiori/dom								 v0.0.0-20230515143342-73569d674e1c \
	github.com/go-shiori/go-epub								 v1.2.2-0.20241010194245-bd691046db94 \
	github.com/go-shiori/go-readability							 v0.0.0-20250217085726-9f5bf5ca7612 \
	github.com/go-shiori/warc								 v0.0.0-20200621032813-359908319d1d \
	github.com/go-sql-driver/mysql								 v1.9.0 \
	github.com/go-stack/stack								 v1.8.1 \
	github.com/gofrs/uuid/v5								 v5.3.1 \
	github.com/gogo/protobuf								 v1.3.2 \
	github.com/gogs/chardet									 v0.0.0-20211120154057-b7413eaefb8f \
	github.com/golang-jwt/jwt/v5								 v5.2.1 \
	github.com/golang/glog									 v1.2.2 \
	github.com/golang/groupcache								 v0.0.0-20210331224755-41bb18bfe9da \
	github.com/golang/protobuf								 v1.5.4 \
	github.com/google/go-cmp								 v0.7.0 \
	github.com/google/pprof									 v0.0.0-20240409012703-83162a5b38cd \
	github.com/google/s2a-go								 v0.1.8 \
	github.com/google/uuid									 v1.6.0 \
	github.com/googleapis/enterprise-certificate-proxy					 v0.3.4 \
	github.com/googleapis/gax-go/v2								 v2.14.1 \
	github.com/grpc-ecosystem/grpc-gateway/v2						 v2.16.0 \
	github.com/h2non/filetype								 v1.1.3 \
	github.com/huandu/go-assert								 v1.1.6 \
	github.com/huandu/go-sqlbuilder								 v1.34.0 \
	github.com/huandu/xstrings								 v1.4.0 \
	github.com/inconshreveable/mousetrap							 v1.1.0 \
	github.com/jmoiron/sqlx									 v1.4.0 \
	github.com/josharian/intern								 v1.0.0 \
	github.com/julienschmidt/httprouter							 v1.3.0 \
	github.com/kballard/go-shellquote							 v0.0.0-20180428030007-95032a82bc51 \
	github.com/kisielk/errcheck								 v1.5.0 \
	github.com/kisielk/gotool								 v1.0.0 \
	github.com/klauspost/compress								 v1.18.0 \
	github.com/konsorten/go-windows-terminal-sequences					 v1.0.2 \
	github.com/kr/fs									 v0.1.0 \
	github.com/kr/pretty									 v0.3.1 \
	github.com/kr/text									 v0.2.0 \
	github.com/lib/pq									 v1.10.9 \
	github.com/lufia/plan9stats								 v0.0.0-20250224150550-a661cff19cfb \
	github.com/magiconair/properties							 v1.8.9 \
	github.com/mailru/easyjson								 v0.9.0 \
	github.com/mattn/go-colorable								 v0.1.14 \
	github.com/mattn/go-isatty								 v0.0.20 \
	github.com/mattn/go-runewidth								 v0.0.10 \
	github.com/mattn/go-sqlite3								 v1.14.24 \
	github.com/mitchellh/go-homedir								 v1.1.0 \
	github.com/mitchellh/go-ps								 v1.0.0 \
	github.com/moby/docker-image-spec							 v1.3.1 \
	github.com/moby/patternmatcher								 v0.6.0 \
	github.com/moby/sys/sequential								 v0.6.0 \
	github.com/moby/sys/user								 v0.3.0 \
	github.com/moby/sys/userns								 v0.1.0 \
	github.com/moby/term									 v0.5.2 \
	github.com/morikuni/aec									 v1.0.0 \
	github.com/muesli/go-app-paths								 v0.2.2 \
	github.com/ncruces/go-strftime								 v0.1.9 \
	github.com/opencontainers/go-digest							 v1.0.0 \
	github.com/opencontainers/image-spec							 v1.1.0 \
	github.com/orisano/pixelmatch								 v0.0.0-20230914042517-fa304d1dc785 \
	github.com/patrickmn/go-cache								 v2.1.0+incompatible \
	github.com/pkg/errors									 v0.9.1 \
	github.com/pkg/sftp									 v1.13.7 \
	github.com/planetscale/vtprotobuf							 v0.6.1-0.20240319094008-0393e58bdf10 \
	github.com/playwright-community/playwright-go						 v0.5001.0 \
	github.com/pmezard/go-difflib								 v1.0.0 \
	github.com/power-devops/perfstat							 v0.0.0-20240221224432-82ca36839d55 \
	github.com/remyoudompheng/bigfft							 v0.0.0-20230129092748-24d4a6f8daec \
	github.com/rivo/uniseg									 v0.1.0 \
	github.com/rogpeppe/go-internal								 v1.13.1 \
	github.com/russross/blackfriday								 v1.6.0 \
	github.com/russross/blackfriday/v2							 v2.1.0 \
	github.com/scylladb/termtables								 v0.0.0-20191203121021-c4c0b6d42ff4 \
	github.com/sergi/go-diff								 v1.1.0 \
	github.com/sethvargo/go-envconfig							 v1.1.1 \
	github.com/shirou/gopsutil/v3								 v3.24.5 \
	github.com/shoenig/go-m1cpu								 v0.1.6 \
	github.com/shoenig/test									 v0.6.4 \
	github.com/shurcoo!l/httpfs								 v0.0.0-20230704072500-f1e31cf0ba5c \
	github.com/shurcoo!l/sanitized_anchor_name						 v1.0.0 \
	github.com/shurcoo!l/vfsgen								 v0.0.0-20230704071429-0000e147ea92 \
	github.com/sirupsen/logrus								 v1.9.3 \
	github.com/spf13/afero									 v1.12.0 \
	github.com/spf13/cobra									 v1.9.1 \
	github.com/spf13/pflag									 v1.0.6 \
	github.com/stretchr/objx								 v0.5.2 \
	github.com/stretchr/testify								 v1.10.0 \
	github.com/swaggo/files/v2								 v2.0.2 \
	github.com/swaggo/http-swagger/v2							 v2.0.2 \
	github.com/swaggo/swag									 v1.16.4 \
	github.com/tdewolff/parse								 v2.3.4+incompatible \
	github.com/tdewolff/test								 v1.0.0 \
	github.com/testcontainers/testcontainers-go						 v0.35.0 \
	github.com/tidwall/gjson								 v1.17.0 \
	github.com/tidwall/match								 v1.1.1 \
	github.com/tidwall/pretty								 v1.2.1 \
	github.com/tklauser/go-sysconf								 v0.3.14 \
	github.com/tklauser/numcpus								 v0.9.0 \
	github.com/urfave/cli/v2								 v2.3.0 \
	github.com/vincent-petithory/dataurl							 v1.0.0 \
	github.com/xeipuuv/gojsonpointer							 v0.0.0-20180127040702-4e3ac2762d5f \
	github.com/xeipuuv/gojsonreference							 v0.0.0-20180127040603-bd5ef7bd5415 \
	github.com/xeipuuv/gojsonschema								 v1.2.0 \
	github.com/yuin/goldmark								 v1.4.13 \
	github.com/yusufpapurcu/wmi								 v1.2.4 \
	go.etcd.io/bbolt									 v1.4.0 \
	go.etcd.io/gofail									 v0.2.0 \
	go.opencensus.io									 v0.24.0 \
	go.opentelemetry.io/auto/sdk								 v1.1.0 \
	go.opentelemetry.io/contrib/detectors/gcp						 v1.31.0 \
	go.opentelemetry.io/contrib/instrumentation/google.golang.org/grpc/otelgrpc		 v0.54.0 \
	go.opentelemetry.io/contrib/instrumentation/net/http/otelhttp				 v0.59.0 \
	go.opentelemetry.io/otel								 v1.34.0 \
	go.opentelemetry.io/otel/exporters/otlp/otlptrace					 v1.19.0 \
	go.opentelemetry.io/otel/exporters/otlp/otlptrace/otlptracehttp				 v1.19.0 \
	go.opentelemetry.io/otel/metric								 v1.34.0 \
	go.opentelemetry.io/otel/sdk								 v1.31.0 \
	go.opentelemetry.io/otel/sdk/metric							 v1.31.0 \
	go.opentelemetry.io/otel/trace								 v1.34.0 \
	go.opentelemetry.io/proto/otlp								 v1.0.0 \
	golang.org/x/crypto									 v0.35.0 \
	golang.org/x/exp									 v0.0.0-20250228200357-dead58393ab7 \
	golang.org/x/image									 v0.24.0 \
	golang.org/x/mod									 v0.23.0 \
	golang.org/x/net									 v0.36.0 \
	golang.org/x/oauth2									 v0.25.0 \
	golang.org/x/sync									 v0.11.0 \
	golang.org/x/sys									 v0.30.0 \
	golang.org/x/telemetry									 v0.0.0-20240521205824-bda55230c457 \
	golang.org/x/term									 v0.29.0 \
	golang.org/x/text									 v0.22.0 \
	golang.org/x/time									 v0.8.0 \
	golang.org/x/tools									 v0.30.0 \
	golang.org/x/xerrors									 v0.0.0-20200804184101-5ec99f83aff1 \
	google.golang.org/api									 v0.215.0 \
	google.golang.org/genproto								 v0.0.0-20241118233622-e639e219e697 \
	google.golang.org/genproto/googleapis/api						 v0.0.0-20241209162323-e6fa225c2576 \
	google.golang.org/genproto/googleapis/rpc						 v0.0.0-20241230172942-26aa7a208def \
	google.golang.org/grpc									 v1.69.2 \
	google.golang.org/protobuf								 v1.36.1 \
	gopkg.in/check.v1									 v1.0.0-20201130134442-10cb98267c6c \
	gopkg.in/yaml.v2									 v2.4.0 \
	gopkg.in/yaml.v3									 v3.0.1 \
	gotest.tools/v3										 v3.5.1 \
	lukechampine.com/uint128								 v1.2.0 \
	modernc.org/cc/v3									 v3.41.0 \
	modernc.org/cc/v4									 v4.24.4 \
	modernc.org/ccgo/v3									 v3.17.0 \
	modernc.org/ccgo/v4									 v4.23.16 \
	modernc.org/fileutil									 v1.3.0 \
	modernc.org/gc/v2									 v2.6.3 \
	modernc.org/libc									 v1.61.13 \
	modernc.org/mathutil									 v1.7.1 \
	modernc.org/memory									 v1.8.2 \
	modernc.org/opt										 v0.1.4 \
	modernc.org/sortutil									 v1.2.1 \
	modernc.org/sqlite									 v1.36.0 \
	modernc.org/strutil									 v1.2.1 \
	modernc.org/token									 v1.1.0 \
	sigs.k8s.io/yaml									 v1.3.0

MODGO_MODFILES =	\
	cel.dev/expr									 v0.16.1 \
	cloud.google.com/go/compute/metadata						 v0.5.2 \
	dario.cat/mergo									 v1.0.0 \
	github.com/!azure/go-ansiterm							 v0.0.0-20210617225240-d185dfc1b5a1 \
	github.com/!google!cloud!platform/opentelemetry-operations-go/detectors/gcp	 v1.24.2 \
	github.com/!microsoft/go-winio							 v0.4.14 \
	github.com/andybalholm/cascadia							 v1.3.2 \
	github.com/cenkalti/backoff/v4							 v4.2.1 \
	github.com/cpuguy83/go-md2man/v2						 v2.0.0-20190314233015-f79a8a8ca69d \
	github.com/davecgh/go-spew							 v1.1.0 \
	github.com/deckarep/golang-set/v2						 v2.6.0 \
	github.com/docker/docker							 v27.1.1+incompatible \
	github.com/gabriel-vasile/mimetype						 v1.4.5 \
	github.com/go-jose/go-jose/v3							 v3.0.3 \
	github.com/go-logr/logr								 v1.2.2 \
	github.com/go-logr/logr								 v1.2.4 \
	github.com/go-logr/logr								 v1.4.1 \
	github.com/go-ole/go-ole							 v1.2.6 \
	github.com/go-openapi/jsonpointer						 v0.19.5 \
	github.com/go-openapi/jsonreference						 v0.19.6 \
	github.com/go-openapi/jsonreference						 v0.20.0 \
	github.com/go-openapi/spec							 v0.20.4 \
	github.com/go-openapi/spec							 v0.20.6 \
	github.com/go-openapi/swag							 v0.19.15 \
	github.com/go-shiori/dom							 v0.0.0-20190930082056-9d974a4f8b25 \
	github.com/go-sql-driver/mysql							 v1.8.1 \
	github.com/gofrs/uuid/v5							 v5.3.0 \
	github.com/golang/protobuf							 v1.5.3 \
	github.com/google/go-cmp							 v0.5.9 \
	github.com/google/go-cmp							 v0.6.0 \
	github.com/klauspost/compress							 v1.17.4 \
	github.com/konsorten/go-windows-terminal-sequences				 v1.0.1 \
	github.com/kr/pretty								 v0.3.0 \
	github.com/lufia/plan9stats							 v0.0.0-20211012122336-39d0f177ccd0 \
	github.com/magiconair/properties						 v1.8.7 \
	github.com/mailru/easyjson							 v0.7.6 \
	github.com/mailru/easyjson							 v0.7.7 \
	github.com/mattn/go-colorable							 v0.1.13 \
	github.com/mattn/go-sqlite3							 v1.14.19 \
	github.com/mattn/go-sqlite3							 v1.14.22 \
	github.com/moby/sys/sequential							 v0.5.0 \
	github.com/moby/sys/user							 v0.1.0 \
	github.com/moby/term								 v0.5.0 \
	github.com/opencontainers/image-spec						 v1.0.2 \
	github.com/opencontainers/image-spec						 v1.1.0-rc5 \
	github.com/power-devops/perfstat						 v0.0.0-20210106213030-5aafc221ea8c \
	github.com/rogpeppe/go-internal							 v1.11.0 \
	github.com/rogpeppe/go-internal							 v1.8.1 \
	github.com/russross/blackfriday/v2						 v2.0.1 \
	github.com/shirou/gopsutil/v3							 v3.23.12 \
	github.com/sirupsen/logrus							 v1.4.2 \
	github.com/spf13/cobra								 v1.8.1 \
	github.com/stretchr/objx							 v0.1.0 \
	github.com/stretchr/objx							 v0.1.1 \
	github.com/stretchr/testify							 v1.2.2 \
	github.com/stretchr/testify							 v1.3.0 \
	github.com/stretchr/testify							 v1.7.0 \
	github.com/stretchr/testify							 v1.8.2 \
	github.com/stretchr/testify							 v1.8.4 \
	github.com/stretchr/testify							 v1.9.0 \
	github.com/swaggo/files/v2							 v2.0.0 \
	github.com/swaggo/swag								 v1.8.1 \
	github.com/tklauser/go-sysconf							 v0.3.12 \
	github.com/tklauser/numcpus							 v0.6.1 \
	github.com/tklauser/numcpus							 v0.8.0 \
	github.com/yuin/goldmark							 v1.1.27 \
	github.com/yuin/goldmark							 v1.2.1 \
	github.com/yusufpapurcu/wmi							 v1.2.3 \
	go.etcd.io/bbolt								 v1.3.3 \
	go.opentelemetry.io/contrib/detectors/gcp					 v1.29.0 \
	go.opentelemetry.io/contrib/instrumentation/net/http/otelhttp			 v0.49.0 \
	go.opentelemetry.io/contrib/instrumentation/net/http/otelhttp			 v0.54.0 \
	go.opentelemetry.io/otel							 v1.19.0 \
	go.opentelemetry.io/otel							 v1.24.0 \
	go.opentelemetry.io/otel							 v1.29.0 \
	go.opentelemetry.io/otel							 v1.31.0 \
	go.opentelemetry.io/otel							 v1.32.0 \
	go.opentelemetry.io/otel/metric							 v1.19.0 \
	go.opentelemetry.io/otel/metric							 v1.24.0 \
	go.opentelemetry.io/otel/metric							 v1.29.0 \
	go.opentelemetry.io/otel/metric							 v1.31.0 \
	go.opentelemetry.io/otel/sdk							 v1.19.0 \
	go.opentelemetry.io/otel/sdk							 v1.29.0 \
	go.opentelemetry.io/otel/sdk/metric						 v1.29.0 \
	go.opentelemetry.io/otel/trace							 v1.19.0 \
	go.opentelemetry.io/otel/trace							 v1.24.0 \
	go.opentelemetry.io/otel/trace							 v1.29.0 \
	go.opentelemetry.io/otel/trace							 v1.31.0 \
	go.opentelemetry.io/otel/trace							 v1.32.0 \
	golang.org/x/crypto								 v0.0.0-20190308221718-c2843e01d9a2 \
	golang.org/x/crypto								 v0.0.0-20191011191535-87dc89f01550 \
	golang.org/x/crypto								 v0.0.0-20200622213623-75b288015ac9 \
	golang.org/x/crypto								 v0.0.0-20210921155107-089bfa567519 \
	golang.org/x/crypto								 v0.13.0 \
	golang.org/x/crypto								 v0.19.0 \
	golang.org/x/crypto								 v0.23.0 \
	golang.org/x/crypto								 v0.31.0 \
	golang.org/x/crypto								 v0.32.0 \
	golang.org/x/exp								 v0.0.0-20230315142452-642cacee5cc0 \
	golang.org/x/image								 v0.0.0-20191009234506-e7c1f5e7dbb8 \
	golang.org/x/mod								 v0.12.0 \
	golang.org/x/mod								 v0.15.0 \
	golang.org/x/mod								 v0.17.0 \
	golang.org/x/mod								 v0.19.0 \
	golang.org/x/mod								 v0.2.0 \
	golang.org/x/mod								 v0.3.0 \
	golang.org/x/mod								 v0.6.0-dev.0.20220419223038-86c51ed26bb4 \
	golang.org/x/mod								 v0.8.0 \
	golang.org/x/net								 v0.0.0-20190404232315-eb5bcb51f2a3 \
	golang.org/x/net								 v0.0.0-20190620200207-3b0461eec859 \
	golang.org/x/net								 v0.0.0-20190926025831-c00fd9afed17 \
	golang.org/x/net								 v0.0.0-20200226121028-0de0cce0169b \
	golang.org/x/net								 v0.0.0-20201021035429-f5854403a974 \
	golang.org/x/net								 v0.0.0-20210226172049-e18ecbb05110 \
	golang.org/x/net								 v0.0.0-20220722155237-a158d28d115b \
	golang.org/x/net								 v0.10.0 \
	golang.org/x/net								 v0.12.0 \
	golang.org/x/net								 v0.15.0 \
	golang.org/x/net								 v0.21.0 \
	golang.org/x/net								 v0.23.0 \
	golang.org/x/net								 v0.25.0 \
	golang.org/x/net								 v0.27.0 \
	golang.org/x/net								 v0.30.0 \
	golang.org/x/net								 v0.33.0 \
	golang.org/x/net								 v0.35.0 \
	golang.org/x/net								 v0.6.0 \
	golang.org/x/oauth2								 v0.23.0 \
	golang.org/x/sync								 v0.0.0-20190423024810-112230192c58 \
	golang.org/x/sync								 v0.0.0-20190911185100-cd5d95a43a6e \
	golang.org/x/sync								 v0.0.0-20201020160332-67f06af15bc9 \
	golang.org/x/sync								 v0.0.0-20220722155255-886fb9371eb4 \
	golang.org/x/sync								 v0.1.0 \
	golang.org/x/sync								 v0.10.0 \
	golang.org/x/sync								 v0.3.0 \
	golang.org/x/sync								 v0.6.0 \
	golang.org/x/sync								 v0.7.0 \
	golang.org/x/sync								 v0.8.0 \
	golang.org/x/sys								 v0.0.0-20190215142949-d0b11bdaac8a \
	golang.org/x/sys								 v0.0.0-20190412213103-97732733099d \
	golang.org/x/sys								 v0.0.0-20190422165155-953cdadca894 \
	golang.org/x/sys								 v0.0.0-20190916202348-b4ddaad3f8a3 \
	golang.org/x/sys								 v0.0.0-20190927073244-c990c680b611 \
	golang.org/x/sys								 v0.0.0-20200930185726-fdedc70b468f \
	golang.org/x/sys								 v0.0.0-20201119102817-f84b799fce68 \
	golang.org/x/sys								 v0.0.0-20201204225414-ed752295db88 \
	golang.org/x/sys								 v0.0.0-20210615035016-665e8c7367d1 \
	golang.org/x/sys								 v0.0.0-20210616094352-59db8d763f22 \
	golang.org/x/sys								 v0.0.0-20220520151302-bc2c85ada10a \
	golang.org/x/sys								 v0.0.0-20220715151400-c0bba94af5f8 \
	golang.org/x/sys								 v0.0.0-20220722155257-8c9f86f7a55f \
	golang.org/x/sys								 v0.1.0 \
	golang.org/x/sys								 v0.10.0 \
	golang.org/x/sys								 v0.12.0 \
	golang.org/x/sys								 v0.17.0 \
	golang.org/x/sys								 v0.18.0 \
	golang.org/x/sys								 v0.19.0 \
	golang.org/x/sys								 v0.20.0 \
	golang.org/x/sys								 v0.25.0 \
	golang.org/x/sys								 v0.26.0 \
	golang.org/x/sys								 v0.28.0 \
	golang.org/x/sys								 v0.29.0 \
	golang.org/x/sys								 v0.5.0 \
	golang.org/x/sys								 v0.6.0 \
	golang.org/x/sys								 v0.7.0 \
	golang.org/x/sys								 v0.8.0 \
	golang.org/x/telemetry								 v0.0.0-20240228155512-f48c80bd79b2 \
	golang.org/x/term								 v0.0.0-20201126162022-7de9c90e9dd1 \
	golang.org/x/term								 v0.0.0-20210927222741-03fcf44c2211 \
	golang.org/x/term								 v0.12.0 \
	golang.org/x/term								 v0.17.0 \
	golang.org/x/term								 v0.20.0 \
	golang.org/x/term								 v0.27.0 \
	golang.org/x/term								 v0.5.0 \
	golang.org/x/term								 v0.8.0 \
	golang.org/x/text								 v0.11.0 \
	golang.org/x/text								 v0.13.0 \
	golang.org/x/text								 v0.14.0 \
	golang.org/x/text								 v0.15.0 \
	golang.org/x/text								 v0.19.0 \
	golang.org/x/text								 v0.21.0 \
	golang.org/x/text								 v0.3.0 \
	golang.org/x/text								 v0.3.3 \
	golang.org/x/text								 v0.3.7 \
	golang.org/x/text								 v0.7.0 \
	golang.org/x/text								 v0.9.0 \
	golang.org/x/tools								 v0.0.0-20180917221912-90fa682c2a6e \
	golang.org/x/tools								 v0.0.0-20191119224855-298f0cb1881e \
	golang.org/x/tools								 v0.0.0-20200619180055-7c47624df98f \
	golang.org/x/tools								 v0.0.0-20210106214847-113979e3529a \
	golang.org/x/tools								 v0.1.12 \
	golang.org/x/tools								 v0.11.0 \
	golang.org/x/tools								 v0.13.0 \
	golang.org/x/tools								 v0.21.1-0.20240508182429-e35e4ccd0d2d \
	golang.org/x/tools								 v0.23.0 \
	golang.org/x/tools								 v0.6.0 \
	golang.org/x/tools								 v0.7.0 \
	golang.org/x/xerrors								 v0.0.0-20190717185122-a985d3407aa7 \
	golang.org/x/xerrors								 v0.0.0-20191011141410-1b5146add898 \
	golang.org/x/xerrors								 v0.0.0-20191204190536-9bdfabe68543 \
	google.golang.org/genproto/googleapis/api					 v0.0.0-20230711160842-782d3b101e98 \
	google.golang.org/genproto/googleapis/api					 v0.0.0-20241015192408-796eee8c2d53 \
	google.golang.org/genproto/googleapis/rpc					 v0.0.0-20230711160842-782d3b101e98 \
	google.golang.org/genproto/googleapis/rpc					 v0.0.0-20241015192408-796eee8c2d53 \
	google.golang.org/genproto/googleapis/rpc					 v0.0.0-20241223144023-3abc09e42ca8 \
	google.golang.org/grpc								 v1.58.2 \
	google.golang.org/grpc								 v1.64.1 \
	google.golang.org/grpc								 v1.67.3 \
	google.golang.org/protobuf							 v1.31.0 \
	google.golang.org/protobuf							 v1.35.1 \
	gopkg.in/check.v1								 v0.0.0-20161208181325-20d25e280405 \
	gopkg.in/yaml.v3								 v3.0.0 \
	gopkg.in/yaml.v3								 v3.0.0-20200313102051-9f266ea9e77c \
	gopkg.in/yaml.v3								 v3.0.0-20210107192922-496545a6307b

