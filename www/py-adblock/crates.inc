MODCARGO_CRATES +=	adblock	0.5.6	# MPL-2.0
MODCARGO_CRATES +=	addr	0.14.0	# MIT/Apache-2.0
MODCARGO_CRATES +=	adler	1.0.2	# 0BSD OR MIT OR Apache-2.0
MODCARGO_CRATES +=	aho-corasick	0.7.18	# Unlicense/MIT
MODCARGO_CRATES +=	autocfg	1.1.0	# Apache-2.0 OR MIT
MODCARGO_CRATES +=	base64	0.13.0	# MIT/Apache-2.0
MODCARGO_CRATES +=	bitflags	1.3.2	# MIT/Apache-2.0
MODCARGO_CRATES +=	byteorder	1.4.3	# Unlicense OR MIT
MODCARGO_CRATES +=	cfg-if	1.0.0	# MIT/Apache-2.0
MODCARGO_CRATES +=	crc32fast	1.3.2	# MIT OR Apache-2.0
MODCARGO_CRATES +=	either	1.7.0	# MIT/Apache-2.0
MODCARGO_CRATES +=	flate2	1.0.24	# MIT OR Apache-2.0
MODCARGO_CRATES +=	form_urlencoded	1.0.1	# MIT/Apache-2.0
MODCARGO_CRATES +=	idna	0.2.3	# MIT/Apache-2.0
MODCARGO_CRATES +=	indoc	1.0.6	# MIT OR Apache-2.0
MODCARGO_CRATES +=	itertools	0.10.3	# MIT/Apache-2.0
MODCARGO_CRATES +=	libc	0.2.126	# MIT OR Apache-2.0
MODCARGO_CRATES +=	lock_api	0.4.7	# MIT OR Apache-2.0
MODCARGO_CRATES +=	matches	0.1.9	# MIT
MODCARGO_CRATES +=	memchr	2.5.0	# Unlicense/MIT
MODCARGO_CRATES +=	miniz_oxide	0.5.3	# MIT OR Zlib OR Apache-2.0
MODCARGO_CRATES +=	num-traits	0.2.15	# MIT OR Apache-2.0
MODCARGO_CRATES +=	once_cell	1.13.0	# MIT OR Apache-2.0
MODCARGO_CRATES +=	parking_lot	0.12.1	# MIT OR Apache-2.0
MODCARGO_CRATES +=	parking_lot_core	0.9.3	# MIT OR Apache-2.0
MODCARGO_CRATES +=	paste	1.0.7	# MIT OR Apache-2.0
MODCARGO_CRATES +=	percent-encoding	2.1.0	# MIT/Apache-2.0
MODCARGO_CRATES +=	proc-macro2	1.0.40	# MIT OR Apache-2.0
MODCARGO_CRATES +=	psl	2.0.90	# MIT/Apache-2.0
MODCARGO_CRATES +=	psl-types	2.0.10	# MIT/Apache-2.0
MODCARGO_CRATES +=	pyo3	0.16.5	# Apache-2.0
MODCARGO_CRATES +=	pyo3-build-config	0.16.5	# Apache-2.0
MODCARGO_CRATES +=	pyo3-ffi	0.16.5	# Apache-2.0
MODCARGO_CRATES +=	pyo3-macros	0.16.5	# Apache-2.0
MODCARGO_CRATES +=	pyo3-macros-backend	0.16.5	# Apache-2.0
MODCARGO_CRATES +=	quote	1.0.20	# MIT OR Apache-2.0
MODCARGO_CRATES +=	redox_syscall	0.2.13	# MIT
MODCARGO_CRATES +=	regex	1.6.0	# MIT OR Apache-2.0
MODCARGO_CRATES +=	regex-syntax	0.6.27	# MIT OR Apache-2.0
MODCARGO_CRATES +=	rmp	0.8.11	# MIT
MODCARGO_CRATES +=	rmp-serde	0.13.7	# MIT
MODCARGO_CRATES +=	rmp-serde	0.15.5	# MIT
MODCARGO_CRATES +=	scopeguard	1.1.0	# MIT/Apache-2.0
MODCARGO_CRATES +=	seahash	3.0.7	# MIT
MODCARGO_CRATES +=	serde	1.0.139	# MIT OR Apache-2.0
MODCARGO_CRATES +=	serde_derive	1.0.139	# MIT OR Apache-2.0
MODCARGO_CRATES +=	smallvec	1.9.0	# MIT OR Apache-2.0
MODCARGO_CRATES +=	syn	1.0.98	# MIT OR Apache-2.0
MODCARGO_CRATES +=	target-lexicon	0.12.4	# Apache-2.0 WITH LLVM-exception
MODCARGO_CRATES +=	tinyvec	1.6.0	# Zlib OR Apache-2.0 OR MIT
MODCARGO_CRATES +=	tinyvec_macros	0.1.0	# MIT OR Apache-2.0 OR Zlib
MODCARGO_CRATES +=	twoway	0.2.2	# MIT/Apache-2.0
MODCARGO_CRATES +=	unchecked-index	0.2.2	# MIT/Apache-2.0
MODCARGO_CRATES +=	unicode-bidi	0.3.8	# MIT OR Apache-2.0
MODCARGO_CRATES +=	unicode-ident	1.0.2	# (MIT OR Apache-2.0) AND Unicode-DFS-2016
MODCARGO_CRATES +=	unicode-normalization	0.1.21	# MIT/Apache-2.0
MODCARGO_CRATES +=	unindent	0.1.9	# MIT OR Apache-2.0
MODCARGO_CRATES +=	url	2.2.2	# MIT/Apache-2.0
MODCARGO_CRATES +=	windows-sys	0.36.1	# MIT OR Apache-2.0
MODCARGO_CRATES +=	windows_aarch64_msvc	0.36.1	# MIT OR Apache-2.0
MODCARGO_CRATES +=	windows_i686_gnu	0.36.1	# MIT OR Apache-2.0
MODCARGO_CRATES +=	windows_i686_msvc	0.36.1	# MIT OR Apache-2.0
MODCARGO_CRATES +=	windows_x86_64_gnu	0.36.1	# MIT OR Apache-2.0
MODCARGO_CRATES +=	windows_x86_64_msvc	0.36.1	# MIT OR Apache-2.0
