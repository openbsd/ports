MODGO_MODULES =	\
	github.com/!burnt!sushi/toml				 v1.1.0 \
	github.com/!scale!f!t/sshkeys				 v0.0.0-20200327173127-6142f742bca5 \
	github.com/alecthomas/template				 v0.0.0-20190718012654-fb15b899a751 \
	github.com/alecthomas/units				 v0.0.0-20190924025748-f65c72e2690d \
	github.com/beorn7/perks					 v1.0.1 \
	github.com/bytedance/sonic				 v1.9.1 \
	github.com/cespare/xxhash/v2				 v2.2.0 \
	github.com/chenzhuoyu/base64x				 v0.0.0-20221115062448-fe3a3abad311 \
	github.com/creack/pty					 v1.1.9 \
	github.com/davecgh/go-spew				 v1.1.1 \
	github.com/dchest/bcrypt_pbkdf				 v0.0.0-20150205184540-83f37f9c154a \
	github.com/gabriel-vasile/mimetype			 v1.4.2 \
	github.com/gin-contrib/sse				 v0.1.0 \
	github.com/gin-gonic/gin				 v1.9.1 \
	github.com/go-kit/log					 v0.2.1 \
	github.com/go-logfmt/logfmt				 v0.5.1 \
	github.com/go-playground/assert/v2			 v2.2.0 \
	github.com/go-playground/locales			 v0.14.1 \
	github.com/go-playground/universal-translator		 v0.18.1 \
	github.com/go-playground/validator/v10			 v10.14.0 \
	github.com/go-sql-driver/mysql				 v1.6.0 \
	github.com/goccy/go-json				 v0.10.2 \
	github.com/golang/protobuf				 v1.5.2 \
	github.com/google/go-cmp				 v0.5.8 \
	github.com/google/gofuzz				 v1.0.0 \
	github.com/jackc/pgpassfile				 v1.0.0 \
	github.com/jessevdk/go-flags				 v1.5.0 \
	github.com/jmoiron/sqlx					 v1.3.5 \
	github.com/jpillora/backoff				 v1.0.0 \
	github.com/json-iterator/go				 v1.1.12 \
	github.com/julienschmidt/httprouter			 v1.3.0 \
	github.com/klauspost/cpuid/v2				 v2.2.4 \
	github.com/kr/pretty					 v0.3.1 \
	github.com/kr/text					 v0.2.0 \
	github.com/leodido/go-urn				 v1.2.4 \
	github.com/lib/pq					 v1.10.5 \
	github.com/mattn/go-isatty				 v0.0.19 \
	github.com/mattn/go-sqlite3				 v1.14.6 \
	github.com/matttproud/golang_protobuf_extensions	 v1.0.4 \
	github.com/mitchellh/go-homedir				 v1.1.0 \
	github.com/modern-go/concurrent				 v0.0.0-20180306012644-bacd9c7ef1dd \
	github.com/modern-go/reflect2				 v1.0.2 \
	github.com/mr-tron/base58				 v1.2.0 \
	github.com/mwitkow/go-conntrack				 v0.0.0-20190716064945-2f068394615f \
	github.com/pelletier/go-toml/v2				 v2.0.8 \
	github.com/pkg/diff					 v0.0.0-20210226163009-20ebb0f2a09e \
	github.com/pmezard/go-difflib				 v1.0.0 \
	github.com/prometheus/client_golang			 v1.14.0 \
	github.com/prometheus/client_model			 v0.3.0 \
	github.com/prometheus/common				 v0.39.0 \
	github.com/prometheus/procfs				 v0.8.0 \
	github.com/rogpeppe/go-internal				 v1.9.0 \
	github.com/sirupsen/logrus				 v1.9.0 \
	github.com/stretchr/objx				 v0.5.0 \
	github.com/stretchr/testify				 v1.8.3 \
	github.com/tuvistavie/securerandom			 v0.0.0-20140719024926-15512123a948 \
	github.com/twitchyliquid64/golang-asm			 v0.15.1 \
	github.com/ugorji/go/codec				 v1.2.11 \
	golang.org/x/arch					 v0.3.0 \
	golang.org/x/crypto					 v0.45.0 \
	golang.org/x/mod					 v0.29.0 \
	golang.org/x/net					 v0.47.0 \
	golang.org/x/oauth2					 v0.3.0 \
	golang.org/x/sync					 v0.18.0 \
	golang.org/x/sys					 v0.38.0 \
	golang.org/x/term					 v0.37.0 \
	golang.org/x/text					 v0.31.0 \
	golang.org/x/tools					 v0.38.0 \
	golang.org/x/xerrors					 v0.0.0-20191204190536-9bdfabe68543 \
	google.golang.org/appengine				 v1.6.7 \
	google.golang.org/protobuf				 v1.30.0 \
	gopkg.in/alecthomas/kingpin.v2				 v2.2.6 \
	gopkg.in/check.v1					 v1.0.0-20201130134442-10cb98267c6c \
	gopkg.in/yaml.v2					 v2.4.0 \
	gopkg.in/yaml.v3					 v3.0.1 \
	rsc.io/pdf						 v0.1.1

MODGO_MODFILES =	\
	github.com/bytedance/sonic				 v1.5.0 \
	github.com/cespare/xxhash/v2				 v2.1.2 \
	github.com/chenzhuoyu/base64x				 v0.0.0-20211019084208-fb5309c8db06 \
	github.com/davecgh/go-spew				 v1.1.0 \
	github.com/golang/protobuf				 v1.2.0 \
	github.com/golang/protobuf				 v1.3.5 \
	github.com/golang/protobuf				 v1.5.0 \
	github.com/google/go-cmp				 v0.5.5 \
	github.com/klauspost/cpuid/v2				 v2.0.9 \
	github.com/lib/pq					 v1.2.0 \
	github.com/matttproud/golang_protobuf_extensions	 v1.0.1 \
	github.com/modern-go/concurrent				 v0.0.0-20180228061459-e0a39a4cb421 \
	github.com/prometheus/common				 v0.37.0 \
	github.com/stretchr/objx				 v0.1.0 \
	github.com/stretchr/objx				 v0.4.0 \
	github.com/stretchr/testify				 v1.3.0 \
	github.com/stretchr/testify				 v1.5.1 \
	github.com/stretchr/testify				 v1.7.0 \
	github.com/stretchr/testify				 v1.7.1 \
	github.com/stretchr/testify				 v1.8.0 \
	github.com/stretchr/testify				 v1.8.1 \
	github.com/stretchr/testify				 v1.8.2 \
	golang.org/x/arch					 v0.0.0-20210923205945-b76863e36670 \
	golang.org/x/crypto					 v0.0.0-20190308221718-c2843e01d9a2 \
	golang.org/x/crypto					 v0.0.0-20200323165209-0ec3e9974c59 \
	golang.org/x/crypto					 v0.44.0 \
	golang.org/x/crypto					 v0.7.0 \
	golang.org/x/crypto					 v0.9.0 \
	golang.org/x/net					 v0.0.0-20190404232315-eb5bcb51f2a3 \
	golang.org/x/net					 v0.0.0-20220225172249-27dd8689420f \
	golang.org/x/net					 v0.10.0 \
	golang.org/x/net					 v0.4.0 \
	golang.org/x/net					 v0.8.0 \
	golang.org/x/oauth2					 v0.0.0-20220223155221-ee480838109b \
	golang.org/x/sync					 v0.0.0-20181221193216-37e7f081c4d4 \
	golang.org/x/sync					 v0.0.0-20220601150217-0de741cfad7f \
	golang.org/x/sys					 v0.0.0-20190215142949-d0b11bdaac8a \
	golang.org/x/sys					 v0.0.0-20190412213103-97732733099d \
	golang.org/x/sys					 v0.0.0-20200219091948-cb0a6d8edb6c \
	golang.org/x/sys					 v0.0.0-20210320140829-1e4c9ba3b0c4 \
	golang.org/x/sys					 v0.0.0-20220520151302-bc2c85ada10a \
	golang.org/x/sys					 v0.0.0-20220704084225-05e143d24a9e \
	golang.org/x/sys					 v0.0.0-20220715151400-c0bba94af5f8 \
	golang.org/x/sys					 v0.3.0 \
	golang.org/x/sys					 v0.6.0 \
	golang.org/x/sys					 v0.8.0 \
	golang.org/x/text					 v0.3.0 \
	golang.org/x/text					 v0.3.7 \
	golang.org/x/text					 v0.3.8 \
	golang.org/x/text					 v0.5.0 \
	golang.org/x/text					 v0.8.0 \
	golang.org/x/text					 v0.9.0 \
	google.golang.org/appengine				 v1.6.6 \
	google.golang.org/protobuf				 v1.26.0 \
	google.golang.org/protobuf				 v1.26.0-rc.1 \
	google.golang.org/protobuf				 v1.28.1 \
	gopkg.in/check.v1					 v0.0.0-20161208181325-20d25e280405 \
	gopkg.in/yaml.v2					 v2.2.2 \
	gopkg.in/yaml.v3					 v3.0.0-20200313102051-9f266ea9e77c

