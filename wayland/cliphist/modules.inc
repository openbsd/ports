MODGO_MODULES =	\
	github.com/davecgh/go-spew	 v1.1.1 \
	github.com/google/go-cmp	 v0.6.0 \
	github.com/pmezard/go-difflib	 v1.0.0 \
	github.com/rivo/uniseg		 v0.4.7 \
	github.com/rogpeppe/go-internal	 v1.12.0 \
	github.com/stretchr/testify	 v1.8.1 \
	github.com/yuin/goldmark	 v1.4.13 \
	go.etcd.io/bbolt		 v1.3.9 \
	go.etcd.io/gofail		 v0.1.0 \
	go.senan.xyz/flagconf		 v0.1.9 \
	golang.org/x/image		 v0.21.0 \
	golang.org/x/mod		 v0.20.0 \
	golang.org/x/net		 v0.28.0 \
	golang.org/x/sync		 v0.8.0 \
	golang.org/x/sys		 v0.26.0 \
	golang.org/x/telemetry		 v0.0.0-20240521205824-bda55230c457 \
	golang.org/x/text		 v0.19.0 \
	golang.org/x/tools		 v0.24.0 \
	gopkg.in/yaml.v3		 v3.0.1

MODGO_MODFILES =	\
	golang.org/x/mod	 v0.9.0 \
	golang.org/x/sync	 v0.5.0 \
	golang.org/x/sys	 v0.0.0-20220722155257-8c9f86f7a55f \
	golang.org/x/sys	 v0.19.0 \
	golang.org/x/sys	 v0.23.0 \
	golang.org/x/sys	 v0.4.0 \
	golang.org/x/tools	 v0.1.12 \
	golang.org/x/tools	 v0.20.0

