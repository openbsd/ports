MODGO_MODULES =	\
	github.com/!burnt!sushi/toml			 v1.3.2 \
	github.com/briandowns/spinner			 v1.23.1 \
	github.com/cpuguy83/go-md2man/v2		 v2.0.4 \
	github.com/fatih/color				 v1.17.0 \
	github.com/gocarina/gocsv			 v0.0.0-20240520201108-78e41c74b4b1 \
	github.com/google/uuid				 v1.6.0 \
	github.com/mattn/go-colorable			 v0.1.13 \
	github.com/mattn/go-isatty			 v0.0.20 \
	github.com/prometheus-community/pro-bing	 v0.8.0 \
	github.com/russross/blackfriday/v2		 v2.1.0 \
	github.com/urfave/cli/v2			 v2.27.4 \
	github.com/xrash/smetrics			 v0.0.0-20240521201337-686a1a2994c1 \
	golang.org/x/crypto				 v0.47.0 \
	golang.org/x/net				 v0.49.0 \
	golang.org/x/sync				 v0.19.0 \
	golang.org/x/sys				 v0.40.0 \
	golang.org/x/term				 v0.39.0 \
	golang.org/x/text				 v0.33.0 \
	gopkg.in/yaml.v3				 v3.0.1

MODGO_MODFILES =	\
	github.com/fatih/color		 v1.7.0 \
	github.com/mattn/go-colorable	 v0.1.2 \
	github.com/mattn/go-isatty	 v0.0.16 \
	github.com/mattn/go-isatty	 v0.0.8 \
	golang.org/x/sys		 v0.0.0-20220412211240-33da011f77ad \
	golang.org/x/sys		 v0.0.0-20220811171246-fbc7d0a398ab \
	golang.org/x/sys		 v0.18.0 \
	golang.org/x/sys		 v0.6.0 \
	golang.org/x/term		 v0.1.0

