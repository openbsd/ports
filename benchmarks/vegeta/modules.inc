MODGO_MODULES =	\
	cloud.google.com/go/auth							 v0.5.1 \
	cloud.google.com/go/auth/oauth2adapt						 v0.2.2 \
	cloud.google.com/go/compute/metadata						 v0.3.0 \
	github.com/!azure!a!d/microsoft-authentication-library-for-go			 v1.2.2 \
	github.com/!azure/azure-sdk-for-go/sdk/azcore					 v1.11.1 \
	github.com/!azure/azure-sdk-for-go/sdk/azidentity				 v1.5.2 \
	github.com/!azure/azure-sdk-for-go/sdk/internal					 v1.6.0 \
	github.com/!azure/azure-sdk-for-go/sdk/resourcemanager/compute/armcompute/v5	 v5.7.0 \
	github.com/!azure/azure-sdk-for-go/sdk/resourcemanager/network/armnetwork/v4	 v4.3.0 \
	github.com/!code-!hex/go-generics-cache						 v1.5.1 \
	github.com/!kim!machine!gun/automemlimit					 v0.6.1 \
	github.com/!microsoft/go-winio							 v0.6.1 \
	github.com/alecthomas/jsonschema						 v0.0.0-20220216202328-9eeeec9d044b \
	github.com/alecthomas/kingpin/v2						 v2.4.0 \
	github.com/alecthomas/units							 v0.0.0-20231202071711-9a357b53e9c9 \
	github.com/armon/go-metrics							 v0.4.1 \
	github.com/asaskevich/govalidator						 v0.0.0-20230301143203-a9d515a09cc2 \
	github.com/aws/aws-sdk-go							 v1.53.16 \
	github.com/bboreham/go-loser							 v0.0.0-20230920113527-fcc2c21820a3 \
	github.com/beorn7/perks								 v1.0.1 \
	github.com/bmizerany/perks							 v0.0.0-20230307044200-03f9df79da1e \
	github.com/c2h5oh/datasize							 v0.0.0-20231215233829-aa82cc1e6500 \
	github.com/cenkalti/backoff/v4							 v4.3.0 \
	github.com/cespare/xxhash/v2							 v2.3.0 \
	github.com/cilium/ebpf								 v0.11.0 \
	github.com/cncf/xds/go								 v0.0.0-20240318125728-8a4994d93e50 \
	github.com/containerd/cgroups/v3						 v3.0.3 \
	github.com/containerd/log							 v0.1.0 \
	github.com/coreos/go-systemd/v22						 v22.5.0 \
	github.com/davecgh/go-spew							 v1.1.2-0.20180830191138-d8f796af33cc \
	github.com/dennwc/varint							 v1.0.0 \
	github.com/dgryski/go-gk							 v0.0.0-20200319235926-a69029f61654 \
	github.com/dgryski/go-lttb							 v0.0.0-20230207170358-f8fc36cdbff1 \
	github.com/digitalocean/godo							 v1.117.0 \
	github.com/distribution/reference						 v0.5.0 \
	github.com/docker/docker							 v26.1.3+incompatible \
	github.com/docker/go-connections						 v0.4.0 \
	github.com/docker/go-units							 v0.5.0 \
	github.com/edsrzf/mmap-go							 v1.1.0 \
	github.com/emicklei/go-restful/v3						 v3.11.0 \
	github.com/envoyproxy/go-control-plane						 v0.12.0 \
	github.com/envoyproxy/protoc-gen-validate					 v1.0.4 \
	github.com/evanphx/json-patch							 v5.6.0+incompatible \
	github.com/facette/natsort							 v0.0.0-20181210072756-2cd4dd1e2dcb \
	github.com/fatih/color								 v1.16.0 \
	github.com/felixge/httpsnoop							 v1.0.4 \
	github.com/fsnotify/fsnotify							 v1.7.0 \
	github.com/ghodss/yaml								 v1.0.0 \
	github.com/go-kit/kit								 v0.12.0 \
	github.com/go-kit/log								 v0.2.1 \
	github.com/go-logfmt/logfmt							 v0.6.0 \
	github.com/go-logr/logr								 v1.4.1 \
	github.com/go-logr/stdr								 v1.2.2 \
	github.com/go-openapi/analysis							 v0.22.2 \
	github.com/go-openapi/errors							 v0.22.0 \
	github.com/go-openapi/jsonpointer						 v0.20.2 \
	github.com/go-openapi/jsonreference						 v0.20.4 \
	github.com/go-openapi/loads							 v0.21.5 \
	github.com/go-openapi/spec							 v0.20.14 \
	github.com/go-openapi/strfmt							 v0.23.0 \
	github.com/go-openapi/swag							 v0.22.9 \
	github.com/go-openapi/validate							 v0.23.0 \
	github.com/go-resty/resty/v2							 v2.13.1 \
	github.com/go-zookeeper/zk							 v1.0.3 \
	github.com/godbus/dbus/v5							 v5.0.4 \
	github.com/gogo/protobuf							 v1.3.2 \
	github.com/golang-jwt/jwt/v5							 v5.2.1 \
	github.com/golang/glog								 v1.2.0 \
	github.com/golang/groupcache							 v0.0.0-20210331224755-41bb18bfe9da \
	github.com/golang/protobuf							 v1.5.4 \
	github.com/golang/snappy							 v0.0.4 \
	github.com/google/gnostic-models						 v0.6.8 \
	github.com/google/go-cmp							 v0.6.0 \
	github.com/google/go-querystring						 v1.1.0 \
	github.com/google/gofuzz							 v1.2.0 \
	github.com/google/pprof								 v0.0.0-20240528025155-186aa0362fba \
	github.com/google/s2a-go							 v0.1.7 \
	github.com/google/uuid								 v1.6.0 \
	github.com/googleapis/enterprise-certificate-proxy				 v0.3.2 \
	github.com/googleapis/gax-go/v2							 v2.12.4 \
	github.com/gophercloud/gophercloud						 v1.12.0 \
	github.com/gorilla/websocket							 v1.5.0 \
	github.com/grafana/regexp							 v0.0.0-20240518133315-a468a5bfb3bc \
	github.com/grpc-ecosystem/grpc-gateway						 v1.16.0 \
	github.com/grpc-ecosystem/grpc-gateway/v2					 v2.20.0 \
	github.com/hashicorp/consul/api							 v1.29.1 \
	github.com/hashicorp/cronexpr							 v1.1.2 \
	github.com/hashicorp/errwrap							 v1.1.0 \
	github.com/hashicorp/go-cleanhttp						 v0.5.2 \
	github.com/hashicorp/go-hclog							 v1.5.0 \
	github.com/hashicorp/go-immutable-radix						 v1.3.1 \
	github.com/hashicorp/go-multierror						 v1.1.1 \
	github.com/hashicorp/go-retryablehttp						 v0.7.4 \
	github.com/hashicorp/go-rootcerts						 v1.0.2 \
	github.com/hashicorp/golang-lru							 v0.6.0 \
	github.com/hashicorp/nomad/api							 v0.0.0-20240604134157-e73d8bb1140d \
	github.com/hashicorp/serf							 v0.10.1 \
	github.com/hetznercloud/hcloud-go/v2						 v2.9.0 \
	github.com/iancoleman/orderedmap						 v0.3.0 \
	github.com/imdario/mergo							 v0.3.16 \
	github.com/influxdata/tdigest							 v0.0.1 \
	github.com/ionos-cloud/sdk-go/v6						 v6.1.11 \
	github.com/jmespath/go-jmespath							 v0.4.0 \
	github.com/josharian/intern							 v1.0.0 \
	github.com/jpillora/backoff							 v1.0.0 \
	github.com/json-iterator/go							 v1.1.12 \
	github.com/julienschmidt/httprouter						 v1.3.0 \
	github.com/kisielk/errcheck							 v1.5.0 \
	github.com/kisielk/gotool							 v1.0.0 \
	github.com/klauspost/compress							 v1.17.8 \
	github.com/kolo/xmlrpc								 v0.0.0-20220921171641-a4b6fa1dd06b \
	github.com/kr/pretty								 v0.3.1 \
	github.com/kylelemons/godebug							 v1.1.0 \
	github.com/linode/linodego							 v1.35.0 \
	github.com/mailru/easyjson							 v0.7.7 \
	github.com/mattn/go-colorable							 v0.1.13 \
	github.com/mattn/go-isatty							 v0.0.20 \
	github.com/matttproud/golang_protobuf_extensions				 v1.0.4 \
	github.com/miekg/dns								 v1.1.61 \
	github.com/mitchellh/go-homedir							 v1.1.0 \
	github.com/mitchellh/mapstructure						 v1.5.0 \
	github.com/moby/docker-image-spec						 v1.3.1 \
	github.com/moby/term								 v0.0.0-20210619224110-3f7ff695adc6 \
	github.com/modern-go/concurrent							 v0.0.0-20180306012644-bacd9c7ef1dd \
	github.com/modern-go/reflect2							 v1.0.2 \
	github.com/morikuni/aec								 v1.0.0 \
	github.com/munnerz/goautoneg							 v0.0.0-20191010083416-a7dc8b61c822 \
	github.com/mwitkow/go-conntrack							 v0.0.0-20190716064945-2f068394615f \
	github.com/nsf/jsondiff								 v0.0.0-20230430225905-43f6cf3098c1 \
	github.com/oklog/run								 v1.1.0 \
	github.com/oklog/ulid								 v1.3.1 \
	github.com/opencontainers/go-digest						 v1.0.0 \
	github.com/opencontainers/image-spec						 v1.0.2 \
	github.com/opencontainers/runtime-spec						 v1.0.2 \
	github.com/ovh/go-ovh								 v1.5.1 \
	github.com/pbnjay/memory							 v0.0.0-20210728143218-7b4eea64cf58 \
	github.com/pkg/browser								 v0.0.0-20240102092130-5ac0b6a4141c \
	github.com/pkg/errors								 v0.9.1 \
	github.com/pmezard/go-difflib							 v1.0.1-0.20181226105442-5d4384ee4fb2 \
	github.com/prometheus/alertmanager						 v0.27.0 \
	github.com/prometheus/client_golang						 v1.19.1 \
	github.com/prometheus/client_model						 v0.6.1 \
	github.com/prometheus/common							 v0.55.0 \
	github.com/prometheus/common/assets						 v0.2.0 \
	github.com/prometheus/common/sigv4						 v0.1.0 \
	github.com/prometheus/exporter-toolkit						 v0.11.0 \
	github.com/prometheus/procfs							 v0.15.1 \
	github.com/prometheus/prometheus						 v0.53.1 \
	github.com/rogpeppe/go-internal							 v1.10.0 \
	github.com/rs/dnscache								 v0.0.0-20230804202142-fc85eb664529 \
	github.com/scaleway/scaleway-sdk-go						 v1.0.0-beta.27 \
	github.com/shurcoo!l/httpfs							 v0.0.0-20230704072500-f1e31cf0ba5c \
	github.com/sirupsen/logrus							 v1.9.3 \
	github.com/spf13/pflag								 v1.0.5 \
	github.com/streadway/quantile							 v0.0.0-20220407130108-4246515d968d \
	github.com/stretchr/objx							 v0.5.2 \
	github.com/stretchr/testify							 v1.9.0 \
	github.com/tsenart/go-tsz							 v0.0.0-20180814235614-0bd30b3df1c3 \
	github.com/vultr/govultr/v2							 v2.17.2 \
	github.com/xhit/go-str2duration/v2						 v2.1.0 \
	github.com/yuin/goldmark							 v1.4.13 \
	go.mongodb.org/mongo-driver							 v1.14.0 \
	go.opencensus.io								 v0.24.0 \
	go.opentelemetry.io/collector/pdata						 v1.8.0 \
	go.opentelemetry.io/collector/semconv						 v0.101.0 \
	go.opentelemetry.io/contrib/instrumentation/net/http/otelhttp			 v0.52.0 \
	go.opentelemetry.io/otel							 v1.27.0 \
	go.opentelemetry.io/otel/exporters/otlp/otlptrace				 v1.27.0 \
	go.opentelemetry.io/otel/exporters/otlp/otlptrace/otlptracegrpc			 v1.27.0 \
	go.opentelemetry.io/otel/exporters/otlp/otlptrace/otlptracehttp			 v1.27.0 \
	go.opentelemetry.io/otel/metric							 v1.27.0 \
	go.opentelemetry.io/otel/sdk							 v1.27.0 \
	go.opentelemetry.io/otel/trace							 v1.27.0 \
	go.opentelemetry.io/proto/otlp							 v1.2.0 \
	go.uber.org/atomic								 v1.11.0 \
	go.uber.org/automaxprocs							 v1.5.3 \
	go.uber.org/goleak								 v1.3.0 \
	go.uber.org/multierr								 v1.11.0 \
	golang.org/x/crypto								 v0.25.0 \
	golang.org/x/exp								 v0.0.0-20240119083558-1b970713d09a \
	golang.org/x/mod								 v0.19.0 \
	golang.org/x/net								 v0.27.0 \
	golang.org/x/oauth2								 v0.21.0 \
	golang.org/x/sync								 v0.7.0 \
	golang.org/x/sys								 v0.22.0 \
	golang.org/x/telemetry								 v0.0.0-20240521205824-bda55230c457 \
	golang.org/x/term								 v0.22.0 \
	golang.org/x/text								 v0.16.0 \
	golang.org/x/time								 v0.5.0 \
	golang.org/x/tools								 v0.23.0 \
	golang.org/x/xerrors								 v0.0.0-20200804184101-5ec99f83aff1 \
	gonum.org/v1/gonum								 v0.0.0-20181121035319-3f7ecaa7e8ca \
	gonum.org/v1/netlib								 v0.0.0-20181029234149-ec6d1f5cefe6 \
	google.golang.org/api								 v0.183.0 \
	google.golang.org/appengine							 v1.6.7 \
	google.golang.org/genproto/googleapis/api					 v0.0.0-20240528184218-531527333157 \
	google.golang.org/genproto/googleapis/rpc					 v0.0.0-20240528184218-531527333157 \
	google.golang.org/grpc								 v1.64.0 \
	google.golang.org/protobuf							 v1.34.2 \
	gopkg.in/check.v1								 v1.0.0-20201130134442-10cb98267c6c \
	gopkg.in/inf.v0									 v0.9.1 \
	gopkg.in/ini.v1									 v1.67.0 \
	gopkg.in/yaml.v2								 v2.4.0 \
	gopkg.in/yaml.v3								 v3.0.1 \
	gotest.tools/v3									 v3.0.3 \
	k8s.io/api									 v0.29.3 \
	k8s.io/apimachinery								 v0.29.3 \
	k8s.io/client-go								 v0.29.3 \
	k8s.io/klog									 v1.0.0 \
	k8s.io/klog/v2									 v2.120.1 \
	k8s.io/kube-openapi								 v0.0.0-20240228011516-70dd3763d340 \
	k8s.io/utils									 v0.0.0-20230726121419-3b25d923346b \
	pgregory.net/rapid								 v1.1.0 \
	sigs.k8s.io/json								 v0.0.0-20221116044647-bc3834ca7abd \
	sigs.k8s.io/structured-merge-diff/v4						 v4.4.1 \
	sigs.k8s.io/yaml								 v1.3.0

MODGO_MODFILES =	\
	github.com/alecthomas/units		 v0.0.0-20211218093645-b94a6e3cc137 \
	github.com/cespare/xxhash/v2		 v2.2.0 \
	github.com/davecgh/go-spew		 v1.1.0 \
	github.com/davecgh/go-spew		 v1.1.1 \
	github.com/go-logfmt/logfmt		 v0.5.1 \
	github.com/golang/protobuf		 v1.2.0 \
	github.com/golang/protobuf		 v1.5.0 \
	github.com/golang/protobuf		 v1.5.3 \
	github.com/google/go-cmp		 v0.2.0 \
	github.com/google/go-cmp		 v0.5.5 \
	github.com/google/go-cmp		 v0.5.8 \
	github.com/iancoleman/orderedmap	 v0.0.0-20190318233801-ac98e3ecb4b0 \
	github.com/miekg/dns			 v1.1.59 \
	github.com/pmezard/go-difflib		 v1.0.0 \
	github.com/prometheus/client_model	 v0.5.0 \
	github.com/prometheus/common		 v0.48.0 \
	github.com/prometheus/common		 v0.54.0 \
	github.com/prometheus/procfs		 v0.12.0 \
	github.com/stretchr/objx		 v0.1.0 \
	github.com/stretchr/testify		 v1.3.1-0.20190311161405-34c6fa2dc709 \
	github.com/yuin/goldmark		 v1.1.27 \
	github.com/yuin/goldmark		 v1.2.1 \
	golang.org/x/crypto			 v0.0.0-20190308221718-c2843e01d9a2 \
	golang.org/x/crypto			 v0.0.0-20191011191535-87dc89f01550 \
	golang.org/x/crypto			 v0.0.0-20200622213623-75b288015ac9 \
	golang.org/x/crypto			 v0.24.0 \
	golang.org/x/exp			 v0.0.0-20180321215751-8460e604b9de \
	golang.org/x/exp			 v0.0.0-20220927162542-c76eaa363f9d \
	golang.org/x/mod			 v0.14.0 \
	golang.org/x/mod			 v0.17.0 \
	golang.org/x/mod			 v0.18.0 \
	golang.org/x/mod			 v0.2.0 \
	golang.org/x/mod			 v0.3.0 \
	golang.org/x/net			 v0.0.0-20190404232315-eb5bcb51f2a3 \
	golang.org/x/net			 v0.0.0-20190620200207-3b0461eec859 \
	golang.org/x/net			 v0.0.0-20200226121028-0de0cce0169b \
	golang.org/x/net			 v0.0.0-20201021035429-f5854403a974 \
	golang.org/x/net			 v0.20.0 \
	golang.org/x/net			 v0.26.0 \
	golang.org/x/oauth2			 v0.16.0 \
	golang.org/x/sync			 v0.0.0-20181221193216-37e7f081c4d4 \
	golang.org/x/sync			 v0.0.0-20190423024810-112230192c58 \
	golang.org/x/sync			 v0.0.0-20190911185100-cd5d95a43a6e \
	golang.org/x/sync			 v0.0.0-20201020160332-67f06af15bc9 \
	golang.org/x/sys			 v0.0.0-20190215142949-d0b11bdaac8a \
	golang.org/x/sys			 v0.0.0-20190412213103-97732733099d \
	golang.org/x/sys			 v0.0.0-20200930185726-fdedc70b468f \
	golang.org/x/sys			 v0.17.0 \
	golang.org/x/sys			 v0.20.0 \
	golang.org/x/sys			 v0.21.0 \
	golang.org/x/term			 v0.21.0 \
	golang.org/x/text			 v0.14.0 \
	golang.org/x/text			 v0.3.0 \
	golang.org/x/text			 v0.3.3 \
	golang.org/x/tools			 v0.0.0-20180525024113-a5b4c53f6e8b \
	golang.org/x/tools			 v0.0.0-20180917221912-90fa682c2a6e \
	golang.org/x/tools			 v0.0.0-20191119224855-298f0cb1881e \
	golang.org/x/tools			 v0.0.0-20200619180055-7c47624df98f \
	golang.org/x/tools			 v0.0.0-20210106214847-113979e3529a \
	golang.org/x/tools			 v0.13.0 \
	golang.org/x/tools			 v0.17.0 \
	golang.org/x/tools			 v0.21.1-0.20240508182429-e35e4ccd0d2d \
	golang.org/x/tools			 v0.22.0 \
	golang.org/x/xerrors			 v0.0.0-20190717185122-a985d3407aa7 \
	golang.org/x/xerrors			 v0.0.0-20191011141410-1b5146add898 \
	golang.org/x/xerrors			 v0.0.0-20191204190536-9bdfabe68543 \
	google.golang.org/protobuf		 v1.33.0 \
	google.golang.org/protobuf		 v1.34.1

