MODCARGO_CRATES +=	addr2line	0.21.0	# Apache-2.0 OR MIT
MODCARGO_CRATES +=	adler	1.0.2	# 0BSD OR MIT OR Apache-2.0
MODCARGO_CRATES +=	aho-corasick	1.1.3	# Unlicense OR MIT
MODCARGO_CRATES +=	anstream	0.6.13	# MIT OR Apache-2.0
MODCARGO_CRATES +=	anstyle	1.0.6	# MIT OR Apache-2.0
MODCARGO_CRATES +=	anstyle-parse	0.2.3	# MIT OR Apache-2.0
MODCARGO_CRATES +=	anstyle-query	1.0.2	# MIT OR Apache-2.0
MODCARGO_CRATES +=	anstyle-wincon	3.0.2	# MIT OR Apache-2.0
MODCARGO_CRATES +=	anyhow	1.0.82	# MIT OR Apache-2.0
MODCARGO_CRATES +=	askama	0.12.1	# MIT OR Apache-2.0
MODCARGO_CRATES +=	askama_derive	0.12.5	# MIT/Apache-2.0
MODCARGO_CRATES +=	askama_escape	0.10.3	# MIT OR Apache-2.0
MODCARGO_CRATES +=	askama_parser	0.2.1	# MIT OR Apache-2.0
MODCARGO_CRATES +=	asn1-rs	0.5.2	# MIT/Apache-2.0
MODCARGO_CRATES +=	asn1-rs-derive	0.4.0	# MIT/Apache-2.0
MODCARGO_CRATES +=	asn1-rs-impl	0.1.0	# MIT/Apache-2.0
MODCARGO_CRATES +=	async-trait	0.1.80	# MIT OR Apache-2.0
MODCARGO_CRATES +=	autocfg	1.2.0	# Apache-2.0 OR MIT
MODCARGO_CRATES +=	backtrace	0.3.71	# MIT OR Apache-2.0
MODCARGO_CRATES +=	base16	0.2.1	# CC0-1.0
MODCARGO_CRATES +=	base64	0.13.1	# MIT/Apache-2.0
MODCARGO_CRATES +=	base64	0.22.0	# MIT OR Apache-2.0
MODCARGO_CRATES +=	basic-toml	0.1.9	# MIT OR Apache-2.0
MODCARGO_CRATES +=	bincode	1.3.3	# MIT
MODCARGO_CRATES +=	bitflags	1.3.2	# MIT/Apache-2.0
MODCARGO_CRATES +=	bitflags	2.5.0	# MIT OR Apache-2.0
MODCARGO_CRATES +=	bitmaps	2.1.0	# MPL-2.0+
MODCARGO_CRATES +=	block-buffer	0.10.4	# MIT OR Apache-2.0
MODCARGO_CRATES +=	bstr	1.9.1	# MIT OR Apache-2.0
MODCARGO_CRATES +=	bumpalo	3.15.4	# MIT OR Apache-2.0
MODCARGO_CRATES +=	bytes	1.6.0	# MIT
MODCARGO_CRATES +=	camino	1.1.6	# MIT OR Apache-2.0
MODCARGO_CRATES +=	capnp	0.14.11	# MIT
MODCARGO_CRATES +=	capnpc	0.14.9	# MIT
MODCARGO_CRATES +=	cc	1.0.90	# MIT OR Apache-2.0
MODCARGO_CRATES +=	cfg-if	1.0.0	# MIT/Apache-2.0
MODCARGO_CRATES +=	cfg_aliases	0.1.1	# MIT
MODCARGO_CRATES +=	clap	4.5.4	# MIT OR Apache-2.0
MODCARGO_CRATES +=	clap_builder	4.5.2	# MIT OR Apache-2.0
MODCARGO_CRATES +=	clap_derive	4.5.4	# MIT OR Apache-2.0
MODCARGO_CRATES +=	clap_lex	0.7.0	# MIT OR Apache-2.0
MODCARGO_CRATES +=	codespan-reporting	0.11.1	# Apache-2.0
MODCARGO_CRATES +=	colorchoice	1.0.0	# MIT OR Apache-2.0
MODCARGO_CRATES +=	combine	4.6.6	# MIT
MODCARGO_CRATES +=	console	0.15.8	# MIT
MODCARGO_CRATES +=	console_error_panic_hook	0.1.7	# Apache-2.0/MIT
MODCARGO_CRATES +=	cpufeatures	0.2.12	# MIT OR Apache-2.0
MODCARGO_CRATES +=	crc32fast	1.4.0	# MIT OR Apache-2.0
MODCARGO_CRATES +=	crossbeam-channel	0.5.12	# MIT OR Apache-2.0
MODCARGO_CRATES +=	crossbeam-deque	0.8.5	# MIT OR Apache-2.0
MODCARGO_CRATES +=	crossbeam-epoch	0.9.18	# MIT OR Apache-2.0
MODCARGO_CRATES +=	crossbeam-utils	0.8.19	# MIT OR Apache-2.0
MODCARGO_CRATES +=	crypto-common	0.1.6	# MIT OR Apache-2.0
MODCARGO_CRATES +=	ctrlc	3.4.4	# MIT/Apache-2.0
MODCARGO_CRATES +=	data-encoding	2.5.0	# MIT
MODCARGO_CRATES +=	dbus	0.9.7	# Apache-2.0/MIT
MODCARGO_CRATES +=	debug-ignore	1.0.5	# MIT OR Apache-2.0
MODCARGO_CRATES +=	der-parser	8.2.0	# MIT/Apache-2.0
MODCARGO_CRATES +=	deranged	0.3.11	# MIT OR Apache-2.0
MODCARGO_CRATES +=	diff	0.1.13	# MIT OR Apache-2.0
MODCARGO_CRATES +=	digest	0.10.7	# MIT OR Apache-2.0
MODCARGO_CRATES +=	dirs-next	2.0.0	# MIT OR Apache-2.0
MODCARGO_CRATES +=	dirs-sys-next	0.1.2	# MIT OR Apache-2.0
MODCARGO_CRATES +=	displaydoc	0.2.4	# MIT OR Apache-2.0
MODCARGO_CRATES +=	ecow	0.2.2	# MIT OR Apache-2.0
MODCARGO_CRATES +=	either	1.10.0	# MIT OR Apache-2.0
MODCARGO_CRATES +=	encode_unicode	0.3.6	# MIT/Apache-2.0
MODCARGO_CRATES +=	equivalent	1.0.1	# Apache-2.0 OR MIT
MODCARGO_CRATES +=	errno	0.3.8	# MIT OR Apache-2.0
MODCARGO_CRATES +=	fastrand	2.0.2	# Apache-2.0 OR MIT
MODCARGO_CRATES +=	filetime	0.2.23	# MIT/Apache-2.0
MODCARGO_CRATES +=	fixedbitset	0.4.2	# MIT/Apache-2.0
MODCARGO_CRATES +=	flate2	1.0.30	# MIT OR Apache-2.0
MODCARGO_CRATES +=	fnv	1.0.7	# Apache-2.0 / MIT
MODCARGO_CRATES +=	form_urlencoded	1.2.1	# MIT OR Apache-2.0
MODCARGO_CRATES +=	fs_extra	1.3.0	# MIT
MODCARGO_CRATES +=	fslock	0.2.1	# MIT
MODCARGO_CRATES +=	futures	0.3.30	# MIT OR Apache-2.0
MODCARGO_CRATES +=	futures-channel	0.3.30	# MIT OR Apache-2.0
MODCARGO_CRATES +=	futures-core	0.3.30	# MIT OR Apache-2.0
MODCARGO_CRATES +=	futures-executor	0.3.30	# MIT OR Apache-2.0
MODCARGO_CRATES +=	futures-io	0.3.30	# MIT OR Apache-2.0
MODCARGO_CRATES +=	futures-macro	0.3.30	# MIT OR Apache-2.0
MODCARGO_CRATES +=	futures-sink	0.3.30	# MIT OR Apache-2.0
MODCARGO_CRATES +=	futures-task	0.3.30	# MIT OR Apache-2.0
MODCARGO_CRATES +=	futures-util	0.3.30	# MIT OR Apache-2.0
MODCARGO_CRATES +=	generic-array	0.14.7	# MIT
MODCARGO_CRATES +=	getrandom	0.2.12	# MIT OR Apache-2.0
MODCARGO_CRATES +=	gimli	0.28.1	# MIT OR Apache-2.0
MODCARGO_CRATES +=	globset	0.4.14	# Unlicense OR MIT
MODCARGO_CRATES +=	hashbrown	0.12.3	# MIT OR Apache-2.0
MODCARGO_CRATES +=	hashbrown	0.14.3	# MIT OR Apache-2.0
MODCARGO_CRATES +=	heck	0.4.1	# MIT OR Apache-2.0
MODCARGO_CRATES +=	heck	0.5.0	# MIT OR Apache-2.0
MODCARGO_CRATES +=	hermit-abi	0.3.9	# MIT OR Apache-2.0
MODCARGO_CRATES +=	hexpm	2.4.1	# Apache-2.0
MODCARGO_CRATES +=	home	0.5.9	# MIT OR Apache-2.0
MODCARGO_CRATES +=	hostname	0.4.0	# MIT
MODCARGO_CRATES +=	http	1.1.0	# MIT OR Apache-2.0
MODCARGO_CRATES +=	http-auth-basic	0.3.3	# MIT OR Apache-2.0
MODCARGO_CRATES +=	http-body	1.0.0	# MIT
MODCARGO_CRATES +=	http-body-util	0.1.1	# MIT
MODCARGO_CRATES +=	httparse	1.8.0	# MIT/Apache-2.0
MODCARGO_CRATES +=	humansize	2.1.3	# MIT/Apache-2.0
MODCARGO_CRATES +=	hyper	1.2.0	# MIT
MODCARGO_CRATES +=	hyper-rustls	0.26.0	# Apache-2.0 OR ISC OR MIT
MODCARGO_CRATES +=	hyper-util	0.1.3	# MIT
MODCARGO_CRATES +=	id-arena	2.2.1	# MIT/Apache-2.0
MODCARGO_CRATES +=	idna	0.5.0	# MIT OR Apache-2.0
MODCARGO_CRATES +=	ignore	0.4.22	# Unlicense OR MIT
MODCARGO_CRATES +=	im	15.1.0	# MPL-2.0+
MODCARGO_CRATES +=	indexmap	1.9.3	# Apache-2.0 OR MIT
MODCARGO_CRATES +=	indexmap	2.2.6	# Apache-2.0 OR MIT
MODCARGO_CRATES +=	insta	1.38.0	# Apache-2.0
MODCARGO_CRATES +=	ipnet	2.9.0	# MIT OR Apache-2.0
MODCARGO_CRATES +=	itertools	0.10.5	# MIT/Apache-2.0
MODCARGO_CRATES +=	itoa	1.0.11	# MIT OR Apache-2.0
MODCARGO_CRATES +=	js-sys	0.3.69	# MIT OR Apache-2.0
MODCARGO_CRATES +=	kstring	1.0.6	# MIT OR Apache-2.0
MODCARGO_CRATES +=	lazy_static	1.4.0	# MIT/Apache-2.0
MODCARGO_CRATES +=	libc	0.2.153	# MIT OR Apache-2.0
MODCARGO_CRATES +=	libdbus-sys	0.2.5	# Apache-2.0/MIT
MODCARGO_CRATES +=	libm	0.2.8	# MIT OR Apache-2.0
MODCARGO_CRATES +=	libredox	0.1.3	# MIT
MODCARGO_CRATES +=	linked-hash-map	0.5.6	# MIT/Apache-2.0
MODCARGO_CRATES +=	linux-raw-sys	0.4.13	# Apache-2.0 WITH LLVM-exception OR Apache-2.0 OR MIT
MODCARGO_CRATES +=	log	0.4.21	# MIT OR Apache-2.0
MODCARGO_CRATES +=	lsp-server	0.7.6	# MIT OR Apache-2.0
MODCARGO_CRATES +=	lsp-types	0.95.1	# MIT
MODCARGO_CRATES +=	matchers	0.1.0	# MIT
MODCARGO_CRATES +=	memchr	2.7.2	# Unlicense OR MIT
MODCARGO_CRATES +=	mime	0.3.17	# MIT OR Apache-2.0
MODCARGO_CRATES +=	mime_guess	2.0.4	# MIT
MODCARGO_CRATES +=	minimal-lexical	0.2.1	# MIT/Apache-2.0
MODCARGO_CRATES +=	miniz_oxide	0.7.2	# MIT OR Zlib OR Apache-2.0
MODCARGO_CRATES +=	mio	0.8.11	# MIT
MODCARGO_CRATES +=	nix	0.28.0	# MIT
MODCARGO_CRATES +=	nom	7.1.3	# MIT
MODCARGO_CRATES +=	normpath	1.2.0	# MIT OR Apache-2.0
MODCARGO_CRATES +=	nu-ansi-term	0.46.0	# MIT
MODCARGO_CRATES +=	num-bigint	0.4.4	# MIT OR Apache-2.0
MODCARGO_CRATES +=	num-conv	0.1.0	# MIT OR Apache-2.0
MODCARGO_CRATES +=	num-integer	0.1.46	# MIT OR Apache-2.0
MODCARGO_CRATES +=	num-traits	0.2.18	# MIT OR Apache-2.0
MODCARGO_CRATES +=	num_cpus	1.16.0	# MIT OR Apache-2.0
MODCARGO_CRATES +=	object	0.32.2	# Apache-2.0 OR MIT
MODCARGO_CRATES +=	oid-registry	0.6.1	# MIT/Apache-2.0
MODCARGO_CRATES +=	once_cell	1.19.0	# MIT OR Apache-2.0
MODCARGO_CRATES +=	opener	0.7.1	# MIT OR Apache-2.0
MODCARGO_CRATES +=	overload	0.1.1	# MIT
MODCARGO_CRATES +=	pathdiff	0.2.1	# MIT/Apache-2.0
MODCARGO_CRATES +=	percent-encoding	2.3.1	# MIT OR Apache-2.0
MODCARGO_CRATES +=	petgraph	0.6.4	# MIT OR Apache-2.0
MODCARGO_CRATES +=	pin-project	1.1.5	# Apache-2.0 OR MIT
MODCARGO_CRATES +=	pin-project-internal	1.1.5	# Apache-2.0 OR MIT
MODCARGO_CRATES +=	pin-project-lite	0.2.14	# Apache-2.0 OR MIT
MODCARGO_CRATES +=	pin-utils	0.1.0	# MIT OR Apache-2.0
MODCARGO_CRATES +=	pkg-config	0.3.30	# MIT OR Apache-2.0
MODCARGO_CRATES +=	powerfmt	0.2.0	# MIT OR Apache-2.0
MODCARGO_CRATES +=	ppv-lite86	0.2.17	# MIT/Apache-2.0
MODCARGO_CRATES +=	pretty_assertions	1.4.0	# MIT OR Apache-2.0
MODCARGO_CRATES +=	proc-macro2	1.0.79	# MIT OR Apache-2.0
MODCARGO_CRATES +=	protobuf	3.4.0	# MIT
MODCARGO_CRATES +=	protobuf-codegen	3.4.0	# MIT
MODCARGO_CRATES +=	protobuf-parse	3.4.0	# MIT
MODCARGO_CRATES +=	protobuf-support	3.4.0	# MIT
MODCARGO_CRATES +=	pubgrub	0.2.1	# MPL-2.0
MODCARGO_CRATES +=	pulldown-cmark	0.10.3	# MIT
MODCARGO_CRATES +=	pulldown-cmark-escape	0.10.0	# MIT
MODCARGO_CRATES +=	quote	1.0.35	# MIT OR Apache-2.0
MODCARGO_CRATES +=	rand	0.8.5	# MIT OR Apache-2.0
MODCARGO_CRATES +=	rand_chacha	0.3.1	# MIT OR Apache-2.0
MODCARGO_CRATES +=	rand_core	0.6.4	# MIT OR Apache-2.0
MODCARGO_CRATES +=	rand_xoshiro	0.6.0	# MIT OR Apache-2.0
MODCARGO_CRATES +=	redox_syscall	0.4.1	# MIT
MODCARGO_CRATES +=	redox_users	0.4.5	# MIT
MODCARGO_CRATES +=	regex	1.10.4	# MIT OR Apache-2.0
MODCARGO_CRATES +=	regex-automata	0.1.10	# Unlicense/MIT
MODCARGO_CRATES +=	regex-automata	0.4.6	# MIT OR Apache-2.0
MODCARGO_CRATES +=	regex-syntax	0.6.29	# MIT OR Apache-2.0
MODCARGO_CRATES +=	regex-syntax	0.8.3	# MIT OR Apache-2.0
MODCARGO_CRATES +=	reqwest	0.12.4	# MIT OR Apache-2.0
MODCARGO_CRATES +=	ring	0.17.8	# LICENSE
MODCARGO_CRATES +=	rpassword	7.3.1	# Apache-2.0
MODCARGO_CRATES +=	rtoolbox	0.0.2	# Apache-2.0
MODCARGO_CRATES +=	rustc-demangle	0.1.23	# MIT/Apache-2.0
MODCARGO_CRATES +=	rustc-hash	1.1.0	# Apache-2.0/MIT
MODCARGO_CRATES +=	rusticata-macros	4.1.0	# MIT/Apache-2.0
MODCARGO_CRATES +=	rustix	0.38.32	# Apache-2.0 WITH LLVM-exception OR Apache-2.0 OR MIT
MODCARGO_CRATES +=	rustls	0.22.4	# Apache-2.0 OR ISC OR MIT
MODCARGO_CRATES +=	rustls-pemfile	2.1.2	# Apache-2.0 OR ISC OR MIT
MODCARGO_CRATES +=	rustls-pki-types	1.4.1	# MIT OR Apache-2.0
MODCARGO_CRATES +=	rustls-webpki	0.102.2	# ISC
MODCARGO_CRATES +=	rustversion	1.0.14	# MIT OR Apache-2.0
MODCARGO_CRATES +=	ryu	1.0.17	# Apache-2.0 OR BSL-1.0
MODCARGO_CRATES +=	same-file	1.0.6	# Unlicense/MIT
MODCARGO_CRATES +=	scoped-tls	1.0.1	# MIT/Apache-2.0
MODCARGO_CRATES +=	serde	1.0.199	# MIT OR Apache-2.0
MODCARGO_CRATES +=	serde-wasm-bindgen	0.6.5	# MIT
MODCARGO_CRATES +=	serde_derive	1.0.199	# MIT OR Apache-2.0
MODCARGO_CRATES +=	serde_json	1.0.116	# MIT OR Apache-2.0
MODCARGO_CRATES +=	serde_repr	0.1.18	# MIT OR Apache-2.0
MODCARGO_CRATES +=	serde_urlencoded	0.7.1	# MIT/Apache-2.0
MODCARGO_CRATES +=	sha2	0.10.8	# MIT OR Apache-2.0
MODCARGO_CRATES +=	sharded-slab	0.1.7	# MIT
MODCARGO_CRATES +=	similar	2.5.0	# Apache-2.0
MODCARGO_CRATES +=	sized-chunks	0.6.5	# MPL-2.0+
MODCARGO_CRATES +=	slab	0.4.9	# MIT
MODCARGO_CRATES +=	smallvec	1.13.2	# MIT OR Apache-2.0
MODCARGO_CRATES +=	smawk	0.3.2	# MIT
MODCARGO_CRATES +=	socket2	0.5.6	# MIT OR Apache-2.0
MODCARGO_CRATES +=	spdx	0.10.4	# MIT OR Apache-2.0
MODCARGO_CRATES +=	spin	0.9.8	# MIT
MODCARGO_CRATES +=	static_vcruntime	2.0.0	# MIT OR Apache-2.0 OR Zlib
MODCARGO_CRATES +=	strsim	0.11.1	# MIT
MODCARGO_CRATES +=	strum	0.26.2	# MIT
MODCARGO_CRATES +=	strum_macros	0.26.2	# MIT
MODCARGO_CRATES +=	subtle	2.5.0	# BSD-3-Clause
MODCARGO_CRATES +=	syn	1.0.109	# MIT OR Apache-2.0
MODCARGO_CRATES +=	syn	2.0.58	# MIT OR Apache-2.0
MODCARGO_CRATES +=	sync_wrapper	0.1.2	# Apache-2.0
MODCARGO_CRATES +=	synstructure	0.12.6	# MIT
MODCARGO_CRATES +=	tar	0.4.40	# MIT/Apache-2.0
MODCARGO_CRATES +=	tempfile	3.10.1	# MIT OR Apache-2.0
MODCARGO_CRATES +=	termcolor	1.4.1	# Unlicense OR MIT
MODCARGO_CRATES +=	terminal_size	0.1.17	# MIT OR Apache-2.0
MODCARGO_CRATES +=	textwrap	0.15.0	# MIT
MODCARGO_CRATES +=	thiserror	1.0.59	# MIT OR Apache-2.0
MODCARGO_CRATES +=	thiserror-impl	1.0.59	# MIT OR Apache-2.0
MODCARGO_CRATES +=	thread_local	1.1.8	# MIT OR Apache-2.0
MODCARGO_CRATES +=	time	0.3.34	# MIT OR Apache-2.0
MODCARGO_CRATES +=	time-core	0.1.2	# MIT OR Apache-2.0
MODCARGO_CRATES +=	time-macros	0.2.17	# MIT OR Apache-2.0
MODCARGO_CRATES +=	tinyvec	1.6.0	# Zlib OR Apache-2.0 OR MIT
MODCARGO_CRATES +=	tinyvec_macros	0.1.1	# MIT OR Apache-2.0 OR Zlib
MODCARGO_CRATES +=	tokio	1.37.0	# MIT
MODCARGO_CRATES +=	tokio-rustls	0.25.0	# MIT/Apache-2.0
MODCARGO_CRATES +=	toml	0.5.11	# MIT/Apache-2.0
MODCARGO_CRATES +=	toml_edit	0.9.1	# MIT/Apache-2.0
MODCARGO_CRATES +=	tower	0.4.13	# MIT
MODCARGO_CRATES +=	tower-layer	0.3.2	# MIT
MODCARGO_CRATES +=	tower-service	0.3.2	# MIT
MODCARGO_CRATES +=	tracing	0.1.40	# MIT
MODCARGO_CRATES +=	tracing-attributes	0.1.27	# MIT
MODCARGO_CRATES +=	tracing-core	0.1.32	# MIT
MODCARGO_CRATES +=	tracing-log	0.2.0	# MIT
MODCARGO_CRATES +=	tracing-subscriber	0.3.18	# MIT
MODCARGO_CRATES +=	tracing-wasm	0.2.1	# MIT OR Apache-2.0
MODCARGO_CRATES +=	try-lock	0.2.5	# MIT
MODCARGO_CRATES +=	typenum	1.17.0	# MIT OR Apache-2.0
MODCARGO_CRATES +=	unicase	2.7.0	# MIT/Apache-2.0
MODCARGO_CRATES +=	unicode-bidi	0.3.15	# MIT OR Apache-2.0
MODCARGO_CRATES +=	unicode-ident	1.0.12	# (MIT OR Apache-2.0) AND Unicode-DFS-2016
MODCARGO_CRATES +=	unicode-linebreak	0.1.5	# Apache-2.0
MODCARGO_CRATES +=	unicode-normalization	0.1.23	# MIT/Apache-2.0
MODCARGO_CRATES +=	unicode-width	0.1.11	# MIT/Apache-2.0
MODCARGO_CRATES +=	unicode-xid	0.2.4	# MIT OR Apache-2.0
MODCARGO_CRATES +=	untrusted	0.9.0	# ISC
MODCARGO_CRATES +=	url	2.5.0	# MIT OR Apache-2.0
MODCARGO_CRATES +=	utf8parse	0.2.1	# Apache-2.0 OR MIT
MODCARGO_CRATES +=	valuable	0.1.0	# MIT
MODCARGO_CRATES +=	vec1	1.12.0	# MIT OR Apache-2.0
MODCARGO_CRATES +=	version_check	0.9.4	# MIT/Apache-2.0
MODCARGO_CRATES +=	walkdir	2.5.0	# Unlicense/MIT
MODCARGO_CRATES +=	want	0.3.1	# MIT
MODCARGO_CRATES +=	wasi	0.11.0+wasi-snapshot-preview1	# Apache-2.0 WITH LLVM-exception OR Apache-2.0 OR MIT
MODCARGO_CRATES +=	wasm-bindgen	0.2.92	# MIT OR Apache-2.0
MODCARGO_CRATES +=	wasm-bindgen-backend	0.2.92	# MIT OR Apache-2.0
MODCARGO_CRATES +=	wasm-bindgen-futures	0.4.42	# MIT OR Apache-2.0
MODCARGO_CRATES +=	wasm-bindgen-macro	0.2.92	# MIT OR Apache-2.0
MODCARGO_CRATES +=	wasm-bindgen-macro-support	0.2.92	# MIT OR Apache-2.0
MODCARGO_CRATES +=	wasm-bindgen-shared	0.2.92	# MIT OR Apache-2.0
MODCARGO_CRATES +=	wasm-bindgen-test	0.3.42	# MIT OR Apache-2.0
MODCARGO_CRATES +=	wasm-bindgen-test-macro	0.3.42	# MIT OR Apache-2.0
MODCARGO_CRATES +=	web-sys	0.3.69	# MIT OR Apache-2.0
MODCARGO_CRATES +=	webpki-roots	0.26.1	# MPL-2.0
MODCARGO_CRATES +=	which	4.4.2	# MIT
MODCARGO_CRATES +=	winapi	0.3.9	# MIT/Apache-2.0
MODCARGO_CRATES +=	winapi-i686-pc-windows-gnu	0.4.0	# MIT/Apache-2.0
MODCARGO_CRATES +=	winapi-util	0.1.6	# Unlicense/MIT
MODCARGO_CRATES +=	winapi-x86_64-pc-windows-gnu	0.4.0	# MIT/Apache-2.0
MODCARGO_CRATES +=	windows	0.52.0	# MIT OR Apache-2.0
MODCARGO_CRATES +=	windows-core	0.52.0	# MIT OR Apache-2.0
MODCARGO_CRATES +=	windows-sys	0.48.0	# MIT OR Apache-2.0
MODCARGO_CRATES +=	windows-sys	0.52.0	# MIT OR Apache-2.0
MODCARGO_CRATES +=	windows-targets	0.48.5	# MIT OR Apache-2.0
MODCARGO_CRATES +=	windows-targets	0.52.4	# MIT OR Apache-2.0
MODCARGO_CRATES +=	windows_aarch64_gnullvm	0.48.5	# MIT OR Apache-2.0
MODCARGO_CRATES +=	windows_aarch64_gnullvm	0.52.4	# MIT OR Apache-2.0
MODCARGO_CRATES +=	windows_aarch64_msvc	0.48.5	# MIT OR Apache-2.0
MODCARGO_CRATES +=	windows_aarch64_msvc	0.52.4	# MIT OR Apache-2.0
MODCARGO_CRATES +=	windows_i686_gnu	0.48.5	# MIT OR Apache-2.0
MODCARGO_CRATES +=	windows_i686_gnu	0.52.4	# MIT OR Apache-2.0
MODCARGO_CRATES +=	windows_i686_msvc	0.48.5	# MIT OR Apache-2.0
MODCARGO_CRATES +=	windows_i686_msvc	0.52.4	# MIT OR Apache-2.0
MODCARGO_CRATES +=	windows_x86_64_gnu	0.48.5	# MIT OR Apache-2.0
MODCARGO_CRATES +=	windows_x86_64_gnu	0.52.4	# MIT OR Apache-2.0
MODCARGO_CRATES +=	windows_x86_64_gnullvm	0.48.5	# MIT OR Apache-2.0
MODCARGO_CRATES +=	windows_x86_64_gnullvm	0.52.4	# MIT OR Apache-2.0
MODCARGO_CRATES +=	windows_x86_64_msvc	0.48.5	# MIT OR Apache-2.0
MODCARGO_CRATES +=	windows_x86_64_msvc	0.52.4	# MIT OR Apache-2.0
MODCARGO_CRATES +=	winreg	0.52.0	# MIT
MODCARGO_CRATES +=	x509-parser	0.15.1	# MIT OR Apache-2.0
MODCARGO_CRATES +=	xattr	1.3.1	# MIT/Apache-2.0
MODCARGO_CRATES +=	xxhash-rust	0.8.10	# BSL-1.0
MODCARGO_CRATES +=	yansi	0.5.1	# MIT/Apache-2.0
MODCARGO_CRATES +=	zeroize	1.7.0	# Apache-2.0 OR MIT
