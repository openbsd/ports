MODCABAL_MANIFEST	= \
	OneTuple	0.4.2	1	\
	QuickCheck	2.16.0.0	0	\
	StateVar	1.2.2	0	\
	X11	1.10.3	1	\
	X11-xft	0.3.4	0	\
	adjunctions	4.4.3	0	\
	aeson	2.2.3.0	4	\
	alex	3.5.4.0	0	\
	appar	0.1.8	0	\
	asn1-encoding	0.9.6	2	\
	asn1-parse	0.9.5	0	\
	asn1-types	0.3.4	0	\
	assoc	1.1.1	1	\
	async	2.2.5	3	\
	attoparsec	0.14.4	6	\
	attoparsec-aeson	2.2.2.0	0	\
	base-orphans	0.9.3	0	\
	base16-bytestring	1.0.2.0	1	\
	base64-bytestring	1.2.1.0	1	\
	basement	0.0.16	0	\
	bifunctors	5.6.2	2	\
	bitvec	1.1.5.0	3	\
	blaze-builder	0.4.4	0	\
	blaze-html	0.9.2.0	1	\
	blaze-markup	0.8.3.0	2	\
	byteorder	1.0.4	0	\
	cabal-doctest	1.0.11	0	\
	cairo	0.13.12.0	0	\
	call-stack	0.4.0	0	\
	case-insensitive	1.2.1.0	0	\
	cborg	0.2.10.0	3	\
	cereal	0.5.8.3	0	\
	character-ps	0.1	0	\
	clock	0.8.4	0	\
	colour	2.3.6	0	\
	comonad	5.0.9	1	\
	conduit	1.3.6.1	0	\
	conduit-extra	1.3.8	1	\
	contravariant	1.5.5	0	\
	cookie	0.5.1	0	\
	crypton	1.0.4	0	\
	crypton-connection	0.4.5	0	\
	crypton-socks	0.6.2	0	\
	crypton-x509	1.7.7	0	\
	crypton-x509-store	1.6.11	0	\
	crypton-x509-system	1.6.7	0	\
	crypton-x509-validation	1.6.14	0	\
	data-default	0.8.0.1	0	\
	data-default-class	0.2.0.0	0	\
	data-fix	0.3.4	1	\
	dbus	1.4.1	0	\
	distributive	0.6.2.1	1	\
	dlist	1.0	2	\
	ech-config	0.0.1	0	\
	extensible-exceptions	0.1.1.4	0	\
	extra	1.8	0	\
	free	5.2	7	\
	generically	0.1.1	4	\
	glib	0.13.12.0	0	\
	gtk2hs-buildtools	0.13.12.0	0	\
	half	0.3.3	0	\
	happy	1.20.1.1	0	\
	hashable	1.5.0.0	1	\
	hashtables	1.4.2	0	\
	hinotify	0.4.2	0	\
	hourglass	0.2.12	1	\
	hpke	0.0.0	0	\
	hsc2hs	0.68.10	4	\
	http-client	0.7.19	0	\
	http-client-tls	0.3.6.4	2	\
	http-conduit	2.3.9.1	0	\
	http-types	0.12.4	0	\
	indexed-traversable	0.1.4	1	\
	indexed-traversable-instances	0.1.2	1	\
	integer-conversion	0.1.1	1	\
	integer-logarithms	1.0.4	0	\
	invariant	0.6.4	1	\
	iproute	1.7.15	0	\
	kan-extensions	5.2.7	0	\
	lens	5.3.5	0	\
	libmpd	0.10.0.1	0	\
	memory	0.18.0	1	\
	mime-types	0.1.2.0	0	\
	mono-traversable	1.0.21.0	0	\
	network	3.2.8.0	0	\
	network-byte-order	0.1.7	0	\
	network-uri	2.6.4.2	1	\
	old-locale	1.0.0.7	2	\
	old-time	1.1.0.4	0	\
	os-string	2.0.8	0	\
	pango	0.13.12.0	0	\
	parallel	3.2.2.0	9	\
	parsec-numbers	0.1.0	0	\
	pem	0.2.4	0	\
	primitive	0.9.1.0	0	\
	profunctors	5.6.3	0	\
	random	1.3.1	0	\
	reflection	2.1.9	1	\
	regex-base	0.94.0.3	0	\
	regex-compat	0.95.2.2	0	\
	regex-posix	0.96.0.2	0	\
	resourcet	1.3.0	0	\
	safe-exceptions	0.1.7.4	1	\
	scientific	0.3.8.0	2	\
	semialign	1.3.1	2	\
	semigroupoids	6.0.1	2	\
	semigroups	0.20	0	\
	serialise	0.2.6.1	5	\
	split	0.2.5	0	\
	splitmix	0.1.2	0	\
	streaming-commons	0.2.3.0	0	\
	strict	0.5.1	1	\
	tagged	0.8.9	0	\
	text-iso8601	0.1.1	2	\
	text-short	0.1.6	3	\
	th-abstraction	0.7.1.0	1	\
	th-compat	0.1.6	0	\
	th-lift	0.8.6	0	\
	these	1.2.1	2	\
	time-compat	1.9.8	0	\
	tls	2.1.11	0	\
	transformers-base	0.4.6	0	\
	transformers-compat	0.7.2	0	\
	typed-process	0.2.13.0	0	\
	unix-time	0.4.17	0	\
	unliftio-core	0.2.1.0	4	\
	unordered-containers	0.2.20	4	\
	utf8-string	1.0.2	0	\
	uuid-types	1.0.6	3	\
	vector	0.13.1.0	0	\
	vector-algorithms	0.9.1.0	0	\
	vector-stream	0.1.0.1	3	\
	void	0.7.3	0	\
	witherable	0.5	1	\
	xml-conduit	1.10.0.1	0	\
	xml-types	0.3.8	0	\
	zlib	0.7.1.0	2
