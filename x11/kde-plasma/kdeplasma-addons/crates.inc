# run: make modcargo-gen-crates-licenses
MODCARGO_CRATES +=	anstyle	1.0.14
MODCARGO_CRATES +=	anyhow	1.0.102
MODCARGO_CRATES +=	async-broadcast	0.7.2
MODCARGO_CRATES +=	async-recursion	1.1.1
MODCARGO_CRATES +=	async-trait	0.1.89
MODCARGO_CRATES +=	autocfg	1.5.0
MODCARGO_CRATES +=	bitflags	2.11.0
MODCARGO_CRATES +=	bitflags	2.13.0
MODCARGO_CRATES +=	bumpalo	3.20.2
MODCARGO_CRATES +=	bytes	1.11.1
MODCARGO_CRATES +=	cc	1.2.58
MODCARGO_CRATES +=	cc	1.2.64
MODCARGO_CRATES +=	cfg-if	1.0.4
MODCARGO_CRATES +=	clap	4.5.54
MODCARGO_CRATES +=	clap	4.6.1
MODCARGO_CRATES +=	clap_builder	4.6.0
MODCARGO_CRATES +=	clap_lex	1.1.0
MODCARGO_CRATES +=	cxxbridge-cmd	1.0.194
MODCARGO_CRATES +=	codespan-reporting	0.13.1
MODCARGO_CRATES +=	concurrent-queue	2.5.0
MODCARGO_CRATES +=	crossbeam-utils	0.8.21
MODCARGO_CRATES +=	dissimilar	1.0.11
MODCARGO_CRATES +=	easy_color	0.1.13
MODCARGO_CRATES +=	either	1.15.0
MODCARGO_CRATES +=	endi	1.1.1
MODCARGO_CRATES +=	enumflags2	0.7.12
MODCARGO_CRATES +=	enumflags2_derive	0.7.12
MODCARGO_CRATES +=	equivalent	1.0.2
MODCARGO_CRATES +=	errno	0.3.14
MODCARGO_CRATES +=	event-listener	5.4.1
MODCARGO_CRATES +=	event-listener-strategy	0.5.4
MODCARGO_CRATES +=	fastrand	2.3.0
MODCARGO_CRATES +=	fastrand	2.4.1
MODCARGO_CRATES +=	find-msvc-tools	0.1.9
MODCARGO_CRATES +=	foldhash	0.1.5
MODCARGO_CRATES +=	foldhash	0.2.0
MODCARGO_CRATES +=	futures-core	0.3.32
MODCARGO_CRATES +=	futures-io	0.3.32
MODCARGO_CRATES +=	futures-lite	2.6.1
MODCARGO_CRATES +=	getrandom	0.2.17
MODCARGO_CRATES +=	getrandom	0.3.4
MODCARGO_CRATES +=	getrandom	0.4.2
MODCARGO_CRATES +=	getrandom	0.4.3
MODCARGO_CRATES +=	glob	0.3.3
MODCARGO_CRATES +=	hashbrown	0.15.5
MODCARGO_CRATES +=	hashbrown	0.16.1
MODCARGO_CRATES +=	hashbrown	0.17.1
MODCARGO_CRATES +=	heck	0.5.0
MODCARGO_CRATES +=	hex	0.4.3
MODCARGO_CRATES +=	hidapi	2.6.5
MODCARGO_CRATES +=	id-arena	2.3.0
MODCARGO_CRATES +=	indexmap	2.13.0
MODCARGO_CRATES +=	indexmap	2.14.0
MODCARGO_CRATES +=	indoc	2.0.7
MODCARGO_CRATES +=	itertools	0.14.0
MODCARGO_CRATES +=	itoa	1.0.18
MODCARGO_CRATES +=	jobserver	0.1.34
MODCARGO_CRATES +=	js-sys	0.3.92
MODCARGO_CRATES +=	leb128fmt	0.1.0
MODCARGO_CRATES +=	libc	0.2.183
MODCARGO_CRATES +=	libc	0.2.186
MODCARGO_CRATES +=	link-cplusplus	1.0.12
MODCARGO_CRATES +=	linux-raw-sys	0.12.1
MODCARGO_CRATES +=	log	0.4.29
MODCARGO_CRATES +=	memchr	2.8.0
MODCARGO_CRATES +=	memchr	2.8.2
MODCARGO_CRATES +=	memoffset	0.9.1
MODCARGO_CRATES +=	mio	1.2.0
MODCARGO_CRATES +=	num_enum	0.7.6
MODCARGO_CRATES +=	num_enum_derive	0.7.6
MODCARGO_CRATES +=	once_cell	1.21.4
MODCARGO_CRATES +=	ordered-stream	0.2.0
MODCARGO_CRATES +=	parking	2.2.1
MODCARGO_CRATES +=	pin-project-lite	0.2.17
MODCARGO_CRATES +=	pkg-config	0.3.32
MODCARGO_CRATES +=	pkg-config	0.3.33
MODCARGO_CRATES +=	ppv-lite86	0.2.21
MODCARGO_CRATES +=	prettyplease	0.2.37
MODCARGO_CRATES +=	proc-macro-crate	3.5.0
MODCARGO_CRATES +=	proc-macro2	1.0.106
MODCARGO_CRATES +=	qmk-via-api	0.7.0
MODCARGO_CRATES +=	quote	1.0.45
MODCARGO_CRATES +=	r-efi	5.3.0
MODCARGO_CRATES +=	r-efi	6.0.0
MODCARGO_CRATES +=	rand	0.8.5
MODCARGO_CRATES +=	rand_chacha	0.3.1
MODCARGO_CRATES +=	rand_core	0.6.4
MODCARGO_CRATES +=	rustix	1.1.4
MODCARGO_CRATES +=	rustversion	1.0.22
MODCARGO_CRATES +=	scratch	1.0.9
MODCARGO_CRATES +=	semver	1.0.27
MODCARGO_CRATES +=	serde	1.0.228
MODCARGO_CRATES +=	serde_core	1.0.228
MODCARGO_CRATES +=	serde_derive	1.0.228
MODCARGO_CRATES +=	serde_json	1.0.149
MODCARGO_CRATES +=	serde_json	1.0.150
MODCARGO_CRATES +=	serde_repr	0.1.20
MODCARGO_CRATES +=	serde_spanned	1.1.1
MODCARGO_CRATES +=	shlex	1.3.0
MODCARGO_CRATES +=	shlex	2.0.1
MODCARGO_CRATES +=	signal-hook-registry	1.4.8
MODCARGO_CRATES +=	socket2	0.6.3
MODCARGO_CRATES +=	static_assertions	1.1.0
MODCARGO_CRATES +=	strsim	0.11.1
MODCARGO_CRATES +=	strum	0.28.0
MODCARGO_CRATES +=	strum_macros	0.28.0
MODCARGO_CRATES +=	syn	2.0.117
MODCARGO_CRATES +=	syn	2.0.118
MODCARGO_CRATES +=	target-triple	1.0.0
MODCARGO_CRATES +=	tempfile	3.27.0
MODCARGO_CRATES +=	termcolor	1.4.1
MODCARGO_CRATES +=	tokio	1.50.0
MODCARGO_CRATES +=	tokio-macros	2.6.1
MODCARGO_CRATES +=	toml	1.1.2+spec-1.1.0
MODCARGO_CRATES +=	toml_datetime	1.1.0+spec-1.1.0
MODCARGO_CRATES +=	toml_datetime	1.1.1+spec-1.1.0
MODCARGO_CRATES +=	toml_edit	0.25.8+spec-1.1.0
MODCARGO_CRATES +=	toml_parser	1.1.0+spec-1.1.0
MODCARGO_CRATES +=	toml_parser	1.1.2+spec-1.1.0
MODCARGO_CRATES +=	toml_writer	1.1.1+spec-1.1.0
MODCARGO_CRATES +=	tracing	0.1.44
MODCARGO_CRATES +=	tracing-attributes	0.1.31
MODCARGO_CRATES +=	tracing-core	0.1.36
MODCARGO_CRATES +=	trybuild	1.0.116
MODCARGO_CRATES +=	uds_windows	1.2.1
MODCARGO_CRATES +=	unicode-ident	1.0.24
MODCARGO_CRATES +=	unicode-width	0.2.2
MODCARGO_CRATES +=	unicode-xid	0.2.6
MODCARGO_CRATES +=	uuid	1.23.0
MODCARGO_CRATES +=	wasi	0.11.1+wasi-snapshot-preview1
MODCARGO_CRATES +=	wasip2	1.0.2+wasi-0.2.9
MODCARGO_CRATES +=	wasip2	1.0.4+wasi-0.2.12
MODCARGO_CRATES +=	wasip3	0.4.0+wasi-0.3.0-rc-2026-01-06
MODCARGO_CRATES +=	wasm-bindgen	0.2.115
MODCARGO_CRATES +=	wasm-bindgen-macro	0.2.115
MODCARGO_CRATES +=	wasm-bindgen-macro-support	0.2.115
MODCARGO_CRATES +=	wasm-bindgen-shared	0.2.115
MODCARGO_CRATES +=	wasm-encoder	0.244.0
MODCARGO_CRATES +=	wasm-metadata	0.244.0
MODCARGO_CRATES +=	wasmparser	0.244.0
MODCARGO_CRATES +=	winapi-util	0.1.11
MODCARGO_CRATES +=	windows-link	0.2.1
MODCARGO_CRATES +=	windows-sys	0.61.2
MODCARGO_CRATES +=	winnow	0.7.15
MODCARGO_CRATES +=	winnow	1.0.1
MODCARGO_CRATES +=	winnow	1.0.3
MODCARGO_CRATES +=	wit-bindgen	0.51.0
MODCARGO_CRATES +=	wit-bindgen	0.57.1
MODCARGO_CRATES +=	wit-bindgen-core	0.51.0
MODCARGO_CRATES +=	wit-bindgen-rust	0.51.0
MODCARGO_CRATES +=	wit-bindgen-rust-macro	0.51.0
MODCARGO_CRATES +=	wit-component	0.244.0
MODCARGO_CRATES +=	wit-parser	0.244.0
MODCARGO_CRATES +=	zbus	5.14.0
MODCARGO_CRATES +=	zbus_macros	5.14.0
MODCARGO_CRATES +=	zbus_names	4.3.1
MODCARGO_CRATES +=	zbus_polkit	5.0.0
MODCARGO_CRATES +=	zerocopy	0.8.48
MODCARGO_CRATES +=	zerocopy-derive	0.8.48
MODCARGO_CRATES +=	zmij	1.0.21
MODCARGO_CRATES +=	zvariant	5.10.0
MODCARGO_CRATES +=	zvariant_derive	5.10.0
MODCARGO_CRATES +=	zvariant_utils	3.3.0
