# $OpenBSD: Makefile.inc,v 1.49 2019/07/13 10:59:27 sthen Exp $

DIST_SUBDIR ?=	kde
HOMEPAGE ?=	http://www.kde.org

MASTER_SITES ?=	${MASTER_SITE_KDE:S@$@Attic/${VERSION}/src/@}
EXTRACT_SUFX ?=	.tar.bz2

MODKDE_VERSION ?=	3.1
MODULES ?=		x11/kde

MODGNU_CONFIG_GUESS_DIR	?=	${MODKDE_CONFIG_GUESS_DIRS}

CONFIGURE_STYLE ?=	autoconf
.if defined(MODKDE_VERSION)
.  if ${MODKDE_VERSION} == "3.5.7"
AUTOCONF_VERSION ?=	2.60
.  endif
.  if ${MODKDE_VERSION} == "3.5.8"
AUTOCONF_VERSION ?=	2.61
.  endif
.endif
AUTOCONF_VERSION ?=	2.57
CONFIGURE_ARGS +=	${MODKDE_CONFIGURE_ARGS}
USE_GMAKE ?=		Yes

PORTHOME ?=		${WRKDIR}
SAMPLECONFDIR =		${TRUEPREFIX}/share/apps.kde3/kde-conf-sample

CONFIGURE_ENV +=	${MODKDE_CONFIGURE_ENV}
MAKE_ENV =		${CONFIGURE_ENV}

MAKE_FLAGS +=		${MODKDE_MAKE_FLAGS}
FAKE_FLAGS ?=		TAR=tar
FAKE_FLAGS +=		sysconfdir=${SAMPLECONFDIR}

# GPL
PERMIT_PACKAGE ?=	Yes

MODKDE_LIB_LINKS =	Yes
