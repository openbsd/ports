# run: make modcargo-gen-crates-licenses
MODCARGO_CRATES +=	anstyle	1.0.13
MODCARGO_CRATES +=	anstyle	1.0.14
MODCARGO_CRATES +=	bitflags	2.10.0
MODCARGO_CRATES +=	bitflags	2.13.0
MODCARGO_CRATES +=	cc	1.2.52
MODCARGO_CRATES +=	cc	1.2.64
MODCARGO_CRATES +=	cc	1.2.65
MODCARGO_CRATES +=	cfg-if	1.0.4
MODCARGO_CRATES +=	clap	4.5.54
MODCARGO_CRATES +=	clap	4.6.1
MODCARGO_CRATES +=	clap_builder	4.5.54
MODCARGO_CRATES +=	clap_builder	4.6.0
MODCARGO_CRATES +=	clap_lex	0.7.7
MODCARGO_CRATES +=	clap_lex	1.1.0
MODCARGO_CRATES +=	codespan-reporting	0.13.1
MODCARGO_CRATES +=	cxx	1.0.192
MODCARGO_CRATES +=	cxx-build	1.0.192
MODCARGO_CRATES +=	cxxbridge-cmd	1.0.192
MODCARGO_CRATES +=	cxxbridge-flags	1.0.192
MODCARGO_CRATES +=	cxxbridge-macro	1.0.192
MODCARGO_CRATES +=	dissimilar	1.0.11
MODCARGO_CRATES +=	equivalent	1.0.2
MODCARGO_CRATES +=	errno	0.3.14
MODCARGO_CRATES +=	fastrand	2.3.0
MODCARGO_CRATES +=	fastrand	2.4.1
MODCARGO_CRATES +=	find-msvc-tools	0.1.7
MODCARGO_CRATES +=	find-msvc-tools	0.1.9
MODCARGO_CRATES +=	foldhash	0.2.0
MODCARGO_CRATES +=	futf	0.1.5
MODCARGO_CRATES +=	getrandom	0.3.4
MODCARGO_CRATES +=	getrandom	0.4.3
MODCARGO_CRATES +=	glob	0.3.3
MODCARGO_CRATES +=	hashbrown	0.16.1
MODCARGO_CRATES +=	hashbrown	0.17.1
MODCARGO_CRATES +=	html2text	0.16.5
MODCARGO_CRATES +=	html5ever	0.36.1
MODCARGO_CRATES +=	indexmap	2.13.0
MODCARGO_CRATES +=	indexmap	2.14.0
MODCARGO_CRATES +=	indoc	2.0.7
MODCARGO_CRATES +=	itoa	1.0.18
MODCARGO_CRATES +=	jobserver	0.1.34
MODCARGO_CRATES +=	libc	0.2.180
MODCARGO_CRATES +=	libc	0.2.186
MODCARGO_CRATES +=	link-cplusplus	1.0.12
MODCARGO_CRATES +=	linux-raw-sys	0.12.1
MODCARGO_CRATES +=	lock_api	0.4.14
MODCARGO_CRATES +=	log	0.4.29
MODCARGO_CRATES +=	mac	0.1.1
MODCARGO_CRATES +=	markup5ever	0.36.1
MODCARGO_CRATES +=	memchr	2.8.2
MODCARGO_CRATES +=	new_debug_unreachable	1.0.6
MODCARGO_CRATES +=	once_cell	1.21.4
MODCARGO_CRATES +=	parking_lot	0.12.5
MODCARGO_CRATES +=	parking_lot_core	0.9.12
MODCARGO_CRATES +=	phf	0.13.1
MODCARGO_CRATES +=	phf_codegen	0.13.1
MODCARGO_CRATES +=	phf_generator	0.13.1
MODCARGO_CRATES +=	phf_shared	0.13.1
MODCARGO_CRATES +=	pkg-config	0.3.33
MODCARGO_CRATES +=	precomputed-hash	0.1.1
MODCARGO_CRATES +=	prettyplease	0.2.37
MODCARGO_CRATES +=	proc-macro2	1.0.105
MODCARGO_CRATES +=	proc-macro2	1.0.106
MODCARGO_CRATES +=	quote	1.0.43
MODCARGO_CRATES +=	quote	1.0.45
MODCARGO_CRATES +=	quote	1.0.46
MODCARGO_CRATES +=	r-efi	5.3.0
MODCARGO_CRATES +=	r-efi	6.0.0
MODCARGO_CRATES +=	redox_syscall	0.5.18
MODCARGO_CRATES +=	rustix	1.1.4
MODCARGO_CRATES +=	rustversion	1.0.22
MODCARGO_CRATES +=	scopeguard	1.2.0
MODCARGO_CRATES +=	scratch	1.0.9
MODCARGO_CRATES +=	serde	1.0.228
MODCARGO_CRATES +=	serde_core	1.0.228
MODCARGO_CRATES +=	serde_derive	1.0.228
MODCARGO_CRATES +=	serde_json	1.0.150
MODCARGO_CRATES +=	serde_spanned	1.1.1
MODCARGO_CRATES +=	shlex	1.3.0
MODCARGO_CRATES +=	shlex	2.0.1
MODCARGO_CRATES +=	siphasher	1.0.1
MODCARGO_CRATES +=	smallvec	1.15.1
MODCARGO_CRATES +=	string_cache	0.9.0
MODCARGO_CRATES +=	string_cache_codegen	0.6.1
MODCARGO_CRATES +=	strsim	0.11.1
MODCARGO_CRATES +=	syn	2.0.114
MODCARGO_CRATES +=	syn	2.0.118
MODCARGO_CRATES +=	target-triple	1.0.0
MODCARGO_CRATES +=	tempfile	3.27.0
MODCARGO_CRATES +=	tendril	0.4.3
MODCARGO_CRATES +=	termcolor	1.4.1
MODCARGO_CRATES +=	thiserror	2.0.17
MODCARGO_CRATES +=	thiserror-impl	2.0.17
MODCARGO_CRATES +=	toml	1.1.2+spec-1.1.0
MODCARGO_CRATES +=	toml_datetime	1.1.1+spec-1.1.0
MODCARGO_CRATES +=	toml_parser	1.1.2+spec-1.1.0
MODCARGO_CRATES +=	toml_writer	1.1.1+spec-1.1.0
MODCARGO_CRATES +=	trybuild	1.0.116
MODCARGO_CRATES +=	trybuild	1.0.117
MODCARGO_CRATES +=	unicode-ident	1.0.22
MODCARGO_CRATES +=	unicode-ident	1.0.24
MODCARGO_CRATES +=	unicode-width	0.1.14
MODCARGO_CRATES +=	unicode-width	0.2.2
MODCARGO_CRATES +=	utf-8	0.7.6
MODCARGO_CRATES +=	wasip2	1.0.4+wasi-0.2.12
MODCARGO_CRATES +=	web_atoms	0.2.1
MODCARGO_CRATES +=	winapi-util	0.1.11
MODCARGO_CRATES +=	windows-link	0.2.1
MODCARGO_CRATES +=	windows-sys	0.61.2
MODCARGO_CRATES +=	winnow	1.0.3
MODCARGO_CRATES +=	wit-bindgen	0.57.1
MODCARGO_CRATES +=	zmij	1.0.21
