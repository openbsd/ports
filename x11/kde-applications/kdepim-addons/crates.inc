# run: make modcargo-gen-crates-licenses
MODCARGO_CRATES +=	adblock	0.11.1
MODCARGO_CRATES +=	addr	0.15.6
MODCARGO_CRATES +=	aho-corasick	1.1.4
MODCARGO_CRATES +=	anstyle	1.0.13
MODCARGO_CRATES +=	anstyle	1.0.14
MODCARGO_CRATES +=	autocfg	1.5.0
MODCARGO_CRATES +=	base64	0.22.1
MODCARGO_CRATES +=	bitflags	2.10.0
MODCARGO_CRATES +=	bitflags	2.13.0
MODCARGO_CRATES +=	byteorder	1.5.0
MODCARGO_CRATES +=	cc	1.2.47
MODCARGO_CRATES +=	cc	1.2.65
MODCARGO_CRATES +=	cfg-if	1.0.4
MODCARGO_CRATES +=	clap	4.5.53
MODCARGO_CRATES +=	clap	4.6.1
MODCARGO_CRATES +=	clap_builder	4.5.53
MODCARGO_CRATES +=	clap_builder	4.6.0
MODCARGO_CRATES +=	clap_lex	0.7.6
MODCARGO_CRATES +=	clap_lex	1.1.0
MODCARGO_CRATES +=	codespan-reporting	0.13.1
MODCARGO_CRATES +=	cxx	1.0.189
MODCARGO_CRATES +=	cxx-build	1.0.189
MODCARGO_CRATES +=	cxxbridge-cmd	1.0.189
MODCARGO_CRATES +=	cxxbridge-flags	1.0.189
MODCARGO_CRATES +=	cxxbridge-macro	1.0.189
MODCARGO_CRATES +=	displaydoc	0.2.5
MODCARGO_CRATES +=	dissimilar	1.0.11
MODCARGO_CRATES +=	either	1.15.0
MODCARGO_CRATES +=	equivalent	1.0.2
MODCARGO_CRATES +=	errno	0.3.14
MODCARGO_CRATES +=	fastrand	2.4.1
MODCARGO_CRATES +=	find-msvc-tools	0.1.5
MODCARGO_CRATES +=	find-msvc-tools	0.1.9
MODCARGO_CRATES +=	flatbuffers	25.12.19
MODCARGO_CRATES +=	foldhash	0.2.0
MODCARGO_CRATES +=	form_urlencoded	1.2.2
MODCARGO_CRATES +=	getrandom	0.3.4
MODCARGO_CRATES +=	getrandom	0.4.3
MODCARGO_CRATES +=	glob	0.3.3
MODCARGO_CRATES +=	hashbrown	0.16.1
MODCARGO_CRATES +=	hashbrown	0.17.1
MODCARGO_CRATES +=	icu_collections	2.1.1
MODCARGO_CRATES +=	icu_locale_core	2.1.1
MODCARGO_CRATES +=	icu_normalizer	2.1.1
MODCARGO_CRATES +=	icu_normalizer_data	2.1.1
MODCARGO_CRATES +=	icu_properties	2.1.1
MODCARGO_CRATES +=	icu_properties_data	2.1.1
MODCARGO_CRATES +=	icu_provider	2.1.1
MODCARGO_CRATES +=	idna	1.1.0
MODCARGO_CRATES +=	idna_adapter	1.2.1
MODCARGO_CRATES +=	indexmap	2.12.1
MODCARGO_CRATES +=	indexmap	2.14.0
MODCARGO_CRATES +=	indoc	2.0.7
MODCARGO_CRATES +=	itertools	0.13.0
MODCARGO_CRATES +=	itoa	1.0.15
MODCARGO_CRATES +=	itoa	1.0.18
MODCARGO_CRATES +=	jobserver	0.1.34
MODCARGO_CRATES +=	libc	0.2.186
MODCARGO_CRATES +=	link-cplusplus	1.0.12
MODCARGO_CRATES +=	linux-raw-sys	0.12.1
MODCARGO_CRATES +=	litemap	0.8.1
MODCARGO_CRATES +=	memchr	2.7.6
MODCARGO_CRATES +=	memchr	2.8.2
MODCARGO_CRATES +=	num-traits	0.2.19
MODCARGO_CRATES +=	once_cell	1.21.3
MODCARGO_CRATES +=	once_cell	1.21.4
MODCARGO_CRATES +=	paste	1.0.15
MODCARGO_CRATES +=	percent-encoding	2.3.2
MODCARGO_CRATES +=	pkg-config	0.3.33
MODCARGO_CRATES +=	potential_utf	0.1.4
MODCARGO_CRATES +=	precomputed-hash	0.1.1
MODCARGO_CRATES +=	prettyplease	0.2.37
MODCARGO_CRATES +=	proc-macro2	1.0.103
MODCARGO_CRATES +=	proc-macro2	1.0.106
MODCARGO_CRATES +=	psl	2.1.163
MODCARGO_CRATES +=	psl-types	2.0.11
MODCARGO_CRATES +=	quote	1.0.42
MODCARGO_CRATES +=	quote	1.0.46
MODCARGO_CRATES +=	r-efi	5.3.0
MODCARGO_CRATES +=	r-efi	6.0.0
MODCARGO_CRATES +=	regex	1.12.2
MODCARGO_CRATES +=	regex-automata	0.4.13
MODCARGO_CRATES +=	regex-syntax	0.8.8
MODCARGO_CRATES +=	rmp	0.8.14
MODCARGO_CRATES +=	rmp-serde	0.15.5
MODCARGO_CRATES +=	rustc-hash	1.1.0
MODCARGO_CRATES +=	rustc_version	0.4.1
MODCARGO_CRATES +=	rustix	1.1.4
MODCARGO_CRATES +=	rustversion	1.0.22
MODCARGO_CRATES +=	ryu	1.0.20
MODCARGO_CRATES +=	scratch	1.0.9
MODCARGO_CRATES +=	seahash	4.1.0
MODCARGO_CRATES +=	semver	1.0.27
MODCARGO_CRATES +=	serde	1.0.228
MODCARGO_CRATES +=	serde_core	1.0.228
MODCARGO_CRATES +=	serde_derive	1.0.228
MODCARGO_CRATES +=	serde_json	1.0.145
MODCARGO_CRATES +=	serde_json	1.0.150
MODCARGO_CRATES +=	serde_spanned	1.1.1
MODCARGO_CRATES +=	shlex	1.3.0
MODCARGO_CRATES +=	shlex	2.0.1
MODCARGO_CRATES +=	smallvec	1.15.1
MODCARGO_CRATES +=	stable_deref_trait	1.2.1
MODCARGO_CRATES +=	strsim	0.11.1
MODCARGO_CRATES +=	syn	2.0.110
MODCARGO_CRATES +=	syn	2.0.118
MODCARGO_CRATES +=	synstructure	0.13.2
MODCARGO_CRATES +=	target-triple	1.0.0
MODCARGO_CRATES +=	tempfile	3.27.0
MODCARGO_CRATES +=	termcolor	1.4.1
MODCARGO_CRATES +=	thiserror	1.0.69
MODCARGO_CRATES +=	thiserror-impl	1.0.69
MODCARGO_CRATES +=	tinystr	0.8.2
MODCARGO_CRATES +=	toml	1.1.2+spec-1.1.0
MODCARGO_CRATES +=	toml_datetime	1.1.1+spec-1.1.0
MODCARGO_CRATES +=	toml_parser	1.1.2+spec-1.1.0
MODCARGO_CRATES +=	toml_writer	1.1.1+spec-1.1.0
MODCARGO_CRATES +=	trybuild	1.0.117
MODCARGO_CRATES +=	unicode-ident	1.0.22
MODCARGO_CRATES +=	unicode-ident	1.0.24
MODCARGO_CRATES +=	unicode-width	0.2.2
MODCARGO_CRATES +=	url	2.5.7
MODCARGO_CRATES +=	utf8_iter	1.0.4
MODCARGO_CRATES +=	wasip2	1.0.4+wasi-0.2.12
MODCARGO_CRATES +=	winapi-util	0.1.11
MODCARGO_CRATES +=	windows-link	0.2.1
MODCARGO_CRATES +=	windows-sys	0.61.2
MODCARGO_CRATES +=	winnow	1.0.3
MODCARGO_CRATES +=	wit-bindgen	0.57.1
MODCARGO_CRATES +=	writeable	0.6.2
MODCARGO_CRATES +=	yoke	0.8.1
MODCARGO_CRATES +=	yoke-derive	0.8.1
MODCARGO_CRATES +=	zerofrom	0.1.6
MODCARGO_CRATES +=	zerofrom-derive	0.1.6
MODCARGO_CRATES +=	zerotrie	0.2.3
MODCARGO_CRATES +=	zerovec	0.11.5
MODCARGO_CRATES +=	zerovec-derive	0.11.2
MODCARGO_CRATES +=	zmij	1.0.21
