MODGO_MODULES =	\
	github.com/!a!l!tree/bigfloat		 v0.2.0 \
	github.com/alecthomas/assert/v2		 v2.11.0 \
	github.com/alecthomas/chroma/v2		 v2.27.0 \
	github.com/alecthomas/repr		 v0.5.2 \
	github.com/bmatcuk/doublestar/v4	 v4.10.0 \
	github.com/davecgh/go-spew		 v1.1.1 \
	github.com/dlclark/regexp2		 v1.12.0 \
	github.com/dlclark/regexp2/v2		 v2.2.1 \
	github.com/ebitengine/purego		 v0.10.1 \
	github.com/emmansun/base64		 v0.10.0 \
	github.com/go-ole/go-ole		 v1.2.6 \
	github.com/google/go-cmp		 v0.7.0 \
	github.com/google/uuid			 v1.6.0 \
	github.com/hako/durafmt			 v0.0.0-20210608085754-5c1018a4e16b \
	github.com/hexops/gotextdiff		 v1.0.3 \
	github.com/jessevdk/go-flags		 v1.4.0 \
	github.com/klauspost/compress		 v1.19.0 \
	github.com/klauspost/cpuid/v2		 v2.2.10 \
	github.com/kovidgoyal/dbus		 v0.0.0-20250519011319-e811c41c0bc1 \
	github.com/kovidgoyal/go-parallel	 v1.1.1 \
	github.com/kovidgoyal/go-shm		 v1.0.0 \
	github.com/kovidgoyal/imaging		 v1.8.23 \
	github.com/lufia/plan9stats		 v0.0.0-20230326075908-cb1d2100619a \
	github.com/nwaples/rardecode/v2		 v2.2.5 \
	github.com/pmezard/go-difflib		 v1.0.0 \
	github.com/power-devops/perfstat	 v0.0.0-20240221224432-82ca36839d55 \
	github.com/rwcarlsen/goexif		 v0.0.0-20190401172101-9e8deecbddbd \
	github.com/seancfoley/bintree		 v1.3.1 \
	github.com/seancfoley/ipaddress-go	 v1.7.1 \
	github.com/sgtdi/fswatcher		 v1.3.0 \
	github.com/shirou/gopsutil/v4		 v4.26.6 \
	github.com/stretchr/testify		 v1.11.1 \
	github.com/tklauser/go-sysconf		 v0.3.16 \
	github.com/tklauser/numcpus		 v0.11.0 \
	github.com/ulikunitz/xz			 v0.5.15 \
	github.com/yusufpapurcu/wmi		 v1.2.4 \
	github.com/zeebo/assert			 v1.3.0 \
	github.com/zeebo/xxh3			 v1.1.0 \
	golang.org/x/exp			 v0.0.0-20230801115018-d63ba01acd4b \
	golang.org/x/image			 v0.44.0 \
	golang.org/x/mod			 v0.37.0 \
	golang.org/x/sync			 v0.22.0 \
	golang.org/x/sys			 v0.47.0 \
	golang.org/x/text			 v0.40.0 \
	golang.org/x/tools			 v0.47.0 \
	gopkg.in/check.v1			 v0.0.0-20161208181325-20d25e280405 \
	gopkg.in/yaml.v1			 v1.0.0-20140924161607-9f9df34309c0 \
	gopkg.in/yaml.v3			 v3.0.1 \
	howett.net/plist			 v1.0.1

MODGO_MODFILES =	\
	github.com/ebitengine/purego	 v0.10.0 \
	github.com/google/go-cmp	 v0.5.8 \
	github.com/google/go-cmp	 v0.5.9 \
	github.com/lufia/plan9stats	 v0.0.0-20211012122336-39d0f177ccd0 \
	golang.org/x/mod		 v0.11.0 \
	golang.org/x/sys		 v0.0.0-20190916202348-b4ddaad3f8a3 \
	golang.org/x/sys		 v0.0.0-20201204225414-ed752295db88 \
	golang.org/x/sys		 v0.1.0 \
	golang.org/x/sys		 v0.30.0 \
	golang.org/x/sys		 v0.33.0 \
	golang.org/x/sys		 v0.38.0 \
	golang.org/x/sys		 v0.41.0 \
	golang.org/x/sys		 v0.45.0 \
	golang.org/x/sys		 v0.46.0 \
	golang.org/x/tools		 v0.2.0

