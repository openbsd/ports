MODGO_MODULES =	\
	cloud.google.com/go				 v0.33.1 \
	github.com/!karpeles!lab/reflink		 v1.0.2 \
	github.com/!masterminds/goutils			 v1.1.1 \
	github.com/!masterminds/semver			 v1.5.0 \
	github.com/!masterminds/sprig			 v2.22.0+incompatible \
	github.com/!puerkito!bio/goquery		 v1.10.3 \
	github.com/andybalholm/cascadia			 v1.3.3 \
	github.com/araddon/dateparse			 v0.0.0-20210429162001-6b43995a97de \
	github.com/argusdusty/treelock			 v0.0.0-20180405040243-bde644eb4b53 \
	github.com/aymerick/douceur			 v0.2.0 \
	github.com/containrrr/shoutrrr			 v0.8.0 \
	github.com/cpuguy83/go-md2man/v2		 v2.0.0-20190314233015-f79a8a8ca69d \
	github.com/davecgh/go-spew			 v1.1.1 \
	github.com/denisenkom/go-mssqldb		 v0.0.0-20191124224453-732737034ffd \
	github.com/dexterlb/mpvipc			 v0.0.0-20241005113212-7cdefca0e933 \
	github.com/disintegration/imaging		 v1.6.2 \
	github.com/djherbis/times			 v1.6.0 \
	github.com/docopt/docopt-go			 v0.0.0-20180111231733-ee0de3bc6815 \
	github.com/dustin/go-humanize			 v1.0.1 \
	github.com/env25/mpdlrc				 v0.7.4 \
	github.com/erikstmartin/go-testdb		 v0.0.0-20160219214506-8d10e4a1bae5 \
	github.com/fatih/color				 v1.18.0 \
	github.com/fatih/structs			 v1.1.0 \
	github.com/fhs/gompd/v2				 v2.3.1-0.20221204164802-46d3f48f8632 \
	github.com/fsnotify/fsnotify			 v1.9.0 \
	github.com/gdamore/encoding			 v1.0.0 \
	github.com/gdamore/tcell/v2			 v2.7.4 \
	github.com/go-openapi/jsonpointer		 v0.22.0 \
	github.com/go-openapi/swag			 v0.21.1 \
	github.com/go-openapi/swag/jsonname		 v0.24.0 \
	github.com/go-sql-driver/mysql			 v1.5.0 \
	github.com/goccy/go-yaml			 v1.18.0 \
	github.com/gofrs/uuid				 v3.2.0+incompatible \
	github.com/golang-sql/civil			 v0.0.0-20190719163853-cb61b32ac6fe \
	github.com/golang/protobuf			 v1.2.0 \
	github.com/google/go-cmp			 v0.6.0 \
	github.com/google/gofuzz			 v1.2.0 \
	github.com/google/shlex				 v0.0.0-20191202100458-e7afc7fbc510 \
	github.com/google/uuid				 v1.6.0 \
	github.com/gorilla/context			 v1.1.2 \
	github.com/gorilla/css				 v1.0.1 \
	github.com/gorilla/securecookie			 v1.1.2 \
	github.com/gorilla/sessions			 v1.4.0 \
	github.com/gosimple/unidecode			 v1.0.1 \
	github.com/gregjones/httpcache			 v0.0.0-20190611155906-901d90724c79 \
	github.com/huandu/xstrings			 v1.5.0 \
	github.com/imdario/mergo			 v0.3.16 \
	github.com/jinzhu/gorm				 v1.9.17-0.20211120011537-5c235b72a414 \
	github.com/jinzhu/inflection			 v1.0.0 \
	github.com/jinzhu/now				 v1.1.2 \
	github.com/joho/godotenv			 v1.3.0 \
	github.com/josephburnett/jd			 v1.9.2 \
	github.com/josharian/intern			 v1.0.0 \
	github.com/json-iterator/go			 v1.1.12 \
	github.com/kr/pretty				 v0.3.1 \
	github.com/kr/text				 v0.2.0 \
	github.com/lib/pq				 v1.3.0 \
	github.com/lucasb-eyer/go-colorful		 v1.2.0 \
	github.com/mailru/easyjson			 v0.7.7 \
	github.com/mattn/go-colorable			 v0.1.14 \
	github.com/mattn/go-isatty			 v0.0.20 \
	github.com/mattn/go-runewidth			 v0.0.15 \
	github.com/mattn/go-sqlite3			 v1.14.32 \
	github.com/microcosm-cc/bluemonday		 v1.0.27 \
	github.com/mitchellh/copystructure		 v1.2.0 \
	github.com/mitchellh/mapstructure		 v1.5.0 \
	github.com/mitchellh/reflectwalk		 v1.0.2 \
	github.com/mmcdole/gofeed			 v1.3.0 \
	github.com/mmcdole/goxpp			 v1.1.1 \
	github.com/modern-go/concurrent			 v0.0.0-20180306012644-bacd9c7ef1dd \
	github.com/modern-go/reflect2			 v1.0.2 \
	github.com/ncruces/go-sqlite3			 v0.28.0 \
	github.com/ncruces/julianday			 v1.0.0 \
	github.com/nfnt/resize				 v0.0.0-20180221191011-83c6a9932646 \
	github.com/pelletier/go-toml/v2			 v2.2.2 \
	github.com/philippta/go-template		 v0.0.0-20220911145045-4556aca435e4 \
	github.com/pmezard/go-difflib			 v1.0.0 \
	github.com/rainycape/unidecode			 v0.0.0-20150907023854-cb7f23ec59be \
	github.com/rivo/uniseg				 v0.4.7 \
	github.com/rogpeppe/go-internal			 v1.14.1 \
	github.com/russross/blackfriday/v2		 v2.0.1 \
	github.com/sentriz/audiotags			 v0.0.0-20240918190302-048d6470aae6 \
	github.com/sentriz/gormstore			 v0.0.0-20220105134332-64e31f7f6981 \
	github.com/sergi/go-diff			 v1.4.0 \
	github.com/shurcoo!l/sanitized_anchor_name	 v1.0.0 \
	github.com/stretchr/objx			 v0.5.2 \
	github.com/stretchr/testify			 v1.11.1 \
	github.com/tetratelabs/wazero			 v1.9.0 \
	github.com/urfave/cli				 v1.22.3 \
	github.com/yudai/golcs				 v0.0.0-20170316035057-ecda9a501e82 \
	github.com/yuin/goldmark			 v1.4.13 \
	go.senan.xyz/flagconf				 v0.1.9 \
	go.senan.xyz/natcmp				 v0.1.2 \
	go.senan.xyz/sqlb				 v0.2.7 \
	go.senan.xyz/table				 v0.0.0-20250823140814-89c73cfe037e \
	go.senan.xyz/taglib				 v0.7.2 \
	go.senan.xyz/wrtag				 v0.17.1 \
	golang.org/x/crypto				 v0.41.0 \
	golang.org/x/exp				 v0.0.0-20240719175910-8a7402abbf56 \
	golang.org/x/image				 v0.30.0 \
	golang.org/x/mod				 v0.26.0 \
	golang.org/x/net				 v0.43.0 \
	golang.org/x/sync				 v0.16.0 \
	golang.org/x/sys				 v0.35.0 \
	golang.org/x/telemetry				 v0.0.0-20240228155512-f48c80bd79b2 \
	golang.org/x/term				 v0.34.0 \
	golang.org/x/text				 v0.28.0 \
	golang.org/x/time				 v0.12.0 \
	golang.org/x/tools				 v0.36.0 \
	golang.org/x/xerrors				 v0.0.0-20190717185122-a985d3407aa7 \
	google.golang.org/appengine			 v1.3.0 \
	gopkg.in/check.v1				 v1.0.0-20201130134442-10cb98267c6c \
	gopkg.in/gormigrate.v1				 v1.6.0 \
	gopkg.in/natefinch/npipe.v2			 v2.0.0-20160621034901-c1b8fa8bdcce \
	gopkg.in/yaml.v2				 v2.4.0 \
	gopkg.in/yaml.v3				 v3.0.1

MODGO_MODFILES =	\
	github.com/!puerkito!bio/goquery	 v1.5.1 \
	github.com/!puerkito!bio/goquery	 v1.8.0 \
	github.com/andybalholm/cascadia		 v1.1.0 \
	github.com/andybalholm/cascadia		 v1.3.1 \
	github.com/davecgh/go-spew		 v1.1.0 \
	github.com/denisenkom/go-mssqldb	 v0.0.0-20181014144952-4e0d7dc8888f \
	github.com/go-openapi/jsonpointer	 v0.19.5 \
	github.com/go-sql-driver/mysql		 v1.4.1 \
	github.com/google/go-cmp		 v0.2.0 \
	github.com/google/gofuzz		 v1.0.0 \
	github.com/gorilla/context		 v1.1.1 \
	github.com/gorilla/securecookie		 v1.1.1 \
	github.com/gorilla/sessions		 v1.2.1 \
	github.com/jinzhu/gorm			 v1.9.2 \
	github.com/jinzhu/inflection		 v0.0.0-20180308033659-04140366298a \
	github.com/jinzhu/now			 v0.0.0-20181116074157-8ec929ed50c3 \
	github.com/jinzhu/now			 v1.0.1 \
	github.com/lib/pq			 v1.0.0 \
	github.com/lib/pq			 v1.1.1 \
	github.com/mattn/go-sqlite3		 v1.10.0 \
	github.com/mattn/go-sqlite3		 v1.14.0 \
	github.com/mmcdole/goxpp		 v1.1.1-0.20240225020742-a0c311522b23 \
	github.com/modern-go/concurrent		 v0.0.0-20180228061459-e0a39a4cb421 \
	github.com/rogpeppe/go-internal		 v1.12.0 \
	github.com/stretchr/objx		 v0.1.0 \
	github.com/stretchr/testify		 v1.10.0 \
	github.com/stretchr/testify		 v1.11.0 \
	github.com/stretchr/testify		 v1.3.0 \
	github.com/stretchr/testify		 v1.8.1 \
	golang.org/x/crypto			 v0.0.0-20181112202954-3d3f9f413869 \
	golang.org/x/crypto			 v0.0.0-20190308221718-c2843e01d9a2 \
	golang.org/x/crypto			 v0.0.0-20190325154230-a5d413f7728c \
	golang.org/x/crypto			 v0.0.0-20191205180655-e7c4368fe9dd \
	golang.org/x/crypto			 v0.0.0-20210921155107-089bfa567519 \
	golang.org/x/crypto			 v0.13.0 \
	golang.org/x/crypto			 v0.19.0 \
	golang.org/x/crypto			 v0.23.0 \
	golang.org/x/crypto			 v0.31.0 \
	golang.org/x/image			 v0.0.0-20191009234506-e7c1f5e7dbb8 \
	golang.org/x/mod			 v0.12.0 \
	golang.org/x/mod			 v0.15.0 \
	golang.org/x/mod			 v0.17.0 \
	golang.org/x/mod			 v0.6.0-dev.0.20220419223038-86c51ed26bb4 \
	golang.org/x/mod			 v0.8.0 \
	golang.org/x/net			 v0.0.0-20180218175443-cbe0f9307d01 \
	golang.org/x/net			 v0.0.0-20180724234803-3673e40ba225 \
	golang.org/x/net			 v0.0.0-20190404232315-eb5bcb51f2a3 \
	golang.org/x/net			 v0.0.0-20190620200207-3b0461eec859 \
	golang.org/x/net			 v0.0.0-20200202094626-16171245cfb2 \
	golang.org/x/net			 v0.0.0-20200324143707-d3edc9973b7e \
	golang.org/x/net			 v0.0.0-20210226172049-e18ecbb05110 \
	golang.org/x/net			 v0.0.0-20220722155237-a158d28d115b \
	golang.org/x/net			 v0.10.0 \
	golang.org/x/net			 v0.15.0 \
	golang.org/x/net			 v0.21.0 \
	golang.org/x/net			 v0.25.0 \
	golang.org/x/net			 v0.26.0 \
	golang.org/x/net			 v0.33.0 \
	golang.org/x/net			 v0.39.0 \
	golang.org/x/net			 v0.4.0 \
	golang.org/x/net			 v0.42.0 \
	golang.org/x/net			 v0.6.0 \
	golang.org/x/sync			 v0.0.0-20190423024810-112230192c58 \
	golang.org/x/sync			 v0.0.0-20220722155255-886fb9371eb4 \
	golang.org/x/sync			 v0.1.0 \
	golang.org/x/sync			 v0.10.0 \
	golang.org/x/sync			 v0.3.0 \
	golang.org/x/sync			 v0.6.0 \
	golang.org/x/sync			 v0.7.0 \
	golang.org/x/sys			 v0.0.0-20190215142949-d0b11bdaac8a \
	golang.org/x/sys			 v0.0.0-20190412213103-97732733099d \
	golang.org/x/sys			 v0.0.0-20200323222414-85ca7c5b95cd \
	golang.org/x/sys			 v0.0.0-20201119102817-f84b799fce68 \
	golang.org/x/sys			 v0.0.0-20210615035016-665e8c7367d1 \
	golang.org/x/sys			 v0.0.0-20220520151302-bc2c85ada10a \
	golang.org/x/sys			 v0.0.0-20220615213510-4f61da869c0c \
	golang.org/x/sys			 v0.0.0-20220722155257-8c9f86f7a55f \
	golang.org/x/sys			 v0.12.0 \
	golang.org/x/sys			 v0.13.0 \
	golang.org/x/sys			 v0.17.0 \
	golang.org/x/sys			 v0.19.0 \
	golang.org/x/sys			 v0.20.0 \
	golang.org/x/sys			 v0.28.0 \
	golang.org/x/sys			 v0.5.0 \
	golang.org/x/sys			 v0.8.0 \
	golang.org/x/term			 v0.0.0-20201126162022-7de9c90e9dd1 \
	golang.org/x/term			 v0.0.0-20210927222741-03fcf44c2211 \
	golang.org/x/term			 v0.12.0 \
	golang.org/x/term			 v0.17.0 \
	golang.org/x/term			 v0.20.0 \
	golang.org/x/term			 v0.27.0 \
	golang.org/x/term			 v0.5.0 \
	golang.org/x/term			 v0.8.0 \
	golang.org/x/text			 v0.13.0 \
	golang.org/x/text			 v0.14.0 \
	golang.org/x/text			 v0.15.0 \
	golang.org/x/text			 v0.21.0 \
	golang.org/x/text			 v0.3.0 \
	golang.org/x/text			 v0.3.3 \
	golang.org/x/text			 v0.3.7 \
	golang.org/x/text			 v0.5.0 \
	golang.org/x/text			 v0.7.0 \
	golang.org/x/text			 v0.9.0 \
	golang.org/x/tools			 v0.0.0-20180917221912-90fa682c2a6e \
	golang.org/x/tools			 v0.0.0-20191119224855-298f0cb1881e \
	golang.org/x/tools			 v0.1.12 \
	golang.org/x/tools			 v0.13.0 \
	golang.org/x/tools			 v0.20.0 \
	golang.org/x/tools			 v0.21.1-0.20240508182429-e35e4ccd0d2d \
	golang.org/x/tools			 v0.35.0 \
	golang.org/x/tools			 v0.6.0 \
	gopkg.in/check.v1			 v0.0.0-20161208181325-20d25e280405
