MODCARGO_CRATES +=	addr2line	0.25.1	# Apache-2.0 OR MIT
MODCARGO_CRATES +=	adler2	2.0.1	# 0BSD OR MIT OR Apache-2.0
MODCARGO_CRATES +=	aes	0.8.4	# MIT OR Apache-2.0
MODCARGO_CRATES +=	aho-corasick	1.1.4	# Unlicense OR MIT
MODCARGO_CRATES +=	allocator-api2	0.2.21	# MIT OR Apache-2.0
MODCARGO_CRATES +=	alsa	0.9.1	# Apache-2.0/MIT
MODCARGO_CRATES +=	alsa	0.10.0	# Apache-2.0/MIT
MODCARGO_CRATES +=	alsa-sys	0.3.1	# MIT
MODCARGO_CRATES +=	android_system_properties	0.1.5	# MIT/Apache-2.0
MODCARGO_CRATES +=	anstream	0.6.21	# MIT OR Apache-2.0
MODCARGO_CRATES +=	anstyle	1.0.13	# MIT OR Apache-2.0
MODCARGO_CRATES +=	anstyle-parse	0.2.7	# MIT OR Apache-2.0
MODCARGO_CRATES +=	anstyle-query	1.1.5	# MIT OR Apache-2.0
MODCARGO_CRATES +=	anstyle-wincon	3.0.11	# MIT OR Apache-2.0
MODCARGO_CRATES +=	anyhow	1.0.100	# MIT OR Apache-2.0
MODCARGO_CRATES +=	arrayvec	0.7.6	# MIT OR Apache-2.0
MODCARGO_CRATES +=	async-trait	0.1.89	# MIT OR Apache-2.0
MODCARGO_CRATES +=	atomic-waker	1.1.2	# Apache-2.0 OR MIT
MODCARGO_CRATES +=	autocfg	1.5.0	# Apache-2.0 OR MIT
MODCARGO_CRATES +=	aws-lc-fips-sys	0.13.10	# ISC AND (Apache-2.0 OR ISC) AND OpenSSL
MODCARGO_CRATES +=	aws-lc-rs	1.15.0	# ISC AND (Apache-2.0 OR ISC)
MODCARGO_CRATES +=	aws-lc-sys	0.33.0	# ISC AND (Apache-2.0 OR ISC) AND OpenSSL
MODCARGO_CRATES +=	backtrace	0.3.76	# MIT OR Apache-2.0
MODCARGO_CRATES +=	base64	0.22.1	# MIT OR Apache-2.0
MODCARGO_CRATES +=	base64ct	1.8.0	# Apache-2.0 OR MIT
MODCARGO_CRATES +=	bindgen	0.72.1	# BSD-3-Clause
MODCARGO_CRATES +=	bitflags	1.3.2	# MIT/Apache-2.0
MODCARGO_CRATES +=	bitflags	2.10.0	# MIT OR Apache-2.0
MODCARGO_CRATES +=	block-buffer	0.10.4	# MIT OR Apache-2.0
MODCARGO_CRATES +=	bumpalo	3.19.0	# MIT OR Apache-2.0
MODCARGO_CRATES +=	bytemuck	1.24.0	# Zlib OR Apache-2.0 OR MIT
MODCARGO_CRATES +=	byteorder	1.5.0	# Unlicense OR MIT
MODCARGO_CRATES +=	bytes	1.11.0	# MIT
MODCARGO_CRATES +=	cc	1.2.46	# MIT OR Apache-2.0
MODCARGO_CRATES +=	cesu8	1.1.0	# Apache-2.0/MIT
MODCARGO_CRATES +=	cexpr	0.6.0	# Apache-2.0/MIT
MODCARGO_CRATES +=	cfg-if	1.0.4	# MIT OR Apache-2.0
MODCARGO_CRATES +=	chrono	0.4.42	# MIT OR Apache-2.0
MODCARGO_CRATES +=	cipher	0.4.4	# MIT OR Apache-2.0
MODCARGO_CRATES +=	clang-sys	1.8.1	# Apache-2.0
MODCARGO_CRATES +=	clap	4.5.52	# MIT OR Apache-2.0
MODCARGO_CRATES +=	clap_builder	4.5.52	# MIT OR Apache-2.0
MODCARGO_CRATES +=	clap_derive	4.5.49	# MIT OR Apache-2.0
MODCARGO_CRATES +=	clap_lex	0.7.6	# MIT OR Apache-2.0
MODCARGO_CRATES +=	cmake	0.1.54	# MIT OR Apache-2.0
MODCARGO_CRATES +=	color-eyre	0.6.5	# MIT OR Apache-2.0
MODCARGO_CRATES +=	color-spantrace	0.3.0	# MIT OR Apache-2.0
MODCARGO_CRATES +=	colorchoice	1.0.4	# MIT OR Apache-2.0
MODCARGO_CRATES +=	colored	2.2.0	# MPL-2.0
MODCARGO_CRATES +=	combine	4.6.7	# MIT
MODCARGO_CRATES +=	const-oid	0.9.6	# Apache-2.0 OR MIT
MODCARGO_CRATES +=	core-foundation	0.9.4	# MIT OR Apache-2.0
MODCARGO_CRATES +=	core-foundation-sys	0.8.7	# MIT OR Apache-2.0
MODCARGO_CRATES +=	coreaudio-rs	0.13.0	# MIT/Apache-2.0
MODCARGO_CRATES +=	cpal	0.16.0	# Apache-2.0
MODCARGO_CRATES +=	cpufeatures	0.2.17	# MIT OR Apache-2.0
MODCARGO_CRATES +=	crc32fast	1.5.0	# MIT OR Apache-2.0
MODCARGO_CRATES +=	crypto-common	0.1.7	# MIT OR Apache-2.0
MODCARGO_CRATES +=	ctr	0.9.2	# MIT OR Apache-2.0
MODCARGO_CRATES +=	daemonize	0.5.0	# MIT/Apache-2.0
MODCARGO_CRATES +=	darling	0.20.11	# MIT
MODCARGO_CRATES +=	darling_core	0.20.11	# MIT
MODCARGO_CRATES +=	darling_macro	0.20.11	# MIT
MODCARGO_CRATES +=	dasp_sample	0.11.0	# MIT OR Apache-2.0
MODCARGO_CRATES +=	data-encoding	2.9.0	# MIT
MODCARGO_CRATES +=	dbus	0.9.9	# Apache-2.0/MIT
MODCARGO_CRATES +=	dbus-crossroads	0.5.2	# Apache-2.0/MIT
MODCARGO_CRATES +=	dbus-tokio	0.7.6	# Apache-2.0/MIT
MODCARGO_CRATES +=	der	0.7.10	# Apache-2.0 OR MIT
MODCARGO_CRATES +=	deranged	0.5.5	# MIT OR Apache-2.0
MODCARGO_CRATES +=	derive_builder	0.20.2	# MIT OR Apache-2.0
MODCARGO_CRATES +=	derive_builder_core	0.20.2	# MIT OR Apache-2.0
MODCARGO_CRATES +=	derive_builder_macro	0.20.2	# MIT OR Apache-2.0
MODCARGO_CRATES +=	digest	0.10.7	# MIT OR Apache-2.0
MODCARGO_CRATES +=	directories	6.0.0	# MIT OR Apache-2.0
MODCARGO_CRATES +=	dirs-sys	0.5.0	# MIT OR Apache-2.0
MODCARGO_CRATES +=	dispatch2	0.3.0	# Zlib OR Apache-2.0 OR MIT
MODCARGO_CRATES +=	displaydoc	0.2.5	# MIT OR Apache-2.0
MODCARGO_CRATES +=	dunce	1.0.5	# CC0-1.0 OR MIT-0 OR Apache-2.0
MODCARGO_CRATES +=	either	1.15.0	# MIT OR Apache-2.0
MODCARGO_CRATES +=	encoding_rs	0.8.35	# (Apache-2.0 OR MIT) AND BSD-3-Clause
MODCARGO_CRATES +=	env_filter	0.1.4	# MIT OR Apache-2.0
MODCARGO_CRATES +=	env_logger	0.11.8	# MIT OR Apache-2.0
MODCARGO_CRATES +=	equivalent	1.0.2	# Apache-2.0 OR MIT
MODCARGO_CRATES +=	errno	0.3.14	# MIT OR Apache-2.0
MODCARGO_CRATES +=	eyre	0.6.12	# MIT OR Apache-2.0
MODCARGO_CRATES +=	fastrand	2.3.0	# Apache-2.0 OR MIT
MODCARGO_CRATES +=	fern	0.7.1	# MIT
MODCARGO_CRATES +=	find-msvc-tools	0.1.5	# MIT OR Apache-2.0
MODCARGO_CRATES +=	flate2	1.1.5	# MIT OR Apache-2.0
MODCARGO_CRATES +=	fnv	1.0.7	# Apache-2.0 / MIT
MODCARGO_CRATES +=	foldhash	0.2.0	# Zlib
MODCARGO_CRATES +=	foreign-types	0.3.2	# MIT/Apache-2.0
MODCARGO_CRATES +=	foreign-types-shared	0.1.1	# MIT/Apache-2.0
MODCARGO_CRATES +=	form_urlencoded	1.2.2	# MIT OR Apache-2.0
MODCARGO_CRATES +=	fs_extra	1.3.0	# MIT
MODCARGO_CRATES +=	futures	0.3.31	# MIT OR Apache-2.0
MODCARGO_CRATES +=	futures-channel	0.3.31	# MIT OR Apache-2.0
MODCARGO_CRATES +=	futures-core	0.3.31	# MIT OR Apache-2.0
MODCARGO_CRATES +=	futures-executor	0.3.31	# MIT OR Apache-2.0
MODCARGO_CRATES +=	futures-io	0.3.31	# MIT OR Apache-2.0
MODCARGO_CRATES +=	futures-macro	0.3.31	# MIT OR Apache-2.0
MODCARGO_CRATES +=	futures-sink	0.3.31	# MIT OR Apache-2.0
MODCARGO_CRATES +=	futures-task	0.3.31	# MIT OR Apache-2.0
MODCARGO_CRATES +=	futures-timer	3.0.3	# MIT/Apache-2.0
MODCARGO_CRATES +=	futures-util	0.3.31	# MIT OR Apache-2.0
MODCARGO_CRATES +=	generic-array	0.14.7	# MIT
MODCARGO_CRATES +=	gethostname	1.1.0	# Apache-2.0
MODCARGO_CRATES +=	getrandom	0.2.16	# MIT OR Apache-2.0
MODCARGO_CRATES +=	getrandom	0.3.4	# MIT OR Apache-2.0
MODCARGO_CRATES +=	gimli	0.32.3	# MIT OR Apache-2.0
MODCARGO_CRATES +=	glob	0.3.3	# MIT OR Apache-2.0
MODCARGO_CRATES +=	governor	0.10.2	# MIT
MODCARGO_CRATES +=	h2	0.4.12	# MIT
MODCARGO_CRATES +=	hashbrown	0.16.0	# MIT OR Apache-2.0
MODCARGO_CRATES +=	headers	0.4.1	# MIT
MODCARGO_CRATES +=	headers-core	0.3.0	# MIT
MODCARGO_CRATES +=	heck	0.5.0	# MIT OR Apache-2.0
MODCARGO_CRATES +=	hex	0.4.3	# MIT OR Apache-2.0
MODCARGO_CRATES +=	hmac	0.12.1	# MIT OR Apache-2.0
MODCARGO_CRATES +=	home	0.5.12	# MIT OR Apache-2.0
MODCARGO_CRATES +=	hostname	0.4.1	# MIT
MODCARGO_CRATES +=	http	1.3.1	# MIT OR Apache-2.0
MODCARGO_CRATES +=	http-body	1.0.1	# MIT
MODCARGO_CRATES +=	http-body-util	0.1.3	# MIT
MODCARGO_CRATES +=	httparse	1.10.1	# MIT OR Apache-2.0
MODCARGO_CRATES +=	httpdate	1.0.3	# MIT OR Apache-2.0
MODCARGO_CRATES +=	hyper	1.8.1	# MIT
MODCARGO_CRATES +=	hyper-proxy2	0.1.0	# MIT
MODCARGO_CRATES +=	hyper-tls	0.6.0	# MIT/Apache-2.0
MODCARGO_CRATES +=	hyper-util	0.1.18	# MIT
MODCARGO_CRATES +=	iana-time-zone	0.1.64	# MIT OR Apache-2.0
MODCARGO_CRATES +=	iana-time-zone-haiku	0.1.2	# MIT OR Apache-2.0
MODCARGO_CRATES +=	icu_collections	2.1.1	# Unicode-3.0
MODCARGO_CRATES +=	icu_locale_core	2.1.1	# Unicode-3.0
MODCARGO_CRATES +=	icu_normalizer	2.1.1	# Unicode-3.0
MODCARGO_CRATES +=	icu_normalizer_data	2.1.1	# Unicode-3.0
MODCARGO_CRATES +=	icu_properties	2.1.1	# Unicode-3.0
MODCARGO_CRATES +=	icu_properties_data	2.1.1	# Unicode-3.0
MODCARGO_CRATES +=	icu_provider	2.1.1	# Unicode-3.0
MODCARGO_CRATES +=	ident_case	1.0.1	# MIT/Apache-2.0
MODCARGO_CRATES +=	idna	1.1.0	# MIT OR Apache-2.0
MODCARGO_CRATES +=	idna_adapter	1.2.1	# Apache-2.0 OR MIT
MODCARGO_CRATES +=	if-addrs	0.14.0	# MIT OR BSD-3-Clause
MODCARGO_CRATES +=	indenter	0.3.4	# MIT OR Apache-2.0
MODCARGO_CRATES +=	indexmap	2.12.0	# Apache-2.0 OR MIT
MODCARGO_CRATES +=	inout	0.1.4	# MIT OR Apache-2.0
MODCARGO_CRATES +=	ipnet	2.11.0	# MIT OR Apache-2.0
MODCARGO_CRATES +=	iri-string	0.7.9	# MIT OR Apache-2.0
MODCARGO_CRATES +=	is-docker	0.2.0	# MIT
MODCARGO_CRATES +=	is-wsl	0.4.0	# MIT
MODCARGO_CRATES +=	is_terminal_polyfill	1.70.2	# MIT OR Apache-2.0
MODCARGO_CRATES +=	itertools	0.13.0	# MIT OR Apache-2.0
MODCARGO_CRATES +=	itoa	1.0.15	# MIT OR Apache-2.0
MODCARGO_CRATES +=	jack	0.13.3	# MIT
MODCARGO_CRATES +=	jack-sys	0.5.1	# MIT OR Apache-2.0
MODCARGO_CRATES +=	jiff	0.2.16	# Unlicense OR MIT
MODCARGO_CRATES +=	jiff-static	0.2.16	# Unlicense OR MIT
MODCARGO_CRATES +=	jni	0.21.1	# MIT/Apache-2.0
MODCARGO_CRATES +=	jni-sys	0.3.0	# MIT/Apache-2.0
MODCARGO_CRATES +=	jobserver	0.1.34	# MIT OR Apache-2.0
MODCARGO_CRATES +=	js-sys	0.3.82	# MIT OR Apache-2.0
MODCARGO_CRATES +=	lazy_static	1.5.0	# MIT OR Apache-2.0
MODCARGO_CRATES +=	libc	0.2.177	# MIT OR Apache-2.0
MODCARGO_CRATES +=	libdbus-sys	0.2.6	# Apache-2.0/MIT
MODCARGO_CRATES +=	libloading	0.7.4	# ISC
MODCARGO_CRATES +=	libloading	0.8.9	# ISC
MODCARGO_CRATES +=	libm	0.2.15	# MIT
MODCARGO_CRATES +=	libmdns	0.10.1	# MIT
MODCARGO_CRATES +=	libpulse-binding	2.30.1	# MIT OR Apache-2.0
MODCARGO_CRATES +=	libpulse-simple-binding	2.29.0	# MIT OR Apache-2.0
MODCARGO_CRATES +=	libpulse-simple-sys	1.22.0	# MIT OR Apache-2.0
MODCARGO_CRATES +=	libpulse-sys	1.23.0	# MIT OR Apache-2.0
MODCARGO_CRATES +=	libredox	0.1.10	# MIT
MODCARGO_CRATES +=	librespot-audio	0.8.0	# MIT
MODCARGO_CRATES +=	librespot-connect	0.8.0	# MIT
MODCARGO_CRATES +=	librespot-core	0.8.0	# MIT
MODCARGO_CRATES +=	librespot-discovery	0.8.0	# MIT
MODCARGO_CRATES +=	librespot-metadata	0.8.0	# MIT
MODCARGO_CRATES +=	librespot-oauth	0.8.0	# MIT
MODCARGO_CRATES +=	librespot-playback	0.8.0	# MIT
MODCARGO_CRATES +=	librespot-protocol	0.8.0	# MIT
MODCARGO_CRATES +=	linux-raw-sys	0.4.15	# Apache-2.0 WITH LLVM-exception OR Apache-2.0 OR MIT
MODCARGO_CRATES +=	linux-raw-sys	0.11.0	# Apache-2.0 WITH LLVM-exception OR Apache-2.0 OR MIT
MODCARGO_CRATES +=	litemap	0.8.1	# Unicode-3.0
MODCARGO_CRATES +=	lock_api	0.4.14	# MIT OR Apache-2.0
MODCARGO_CRATES +=	log	0.4.28	# MIT OR Apache-2.0
MODCARGO_CRATES +=	mach2	0.4.3	# BSD-2-Clause OR MIT OR Apache-2.0
MODCARGO_CRATES +=	memchr	2.7.6	# Unlicense OR MIT
MODCARGO_CRATES +=	mime	0.3.17	# MIT OR Apache-2.0
MODCARGO_CRATES +=	minimal-lexical	0.2.1	# MIT/Apache-2.0
MODCARGO_CRATES +=	miniz_oxide	0.8.9	# MIT OR Zlib OR Apache-2.0
MODCARGO_CRATES +=	mio	1.1.0	# MIT
MODCARGO_CRATES +=	multimap	0.10.1	# MIT OR Apache-2.0
MODCARGO_CRATES +=	native-tls	0.2.14	# MIT OR Apache-2.0
MODCARGO_CRATES +=	ndk	0.9.0	# MIT OR Apache-2.0
MODCARGO_CRATES +=	ndk-context	0.1.1	# MIT OR Apache-2.0
MODCARGO_CRATES +=	ndk-sys	0.6.0+11769913	# MIT OR Apache-2.0
MODCARGO_CRATES +=	nom	7.1.3	# MIT
MODCARGO_CRATES +=	nonzero_ext	0.3.0	# Apache-2.0
MODCARGO_CRATES +=	ntapi	0.4.1	# Apache-2.0 OR MIT
MODCARGO_CRATES +=	num-bigint	0.4.6	# MIT OR Apache-2.0
MODCARGO_CRATES +=	num-bigint-dig	0.8.6	# MIT/Apache-2.0
MODCARGO_CRATES +=	num-conv	0.1.0	# MIT OR Apache-2.0
MODCARGO_CRATES +=	num-derive	0.4.2	# MIT OR Apache-2.0
MODCARGO_CRATES +=	num-integer	0.1.46	# MIT OR Apache-2.0
MODCARGO_CRATES +=	num-iter	0.1.45	# MIT OR Apache-2.0
MODCARGO_CRATES +=	num-rational	0.4.2	# MIT OR Apache-2.0
MODCARGO_CRATES +=	num-traits	0.2.19	# MIT OR Apache-2.0
MODCARGO_CRATES +=	num_enum	0.7.5	# BSD-3-Clause OR MIT OR Apache-2.0
MODCARGO_CRATES +=	num_enum_derive	0.7.5	# BSD-3-Clause OR MIT OR Apache-2.0
MODCARGO_CRATES +=	num_threads	0.1.7	# MIT OR Apache-2.0
MODCARGO_CRATES +=	oauth2	5.0.0	# MIT OR Apache-2.0
MODCARGO_CRATES +=	objc2	0.6.3	# MIT
MODCARGO_CRATES +=	objc2-audio-toolbox	0.3.2	# Zlib OR Apache-2.0 OR MIT
MODCARGO_CRATES +=	objc2-core-audio	0.3.2	# Zlib OR Apache-2.0 OR MIT
MODCARGO_CRATES +=	objc2-core-audio-types	0.3.2	# Zlib OR Apache-2.0 OR MIT
MODCARGO_CRATES +=	objc2-core-foundation	0.3.2	# Zlib OR Apache-2.0 OR MIT
MODCARGO_CRATES +=	objc2-encode	4.1.0	# MIT
MODCARGO_CRATES +=	objc2-foundation	0.3.2	# MIT
MODCARGO_CRATES +=	objc2-io-kit	0.3.2	# Zlib OR Apache-2.0 OR MIT
MODCARGO_CRATES +=	object	0.37.3	# Apache-2.0 OR MIT
MODCARGO_CRATES +=	once_cell	1.21.3	# MIT OR Apache-2.0
MODCARGO_CRATES +=	once_cell_polyfill	1.70.2	# MIT OR Apache-2.0
MODCARGO_CRATES +=	open	5.3.3	# MIT
MODCARGO_CRATES +=	openssl	0.10.75	# Apache-2.0
MODCARGO_CRATES +=	openssl-macros	0.1.1	# MIT/Apache-2.0
MODCARGO_CRATES +=	openssl-probe	0.1.6	# MIT/Apache-2.0
MODCARGO_CRATES +=	openssl-sys	0.9.111	# MIT
MODCARGO_CRATES +=	option-ext	0.2.0	# MPL-2.0
MODCARGO_CRATES +=	owo-colors	4.2.3	# MIT
MODCARGO_CRATES +=	parking_lot	0.12.5	# MIT OR Apache-2.0
MODCARGO_CRATES +=	parking_lot_core	0.9.12	# MIT OR Apache-2.0
MODCARGO_CRATES +=	pathdiff	0.2.3	# MIT/Apache-2.0
MODCARGO_CRATES +=	pbkdf2	0.12.2	# MIT OR Apache-2.0
MODCARGO_CRATES +=	pem-rfc7468	0.7.0	# Apache-2.0 OR MIT
MODCARGO_CRATES +=	percent-encoding	2.3.2	# MIT OR Apache-2.0
MODCARGO_CRATES +=	pin-project-lite	0.2.16	# Apache-2.0 OR MIT
MODCARGO_CRATES +=	pin-utils	0.1.0	# MIT OR Apache-2.0
MODCARGO_CRATES +=	pkcs1	0.7.5	# Apache-2.0 OR MIT
MODCARGO_CRATES +=	pkcs8	0.10.2	# Apache-2.0 OR MIT
MODCARGO_CRATES +=	pkg-config	0.3.32	# MIT OR Apache-2.0
MODCARGO_CRATES +=	pledge	0.4.2	# MIT
MODCARGO_CRATES +=	portable-atomic	1.11.1	# Apache-2.0 OR MIT
MODCARGO_CRATES +=	portable-atomic-util	0.2.4	# Apache-2.0 OR MIT
MODCARGO_CRATES +=	portaudio-rs	0.3.2	# MIT
MODCARGO_CRATES +=	portaudio-sys	0.1.1	# MIT
MODCARGO_CRATES +=	potential_utf	0.1.4	# Unicode-3.0
MODCARGO_CRATES +=	powerfmt	0.2.0	# MIT OR Apache-2.0
MODCARGO_CRATES +=	ppv-lite86	0.2.21	# MIT OR Apache-2.0
MODCARGO_CRATES +=	prettyplease	0.2.37	# MIT OR Apache-2.0
MODCARGO_CRATES +=	priority-queue	2.7.0	# LGPL-3.0-or-later OR MPL-2.0
MODCARGO_CRATES +=	proc-macro-crate	3.4.0	# MIT OR Apache-2.0
MODCARGO_CRATES +=	proc-macro2	1.0.103	# MIT OR Apache-2.0
MODCARGO_CRATES +=	protobuf	3.7.2	# MIT
MODCARGO_CRATES +=	protobuf-codegen	3.7.2	# MIT
MODCARGO_CRATES +=	protobuf-json-mapping	3.7.2	# MIT
MODCARGO_CRATES +=	protobuf-parse	3.7.2	# MIT
MODCARGO_CRATES +=	protobuf-support	3.7.2	# MIT
MODCARGO_CRATES +=	quick-xml	0.38.4	# MIT
MODCARGO_CRATES +=	quote	1.0.42	# MIT OR Apache-2.0
MODCARGO_CRATES +=	r-efi	5.3.0	# MIT OR Apache-2.0 OR LGPL-2.1-or-later
MODCARGO_CRATES +=	rand	0.8.5	# MIT OR Apache-2.0
MODCARGO_CRATES +=	rand	0.9.2	# MIT OR Apache-2.0
MODCARGO_CRATES +=	rand_chacha	0.3.1	# MIT OR Apache-2.0
MODCARGO_CRATES +=	rand_chacha	0.9.0	# MIT OR Apache-2.0
MODCARGO_CRATES +=	rand_core	0.6.4	# MIT OR Apache-2.0
MODCARGO_CRATES +=	rand_core	0.9.3	# MIT OR Apache-2.0
MODCARGO_CRATES +=	rand_distr	0.5.1	# MIT OR Apache-2.0
MODCARGO_CRATES +=	redox_syscall	0.5.18	# MIT
MODCARGO_CRATES +=	redox_users	0.5.2	# MIT
MODCARGO_CRATES +=	regex	1.12.2	# MIT OR Apache-2.0
MODCARGO_CRATES +=	regex-automata	0.4.13	# MIT OR Apache-2.0
MODCARGO_CRATES +=	regex-syntax	0.8.8	# MIT OR Apache-2.0
MODCARGO_CRATES +=	reqwest	0.12.24	# MIT OR Apache-2.0
MODCARGO_CRATES +=	rodio	0.21.1	# MIT OR Apache-2.0
MODCARGO_CRATES +=	rsa	0.9.9	# MIT OR Apache-2.0
MODCARGO_CRATES +=	rustc-demangle	0.1.26	# MIT/Apache-2.0
MODCARGO_CRATES +=	rustc-hash	2.1.1	# Apache-2.0 OR MIT
MODCARGO_CRATES +=	rustix	0.38.44	# Apache-2.0 WITH LLVM-exception OR Apache-2.0 OR MIT
MODCARGO_CRATES +=	rustix	1.1.2	# Apache-2.0 WITH LLVM-exception OR Apache-2.0 OR MIT
MODCARGO_CRATES +=	rustls-pki-types	1.13.0	# MIT OR Apache-2.0
MODCARGO_CRATES +=	rustversion	1.0.22	# MIT OR Apache-2.0
MODCARGO_CRATES +=	ryu	1.0.20	# Apache-2.0 OR BSL-1.0
MODCARGO_CRATES +=	same-file	1.0.6	# Unlicense/MIT
MODCARGO_CRATES +=	schannel	0.1.28	# MIT
MODCARGO_CRATES +=	scopeguard	1.2.0	# MIT OR Apache-2.0
MODCARGO_CRATES +=	security-framework	2.11.1	# MIT OR Apache-2.0
MODCARGO_CRATES +=	security-framework-sys	2.15.0	# MIT OR Apache-2.0
MODCARGO_CRATES +=	serde	1.0.228	# MIT OR Apache-2.0
MODCARGO_CRATES +=	serde_core	1.0.228	# MIT OR Apache-2.0
MODCARGO_CRATES +=	serde_derive	1.0.228	# MIT OR Apache-2.0
MODCARGO_CRATES +=	serde_ignored	0.1.14	# MIT OR Apache-2.0
MODCARGO_CRATES +=	serde_json	1.0.145	# MIT OR Apache-2.0
MODCARGO_CRATES +=	serde_path_to_error	0.1.20	# MIT OR Apache-2.0
MODCARGO_CRATES +=	serde_repr	0.1.20	# MIT OR Apache-2.0
MODCARGO_CRATES +=	serde_spanned	1.0.3	# MIT OR Apache-2.0
MODCARGO_CRATES +=	serde_urlencoded	0.7.1	# MIT/Apache-2.0
MODCARGO_CRATES +=	sha-1	0.10.1	# MIT OR Apache-2.0
MODCARGO_CRATES +=	sha1	0.10.6	# MIT OR Apache-2.0
MODCARGO_CRATES +=	sha2	0.10.9	# MIT OR Apache-2.0
MODCARGO_CRATES +=	shannon	0.2.0	# MIT
MODCARGO_CRATES +=	sharded-slab	0.1.7	# MIT
MODCARGO_CRATES +=	shell-words	1.1.0	# MIT/Apache-2.0
MODCARGO_CRATES +=	shlex	1.3.0	# MIT OR Apache-2.0
MODCARGO_CRATES +=	signal-hook-registry	1.4.6	# Apache-2.0/MIT
MODCARGO_CRATES +=	signature	2.2.0	# Apache-2.0 OR MIT
MODCARGO_CRATES +=	simd-adler32	0.3.7	# MIT
MODCARGO_CRATES +=	slab	0.4.11	# MIT
MODCARGO_CRATES +=	smallvec	1.15.1	# MIT OR Apache-2.0
MODCARGO_CRATES +=	socket2	0.6.1	# MIT OR Apache-2.0
MODCARGO_CRATES +=	spin	0.9.8	# MIT
MODCARGO_CRATES +=	spinning_top	0.3.0	# MIT/Apache-2.0
MODCARGO_CRATES +=	spki	0.7.3	# Apache-2.0 OR MIT
MODCARGO_CRATES +=	stable_deref_trait	1.2.1	# MIT OR Apache-2.0
MODCARGO_CRATES +=	strsim	0.11.1	# MIT
MODCARGO_CRATES +=	subtle	2.6.1	# BSD-3-Clause
MODCARGO_CRATES +=	symphonia	0.5.5	# MPL-2.0
MODCARGO_CRATES +=	symphonia-bundle-flac	0.5.5	# MPL-2.0
MODCARGO_CRATES +=	symphonia-bundle-mp3	0.5.5	# MPL-2.0
MODCARGO_CRATES +=	symphonia-codec-vorbis	0.5.5	# MPL-2.0
MODCARGO_CRATES +=	symphonia-core	0.5.5	# MPL-2.0
MODCARGO_CRATES +=	symphonia-format-ogg	0.5.5	# MPL-2.0
MODCARGO_CRATES +=	symphonia-metadata	0.5.5	# MPL-2.0
MODCARGO_CRATES +=	symphonia-utils-xiph	0.5.5	# MPL-2.0
MODCARGO_CRATES +=	syn	2.0.110	# MIT OR Apache-2.0
MODCARGO_CRATES +=	sync_wrapper	1.0.2	# Apache-2.0
MODCARGO_CRATES +=	synstructure	0.13.2	# MIT
MODCARGO_CRATES +=	sysinfo	0.36.1	# MIT
MODCARGO_CRATES +=	syslog	7.0.0	# MIT
MODCARGO_CRATES +=	system-configuration	0.6.1	# MIT OR Apache-2.0
MODCARGO_CRATES +=	system-configuration-sys	0.6.0	# MIT OR Apache-2.0
MODCARGO_CRATES +=	tempfile	3.23.0	# MIT OR Apache-2.0
MODCARGO_CRATES +=	thiserror	1.0.69	# MIT OR Apache-2.0
MODCARGO_CRATES +=	thiserror	2.0.17	# MIT OR Apache-2.0
MODCARGO_CRATES +=	thiserror-impl	1.0.69	# MIT OR Apache-2.0
MODCARGO_CRATES +=	thiserror-impl	2.0.17	# MIT OR Apache-2.0
MODCARGO_CRATES +=	thread_local	1.1.9	# MIT OR Apache-2.0
MODCARGO_CRATES +=	time	0.3.44	# MIT OR Apache-2.0
MODCARGO_CRATES +=	time-core	0.1.6	# MIT OR Apache-2.0
MODCARGO_CRATES +=	time-macros	0.2.24	# MIT OR Apache-2.0
MODCARGO_CRATES +=	tinystr	0.8.2	# Unicode-3.0
MODCARGO_CRATES +=	tokio	1.48.0	# MIT
MODCARGO_CRATES +=	tokio-macros	2.6.0	# MIT
MODCARGO_CRATES +=	tokio-native-tls	0.3.1	# MIT
MODCARGO_CRATES +=	tokio-stream	0.1.17	# MIT
MODCARGO_CRATES +=	tokio-tungstenite	0.28.0	# MIT
MODCARGO_CRATES +=	tokio-util	0.7.17	# MIT
MODCARGO_CRATES +=	toml	0.9.8	# MIT OR Apache-2.0
MODCARGO_CRATES +=	toml_datetime	0.7.3	# MIT OR Apache-2.0
MODCARGO_CRATES +=	toml_edit	0.23.7	# MIT OR Apache-2.0
MODCARGO_CRATES +=	toml_parser	1.0.4	# MIT OR Apache-2.0
MODCARGO_CRATES +=	toml_writer	1.0.4	# MIT OR Apache-2.0
MODCARGO_CRATES +=	tower	0.5.2	# MIT
MODCARGO_CRATES +=	tower-http	0.6.6	# MIT
MODCARGO_CRATES +=	tower-layer	0.3.3	# MIT
MODCARGO_CRATES +=	tower-service	0.3.3	# MIT
MODCARGO_CRATES +=	tracing	0.1.41	# MIT
MODCARGO_CRATES +=	tracing-core	0.1.34	# MIT
MODCARGO_CRATES +=	tracing-error	0.2.1	# MIT
MODCARGO_CRATES +=	tracing-subscriber	0.3.20	# MIT
MODCARGO_CRATES +=	try-lock	0.2.5	# MIT
MODCARGO_CRATES +=	tungstenite	0.28.0	# MIT OR Apache-2.0
MODCARGO_CRATES +=	typenum	1.19.0	# MIT OR Apache-2.0
MODCARGO_CRATES +=	unicode-ident	1.0.22	# (MIT OR Apache-2.0) AND Unicode-3.0
MODCARGO_CRATES +=	untrusted	0.7.1	# ISC
MODCARGO_CRATES +=	url	2.5.7	# MIT OR Apache-2.0
MODCARGO_CRATES +=	utf-8	0.7.6	# MIT OR Apache-2.0
MODCARGO_CRATES +=	utf8_iter	1.0.4	# Apache-2.0 OR MIT
MODCARGO_CRATES +=	utf8parse	0.2.2	# Apache-2.0 OR MIT
MODCARGO_CRATES +=	uuid	1.18.1	# Apache-2.0 OR MIT
MODCARGO_CRATES +=	valuable	0.1.1	# MIT
MODCARGO_CRATES +=	vcpkg	0.2.15	# MIT/Apache-2.0
MODCARGO_CRATES +=	vergen	9.0.6	# MIT OR Apache-2.0
MODCARGO_CRATES +=	vergen-gitcl	1.0.8	# MIT OR Apache-2.0
MODCARGO_CRATES +=	vergen-lib	0.1.6	# MIT OR Apache-2.0
MODCARGO_CRATES +=	version_check	0.9.5	# MIT/Apache-2.0
MODCARGO_CRATES +=	walkdir	2.5.0	# Unlicense/MIT
MODCARGO_CRATES +=	want	0.3.1	# MIT
MODCARGO_CRATES +=	wasi	0.11.1+wasi-snapshot-preview1	# Apache-2.0 WITH LLVM-exception OR Apache-2.0 OR MIT
MODCARGO_CRATES +=	wasip2	1.0.1+wasi-0.2.4	# Apache-2.0 WITH LLVM-exception OR Apache-2.0 OR MIT
MODCARGO_CRATES +=	wasite	0.1.0	# Apache-2.0 OR BSL-1.0 OR MIT
MODCARGO_CRATES +=	wasm-bindgen	0.2.105	# MIT OR Apache-2.0
MODCARGO_CRATES +=	wasm-bindgen-futures	0.4.55	# MIT OR Apache-2.0
MODCARGO_CRATES +=	wasm-bindgen-macro	0.2.105	# MIT OR Apache-2.0
MODCARGO_CRATES +=	wasm-bindgen-macro-support	0.2.105	# MIT OR Apache-2.0
MODCARGO_CRATES +=	wasm-bindgen-shared	0.2.105	# MIT OR Apache-2.0
MODCARGO_CRATES +=	web-sys	0.3.82	# MIT OR Apache-2.0
MODCARGO_CRATES +=	web-time	1.1.0	# MIT OR Apache-2.0
MODCARGO_CRATES +=	which	4.4.2	# MIT
MODCARGO_CRATES +=	whoami	1.6.1	# Apache-2.0 OR BSL-1.0 OR MIT
MODCARGO_CRATES +=	winapi	0.3.9	# MIT/Apache-2.0
MODCARGO_CRATES +=	winapi-i686-pc-windows-gnu	0.4.0	# MIT/Apache-2.0
MODCARGO_CRATES +=	winapi-util	0.1.11	# Unlicense OR MIT
MODCARGO_CRATES +=	winapi-x86_64-pc-windows-gnu	0.4.0	# MIT/Apache-2.0
MODCARGO_CRATES +=	windows	0.54.0	# MIT OR Apache-2.0
MODCARGO_CRATES +=	windows	0.61.3	# MIT OR Apache-2.0
MODCARGO_CRATES +=	windows-collections	0.2.0	# MIT OR Apache-2.0
MODCARGO_CRATES +=	windows-core	0.54.0	# MIT OR Apache-2.0
MODCARGO_CRATES +=	windows-core	0.61.2	# MIT OR Apache-2.0
MODCARGO_CRATES +=	windows-core	0.62.2	# MIT OR Apache-2.0
MODCARGO_CRATES +=	windows-future	0.2.1	# MIT OR Apache-2.0
MODCARGO_CRATES +=	windows-implement	0.60.2	# MIT OR Apache-2.0
MODCARGO_CRATES +=	windows-interface	0.59.3	# MIT OR Apache-2.0
MODCARGO_CRATES +=	windows-link	0.1.3	# MIT OR Apache-2.0
MODCARGO_CRATES +=	windows-link	0.2.1	# MIT OR Apache-2.0
MODCARGO_CRATES +=	windows-numerics	0.2.0	# MIT OR Apache-2.0
MODCARGO_CRATES +=	windows-registry	0.6.1	# MIT OR Apache-2.0
MODCARGO_CRATES +=	windows-result	0.1.2	# MIT OR Apache-2.0
MODCARGO_CRATES +=	windows-result	0.3.4	# MIT OR Apache-2.0
MODCARGO_CRATES +=	windows-result	0.4.1	# MIT OR Apache-2.0
MODCARGO_CRATES +=	windows-strings	0.4.2	# MIT OR Apache-2.0
MODCARGO_CRATES +=	windows-strings	0.5.1	# MIT OR Apache-2.0
MODCARGO_CRATES +=	windows-sys	0.45.0	# MIT OR Apache-2.0
MODCARGO_CRATES +=	windows-sys	0.59.0	# MIT OR Apache-2.0
MODCARGO_CRATES +=	windows-sys	0.60.2	# MIT OR Apache-2.0
MODCARGO_CRATES +=	windows-sys	0.61.2	# MIT OR Apache-2.0
MODCARGO_CRATES +=	windows-targets	0.42.2	# MIT OR Apache-2.0
MODCARGO_CRATES +=	windows-targets	0.52.6	# MIT OR Apache-2.0
MODCARGO_CRATES +=	windows-targets	0.53.5	# MIT OR Apache-2.0
MODCARGO_CRATES +=	windows-threading	0.1.0	# MIT OR Apache-2.0
MODCARGO_CRATES +=	windows_aarch64_gnullvm	0.42.2	# MIT OR Apache-2.0
MODCARGO_CRATES +=	windows_aarch64_gnullvm	0.52.6	# MIT OR Apache-2.0
MODCARGO_CRATES +=	windows_aarch64_gnullvm	0.53.1	# MIT OR Apache-2.0
MODCARGO_CRATES +=	windows_aarch64_msvc	0.42.2	# MIT OR Apache-2.0
MODCARGO_CRATES +=	windows_aarch64_msvc	0.52.6	# MIT OR Apache-2.0
MODCARGO_CRATES +=	windows_aarch64_msvc	0.53.1	# MIT OR Apache-2.0
MODCARGO_CRATES +=	windows_i686_gnu	0.42.2	# MIT OR Apache-2.0
MODCARGO_CRATES +=	windows_i686_gnu	0.52.6	# MIT OR Apache-2.0
MODCARGO_CRATES +=	windows_i686_gnu	0.53.1	# MIT OR Apache-2.0
MODCARGO_CRATES +=	windows_i686_gnullvm	0.52.6	# MIT OR Apache-2.0
MODCARGO_CRATES +=	windows_i686_gnullvm	0.53.1	# MIT OR Apache-2.0
MODCARGO_CRATES +=	windows_i686_msvc	0.42.2	# MIT OR Apache-2.0
MODCARGO_CRATES +=	windows_i686_msvc	0.52.6	# MIT OR Apache-2.0
MODCARGO_CRATES +=	windows_i686_msvc	0.53.1	# MIT OR Apache-2.0
MODCARGO_CRATES +=	windows_x86_64_gnu	0.42.2	# MIT OR Apache-2.0
MODCARGO_CRATES +=	windows_x86_64_gnu	0.52.6	# MIT OR Apache-2.0
MODCARGO_CRATES +=	windows_x86_64_gnu	0.53.1	# MIT OR Apache-2.0
MODCARGO_CRATES +=	windows_x86_64_gnullvm	0.42.2	# MIT OR Apache-2.0
MODCARGO_CRATES +=	windows_x86_64_gnullvm	0.52.6	# MIT OR Apache-2.0
MODCARGO_CRATES +=	windows_x86_64_gnullvm	0.53.1	# MIT OR Apache-2.0
MODCARGO_CRATES +=	windows_x86_64_msvc	0.42.2	# MIT OR Apache-2.0
MODCARGO_CRATES +=	windows_x86_64_msvc	0.52.6	# MIT OR Apache-2.0
MODCARGO_CRATES +=	windows_x86_64_msvc	0.53.1	# MIT OR Apache-2.0
MODCARGO_CRATES +=	winnow	0.7.13	# MIT
MODCARGO_CRATES +=	wit-bindgen	0.46.0	# Apache-2.0 WITH LLVM-exception OR Apache-2.0 OR MIT
MODCARGO_CRATES +=	writeable	0.6.2	# Unicode-3.0
MODCARGO_CRATES +=	yoke	0.8.1	# Unicode-3.0
MODCARGO_CRATES +=	yoke-derive	0.8.1	# Unicode-3.0
MODCARGO_CRATES +=	zerocopy	0.8.27	# BSD-2-Clause OR Apache-2.0 OR MIT
MODCARGO_CRATES +=	zerocopy-derive	0.8.27	# BSD-2-Clause OR Apache-2.0 OR MIT
MODCARGO_CRATES +=	zerofrom	0.1.6	# Unicode-3.0
MODCARGO_CRATES +=	zerofrom-derive	0.1.6	# Unicode-3.0
MODCARGO_CRATES +=	zeroize	1.8.2	# Apache-2.0 OR MIT
MODCARGO_CRATES +=	zerotrie	0.2.3	# Unicode-3.0
MODCARGO_CRATES +=	zerovec	0.11.5	# Unicode-3.0
MODCARGO_CRATES +=	zerovec-derive	0.11.2	# Unicode-3.0
