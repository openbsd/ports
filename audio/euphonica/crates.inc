MODCARGO_CRATES +=	adler2	2.0.1	# 0BSD OR MIT OR Apache-2.0
MODCARGO_CRATES +=	ahash	0.8.12	# MIT OR Apache-2.0
MODCARGO_CRATES +=	aho-corasick	1.1.4	# Unlicense OR MIT
MODCARGO_CRATES +=	aligned	0.4.3	# MIT OR Apache-2.0
MODCARGO_CRATES +=	aligned-vec	0.6.4	# MIT
MODCARGO_CRATES +=	allocator-api2	0.2.21	# MIT OR Apache-2.0
MODCARGO_CRATES +=	android_system_properties	0.1.5	# MIT/Apache-2.0
MODCARGO_CRATES +=	annotate-snippets	0.11.5	# MIT OR Apache-2.0
MODCARGO_CRATES +=	anstyle	1.0.14	# MIT OR Apache-2.0
MODCARGO_CRATES +=	anyhow	1.0.102	# MIT OR Apache-2.0
MODCARGO_CRATES +=	approx	0.5.1	# Apache-2.0
MODCARGO_CRATES +=	arbitrary	1.4.2	# MIT OR Apache-2.0
MODCARGO_CRATES +=	arg_enum_proc_macro	0.3.4	# MIT
MODCARGO_CRATES +=	arrayvec	0.7.6	# MIT OR Apache-2.0
MODCARGO_CRATES +=	as-slice	0.2.1	# MIT OR Apache-2.0
MODCARGO_CRATES +=	ashpd	0.10.3	# MIT
MODCARGO_CRATES +=	async-broadcast	0.7.2	# MIT OR Apache-2.0
MODCARGO_CRATES +=	async-channel	2.5.0	# Apache-2.0 OR MIT
MODCARGO_CRATES +=	async-executor	1.13.3	# Apache-2.0 OR MIT
MODCARGO_CRATES +=	async-fs	2.2.0	# Apache-2.0 OR MIT
MODCARGO_CRATES +=	async-io	2.6.0	# Apache-2.0 OR MIT
MODCARGO_CRATES +=	async-lock	3.4.2	# Apache-2.0 OR MIT
MODCARGO_CRATES +=	async-process	2.5.0	# Apache-2.0 OR MIT
MODCARGO_CRATES +=	async-recursion	1.1.1	# MIT OR Apache-2.0
MODCARGO_CRATES +=	async-signal	0.2.13	# Apache-2.0 OR MIT
MODCARGO_CRATES +=	async-task	4.7.1	# Apache-2.0 OR MIT
MODCARGO_CRATES +=	async-trait	0.1.89	# MIT OR Apache-2.0
MODCARGO_CRATES +=	asyncified	0.6.2	# MIT
MODCARGO_CRATES +=	atomic-waker	1.1.2	# Apache-2.0 OR MIT
MODCARGO_CRATES +=	auto-palette	0.6.0	# MIT
MODCARGO_CRATES +=	autocfg	1.5.0	# Apache-2.0 OR MIT
MODCARGO_CRATES +=	av-scenechange	0.14.1	# MIT
MODCARGO_CRATES +=	av1-grain	0.2.5	# BSD-2-Clause
MODCARGO_CRATES +=	avif-serialize	0.8.6	# BSD-3-Clause
MODCARGO_CRATES +=	base64	0.22.1	# MIT OR Apache-2.0
MODCARGO_CRATES +=	bindgen	0.72.1	# BSD-3-Clause
MODCARGO_CRATES +=	bit_field	0.10.3	# Apache-2.0/MIT
MODCARGO_CRATES +=	bitflags	2.11.0	# MIT OR Apache-2.0
MODCARGO_CRATES +=	bitstream-io	4.9.0	# MIT/Apache-2.0
MODCARGO_CRATES +=	bitvec	1.0.1	# MIT
MODCARGO_CRATES +=	block	0.1.6	# MIT
MODCARGO_CRATES +=	block-buffer	0.10.4	# MIT OR Apache-2.0
MODCARGO_CRATES +=	blocking	1.6.2	# Apache-2.0 OR MIT
MODCARGO_CRATES +=	bson	3.1.0	# MIT
MODCARGO_CRATES +=	bufstream	0.1.4	# MIT/Apache-2.0
MODCARGO_CRATES +=	built	0.8.0	# MIT
MODCARGO_CRATES +=	bumpalo	3.20.2	# MIT OR Apache-2.0
MODCARGO_CRATES +=	bytemuck	1.24.0	# Zlib OR Apache-2.0 OR MIT
MODCARGO_CRATES +=	byteorder	1.5.0	# Unlicense OR MIT
MODCARGO_CRATES +=	byteorder-lite	0.1.0	# Unlicense OR MIT
MODCARGO_CRATES +=	bytes	1.11.1	# MIT
MODCARGO_CRATES +=	cairo-rs	0.21.5	# MIT
MODCARGO_CRATES +=	cairo-sys-rs	0.21.5	# MIT
MODCARGO_CRATES +=	cast	0.3.0	# MIT OR Apache-2.0
MODCARGO_CRATES +=	cc	1.2.57	# MIT OR Apache-2.0
MODCARGO_CRATES +=	cexpr	0.6.0	# Apache-2.0/MIT
MODCARGO_CRATES +=	cfg-expr	0.20.7	# MIT OR Apache-2.0
MODCARGO_CRATES +=	cfg-if	1.0.4	# MIT OR Apache-2.0
MODCARGO_CRATES +=	cfg_aliases	0.2.1	# MIT
MODCARGO_CRATES +=	chrono	0.4.42	# MIT OR Apache-2.0
MODCARGO_CRATES +=	clang-sys	1.8.1	# Apache-2.0
MODCARGO_CRATES +=	color_quant	1.1.0	# MIT
MODCARGO_CRATES +=	colorutils-rs	0.7.6	# BSD-3-Clause OR Apache-2.0
MODCARGO_CRATES +=	concurrent-queue	2.5.0	# Apache-2.0 OR MIT
MODCARGO_CRATES +=	convert_case	0.8.0	# MIT
MODCARGO_CRATES +=	cookie-factory	0.3.3	# MIT
MODCARGO_CRATES +=	core-foundation	0.9.4	# MIT OR Apache-2.0
MODCARGO_CRATES +=	core-foundation-sys	0.8.7	# MIT OR Apache-2.0
MODCARGO_CRATES +=	core2	0.4.0	# Apache-2.0 OR MIT
MODCARGO_CRATES +=	cpufeatures	0.2.17	# MIT OR Apache-2.0
MODCARGO_CRATES +=	crc32fast	1.5.0	# MIT OR Apache-2.0
MODCARGO_CRATES +=	crossbeam-deque	0.8.6	# MIT OR Apache-2.0
MODCARGO_CRATES +=	crossbeam-epoch	0.9.18	# MIT OR Apache-2.0
MODCARGO_CRATES +=	crossbeam-utils	0.8.21	# MIT OR Apache-2.0
MODCARGO_CRATES +=	crunchy	0.2.4	# MIT
MODCARGO_CRATES +=	crypto-common	0.1.7	# MIT OR Apache-2.0
MODCARGO_CRATES +=	cssparser	0.35.0	# MPL-2.0
MODCARGO_CRATES +=	cssparser-color	0.3.0	# MPL-2.0
MODCARGO_CRATES +=	cssparser-macros	0.6.1	# MPL-2.0
MODCARGO_CRATES +=	data-url	0.3.2	# MIT OR Apache-2.0
MODCARGO_CRATES +=	deranged	0.5.5	# MIT OR Apache-2.0
MODCARGO_CRATES +=	derivative	2.2.0	# MIT/Apache-2.0
MODCARGO_CRATES +=	derive_more	2.1.1	# MIT
MODCARGO_CRATES +=	derive_more-impl	2.1.1	# MIT
MODCARGO_CRATES +=	digest	0.10.7	# MIT OR Apache-2.0
MODCARGO_CRATES +=	dirs	4.0.0	# MIT OR Apache-2.0
MODCARGO_CRATES +=	dirs-sys	0.3.7	# MIT OR Apache-2.0
MODCARGO_CRATES +=	displaydoc	0.2.5	# MIT OR Apache-2.0
MODCARGO_CRATES +=	dtoa	1.0.11	# MIT OR Apache-2.0
MODCARGO_CRATES +=	dtoa-short	0.3.5	# MPL-2.0
MODCARGO_CRATES +=	duplicate	2.0.1	# MIT OR Apache-2.0
MODCARGO_CRATES +=	either	1.15.0	# MIT OR Apache-2.0
MODCARGO_CRATES +=	encoding_rs	0.8.35	# (Apache-2.0 OR MIT) AND BSD-3-Clause
MODCARGO_CRATES +=	endi	1.1.1	# MIT
MODCARGO_CRATES +=	enumflags2	0.7.12	# MIT OR Apache-2.0
MODCARGO_CRATES +=	enumflags2_derive	0.7.12	# MIT OR Apache-2.0
MODCARGO_CRATES +=	equator	0.4.2	# MIT
MODCARGO_CRATES +=	equator-macro	0.4.2	# MIT
MODCARGO_CRATES +=	equivalent	1.0.2	# Apache-2.0 OR MIT
MODCARGO_CRATES +=	errno	0.3.14	# MIT OR Apache-2.0
MODCARGO_CRATES +=	erydanos	0.2.18	# Apache-2.0 OR BSD-3-Clause
MODCARGO_CRATES +=	event-listener	5.4.1	# Apache-2.0 OR MIT
MODCARGO_CRATES +=	event-listener-strategy	0.5.4	# Apache-2.0 OR MIT
MODCARGO_CRATES +=	exr	1.74.0	# BSD-3-Clause
MODCARGO_CRATES +=	fallible-iterator	0.3.0	# MIT/Apache-2.0
MODCARGO_CRATES +=	fallible-streaming-iterator	0.1.9	# MIT/Apache-2.0
MODCARGO_CRATES +=	fastrand	2.3.0	# Apache-2.0 OR MIT
MODCARGO_CRATES +=	fax	0.2.6	# MIT
MODCARGO_CRATES +=	fax_derive	0.2.0	# MIT
MODCARGO_CRATES +=	fdeflate	0.3.7	# MIT OR Apache-2.0
MODCARGO_CRATES +=	field-offset	0.3.6	# MIT OR Apache-2.0
MODCARGO_CRATES +=	find-msvc-tools	0.1.9	# MIT OR Apache-2.0
MODCARGO_CRATES +=	flate2	1.1.5	# MIT OR Apache-2.0
MODCARGO_CRATES +=	float-cmp	0.8.0	# MIT
MODCARGO_CRATES +=	float-cmp	0.10.0	# MIT
MODCARGO_CRATES +=	fnv	1.0.7	# Apache-2.0 / MIT
MODCARGO_CRATES +=	foldhash	0.1.5	# Zlib
MODCARGO_CRATES +=	foldhash	0.2.0	# Zlib
MODCARGO_CRATES +=	foreign-types	0.3.2	# MIT/Apache-2.0
MODCARGO_CRATES +=	foreign-types-shared	0.1.1	# MIT/Apache-2.0
MODCARGO_CRATES +=	form_urlencoded	1.2.2	# MIT OR Apache-2.0
MODCARGO_CRATES +=	funty	2.0.0	# MIT
MODCARGO_CRATES +=	futf	0.1.5	# MIT / Apache-2.0
MODCARGO_CRATES +=	futures	0.3.32	# MIT OR Apache-2.0
MODCARGO_CRATES +=	futures-channel	0.3.32	# MIT OR Apache-2.0
MODCARGO_CRATES +=	futures-core	0.3.32	# MIT OR Apache-2.0
MODCARGO_CRATES +=	futures-executor	0.3.32	# MIT OR Apache-2.0
MODCARGO_CRATES +=	futures-io	0.3.32	# MIT OR Apache-2.0
MODCARGO_CRATES +=	futures-lite	2.6.1	# Apache-2.0 OR MIT
MODCARGO_CRATES +=	futures-macro	0.3.32	# MIT OR Apache-2.0
MODCARGO_CRATES +=	futures-sink	0.3.32	# MIT OR Apache-2.0
MODCARGO_CRATES +=	futures-task	0.3.32	# MIT OR Apache-2.0
MODCARGO_CRATES +=	futures-util	0.3.32	# MIT OR Apache-2.0
MODCARGO_CRATES +=	fxhash	0.2.1	# Apache-2.0/MIT
MODCARGO_CRATES +=	gdk-pixbuf	0.21.5	# MIT
MODCARGO_CRATES +=	gdk-pixbuf-sys	0.21.5	# MIT
MODCARGO_CRATES +=	gdk4	0.10.3	# MIT
MODCARGO_CRATES +=	gdk4-sys	0.10.3	# MIT
MODCARGO_CRATES +=	generic-array	0.14.7	# MIT
MODCARGO_CRATES +=	getrandom	0.2.16	# MIT OR Apache-2.0
MODCARGO_CRATES +=	getrandom	0.3.4	# MIT OR Apache-2.0
MODCARGO_CRATES +=	gettext-rs	0.7.7	# MIT
MODCARGO_CRATES +=	gettext-sys	0.26.0	# MIT
MODCARGO_CRATES +=	gif	0.14.1	# MIT OR Apache-2.0
MODCARGO_CRATES +=	gio	0.21.5	# MIT
MODCARGO_CRATES +=	gio-sys	0.21.5	# MIT
MODCARGO_CRATES +=	glib	0.21.5	# MIT
MODCARGO_CRATES +=	glib-macros	0.21.5	# MIT
MODCARGO_CRATES +=	glib-sys	0.21.5	# MIT
MODCARGO_CRATES +=	glob	0.3.3	# MIT OR Apache-2.0
MODCARGO_CRATES +=	gobject-sys	0.21.5	# MIT
MODCARGO_CRATES +=	graphene-rs	0.21.5	# MIT
MODCARGO_CRATES +=	graphene-sys	0.21.5	# MIT
MODCARGO_CRATES +=	gsk4	0.10.3	# MIT
MODCARGO_CRATES +=	gsk4-sys	0.10.3	# MIT
MODCARGO_CRATES +=	gtk4	0.10.3	# MIT
MODCARGO_CRATES +=	gtk4-macros	0.10.3	# MIT
MODCARGO_CRATES +=	gtk4-sys	0.10.3	# MIT
MODCARGO_CRATES +=	h2	0.4.12	# MIT
MODCARGO_CRATES +=	half	2.7.1	# MIT OR Apache-2.0
MODCARGO_CRATES +=	hashbrown	0.15.5	# MIT OR Apache-2.0
MODCARGO_CRATES +=	hashbrown	0.16.1	# MIT OR Apache-2.0
MODCARGO_CRATES +=	hashlink	0.10.0	# MIT OR Apache-2.0
MODCARGO_CRATES +=	heck	0.5.0	# MIT OR Apache-2.0
MODCARGO_CRATES +=	hermit-abi	0.5.2	# MIT OR Apache-2.0
MODCARGO_CRATES +=	hex	0.4.3	# MIT OR Apache-2.0
MODCARGO_CRATES +=	http	1.4.0	# MIT OR Apache-2.0
MODCARGO_CRATES +=	http-body	1.0.1	# MIT
MODCARGO_CRATES +=	http-body-util	0.1.3	# MIT
MODCARGO_CRATES +=	httparse	1.10.1	# MIT OR Apache-2.0
MODCARGO_CRATES +=	hyper	1.8.1	# MIT
MODCARGO_CRATES +=	hyper-rustls	0.27.7	# Apache-2.0 OR ISC OR MIT
MODCARGO_CRATES +=	hyper-tls	0.6.0	# MIT/Apache-2.0
MODCARGO_CRATES +=	hyper-util	0.1.19	# MIT
MODCARGO_CRATES +=	iana-time-zone	0.1.64	# MIT OR Apache-2.0
MODCARGO_CRATES +=	iana-time-zone-haiku	0.1.2	# MIT OR Apache-2.0
MODCARGO_CRATES +=	icu_collections	2.1.1	# Unicode-3.0
MODCARGO_CRATES +=	icu_locale_core	2.1.1	# Unicode-3.0
MODCARGO_CRATES +=	icu_normalizer	2.1.1	# Unicode-3.0
MODCARGO_CRATES +=	icu_normalizer_data	2.1.1	# Unicode-3.0
MODCARGO_CRATES +=	icu_properties	2.1.2	# Unicode-3.0
MODCARGO_CRATES +=	icu_properties_data	2.1.2	# Unicode-3.0
MODCARGO_CRATES +=	icu_provider	2.1.1	# Unicode-3.0
MODCARGO_CRATES +=	idna	1.1.0	# MIT OR Apache-2.0
MODCARGO_CRATES +=	idna_adapter	1.2.1	# Apache-2.0 OR MIT
MODCARGO_CRATES +=	image	0.25.9	# MIT OR Apache-2.0
MODCARGO_CRATES +=	image-webp	0.2.4	# MIT OR Apache-2.0
MODCARGO_CRATES +=	imgref	1.12.0	# CC0-1.0 OR Apache-2.0
MODCARGO_CRATES +=	indexmap	2.13.0	# Apache-2.0 OR MIT
MODCARGO_CRATES +=	interpolate_name	0.2.4	# MIT
MODCARGO_CRATES +=	ipnet	2.11.0	# MIT OR Apache-2.0
MODCARGO_CRATES +=	iri-string	0.7.10	# MIT OR Apache-2.0
MODCARGO_CRATES +=	is-docker	0.2.0	# MIT
MODCARGO_CRATES +=	is-wsl	0.4.0	# MIT
MODCARGO_CRATES +=	itertools	0.13.0	# MIT OR Apache-2.0
MODCARGO_CRATES +=	itertools	0.14.0	# MIT OR Apache-2.0
MODCARGO_CRATES +=	itoa	1.0.17	# MIT OR Apache-2.0
MODCARGO_CRATES +=	jobserver	0.1.34	# MIT OR Apache-2.0
MODCARGO_CRATES +=	js-sys	0.3.83	# MIT OR Apache-2.0
MODCARGO_CRATES +=	language-tags	0.3.2	# MIT/Apache-2.0
MODCARGO_CRATES +=	lazy_static	1.5.0	# MIT OR Apache-2.0
MODCARGO_CRATES +=	lebe	0.5.3	# BSD-3-Clause
MODCARGO_CRATES +=	libadwaita	0.8.1	# MIT
MODCARGO_CRATES +=	libadwaita-sys	0.8.1	# MIT
MODCARGO_CRATES +=	libblur	0.14.10	# Apache-2.0 OR BSD-3-Clause
MODCARGO_CRATES +=	libc	0.2.183	# MIT OR Apache-2.0
MODCARGO_CRATES +=	libfuzzer-sys	0.4.10	# (MIT OR Apache-2.0) AND NCSA
MODCARGO_CRATES +=	libloading	0.8.9	# ISC
MODCARGO_CRATES +=	libm	0.2.15	# MIT
MODCARGO_CRATES +=	libredox	0.1.12	# MIT
MODCARGO_CRATES +=	librsvg	2.61.3	# LGPL-2.1-or-later
MODCARGO_CRATES +=	libsecret	0.8.0	# MIT
MODCARGO_CRATES +=	libsecret-sys	0.8.0	# MIT
MODCARGO_CRATES +=	libspa	0.9.2	# MIT
MODCARGO_CRATES +=	libspa-sys	0.9.2	# MIT
MODCARGO_CRATES +=	libsqlite3-sys	0.35.0	# MIT
MODCARGO_CRATES +=	linux-raw-sys	0.11.0	# Apache-2.0 WITH LLVM-exception OR Apache-2.0 OR MIT
MODCARGO_CRATES +=	litemap	0.8.1	# Unicode-3.0
MODCARGO_CRATES +=	locale_config	0.3.0	# MIT
MODCARGO_CRATES +=	lock_api	0.4.14	# MIT OR Apache-2.0
MODCARGO_CRATES +=	log	0.4.29	# MIT OR Apache-2.0
MODCARGO_CRATES +=	loop9	0.1.5	# MIT
MODCARGO_CRATES +=	lru	0.16.2	# MIT
MODCARGO_CRATES +=	lucene_query_builder	0.3.0	# MIT
MODCARGO_CRATES +=	lucene_query_builder_rs_derive	0.3.0	# MIT
MODCARGO_CRATES +=	mac	0.1.1	# MIT/Apache-2.0
MODCARGO_CRATES +=	malloc_buf	0.0.6	# MIT
MODCARGO_CRATES +=	markup5ever	0.35.0	# MIT OR Apache-2.0
MODCARGO_CRATES +=	matrixmultiply	0.3.10	# MIT/Apache-2.0
MODCARGO_CRATES +=	maybe-async	0.2.10	# MIT
MODCARGO_CRATES +=	maybe-rayon	0.1.1	# MIT
MODCARGO_CRATES +=	memchr	2.8.0	# Unlicense OR MIT
MODCARGO_CRATES +=	memoffset	0.9.1	# MIT
MODCARGO_CRATES +=	microfft	0.4.0	# MIT
MODCARGO_CRATES +=	mime	0.3.17	# MIT OR Apache-2.0
MODCARGO_CRATES +=	minimal-lexical	0.2.1	# MIT/Apache-2.0
MODCARGO_CRATES +=	miniz_oxide	0.8.9	# MIT OR Zlib OR Apache-2.0
MODCARGO_CRATES +=	mio	1.1.1	# MIT
MODCARGO_CRATES +=	moxcms	0.7.11	# BSD-3-Clause OR Apache-2.0
MODCARGO_CRATES +=	mpris-server	0.8.1	# MPL-2.0
MODCARGO_CRATES +=	musicbrainz_rs	0.12.0	# MIT
MODCARGO_CRATES +=	nalgebra	0.33.2	# Apache-2.0
MODCARGO_CRATES +=	nalgebra-macros	0.2.2	# Apache-2.0
MODCARGO_CRATES +=	native-tls	0.2.14	# MIT OR Apache-2.0
MODCARGO_CRATES +=	new_debug_unreachable	1.0.6	# MIT
MODCARGO_CRATES +=	nix	0.29.0	# MIT
MODCARGO_CRATES +=	nix	0.30.1	# MIT
MODCARGO_CRATES +=	nohash-hasher	0.2.0	# Apache-2.0 OR MIT
MODCARGO_CRATES +=	nom	7.1.3	# MIT
MODCARGO_CRATES +=	nom	8.0.0	# MIT
MODCARGO_CRATES +=	noop_proc_macro	0.3.0	# MIT
MODCARGO_CRATES +=	num-bigint	0.4.6	# MIT OR Apache-2.0
MODCARGO_CRATES +=	num-complex	0.4.6	# MIT OR Apache-2.0
MODCARGO_CRATES +=	num-conv	0.2.0	# MIT OR Apache-2.0
MODCARGO_CRATES +=	num-derive	0.4.2	# MIT OR Apache-2.0
MODCARGO_CRATES +=	num-integer	0.1.46	# MIT OR Apache-2.0
MODCARGO_CRATES +=	num-rational	0.4.2	# MIT OR Apache-2.0
MODCARGO_CRATES +=	num-traits	0.2.19	# MIT OR Apache-2.0
MODCARGO_CRATES +=	num_threads	0.1.7	# MIT OR Apache-2.0
MODCARGO_CRATES +=	objc	0.2.7	# MIT
MODCARGO_CRATES +=	objc-foundation	0.1.1	# MIT
MODCARGO_CRATES +=	objc_id	0.1.1	# MIT
MODCARGO_CRATES +=	once_cell	1.21.4	# MIT OR Apache-2.0
MODCARGO_CRATES +=	oneshot	0.1.12	# MIT OR Apache-2.0
MODCARGO_CRATES +=	open	5.3.3	# MIT
MODCARGO_CRATES +=	openssl	0.10.75	# Apache-2.0
MODCARGO_CRATES +=	openssl-macros	0.1.1	# MIT/Apache-2.0
MODCARGO_CRATES +=	openssl-probe	0.1.6	# MIT/Apache-2.0
MODCARGO_CRATES +=	openssl-sys	0.9.111	# MIT
MODCARGO_CRATES +=	ordered-stream	0.2.0	# MIT OR Apache-2.0
MODCARGO_CRATES +=	pango	0.21.5	# MIT
MODCARGO_CRATES +=	pango-sys	0.21.5	# MIT
MODCARGO_CRATES +=	pangocairo	0.21.5	# MIT
MODCARGO_CRATES +=	pangocairo-sys	0.21.5	# MIT
MODCARGO_CRATES +=	parking	2.2.1	# Apache-2.0 OR MIT
MODCARGO_CRATES +=	parking_lot	0.12.5	# MIT OR Apache-2.0
MODCARGO_CRATES +=	parking_lot_core	0.9.12	# MIT OR Apache-2.0
MODCARGO_CRATES +=	paste	1.0.15	# MIT OR Apache-2.0
MODCARGO_CRATES +=	pastey	0.1.1	# MIT OR Apache-2.0
MODCARGO_CRATES +=	pathdiff	0.2.3	# MIT/Apache-2.0
MODCARGO_CRATES +=	percent-encoding	2.3.2	# MIT OR Apache-2.0
MODCARGO_CRATES +=	phf	0.11.3	# MIT
MODCARGO_CRATES +=	phf_codegen	0.11.3	# MIT
MODCARGO_CRATES +=	phf_generator	0.11.3	# MIT
MODCARGO_CRATES +=	phf_macros	0.11.3	# MIT
MODCARGO_CRATES +=	phf_shared	0.11.3	# MIT
MODCARGO_CRATES +=	phf_shared	0.13.1	# MIT
MODCARGO_CRATES +=	pin-project-lite	0.2.17	# Apache-2.0 OR MIT
MODCARGO_CRATES +=	pin-utils	0.1.0	# MIT OR Apache-2.0
MODCARGO_CRATES +=	piper	0.2.4	# MIT OR Apache-2.0
MODCARGO_CRATES +=	pipewire	0.9.2	# MIT
MODCARGO_CRATES +=	pipewire-sys	0.9.2	# MIT
MODCARGO_CRATES +=	pkg-config	0.3.32	# MIT OR Apache-2.0
MODCARGO_CRATES +=	png	0.18.0	# MIT OR Apache-2.0
MODCARGO_CRATES +=	polling	3.11.0	# Apache-2.0 OR MIT
MODCARGO_CRATES +=	potential_utf	0.1.4	# Unicode-3.0
MODCARGO_CRATES +=	powerfmt	0.2.0	# MIT OR Apache-2.0
MODCARGO_CRATES +=	ppv-lite86	0.2.21	# MIT OR Apache-2.0
MODCARGO_CRATES +=	precomputed-hash	0.1.1	# MIT
MODCARGO_CRATES +=	proc-macro-crate	3.5.0	# MIT OR Apache-2.0
MODCARGO_CRATES +=	proc-macro2	1.0.106	# MIT OR Apache-2.0
MODCARGO_CRATES +=	proc-macro2-diagnostics	0.10.1	# MIT/Apache-2.0
MODCARGO_CRATES +=	profiling	1.0.17	# MIT OR Apache-2.0
MODCARGO_CRATES +=	profiling-procmacros	1.0.17	# MIT OR Apache-2.0
MODCARGO_CRATES +=	pxfm	0.1.27	# BSD-3-Clause OR Apache-2.0
MODCARGO_CRATES +=	qoi	0.4.1	# MIT/Apache-2.0
MODCARGO_CRATES +=	quick-error	2.0.1	# MIT/Apache-2.0
MODCARGO_CRATES +=	quote	1.0.45	# MIT OR Apache-2.0
MODCARGO_CRATES +=	r-efi	5.3.0	# MIT OR Apache-2.0 OR LGPL-2.1-or-later
MODCARGO_CRATES +=	r2d2	0.8.10	# MIT/Apache-2.0
MODCARGO_CRATES +=	r2d2_sqlite	0.31.0	# MIT
MODCARGO_CRATES +=	radium	0.7.0	# MIT
MODCARGO_CRATES +=	rand	0.8.5	# MIT OR Apache-2.0
MODCARGO_CRATES +=	rand	0.9.2	# MIT OR Apache-2.0
MODCARGO_CRATES +=	rand_chacha	0.3.1	# MIT OR Apache-2.0
MODCARGO_CRATES +=	rand_chacha	0.9.0	# MIT OR Apache-2.0
MODCARGO_CRATES +=	rand_core	0.6.4	# MIT OR Apache-2.0
MODCARGO_CRATES +=	rand_core	0.9.3	# MIT OR Apache-2.0
MODCARGO_CRATES +=	rand_distr	0.5.1	# MIT OR Apache-2.0
MODCARGO_CRATES +=	rav1e	0.8.1	# BSD-2-Clause
MODCARGO_CRATES +=	ravif	0.12.0	# BSD-3-Clause
MODCARGO_CRATES +=	rawpointer	0.2.1	# MIT/Apache-2.0
MODCARGO_CRATES +=	rayon	1.11.0	# MIT OR Apache-2.0
MODCARGO_CRATES +=	rayon-core	1.13.0	# MIT OR Apache-2.0
MODCARGO_CRATES +=	rctree	0.6.0	# MIT
MODCARGO_CRATES +=	redox_syscall	0.5.18	# MIT
MODCARGO_CRATES +=	redox_users	0.4.6	# MIT
MODCARGO_CRATES +=	regex	1.12.3	# MIT OR Apache-2.0
MODCARGO_CRATES +=	regex-automata	0.4.14	# MIT OR Apache-2.0
MODCARGO_CRATES +=	regex-syntax	0.8.10	# MIT OR Apache-2.0
MODCARGO_CRATES +=	reqwest	0.12.28	# MIT OR Apache-2.0
MODCARGO_CRATES +=	resolve-path	0.1.0	# MIT OR Apache-2.0
MODCARGO_CRATES +=	rgb	0.8.52	# MIT
MODCARGO_CRATES +=	ring	0.17.14	# Apache-2.0 AND ISC
MODCARGO_CRATES +=	ringbuffer	0.15.0	# MIT
MODCARGO_CRATES +=	rusqlite	0.37.0	# MIT
MODCARGO_CRATES +=	rustc-hash	2.1.1	# Apache-2.0 OR MIT
MODCARGO_CRATES +=	rustc_version	0.4.1	# MIT OR Apache-2.0
MODCARGO_CRATES +=	rustix	1.1.3	# Apache-2.0 WITH LLVM-exception OR Apache-2.0 OR MIT
MODCARGO_CRATES +=	rustls	0.23.35	# Apache-2.0 OR ISC OR MIT
MODCARGO_CRATES +=	rustls-pki-types	1.13.2	# MIT OR Apache-2.0
MODCARGO_CRATES +=	rustls-webpki	0.103.8	# ISC
MODCARGO_CRATES +=	rustversion	1.0.22	# MIT OR Apache-2.0
MODCARGO_CRATES +=	ryu	1.0.22	# Apache-2.0 OR BSL-1.0
MODCARGO_CRATES +=	safe_arch	0.7.4	# Zlib OR Apache-2.0 OR MIT
MODCARGO_CRATES +=	schannel	0.1.28	# MIT
MODCARGO_CRATES +=	scheduled-thread-pool	0.2.7	# MIT/Apache-2.0
MODCARGO_CRATES +=	scopeguard	1.2.0	# MIT OR Apache-2.0
MODCARGO_CRATES +=	security-framework	2.11.1	# MIT OR Apache-2.0
MODCARGO_CRATES +=	security-framework-sys	2.15.0	# MIT OR Apache-2.0
MODCARGO_CRATES +=	selectors	0.31.0	# MPL-2.0
MODCARGO_CRATES +=	semver	1.0.27	# MIT OR Apache-2.0
MODCARGO_CRATES +=	serde	1.0.228	# MIT OR Apache-2.0
MODCARGO_CRATES +=	serde_bytes	0.11.19	# MIT OR Apache-2.0
MODCARGO_CRATES +=	serde_core	1.0.228	# MIT OR Apache-2.0
MODCARGO_CRATES +=	serde_derive	1.0.228	# MIT OR Apache-2.0
MODCARGO_CRATES +=	serde_json	1.0.148	# MIT OR Apache-2.0
MODCARGO_CRATES +=	serde_repr	0.1.20	# MIT OR Apache-2.0
MODCARGO_CRATES +=	serde_spanned	1.0.4	# MIT OR Apache-2.0
MODCARGO_CRATES +=	serde_urlencoded	0.7.1	# MIT/Apache-2.0
MODCARGO_CRATES +=	servo_arc	0.4.3	# MIT OR Apache-2.0
MODCARGO_CRATES +=	sha1	0.10.6	# MIT OR Apache-2.0
MODCARGO_CRATES +=	shlex	1.3.0	# MIT OR Apache-2.0
MODCARGO_CRATES +=	signal-hook-registry	1.4.8	# MIT OR Apache-2.0
MODCARGO_CRATES +=	simba	0.9.1	# Apache-2.0
MODCARGO_CRATES +=	simd-adler32	0.3.8	# MIT
MODCARGO_CRATES +=	simd_helpers	0.1.0	# MIT
MODCARGO_CRATES +=	simdutf8	0.1.5	# MIT OR Apache-2.0
MODCARGO_CRATES +=	siphasher	1.0.1	# MIT/Apache-2.0
MODCARGO_CRATES +=	slab	0.4.12	# MIT
MODCARGO_CRATES +=	smallvec	1.15.1	# MIT OR Apache-2.0
MODCARGO_CRATES +=	socket2	0.6.1	# MIT OR Apache-2.0
MODCARGO_CRATES +=	spectrum-analyzer	0.5.2	# MIT
MODCARGO_CRATES +=	stable_deref_trait	1.2.1	# MIT OR Apache-2.0
MODCARGO_CRATES +=	static_assertions	1.1.0	# MIT OR Apache-2.0
MODCARGO_CRATES +=	string_cache	0.8.9	# MIT OR Apache-2.0
MODCARGO_CRATES +=	string_cache	0.9.0	# MIT OR Apache-2.0
MODCARGO_CRATES +=	string_cache_codegen	0.5.4	# MIT OR Apache-2.0
MODCARGO_CRATES +=	strum	0.27.2	# MIT
MODCARGO_CRATES +=	strum_macros	0.27.2	# MIT
MODCARGO_CRATES +=	subtle	2.6.1	# BSD-3-Clause
MODCARGO_CRATES +=	syn	1.0.109	# MIT OR Apache-2.0
MODCARGO_CRATES +=	syn	2.0.117	# MIT OR Apache-2.0
MODCARGO_CRATES +=	sync_wrapper	1.0.2	# Apache-2.0
MODCARGO_CRATES +=	synstructure	0.13.2	# MIT
MODCARGO_CRATES +=	system-configuration	0.6.1	# MIT OR Apache-2.0
MODCARGO_CRATES +=	system-configuration-sys	0.6.0	# MIT OR Apache-2.0
MODCARGO_CRATES +=	system-deps	7.0.7	# MIT OR Apache-2.0
MODCARGO_CRATES +=	tap	1.0.1	# MIT
MODCARGO_CRATES +=	target-lexicon	0.13.3	# Apache-2.0 WITH LLVM-exception
MODCARGO_CRATES +=	temp-dir	0.1.16	# Apache-2.0
MODCARGO_CRATES +=	tempfile	3.24.0	# MIT OR Apache-2.0
MODCARGO_CRATES +=	tendril	0.4.3	# MIT/Apache-2.0
MODCARGO_CRATES +=	thiserror	1.0.69	# MIT OR Apache-2.0
MODCARGO_CRATES +=	thiserror	2.0.17	# MIT OR Apache-2.0
MODCARGO_CRATES +=	thiserror-impl	1.0.69	# MIT OR Apache-2.0
MODCARGO_CRATES +=	thiserror-impl	2.0.17	# MIT OR Apache-2.0
MODCARGO_CRATES +=	tiff	0.10.3	# MIT
MODCARGO_CRATES +=	time	0.3.47	# MIT OR Apache-2.0
MODCARGO_CRATES +=	time-core	0.1.8	# MIT OR Apache-2.0
MODCARGO_CRATES +=	time-macros	0.2.27	# MIT OR Apache-2.0
MODCARGO_CRATES +=	tinystr	0.8.2	# Unicode-3.0
MODCARGO_CRATES +=	tinyvec	1.10.0	# Zlib OR Apache-2.0 OR MIT
MODCARGO_CRATES +=	tinyvec_macros	0.1.1	# MIT OR Apache-2.0 OR Zlib
MODCARGO_CRATES +=	tokio	1.48.0	# MIT
MODCARGO_CRATES +=	tokio-native-tls	0.3.1	# MIT
MODCARGO_CRATES +=	tokio-rustls	0.26.4	# MIT OR Apache-2.0
MODCARGO_CRATES +=	tokio-util	0.7.17	# MIT
MODCARGO_CRATES +=	toml	0.9.12+spec-1.1.0	# MIT OR Apache-2.0
MODCARGO_CRATES +=	toml_datetime	0.7.5+spec-1.1.0	# MIT OR Apache-2.0
MODCARGO_CRATES +=	toml_datetime	1.0.0+spec-1.1.0	# MIT OR Apache-2.0
MODCARGO_CRATES +=	toml_edit	0.25.4+spec-1.1.0	# MIT OR Apache-2.0
MODCARGO_CRATES +=	toml_parser	1.0.9+spec-1.1.0	# MIT OR Apache-2.0
MODCARGO_CRATES +=	toml_writer	1.0.6+spec-1.1.0	# MIT OR Apache-2.0
MODCARGO_CRATES +=	tower	0.5.2	# MIT
MODCARGO_CRATES +=	tower-http	0.6.8	# MIT
MODCARGO_CRATES +=	tower-layer	0.3.3	# MIT
MODCARGO_CRATES +=	tower-service	0.3.3	# MIT
MODCARGO_CRATES +=	tracing	0.1.44	# MIT
MODCARGO_CRATES +=	tracing-attributes	0.1.31	# MIT
MODCARGO_CRATES +=	tracing-core	0.1.36	# MIT
MODCARGO_CRATES +=	trait-variant	0.1.2	# MIT OR Apache-2.0
MODCARGO_CRATES +=	try-lock	0.2.5	# MIT
MODCARGO_CRATES +=	typenum	1.19.0	# MIT OR Apache-2.0
MODCARGO_CRATES +=	uds_windows	1.1.0	# MIT
MODCARGO_CRATES +=	unicode-ident	1.0.24	# (MIT OR Apache-2.0) AND Unicode-3.0
MODCARGO_CRATES +=	unicode-segmentation	1.12.0	# MIT OR Apache-2.0
MODCARGO_CRATES +=	unicode-width	0.2.2	# MIT OR Apache-2.0
MODCARGO_CRATES +=	untrusted	0.9.0	# ISC
MODCARGO_CRATES +=	url	2.5.7	# MIT OR Apache-2.0
MODCARGO_CRATES +=	urlencoding	2.1.3	# MIT
MODCARGO_CRATES +=	utf-8	0.7.6	# MIT OR Apache-2.0
MODCARGO_CRATES +=	utf8_iter	1.0.4	# Apache-2.0 OR MIT
MODCARGO_CRATES +=	uuid	1.19.0	# Apache-2.0 OR MIT
MODCARGO_CRATES +=	uuid-macro-internal	1.19.0	# Apache-2.0 OR MIT
MODCARGO_CRATES +=	v_frame	0.3.9	# BSD-2-Clause
MODCARGO_CRATES +=	vcpkg	0.2.15	# MIT/Apache-2.0
MODCARGO_CRATES +=	version-compare	0.2.1	# MIT
MODCARGO_CRATES +=	version_check	0.9.5	# MIT/Apache-2.0
MODCARGO_CRATES +=	want	0.3.1	# MIT
MODCARGO_CRATES +=	wasi	0.11.1+wasi-snapshot-preview1	# Apache-2.0 WITH LLVM-exception OR Apache-2.0 OR MIT
MODCARGO_CRATES +=	wasip2	1.0.2+wasi-0.2.9	# Apache-2.0 WITH LLVM-exception OR Apache-2.0 OR MIT
MODCARGO_CRATES +=	wasm-bindgen	0.2.106	# MIT OR Apache-2.0
MODCARGO_CRATES +=	wasm-bindgen-futures	0.4.56	# MIT OR Apache-2.0
MODCARGO_CRATES +=	wasm-bindgen-macro	0.2.106	# MIT OR Apache-2.0
MODCARGO_CRATES +=	wasm-bindgen-macro-support	0.2.106	# MIT OR Apache-2.0
MODCARGO_CRATES +=	wasm-bindgen-shared	0.2.106	# MIT OR Apache-2.0
MODCARGO_CRATES +=	web-sys	0.3.83	# MIT OR Apache-2.0
MODCARGO_CRATES +=	web_atoms	0.1.3	# MIT OR Apache-2.0
MODCARGO_CRATES +=	weezl	0.1.12	# MIT OR Apache-2.0
MODCARGO_CRATES +=	wide	0.7.33	# Zlib OR Apache-2.0 OR MIT
MODCARGO_CRATES +=	winapi	0.3.9	# MIT/Apache-2.0
MODCARGO_CRATES +=	winapi-i686-pc-windows-gnu	0.4.0	# MIT/Apache-2.0
MODCARGO_CRATES +=	winapi-x86_64-pc-windows-gnu	0.4.0	# MIT/Apache-2.0
MODCARGO_CRATES +=	windows-core	0.62.2	# MIT OR Apache-2.0
MODCARGO_CRATES +=	windows-implement	0.60.2	# MIT OR Apache-2.0
MODCARGO_CRATES +=	windows-interface	0.59.3	# MIT OR Apache-2.0
MODCARGO_CRATES +=	windows-link	0.2.1	# MIT OR Apache-2.0
MODCARGO_CRATES +=	windows-registry	0.6.1	# MIT OR Apache-2.0
MODCARGO_CRATES +=	windows-result	0.4.1	# MIT OR Apache-2.0
MODCARGO_CRATES +=	windows-strings	0.5.1	# MIT OR Apache-2.0
MODCARGO_CRATES +=	windows-sys	0.52.0	# MIT OR Apache-2.0
MODCARGO_CRATES +=	windows-sys	0.59.0	# MIT OR Apache-2.0
MODCARGO_CRATES +=	windows-sys	0.60.2	# MIT OR Apache-2.0
MODCARGO_CRATES +=	windows-sys	0.61.2	# MIT OR Apache-2.0
MODCARGO_CRATES +=	windows-targets	0.52.6	# MIT OR Apache-2.0
MODCARGO_CRATES +=	windows-targets	0.53.5	# MIT OR Apache-2.0
MODCARGO_CRATES +=	windows_aarch64_gnullvm	0.52.6	# MIT OR Apache-2.0
MODCARGO_CRATES +=	windows_aarch64_gnullvm	0.53.1	# MIT OR Apache-2.0
MODCARGO_CRATES +=	windows_aarch64_msvc	0.52.6	# MIT OR Apache-2.0
MODCARGO_CRATES +=	windows_aarch64_msvc	0.53.1	# MIT OR Apache-2.0
MODCARGO_CRATES +=	windows_i686_gnu	0.52.6	# MIT OR Apache-2.0
MODCARGO_CRATES +=	windows_i686_gnu	0.53.1	# MIT OR Apache-2.0
MODCARGO_CRATES +=	windows_i686_gnullvm	0.52.6	# MIT OR Apache-2.0
MODCARGO_CRATES +=	windows_i686_gnullvm	0.53.1	# MIT OR Apache-2.0
MODCARGO_CRATES +=	windows_i686_msvc	0.52.6	# MIT OR Apache-2.0
MODCARGO_CRATES +=	windows_i686_msvc	0.53.1	# MIT OR Apache-2.0
MODCARGO_CRATES +=	windows_x86_64_gnu	0.52.6	# MIT OR Apache-2.0
MODCARGO_CRATES +=	windows_x86_64_gnu	0.53.1	# MIT OR Apache-2.0
MODCARGO_CRATES +=	windows_x86_64_gnullvm	0.52.6	# MIT OR Apache-2.0
MODCARGO_CRATES +=	windows_x86_64_gnullvm	0.53.1	# MIT OR Apache-2.0
MODCARGO_CRATES +=	windows_x86_64_msvc	0.52.6	# MIT OR Apache-2.0
MODCARGO_CRATES +=	windows_x86_64_msvc	0.53.1	# MIT OR Apache-2.0
MODCARGO_CRATES +=	winnow	0.7.15	# MIT
MODCARGO_CRATES +=	wit-bindgen	0.51.0	# Apache-2.0 WITH LLVM-exception OR Apache-2.0 OR MIT
MODCARGO_CRATES +=	writeable	0.6.2	# Unicode-3.0
MODCARGO_CRATES +=	wyz	0.5.1	# MIT
MODCARGO_CRATES +=	xdg-home	1.3.0	# MIT
MODCARGO_CRATES +=	xml5ever	0.35.0	# MIT OR Apache-2.0
MODCARGO_CRATES +=	y4m	0.8.0	# MIT
MODCARGO_CRATES +=	yoke	0.8.1	# Unicode-3.0
MODCARGO_CRATES +=	yoke-derive	0.8.1	# Unicode-3.0
MODCARGO_CRATES +=	zbus	4.4.0	# MIT
MODCARGO_CRATES +=	zbus	5.12.0	# MIT
MODCARGO_CRATES +=	zbus_macros	4.4.0	# MIT
MODCARGO_CRATES +=	zbus_macros	5.12.0	# MIT
MODCARGO_CRATES +=	zbus_names	3.0.0	# MIT
MODCARGO_CRATES +=	zbus_names	4.2.0	# MIT
MODCARGO_CRATES +=	zerocopy	0.8.31	# BSD-2-Clause OR Apache-2.0 OR MIT
MODCARGO_CRATES +=	zerocopy-derive	0.8.31	# BSD-2-Clause OR Apache-2.0 OR MIT
MODCARGO_CRATES +=	zerofrom	0.1.6	# Unicode-3.0
MODCARGO_CRATES +=	zerofrom-derive	0.1.6	# Unicode-3.0
MODCARGO_CRATES +=	zeroize	1.8.2	# Apache-2.0 OR MIT
MODCARGO_CRATES +=	zerotrie	0.2.3	# Unicode-3.0
MODCARGO_CRATES +=	zerovec	0.11.5	# Unicode-3.0
MODCARGO_CRATES +=	zerovec-derive	0.11.2	# Unicode-3.0
MODCARGO_CRATES +=	zmij	1.0.7	# MIT
MODCARGO_CRATES +=	zune-core	0.4.12	# MIT OR Apache-2.0 OR Zlib
MODCARGO_CRATES +=	zune-core	0.5.0	# MIT OR Apache-2.0 OR Zlib
MODCARGO_CRATES +=	zune-inflate	0.2.54	# MIT OR Apache-2.0 OR Zlib
MODCARGO_CRATES +=	zune-jpeg	0.4.21	# MIT OR Apache-2.0 OR Zlib
MODCARGO_CRATES +=	zune-jpeg	0.5.8	# MIT OR Apache-2.0 OR Zlib
MODCARGO_CRATES +=	zvariant	4.2.0	# MIT
MODCARGO_CRATES +=	zvariant	5.8.0	# MIT
MODCARGO_CRATES +=	zvariant_derive	4.2.0	# MIT
MODCARGO_CRATES +=	zvariant_derive	5.8.0	# MIT
MODCARGO_CRATES +=	zvariant_utils	2.1.0	# MIT
MODCARGO_CRATES +=	zvariant_utils	3.2.1	# MIT
