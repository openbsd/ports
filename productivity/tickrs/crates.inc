MODCARGO_CRATES +=	addr2line	0.20.0	# Apache-2.0 OR MIT
MODCARGO_CRATES +=	adler	1.0.2	# 0BSD OR MIT OR Apache-2.0
MODCARGO_CRATES +=	android-tzdata	0.1.1	# MIT OR Apache-2.0
MODCARGO_CRATES +=	android_system_properties	0.1.5	# MIT/Apache-2.0
MODCARGO_CRATES +=	ansi_term	0.12.1	# MIT
MODCARGO_CRATES +=	anyhow	1.0.72	# MIT OR Apache-2.0
MODCARGO_CRATES +=	async-attributes	1.1.2	# MIT OR Apache-2.0
MODCARGO_CRATES +=	async-channel	1.9.0	# Apache-2.0 OR MIT
MODCARGO_CRATES +=	async-executor	1.5.1	# Apache-2.0 OR MIT
MODCARGO_CRATES +=	async-global-executor	2.3.1	# Apache-2.0 OR MIT
MODCARGO_CRATES +=	async-io	1.13.0	# Apache-2.0 OR MIT
MODCARGO_CRATES +=	async-lock	2.7.0	# Apache-2.0 OR MIT
MODCARGO_CRATES +=	async-std	1.12.0	# Apache-2.0/MIT
MODCARGO_CRATES +=	async-task	4.4.0	# Apache-2.0 OR MIT
MODCARGO_CRATES +=	atomic-waker	1.1.1	# Apache-2.0 OR MIT
MODCARGO_CRATES +=	atty	0.2.14	# MIT
MODCARGO_CRATES +=	autocfg	1.1.0	# Apache-2.0 OR MIT
MODCARGO_CRATES +=	backtrace	0.3.68	# MIT OR Apache-2.0
MODCARGO_CRATES +=	better-panic	0.3.0	# MIT
MODCARGO_CRATES +=	bitflags	1.3.2	# MIT/Apache-2.0
MODCARGO_CRATES +=	blocking	1.3.1	# Apache-2.0 OR MIT
MODCARGO_CRATES +=	bumpalo	3.13.0	# MIT/Apache-2.0
MODCARGO_CRATES +=	bytes	1.4.0	# MIT
MODCARGO_CRATES +=	cassowary	0.3.0	# MIT / Apache-2.0
MODCARGO_CRATES +=	castaway	0.1.2	# MIT
MODCARGO_CRATES +=	cc	1.0.79	# MIT OR Apache-2.0
MODCARGO_CRATES +=	cfg-if	1.0.0	# MIT/Apache-2.0
MODCARGO_CRATES +=	chrono	0.4.26	# MIT/Apache-2.0
MODCARGO_CRATES +=	clap	2.34.0	# MIT
MODCARGO_CRATES +=	concurrent-queue	2.2.0	# Apache-2.0 OR MIT
MODCARGO_CRATES +=	console	0.15.7	# MIT
MODCARGO_CRATES +=	core-foundation-sys	0.8.4	# MIT / Apache-2.0
MODCARGO_CRATES +=	crossbeam-channel	0.5.8	# MIT OR Apache-2.0
MODCARGO_CRATES +=	crossbeam-utils	0.8.16	# MIT OR Apache-2.0
MODCARGO_CRATES +=	crossterm	0.25.0	# MIT
MODCARGO_CRATES +=	crossterm_winapi	0.9.1	# MIT
MODCARGO_CRATES +=	curl	0.4.46	# MIT
MODCARGO_CRATES +=	curl-sys	0.4.72+curl-8.6.0	# MIT
MODCARGO_CRATES +=	dirs-next	2.0.0	# MIT OR Apache-2.0
MODCARGO_CRATES +=	dirs-sys-next	0.1.2	# MIT OR Apache-2.0
MODCARGO_CRATES +=	either	1.9.0	# MIT OR Apache-2.0
MODCARGO_CRATES +=	encode_unicode	0.3.6	# MIT/Apache-2.0
MODCARGO_CRATES +=	encoding_rs	0.8.32	# (Apache-2.0 OR MIT) AND BSD-3-Clause
MODCARGO_CRATES +=	equivalent	1.0.1	# Apache-2.0 OR MIT
MODCARGO_CRATES +=	errno	0.3.1	# MIT OR Apache-2.0
MODCARGO_CRATES +=	errno-dragonfly	0.1.2	# MIT
MODCARGO_CRATES +=	event-listener	2.5.3	# Apache-2.0 OR MIT
MODCARGO_CRATES +=	fastrand	1.9.0	# Apache-2.0 OR MIT
MODCARGO_CRATES +=	fnv	1.0.7	# Apache-2.0 / MIT
MODCARGO_CRATES +=	form_urlencoded	1.2.0	# MIT OR Apache-2.0
MODCARGO_CRATES +=	futures	0.3.28	# MIT OR Apache-2.0
MODCARGO_CRATES +=	futures-channel	0.3.28	# MIT OR Apache-2.0
MODCARGO_CRATES +=	futures-core	0.3.28	# MIT OR Apache-2.0
MODCARGO_CRATES +=	futures-executor	0.3.28	# MIT OR Apache-2.0
MODCARGO_CRATES +=	futures-io	0.3.28	# MIT OR Apache-2.0
MODCARGO_CRATES +=	futures-lite	1.13.0	# Apache-2.0 OR MIT
MODCARGO_CRATES +=	futures-macro	0.3.28	# MIT OR Apache-2.0
MODCARGO_CRATES +=	futures-sink	0.3.28	# MIT OR Apache-2.0
MODCARGO_CRATES +=	futures-task	0.3.28	# MIT OR Apache-2.0
MODCARGO_CRATES +=	futures-util	0.3.28	# MIT OR Apache-2.0
MODCARGO_CRATES +=	getrandom	0.2.10	# MIT OR Apache-2.0
MODCARGO_CRATES +=	gimli	0.27.3	# MIT OR Apache-2.0
MODCARGO_CRATES +=	gloo-timers	0.2.6	# MIT/Apache-2.0
MODCARGO_CRATES +=	hashbrown	0.14.0	# MIT OR Apache-2.0
MODCARGO_CRATES +=	heck	0.3.3	# MIT OR Apache-2.0
MODCARGO_CRATES +=	hermit-abi	0.1.19	# MIT/Apache-2.0
MODCARGO_CRATES +=	hermit-abi	0.3.2	# MIT OR Apache-2.0
MODCARGO_CRATES +=	http	0.2.9	# MIT OR Apache-2.0
MODCARGO_CRATES +=	iana-time-zone	0.1.57	# MIT OR Apache-2.0
MODCARGO_CRATES +=	iana-time-zone-haiku	0.1.2	# MIT OR Apache-2.0
MODCARGO_CRATES +=	idna	0.4.0	# MIT OR Apache-2.0
MODCARGO_CRATES +=	indexmap	2.0.0	# Apache-2.0 OR MIT
MODCARGO_CRATES +=	instant	0.1.12	# BSD-3-Clause
MODCARGO_CRATES +=	io-lifetimes	1.0.11	# Apache-2.0 WITH LLVM-exception OR Apache-2.0 OR MIT
MODCARGO_CRATES +=	isahc	1.7.2	# MIT
MODCARGO_CRATES +=	itertools	0.10.5	# MIT/Apache-2.0
MODCARGO_CRATES +=	itoa	1.0.9	# MIT OR Apache-2.0
MODCARGO_CRATES +=	js-sys	0.3.64	# MIT/Apache-2.0
MODCARGO_CRATES +=	kv-log-macro	1.0.7	# MIT OR Apache-2.0
MODCARGO_CRATES +=	lazy_static	1.4.0	# MIT/Apache-2.0
MODCARGO_CRATES +=	libc	0.2.147	# MIT OR Apache-2.0
MODCARGO_CRATES +=	libnghttp2-sys	0.1.7+1.45.0	# MIT/Apache-2.0
MODCARGO_CRATES +=	libz-sys	1.1.11	# MIT OR Apache-2.0
MODCARGO_CRATES +=	linux-raw-sys	0.3.8	# Apache-2.0 WITH LLVM-exception OR Apache-2.0 OR MIT
MODCARGO_CRATES +=	lock_api	0.4.10	# MIT OR Apache-2.0
MODCARGO_CRATES +=	log	0.4.19	# MIT OR Apache-2.0
MODCARGO_CRATES +=	memchr	2.5.0	# Unlicense/MIT
MODCARGO_CRATES +=	mime	0.3.17	# MIT OR Apache-2.0
MODCARGO_CRATES +=	miniz_oxide	0.7.1	# MIT OR Zlib OR Apache-2.0
MODCARGO_CRATES +=	mio	0.8.8	# MIT
MODCARGO_CRATES +=	num-traits	0.2.16	# MIT OR Apache-2.0
MODCARGO_CRATES +=	object	0.31.1	# Apache-2.0 OR MIT
MODCARGO_CRATES +=	once_cell	1.18.0	# MIT OR Apache-2.0
MODCARGO_CRATES +=	openssl-probe	0.1.5	# MIT/Apache-2.0
MODCARGO_CRATES +=	openssl-src	111.26.0+1.1.1u	# MIT/Apache-2.0
MODCARGO_CRATES +=	openssl-sys	0.9.90	# MIT
MODCARGO_CRATES +=	parking	2.1.0	# Apache-2.0 OR MIT
MODCARGO_CRATES +=	parking_lot	0.12.1	# MIT OR Apache-2.0
MODCARGO_CRATES +=	parking_lot_core	0.9.8	# MIT OR Apache-2.0
MODCARGO_CRATES +=	percent-encoding	2.3.0	# MIT OR Apache-2.0
MODCARGO_CRATES +=	pin-project	1.1.2	# Apache-2.0 OR MIT
MODCARGO_CRATES +=	pin-project-internal	1.1.2	# Apache-2.0 OR MIT
MODCARGO_CRATES +=	pin-project-lite	0.2.10	# Apache-2.0 OR MIT
MODCARGO_CRATES +=	pin-utils	0.1.0	# MIT OR Apache-2.0
MODCARGO_CRATES +=	pkg-config	0.3.27	# MIT OR Apache-2.0
MODCARGO_CRATES +=	polling	2.8.0	# Apache-2.0 OR MIT
MODCARGO_CRATES +=	proc-macro-error	1.0.4	# MIT OR Apache-2.0
MODCARGO_CRATES +=	proc-macro-error-attr	1.0.4	# MIT OR Apache-2.0
MODCARGO_CRATES +=	proc-macro2	1.0.66	# MIT OR Apache-2.0
MODCARGO_CRATES +=	quote	1.0.32	# MIT OR Apache-2.0
MODCARGO_CRATES +=	rclite	0.1.5	# MIT OR Apache-2.0
MODCARGO_CRATES +=	redox_syscall	0.2.16	# MIT
MODCARGO_CRATES +=	redox_syscall	0.3.5	# MIT
MODCARGO_CRATES +=	redox_users	0.4.3	# MIT
MODCARGO_CRATES +=	rustc-demangle	0.1.23	# MIT/Apache-2.0
MODCARGO_CRATES +=	rustix	0.37.23	# Apache-2.0 WITH LLVM-exception OR Apache-2.0 OR MIT
MODCARGO_CRATES +=	ryu	1.0.15	# Apache-2.0 OR BSL-1.0
MODCARGO_CRATES +=	schannel	0.1.22	# MIT
MODCARGO_CRATES +=	scopeguard	1.2.0	# MIT OR Apache-2.0
MODCARGO_CRATES +=	serde	1.0.175	# MIT OR Apache-2.0
MODCARGO_CRATES +=	serde_derive	1.0.175	# MIT OR Apache-2.0
MODCARGO_CRATES +=	serde_json	1.0.103	# MIT OR Apache-2.0
MODCARGO_CRATES +=	serde_urlencoded	0.7.1	# MIT/Apache-2.0
MODCARGO_CRATES +=	serde_yaml	0.9.25	# MIT OR Apache-2.0
MODCARGO_CRATES +=	signal-hook	0.3.17	# Apache-2.0/MIT
MODCARGO_CRATES +=	signal-hook-mio	0.2.3	# Apache-2.0/MIT
MODCARGO_CRATES +=	signal-hook-registry	1.4.1	# Apache-2.0/MIT
MODCARGO_CRATES +=	slab	0.4.8	# MIT
MODCARGO_CRATES +=	sluice	0.5.5	# MIT
MODCARGO_CRATES +=	smallvec	1.11.0	# MIT OR Apache-2.0
MODCARGO_CRATES +=	socket2	0.4.9	# MIT OR Apache-2.0
MODCARGO_CRATES +=	socket2	0.5.4	# MIT OR Apache-2.0
MODCARGO_CRATES +=	strsim	0.8.0	# MIT
MODCARGO_CRATES +=	structopt	0.3.26	# Apache-2.0 OR MIT
MODCARGO_CRATES +=	structopt-derive	0.4.18	# Apache-2.0/MIT
MODCARGO_CRATES +=	syn	1.0.109	# MIT OR Apache-2.0
MODCARGO_CRATES +=	syn	2.0.27	# MIT OR Apache-2.0
MODCARGO_CRATES +=	textwrap	0.11.0	# MIT
MODCARGO_CRATES +=	thiserror	1.0.44	# MIT OR Apache-2.0
MODCARGO_CRATES +=	thiserror-impl	1.0.44	# MIT OR Apache-2.0
MODCARGO_CRATES +=	time	0.1.45	# MIT/Apache-2.0
MODCARGO_CRATES +=	tinyvec	1.6.0	# Zlib OR Apache-2.0 OR MIT
MODCARGO_CRATES +=	tinyvec_macros	0.1.1	# MIT OR Apache-2.0 OR Zlib
MODCARGO_CRATES +=	tracing	0.1.37	# MIT
MODCARGO_CRATES +=	tracing-attributes	0.1.26	# MIT
MODCARGO_CRATES +=	tracing-core	0.1.31	# MIT
MODCARGO_CRATES +=	tracing-futures	0.2.5	# MIT
MODCARGO_CRATES +=	tui	0.19.0	# MIT
MODCARGO_CRATES +=	unicode-bidi	0.3.13	# MIT OR Apache-2.0
MODCARGO_CRATES +=	unicode-ident	1.0.11	# (MIT OR Apache-2.0) AND Unicode-DFS-2016
MODCARGO_CRATES +=	unicode-normalization	0.1.22	# MIT/Apache-2.0
MODCARGO_CRATES +=	unicode-segmentation	1.10.1	# MIT/Apache-2.0
MODCARGO_CRATES +=	unicode-width	0.1.10	# MIT/Apache-2.0
MODCARGO_CRATES +=	unsafe-libyaml	0.2.9	# MIT
MODCARGO_CRATES +=	url	2.4.0	# MIT OR Apache-2.0
MODCARGO_CRATES +=	value-bag	1.4.1	# Apache-2.0 OR MIT
MODCARGO_CRATES +=	vcpkg	0.2.15	# MIT/Apache-2.0
MODCARGO_CRATES +=	vec_map	0.8.2	# MIT/Apache-2.0
MODCARGO_CRATES +=	version_check	0.9.4	# MIT/Apache-2.0
MODCARGO_CRATES +=	waker-fn	1.1.0	# Apache-2.0 OR MIT
MODCARGO_CRATES +=	wasi	0.10.0+wasi-snapshot-preview1	# Apache-2.0 WITH LLVM-exception OR Apache-2.0 OR MIT
MODCARGO_CRATES +=	wasi	0.11.0+wasi-snapshot-preview1	# Apache-2.0 WITH LLVM-exception OR Apache-2.0 OR MIT
MODCARGO_CRATES +=	wasm-bindgen	0.2.87	# MIT/Apache-2.0
MODCARGO_CRATES +=	wasm-bindgen-backend	0.2.87	# MIT/Apache-2.0
MODCARGO_CRATES +=	wasm-bindgen-futures	0.4.37	# MIT/Apache-2.0
MODCARGO_CRATES +=	wasm-bindgen-macro	0.2.87	# MIT/Apache-2.0
MODCARGO_CRATES +=	wasm-bindgen-macro-support	0.2.87	# MIT/Apache-2.0
MODCARGO_CRATES +=	wasm-bindgen-shared	0.2.87	# MIT/Apache-2.0
MODCARGO_CRATES +=	web-sys	0.3.64	# MIT/Apache-2.0
MODCARGO_CRATES +=	winapi	0.3.9	# MIT/Apache-2.0
MODCARGO_CRATES +=	winapi-i686-pc-windows-gnu	0.4.0	# MIT/Apache-2.0
MODCARGO_CRATES +=	winapi-x86_64-pc-windows-gnu	0.4.0	# MIT/Apache-2.0
MODCARGO_CRATES +=	windows	0.48.0	# MIT OR Apache-2.0
MODCARGO_CRATES +=	windows-sys	0.45.0	# MIT OR Apache-2.0
MODCARGO_CRATES +=	windows-sys	0.48.0	# MIT OR Apache-2.0
MODCARGO_CRATES +=	windows-sys	0.52.0	# MIT OR Apache-2.0
MODCARGO_CRATES +=	windows-targets	0.42.2	# MIT OR Apache-2.0
MODCARGO_CRATES +=	windows-targets	0.48.1	# MIT OR Apache-2.0
MODCARGO_CRATES +=	windows-targets	0.52.5	# MIT OR Apache-2.0
MODCARGO_CRATES +=	windows_aarch64_gnullvm	0.42.2	# MIT OR Apache-2.0
MODCARGO_CRATES +=	windows_aarch64_gnullvm	0.48.0	# MIT OR Apache-2.0
MODCARGO_CRATES +=	windows_aarch64_gnullvm	0.52.5	# MIT OR Apache-2.0
MODCARGO_CRATES +=	windows_aarch64_msvc	0.42.2	# MIT OR Apache-2.0
MODCARGO_CRATES +=	windows_aarch64_msvc	0.48.0	# MIT OR Apache-2.0
MODCARGO_CRATES +=	windows_aarch64_msvc	0.52.5	# MIT OR Apache-2.0
MODCARGO_CRATES +=	windows_i686_gnu	0.42.2	# MIT OR Apache-2.0
MODCARGO_CRATES +=	windows_i686_gnu	0.48.0	# MIT OR Apache-2.0
MODCARGO_CRATES +=	windows_i686_gnu	0.52.5	# MIT OR Apache-2.0
MODCARGO_CRATES +=	windows_i686_gnullvm	0.52.5	# MIT OR Apache-2.0
MODCARGO_CRATES +=	windows_i686_msvc	0.42.2	# MIT OR Apache-2.0
MODCARGO_CRATES +=	windows_i686_msvc	0.48.0	# MIT OR Apache-2.0
MODCARGO_CRATES +=	windows_i686_msvc	0.52.5	# MIT OR Apache-2.0
MODCARGO_CRATES +=	windows_x86_64_gnu	0.42.2	# MIT OR Apache-2.0
MODCARGO_CRATES +=	windows_x86_64_gnu	0.48.0	# MIT OR Apache-2.0
MODCARGO_CRATES +=	windows_x86_64_gnu	0.52.5	# MIT OR Apache-2.0
MODCARGO_CRATES +=	windows_x86_64_gnullvm	0.42.2	# MIT OR Apache-2.0
MODCARGO_CRATES +=	windows_x86_64_gnullvm	0.48.0	# MIT OR Apache-2.0
MODCARGO_CRATES +=	windows_x86_64_gnullvm	0.52.5	# MIT OR Apache-2.0
MODCARGO_CRATES +=	windows_x86_64_msvc	0.42.2	# MIT OR Apache-2.0
MODCARGO_CRATES +=	windows_x86_64_msvc	0.48.0	# MIT OR Apache-2.0
MODCARGO_CRATES +=	windows_x86_64_msvc	0.52.5	# MIT OR Apache-2.0
