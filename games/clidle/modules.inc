MODGO_MODULES =	\
	dario.cat/mergo				 v1.0.0 \
	github.com/!microsoft/go-winio		 v0.6.1 \
	github.com/!proton!mail/go-crypto	 v1.0.0 \
	github.com/adrg/xdg			 v0.5.2 \
	github.com/anmitsu/go-shlex		 v0.0.0-20200514113438-38f4b401e2be \
	github.com/aymanbagabas/go-osc52/v2	 v2.0.1 \
	github.com/aymanbagabas/go-udiff	 v0.2.0 \
	github.com/charmbracelet/bubbletea	 v1.1.2 \
	github.com/charmbracelet/keygen		 v0.5.1 \
	github.com/charmbracelet/lipgloss	 v0.13.1 \
	github.com/charmbracelet/log		 v0.4.0 \
	github.com/charmbracelet/ssh		 v0.0.0-20240725163421-eb71b85b27aa \
	github.com/charmbracelet/wish		 v1.4.3 \
	github.com/charmbracelet/x/ansi		 v0.4.2 \
	github.com/charmbracelet/x/conpty	 v0.1.0 \
	github.com/charmbracelet/x/errors	 v0.0.0-20240508181413-e8d8b6e2de86 \
	github.com/charmbracelet/x/exp/golden	 v0.0.0-20240806155701-69247e0abc2a \
	github.com/charmbracelet/x/input	 v0.2.0 \
	github.com/charmbracelet/x/term		 v0.2.0 \
	github.com/charmbracelet/x/termios	 v0.1.0 \
	github.com/cloudflare/circl		 v1.3.7 \
	github.com/creack/pty			 v1.1.21 \
	github.com/cyphar/filepath-securejoin	 v0.2.4 \
	github.com/davecgh/go-spew		 v1.1.1 \
	github.com/dustin/go-humanize		 v1.0.1 \
	github.com/emirpasic/gods		 v1.18.1 \
	github.com/erikgeiser/coninput		 v0.0.0-20211004153227-1c3628e74d0f \
	github.com/go-git/gcfg			 v1.5.1-0.20230307220236-3a3c6141e376 \
	github.com/go-git/go-billy/v5		 v5.5.0 \
	github.com/go-git/go-git/v5		 v5.12.0 \
	github.com/go-logfmt/logfmt		 v0.6.0 \
	github.com/golang/groupcache		 v0.0.0-20210331224755-41bb18bfe9da \
	github.com/google/go-cmp		 v0.6.0 \
	github.com/google/pprof			 v0.0.0-20240409012703-83162a5b38cd \
	github.com/google/uuid			 v1.6.0 \
	github.com/hashicorp/golang-lru/v2	 v2.0.7 \
	github.com/jbenet/go-context		 v0.0.0-20150711004518-d14ea06fba99 \
	github.com/kevinburke/ssh_config	 v1.2.0 \
	github.com/lucasb-eyer/go-colorful	 v1.2.0 \
	github.com/matryer/is			 v1.4.1 \
	github.com/mattn/go-isatty		 v0.0.20 \
	github.com/mattn/go-localereader	 v0.0.1 \
	github.com/mattn/go-runewidth		 v0.0.16 \
	github.com/muesli/ansi			 v0.0.0-20230316100256-276c6243b2f6 \
	github.com/muesli/cancelreader		 v0.2.2 \
	github.com/muesli/reflow		 v0.3.0 \
	github.com/muesli/termenv		 v0.15.3-0.20240509142007-81b8f94111d5 \
	github.com/ncruces/go-strftime		 v0.1.9 \
	github.com/pjbgf/sha1cd			 v0.3.0 \
	github.com/pkg/errors			 v0.9.1 \
	github.com/pmezard/go-difflib		 v1.0.0 \
	github.com/remyoudompheng/bigfft	 v0.0.0-20230129092748-24d4a6f8daec \
	github.com/rivo/uniseg			 v0.4.7 \
	github.com/sergi/go-diff		 v1.3.2-0.20230802210424-5b0b94c5c0d3 \
	github.com/skeema/knownhosts		 v1.2.2 \
	github.com/stretchr/testify		 v1.9.0 \
	github.com/xanzy/ssh-agent		 v0.3.3 \
	github.com/xo/terminfo			 v0.0.0-20220910002029-abceb7e1c41e \
	golang.org/x/crypto			 v0.26.0 \
	golang.org/x/exp			 v0.0.0-20231108232855-2478ac86f678 \
	golang.org/x/mod			 v0.17.0 \
	golang.org/x/net			 v0.25.0 \
	golang.org/x/sync			 v0.8.0 \
	golang.org/x/sys			 v0.26.0 \
	golang.org/x/term			 v0.23.0 \
	golang.org/x/text			 v0.19.0 \
	golang.org/x/time			 v0.6.0 \
	golang.org/x/tools			 v0.21.1-0.20240508182429-e35e4ccd0d2d \
	gopkg.in/warnings.v0			 v0.1.2 \
	gopkg.in/yaml.v3			 v3.0.1 \
	modernc.org/cc/v4			 v4.21.4 \
	modernc.org/ccgo/v4			 v4.19.2 \
	modernc.org/fileutil			 v1.3.0 \
	modernc.org/gc/v2			 v2.4.1 \
	modernc.org/gc/v3			 v3.0.0-20240107210532-573471604cb6 \
	modernc.org/libc			 v1.55.3 \
	modernc.org/mathutil			 v1.6.0 \
	modernc.org/memory			 v1.8.0 \
	modernc.org/opt				 v0.1.3 \
	modernc.org/sortutil			 v1.2.0 \
	modernc.org/sqlite			 v1.33.1 \
	modernc.org/strutil			 v1.2.0 \
	modernc.org/token			 v1.1.0

MODGO_MODFILES =	\
	github.com/charmbracelet/bubbletea	 v1.0.0 \
	github.com/charmbracelet/lipgloss	 v0.10.0 \
	github.com/charmbracelet/lipgloss	 v0.13.0 \
	github.com/charmbracelet/x/ansi		 v0.2.2 \
	github.com/charmbracelet/x/ansi		 v0.2.3 \
	github.com/charmbracelet/x/ansi		 v0.3.2 \
	github.com/charmbracelet/x/ansi		 v0.4.0 \
	github.com/google/go-cmp		 v0.5.8 \
	github.com/mattn/go-isatty		 v0.0.18 \
	github.com/mattn/go-isatty		 v0.0.19 \
	github.com/mattn/go-runewidth		 v0.0.14 \
	github.com/mattn/go-runewidth		 v0.0.15 \
	github.com/muesli/termenv		 v0.15.2 \
	github.com/rivo/uniseg			 v0.2.0 \
	github.com/rivo/uniseg			 v0.4.4 \
	golang.org/x/crypto			 v0.17.0 \
	golang.org/x/exp			 v0.0.0-20220909182711-5c715a9e8561 \
	golang.org/x/exp			 v0.0.0-20231006140011-7918f672742d \
	golang.org/x/mod			 v0.14.0 \
	golang.org/x/mod			 v0.16.0 \
	golang.org/x/net			 v0.21.0 \
	golang.org/x/sys			 v0.0.0-20210809222454-d867a43fc93e \
	golang.org/x/sys			 v0.0.0-20220204135822-1c1b9b1eba6a \
	golang.org/x/sys			 v0.10.0 \
	golang.org/x/sys			 v0.13.0 \
	golang.org/x/sys			 v0.14.0 \
	golang.org/x/sys			 v0.18.0 \
	golang.org/x/sys			 v0.19.0 \
	golang.org/x/sys			 v0.20.0 \
	golang.org/x/sys			 v0.22.0 \
	golang.org/x/sys			 v0.23.0 \
	golang.org/x/sys			 v0.24.0 \
	golang.org/x/sys			 v0.6.0 \
	golang.org/x/text			 v0.17.0 \
	golang.org/x/text			 v0.3.8 \
	golang.org/x/tools			 v0.15.0 \
	golang.org/x/tools			 v0.19.0

