MODCARGO_CRATES +=	addr2line	0.25.1	# Apache-2.0 OR MIT
MODCARGO_CRATES +=	adler2	2.0.1	# 0BSD OR MIT OR Apache-2.0
MODCARGO_CRATES +=	aho-corasick	1.1.4	# Unlicense OR MIT
MODCARGO_CRATES +=	alloca	0.4.0	# MIT
MODCARGO_CRATES +=	android_system_properties	0.1.5	# MIT/Apache-2.0
MODCARGO_CRATES +=	anes	0.1.6	# MIT OR Apache-2.0
MODCARGO_CRATES +=	ansi-width	0.1.0	# MIT
MODCARGO_CRATES +=	anstream	0.6.21	# MIT OR Apache-2.0
MODCARGO_CRATES +=	anstyle	1.0.13	# MIT OR Apache-2.0
MODCARGO_CRATES +=	anstyle-parse	0.2.7	# MIT OR Apache-2.0
MODCARGO_CRATES +=	anstyle-query	1.1.5	# MIT OR Apache-2.0
MODCARGO_CRATES +=	anstyle-wincon	3.0.11	# MIT OR Apache-2.0
MODCARGO_CRATES +=	anyhow	1.0.101	# MIT OR Apache-2.0
MODCARGO_CRATES +=	approx	0.5.1	# Apache-2.0
MODCARGO_CRATES +=	autocfg	1.5.0	# Apache-2.0 OR MIT
MODCARGO_CRATES +=	automod	1.0.16	# MIT OR Apache-2.0
MODCARGO_CRATES +=	backtrace	0.3.76	# MIT OR Apache-2.0
MODCARGO_CRATES +=	base64	0.22.1	# MIT OR Apache-2.0
MODCARGO_CRATES +=	bitflags	2.11.0	# MIT OR Apache-2.0
MODCARGO_CRATES +=	bumpalo	3.19.1	# MIT OR Apache-2.0
MODCARGO_CRATES +=	by_address	1.2.1	# MIT OR Apache-2.0
MODCARGO_CRATES +=	cast	0.3.0	# MIT OR Apache-2.0
MODCARGO_CRATES +=	cc	1.2.56	# MIT OR Apache-2.0
MODCARGO_CRATES +=	cfg-if	1.0.4	# MIT OR Apache-2.0
MODCARGO_CRATES +=	chrono	0.4.43	# MIT OR Apache-2.0
MODCARGO_CRATES +=	ciborium	0.2.2	# Apache-2.0
MODCARGO_CRATES +=	ciborium-io	0.2.2	# Apache-2.0
MODCARGO_CRATES +=	ciborium-ll	0.2.2	# Apache-2.0
MODCARGO_CRATES +=	clap	4.5.59	# MIT OR Apache-2.0
MODCARGO_CRATES +=	clap_builder	4.5.59	# MIT OR Apache-2.0
MODCARGO_CRATES +=	clap_derive	4.5.55	# MIT OR Apache-2.0
MODCARGO_CRATES +=	clap_lex	1.0.0	# MIT OR Apache-2.0
MODCARGO_CRATES +=	colorchoice	1.0.4	# MIT OR Apache-2.0
MODCARGO_CRATES +=	content_inspector	0.2.4	# MIT/Apache-2.0
MODCARGO_CRATES +=	core-foundation-sys	0.8.7	# MIT OR Apache-2.0
MODCARGO_CRATES +=	criterion	0.8.2	# Apache-2.0 OR MIT
MODCARGO_CRATES +=	criterion-plot	0.8.2	# Apache-2.0 OR MIT
MODCARGO_CRATES +=	crossbeam-deque	0.8.6	# MIT OR Apache-2.0
MODCARGO_CRATES +=	crossbeam-epoch	0.9.20	# MIT OR Apache-2.0
MODCARGO_CRATES +=	crossbeam-utils	0.8.21	# MIT OR Apache-2.0
MODCARGO_CRATES +=	crunchy	0.2.4	# MIT
MODCARGO_CRATES +=	deranged	0.5.6	# MIT OR Apache-2.0
MODCARGO_CRATES +=	dirs	6.0.0	# MIT OR Apache-2.0
MODCARGO_CRATES +=	dirs-sys	0.5.0	# MIT OR Apache-2.0
MODCARGO_CRATES +=	dunce	1.0.5	# CC0-1.0 OR MIT-0 OR Apache-2.0
MODCARGO_CRATES +=	either	1.15.0	# MIT OR Apache-2.0
MODCARGO_CRATES +=	equivalent	1.0.2	# Apache-2.0 OR MIT
MODCARGO_CRATES +=	errno	0.3.14	# MIT OR Apache-2.0
MODCARGO_CRATES +=	fast-srgb8	1.0.0	# MIT OR Apache-2.0 OR CC0-1.0
MODCARGO_CRATES +=	fastrand	2.3.0	# Apache-2.0 OR MIT
MODCARGO_CRATES +=	filetime	0.2.27	# MIT/Apache-2.0
MODCARGO_CRATES +=	find-msvc-tools	0.1.9	# MIT OR Apache-2.0
MODCARGO_CRATES +=	foldhash	0.1.5	# Zlib
MODCARGO_CRATES +=	getrandom	0.2.17	# MIT OR Apache-2.0
MODCARGO_CRATES +=	getrandom	0.3.4	# MIT OR Apache-2.0
MODCARGO_CRATES +=	getrandom	0.4.1	# MIT OR Apache-2.0
MODCARGO_CRATES +=	gimli	0.32.3	# MIT OR Apache-2.0
MODCARGO_CRATES +=	git2	0.21.0	# MIT OR Apache-2.0
MODCARGO_CRATES +=	glob	0.3.3	# MIT OR Apache-2.0
MODCARGO_CRATES +=	half	2.7.1	# MIT OR Apache-2.0
MODCARGO_CRATES +=	hashbrown	0.15.5	# MIT OR Apache-2.0
MODCARGO_CRATES +=	hashbrown	0.16.1	# MIT OR Apache-2.0
MODCARGO_CRATES +=	heck	0.5.0	# MIT OR Apache-2.0
MODCARGO_CRATES +=	humantime	2.3.0	# MIT OR Apache-2.0
MODCARGO_CRATES +=	humantime-serde	1.1.1	# MIT OR Apache-2.0
MODCARGO_CRATES +=	iana-time-zone	0.1.65	# MIT OR Apache-2.0
MODCARGO_CRATES +=	iana-time-zone-haiku	0.1.2	# MIT OR Apache-2.0
MODCARGO_CRATES +=	id-arena	2.3.0	# MIT/Apache-2.0
MODCARGO_CRATES +=	indexmap	2.13.0	# Apache-2.0 OR MIT
MODCARGO_CRATES +=	is_terminal_polyfill	1.70.2	# MIT OR Apache-2.0
MODCARGO_CRATES +=	itertools	0.13.0	# MIT OR Apache-2.0
MODCARGO_CRATES +=	itoa	1.0.17	# MIT OR Apache-2.0
MODCARGO_CRATES +=	jobserver	0.1.34	# MIT OR Apache-2.0
MODCARGO_CRATES +=	js-sys	0.3.85	# MIT OR Apache-2.0
MODCARGO_CRATES +=	leb128fmt	0.1.0	# MIT OR Apache-2.0
MODCARGO_CRATES +=	libc	0.2.182	# MIT OR Apache-2.0
MODCARGO_CRATES +=	libgit2-sys	0.18.5+1.9.4	# MIT OR Apache-2.0
MODCARGO_CRATES +=	libredox	0.1.12	# MIT
MODCARGO_CRATES +=	libz-sys	1.1.23	# MIT OR Apache-2.0
MODCARGO_CRATES +=	linux-raw-sys	0.11.0	# Apache-2.0 WITH LLVM-exception OR Apache-2.0 OR MIT
MODCARGO_CRATES +=	locale	0.2.2	# MIT
MODCARGO_CRATES +=	log	0.4.29	# MIT OR Apache-2.0
MODCARGO_CRATES +=	memchr	2.8.0	# Unlicense OR MIT
MODCARGO_CRATES +=	miniz_oxide	0.8.9	# MIT OR Zlib OR Apache-2.0
MODCARGO_CRATES +=	natord-plus-plus	2.0.0	# MIT
MODCARGO_CRATES +=	normalize-line-endings	0.3.0	# Apache-2.0
MODCARGO_CRATES +=	nu-ansi-term	0.50.3	# MIT
MODCARGO_CRATES +=	num-conv	0.2.0	# MIT OR Apache-2.0
MODCARGO_CRATES +=	num-traits	0.2.19	# MIT OR Apache-2.0
MODCARGO_CRATES +=	object	0.37.3	# Apache-2.0 OR MIT
MODCARGO_CRATES +=	once_cell	1.21.3	# MIT OR Apache-2.0
MODCARGO_CRATES +=	once_cell_polyfill	1.70.2	# MIT OR Apache-2.0
MODCARGO_CRATES +=	oorandom	11.1.5	# MIT
MODCARGO_CRATES +=	openssl-src	300.5.5+3.5.5	# MIT/Apache-2.0
MODCARGO_CRATES +=	openssl-sys	0.9.111	# MIT
MODCARGO_CRATES +=	option-ext	0.2.0	# MPL-2.0
MODCARGO_CRATES +=	os_pipe	1.2.3	# MIT
MODCARGO_CRATES +=	page_size	0.6.0	# MIT/Apache-2.0
MODCARGO_CRATES +=	palette	0.7.5	# MIT OR Apache-2.0
MODCARGO_CRATES +=	palette_derive	0.7.6	# MIT OR Apache-2.0
MODCARGO_CRATES +=	partition-identity	0.3.0	# MIT
MODCARGO_CRATES +=	path-clean	1.0.1	# MIT OR Apache-2.0
MODCARGO_CRATES +=	percent-encoding	2.3.2	# MIT OR Apache-2.0
MODCARGO_CRATES +=	phf	0.13.1	# MIT
MODCARGO_CRATES +=	phf_generator	0.13.1	# MIT
MODCARGO_CRATES +=	phf_macros	0.13.1	# MIT
MODCARGO_CRATES +=	phf_shared	0.13.1	# MIT
MODCARGO_CRATES +=	pkg-config	0.3.32	# MIT OR Apache-2.0
MODCARGO_CRATES +=	plist	1.10.0	# MIT
MODCARGO_CRATES +=	plotters	0.3.7	# MIT
MODCARGO_CRATES +=	plotters-backend	0.3.7	# MIT
MODCARGO_CRATES +=	plotters-svg	0.3.7	# MIT
MODCARGO_CRATES +=	powerfmt	0.2.0	# MIT OR Apache-2.0
MODCARGO_CRATES +=	prettyplease	0.2.37	# MIT OR Apache-2.0
MODCARGO_CRATES +=	proc-macro2	1.0.106	# MIT OR Apache-2.0
MODCARGO_CRATES +=	proc-mounts	0.3.0	# MIT
MODCARGO_CRATES +=	quick-xml	0.41.0	# MIT
MODCARGO_CRATES +=	quote	1.0.44	# MIT OR Apache-2.0
MODCARGO_CRATES +=	r-efi	5.3.0	# MIT OR Apache-2.0 OR LGPL-2.1-or-later
MODCARGO_CRATES +=	rayon	1.11.0	# MIT OR Apache-2.0
MODCARGO_CRATES +=	rayon-core	1.13.0	# MIT OR Apache-2.0
MODCARGO_CRATES +=	redox_syscall	0.7.1	# MIT
MODCARGO_CRATES +=	redox_users	0.5.2	# MIT
MODCARGO_CRATES +=	regex	1.12.3	# MIT OR Apache-2.0
MODCARGO_CRATES +=	regex-automata	0.4.14	# MIT OR Apache-2.0
MODCARGO_CRATES +=	regex-syntax	0.8.9	# MIT OR Apache-2.0
MODCARGO_CRATES +=	rustc-demangle	0.1.27	# MIT/Apache-2.0
MODCARGO_CRATES +=	rustix	1.1.3	# Apache-2.0 WITH LLVM-exception OR Apache-2.0 OR MIT
MODCARGO_CRATES +=	rustversion	1.0.22	# MIT OR Apache-2.0
MODCARGO_CRATES +=	ryu	1.0.23	# Apache-2.0 OR BSL-1.0
MODCARGO_CRATES +=	same-file	1.0.6	# Unlicense/MIT
MODCARGO_CRATES +=	semver	1.0.27	# MIT OR Apache-2.0
MODCARGO_CRATES +=	serde	1.0.228	# MIT OR Apache-2.0
MODCARGO_CRATES +=	serde_core	1.0.228	# MIT OR Apache-2.0
MODCARGO_CRATES +=	serde_derive	1.0.228	# MIT OR Apache-2.0
MODCARGO_CRATES +=	serde_json	1.0.149	# MIT OR Apache-2.0
MODCARGO_CRATES +=	serde_norway	0.9.42	# MIT OR Apache-2.0
MODCARGO_CRATES +=	serde_spanned	1.0.4	# MIT OR Apache-2.0
MODCARGO_CRATES +=	shlex	1.3.0	# MIT OR Apache-2.0
MODCARGO_CRATES +=	similar	2.7.0	# Apache-2.0
MODCARGO_CRATES +=	siphasher	1.0.2	# MIT/Apache-2.0
MODCARGO_CRATES +=	snapbox	1.0.0	# MIT OR Apache-2.0
MODCARGO_CRATES +=	snapbox-macros	1.0.0	# MIT OR Apache-2.0
MODCARGO_CRATES +=	strsim	0.11.1	# MIT
MODCARGO_CRATES +=	syn	2.0.116	# MIT OR Apache-2.0
MODCARGO_CRATES +=	tempfile	3.25.0	# MIT OR Apache-2.0
MODCARGO_CRATES +=	terminal_size	0.4.3	# MIT OR Apache-2.0
MODCARGO_CRATES +=	thiserror	1.0.69	# MIT OR Apache-2.0
MODCARGO_CRATES +=	thiserror	2.0.18	# MIT OR Apache-2.0
MODCARGO_CRATES +=	thiserror-impl	1.0.69	# MIT OR Apache-2.0
MODCARGO_CRATES +=	thiserror-impl	2.0.18	# MIT OR Apache-2.0
MODCARGO_CRATES +=	time	0.3.47	# MIT OR Apache-2.0
MODCARGO_CRATES +=	time-core	0.1.8	# MIT OR Apache-2.0
MODCARGO_CRATES +=	time-macros	0.2.27	# MIT OR Apache-2.0
MODCARGO_CRATES +=	timeago	0.6.0	# MIT OR Apache-2.0
MODCARGO_CRATES +=	tinytemplate	1.2.1	# Apache-2.0 OR MIT
MODCARGO_CRATES +=	toml_datetime	0.7.5+spec-1.1.0	# MIT OR Apache-2.0
MODCARGO_CRATES +=	toml_edit	0.23.10+spec-1.0.0	# MIT OR Apache-2.0
MODCARGO_CRATES +=	toml_parser	1.0.9+spec-1.1.0	# MIT OR Apache-2.0
MODCARGO_CRATES +=	toml_writer	1.0.6+spec-1.1.0	# MIT OR Apache-2.0
MODCARGO_CRATES +=	trycmd	1.0.0	# MIT OR Apache-2.0
MODCARGO_CRATES +=	unicode-ident	1.0.24	# (MIT OR Apache-2.0) AND Unicode-3.0
MODCARGO_CRATES +=	unicode-width	0.1.14	# MIT OR Apache-2.0
MODCARGO_CRATES +=	unicode-width	0.2.2	# MIT OR Apache-2.0
MODCARGO_CRATES +=	unicode-xid	0.2.6	# MIT OR Apache-2.0
MODCARGO_CRATES +=	unit-prefix	0.5.2	# MIT
MODCARGO_CRATES +=	unsafe-libyaml-norway	0.2.15	# MIT
MODCARGO_CRATES +=	utf8parse	0.2.2	# Apache-2.0 OR MIT
MODCARGO_CRATES +=	uutils_term_grid	0.7.0	# MIT
MODCARGO_CRATES +=	uzers	0.12.2	# MIT
MODCARGO_CRATES +=	vcpkg	0.2.15	# MIT/Apache-2.0
MODCARGO_CRATES +=	wait-timeout	0.2.1	# MIT/Apache-2.0
MODCARGO_CRATES +=	walkdir	2.5.0	# Unlicense/MIT
MODCARGO_CRATES +=	wasi	0.11.1+wasi-snapshot-preview1	# Apache-2.0 WITH LLVM-exception OR Apache-2.0 OR MIT
MODCARGO_CRATES +=	wasip2	1.0.2+wasi-0.2.9	# Apache-2.0 WITH LLVM-exception OR Apache-2.0 OR MIT
MODCARGO_CRATES +=	wasip3	0.4.0+wasi-0.3.0-rc-2026-01-06	# Apache-2.0 WITH LLVM-exception OR Apache-2.0 OR MIT
MODCARGO_CRATES +=	wasm-bindgen	0.2.108	# MIT OR Apache-2.0
MODCARGO_CRATES +=	wasm-bindgen-macro	0.2.108	# MIT OR Apache-2.0
MODCARGO_CRATES +=	wasm-bindgen-macro-support	0.2.108	# MIT OR Apache-2.0
MODCARGO_CRATES +=	wasm-bindgen-shared	0.2.108	# MIT OR Apache-2.0
MODCARGO_CRATES +=	wasm-encoder	0.244.0	# Apache-2.0 WITH LLVM-exception OR Apache-2.0 OR MIT
MODCARGO_CRATES +=	wasm-metadata	0.244.0	# Apache-2.0 WITH LLVM-exception OR Apache-2.0 OR MIT
MODCARGO_CRATES +=	wasmparser	0.244.0	# Apache-2.0 WITH LLVM-exception OR Apache-2.0 OR MIT
MODCARGO_CRATES +=	web-sys	0.3.85	# MIT OR Apache-2.0
MODCARGO_CRATES +=	winapi	0.3.9	# MIT/Apache-2.0
MODCARGO_CRATES +=	winapi-i686-pc-windows-gnu	0.4.0	# MIT/Apache-2.0
MODCARGO_CRATES +=	winapi-util	0.1.11	# Unlicense OR MIT
MODCARGO_CRATES +=	winapi-x86_64-pc-windows-gnu	0.4.0	# MIT/Apache-2.0
MODCARGO_CRATES +=	windows-core	0.62.2	# MIT OR Apache-2.0
MODCARGO_CRATES +=	windows-implement	0.60.2	# MIT OR Apache-2.0
MODCARGO_CRATES +=	windows-interface	0.59.3	# MIT OR Apache-2.0
MODCARGO_CRATES +=	windows-link	0.2.1	# MIT OR Apache-2.0
MODCARGO_CRATES +=	windows-result	0.4.1	# MIT OR Apache-2.0
MODCARGO_CRATES +=	windows-strings	0.5.1	# MIT OR Apache-2.0
MODCARGO_CRATES +=	windows-sys	0.60.2	# MIT OR Apache-2.0
MODCARGO_CRATES +=	windows-sys	0.61.2	# MIT OR Apache-2.0
MODCARGO_CRATES +=	windows-targets	0.53.5	# MIT OR Apache-2.0
MODCARGO_CRATES +=	windows_aarch64_gnullvm	0.53.1	# MIT OR Apache-2.0
MODCARGO_CRATES +=	windows_aarch64_msvc	0.53.1	# MIT OR Apache-2.0
MODCARGO_CRATES +=	windows_i686_gnu	0.53.1	# MIT OR Apache-2.0
MODCARGO_CRATES +=	windows_i686_gnullvm	0.53.1	# MIT OR Apache-2.0
MODCARGO_CRATES +=	windows_i686_msvc	0.53.1	# MIT OR Apache-2.0
MODCARGO_CRATES +=	windows_x86_64_gnu	0.53.1	# MIT OR Apache-2.0
MODCARGO_CRATES +=	windows_x86_64_gnullvm	0.53.1	# MIT OR Apache-2.0
MODCARGO_CRATES +=	windows_x86_64_msvc	0.53.1	# MIT OR Apache-2.0
MODCARGO_CRATES +=	winnow	0.7.14	# MIT
MODCARGO_CRATES +=	wit-bindgen	0.51.0	# Apache-2.0 WITH LLVM-exception OR Apache-2.0 OR MIT
MODCARGO_CRATES +=	wit-bindgen-core	0.51.0	# Apache-2.0 WITH LLVM-exception OR Apache-2.0 OR MIT
MODCARGO_CRATES +=	wit-bindgen-rust	0.51.0	# Apache-2.0 WITH LLVM-exception OR Apache-2.0 OR MIT
MODCARGO_CRATES +=	wit-bindgen-rust-macro	0.51.0	# Apache-2.0 WITH LLVM-exception OR Apache-2.0 OR MIT
MODCARGO_CRATES +=	wit-component	0.244.0	# Apache-2.0 WITH LLVM-exception OR Apache-2.0 OR MIT
MODCARGO_CRATES +=	wit-parser	0.244.0	# Apache-2.0 WITH LLVM-exception OR Apache-2.0 OR MIT
MODCARGO_CRATES +=	zerocopy	0.8.39	# BSD-2-Clause OR Apache-2.0 OR MIT
MODCARGO_CRATES +=	zerocopy-derive	0.8.39	# BSD-2-Clause OR Apache-2.0 OR MIT
MODCARGO_CRATES +=	zmij	1.0.21	# MIT
