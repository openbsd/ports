MODGO_MODULES =	\
	github.com/a8m/tree		 v0.0.0-20210115125333-10a5fd5b637d \
	github.com/creack/pty		 v1.1.9 \
	github.com/davecgh/go-spew	 v1.1.1 \
	github.com/dougm/pretty		 v0.0.0-20171025230240-2ee9d7453c02 \
	github.com/google/go-cmp	 v0.6.0 \
	github.com/google/uuid		 v1.6.0 \
	github.com/kr/pretty		 v0.3.0 \
	github.com/kr/pty		 v1.1.1 \
	github.com/kr/text		 v0.2.0 \
	github.com/pmezard/go-difflib	 v1.0.0 \
	github.com/rasky/go-xdr		 v0.0.0-20170217172119-4930550ba2e2 \
	github.com/rogpeppe/go-internal	 v1.6.1 \
	github.com/stretchr/objx	 v0.5.2 \
	github.com/stretchr/testify	 v1.9.0 \
	github.com/vmware/vmw-guestinfo	 v0.0.0-20170707015358-25eff159a728 \
	github.com/xlab/treeprint	 v1.2.0 \
	golang.org/x/mod		 v0.17.0 \
	golang.org/x/sync		 v0.7.0 \
	golang.org/x/text		 v0.16.0 \
	golang.org/x/tools		 v0.21.1-0.20240508182429-e35e4ccd0d2d \
	gopkg.in/check.v1		 v1.0.0-20180628173108-788fd7840127 \
	gopkg.in/errgo.v2		 v2.1.0 \
	gopkg.in/yaml.v3		 v3.0.1

MODGO_MODFILES =	\
	github.com/davecgh/go-spew	 v1.1.0 \
	github.com/kr/pretty		 v0.1.0 \
	github.com/kr/text		 v0.1.0 \
	github.com/stretchr/objx	 v0.1.0 \
	github.com/stretchr/testify	 v1.7.0 \
	gopkg.in/check.v1		 v0.0.0-20161208181325-20d25e280405 \
	gopkg.in/yaml.v3		 v3.0.0-20200313102051-9f266ea9e77c
