MODCARGO_CRATES +=	addr2line	0.25.1	# Apache-2.0 OR MIT
MODCARGO_CRATES +=	adler2	2.0.1	# 0BSD OR MIT OR Apache-2.0
MODCARGO_CRATES +=	aho-corasick	1.1.4	# Unlicense OR MIT
MODCARGO_CRATES +=	alloca	0.4.0	# MIT
MODCARGO_CRATES +=	allocator-api2	0.2.21	# MIT OR Apache-2.0
MODCARGO_CRATES +=	anes	0.1.6	# MIT OR Apache-2.0
MODCARGO_CRATES +=	ansi-to-tui	8.0.1	# MIT
MODCARGO_CRATES +=	anstream	1.0.0	# MIT OR Apache-2.0
MODCARGO_CRATES +=	anstyle	1.0.14	# MIT OR Apache-2.0
MODCARGO_CRATES +=	anstyle-parse	1.0.0	# MIT OR Apache-2.0
MODCARGO_CRATES +=	anstyle-query	1.1.5	# MIT OR Apache-2.0
MODCARGO_CRATES +=	anstyle-wincon	3.0.11	# MIT OR Apache-2.0
MODCARGO_CRATES +=	anyhow	1.0.102	# MIT OR Apache-2.0
MODCARGO_CRATES +=	arrayvec	0.7.6	# MIT OR Apache-2.0
MODCARGO_CRATES +=	assert_enum_variants	0.1.2	# MIT OR Apache-2.0
MODCARGO_CRATES +=	atomic	0.6.1	# Apache-2.0/MIT
MODCARGO_CRATES +=	autocfg	1.5.0	# Apache-2.0 OR MIT
MODCARGO_CRATES +=	backtrace	0.3.76	# MIT OR Apache-2.0
MODCARGO_CRATES +=	base64	0.22.1	# MIT OR Apache-2.0
MODCARGO_CRATES +=	bincode	1.3.3	# MIT
MODCARGO_CRATES +=	bit-set	0.5.3	# MIT/Apache-2.0
MODCARGO_CRATES +=	bit-vec	0.6.3	# MIT/Apache-2.0
MODCARGO_CRATES +=	bitflags	1.3.2	# MIT/Apache-2.0
MODCARGO_CRATES +=	bitflags	2.11.1	# MIT OR Apache-2.0
MODCARGO_CRATES +=	block-buffer	0.10.4	# MIT OR Apache-2.0
MODCARGO_CRATES +=	bstr	1.12.1	# MIT OR Apache-2.0
MODCARGO_CRATES +=	bumpalo	3.20.2	# MIT OR Apache-2.0
MODCARGO_CRATES +=	bytemuck	1.25.0	# Zlib OR Apache-2.0 OR MIT
MODCARGO_CRATES +=	byteorder	1.5.0	# Unlicense OR MIT
MODCARGO_CRATES +=	bytes	1.11.1	# MIT
MODCARGO_CRATES +=	cast	0.3.0	# MIT OR Apache-2.0
MODCARGO_CRATES +=	castaway	0.2.4	# MIT
MODCARGO_CRATES +=	cc	1.2.61	# MIT OR Apache-2.0
MODCARGO_CRATES +=	cfg-if	1.0.4	# MIT OR Apache-2.0
MODCARGO_CRATES +=	cfg_aliases	0.1.1	# MIT
MODCARGO_CRATES +=	cfg_aliases	0.2.1	# MIT
MODCARGO_CRATES +=	chacha20	0.10.0	# MIT OR Apache-2.0
MODCARGO_CRATES +=	ciborium	0.2.2	# Apache-2.0
MODCARGO_CRATES +=	ciborium-io	0.2.2	# Apache-2.0
MODCARGO_CRATES +=	ciborium-ll	0.2.2	# Apache-2.0
MODCARGO_CRATES +=	clap	4.6.1	# MIT OR Apache-2.0
MODCARGO_CRATES +=	clap_builder	4.6.0	# MIT OR Apache-2.0
MODCARGO_CRATES +=	clap_complete	4.6.2	# MIT OR Apache-2.0
MODCARGO_CRATES +=	clap_complete_nushell	4.6.0	# MIT OR Apache-2.0
MODCARGO_CRATES +=	clap_derive	4.6.1	# MIT OR Apache-2.0
MODCARGO_CRATES +=	clap_lex	1.1.0	# MIT OR Apache-2.0
MODCARGO_CRATES +=	clap_mangen	0.3.0	# MIT OR Apache-2.0
MODCARGO_CRATES +=	color-eyre	0.6.5	# MIT OR Apache-2.0
MODCARGO_CRATES +=	color-spantrace	0.3.0	# MIT OR Apache-2.0
MODCARGO_CRATES +=	colorchoice	1.0.5	# MIT OR Apache-2.0
MODCARGO_CRATES +=	compact_str	0.9.0	# MIT
MODCARGO_CRATES +=	console	0.16.3	# MIT
MODCARGO_CRATES +=	convert_case	0.10.0	# MIT
MODCARGO_CRATES +=	cpufeatures	0.2.17	# MIT OR Apache-2.0
MODCARGO_CRATES +=	cpufeatures	0.3.0	# MIT OR Apache-2.0
MODCARGO_CRATES +=	criterion	0.8.2	# Apache-2.0 OR MIT
MODCARGO_CRATES +=	criterion-plot	0.8.2	# Apache-2.0 OR MIT
MODCARGO_CRATES +=	crossbeam-deque	0.8.6	# MIT OR Apache-2.0
MODCARGO_CRATES +=	crossbeam-epoch	0.9.18	# MIT OR Apache-2.0
MODCARGO_CRATES +=	crossbeam-utils	0.8.21	# MIT OR Apache-2.0
MODCARGO_CRATES +=	crossterm	0.29.0	# MIT
MODCARGO_CRATES +=	crossterm_winapi	0.9.1	# MIT
MODCARGO_CRATES +=	crunchy	0.2.4	# MIT
MODCARGO_CRATES +=	crypto-common	0.1.7	# MIT OR Apache-2.0
MODCARGO_CRATES +=	csscolorparser	0.6.2	# MIT OR Apache-2.0
MODCARGO_CRATES +=	darling	0.20.11	# MIT
MODCARGO_CRATES +=	darling	0.23.0	# MIT
MODCARGO_CRATES +=	darling_core	0.20.11	# MIT
MODCARGO_CRATES +=	darling_core	0.23.0	# MIT
MODCARGO_CRATES +=	darling_macro	0.20.11	# MIT
MODCARGO_CRATES +=	darling_macro	0.23.0	# MIT
MODCARGO_CRATES +=	deltae	0.3.2	# MIT
MODCARGO_CRATES +=	deranged	0.5.8	# MIT OR Apache-2.0
MODCARGO_CRATES +=	derive_builder	0.20.2	# MIT OR Apache-2.0
MODCARGO_CRATES +=	derive_builder_core	0.20.2	# MIT OR Apache-2.0
MODCARGO_CRATES +=	derive_builder_macro	0.20.2	# MIT OR Apache-2.0
MODCARGO_CRATES +=	derive_more	2.1.1	# MIT
MODCARGO_CRATES +=	derive_more-impl	2.1.1	# MIT
MODCARGO_CRATES +=	digest	0.10.7	# MIT OR Apache-2.0
MODCARGO_CRATES +=	doctest-file	1.1.1	# 0BSD
MODCARGO_CRATES +=	document-features	0.2.12	# MIT OR Apache-2.0
MODCARGO_CRATES +=	downcast-rs	1.2.1	# MIT/Apache-2.0
MODCARGO_CRATES +=	either	1.15.0	# MIT OR Apache-2.0
MODCARGO_CRATES +=	encode_unicode	1.0.0	# Apache-2.0 OR MIT
MODCARGO_CRATES +=	env_filter	1.0.1	# MIT OR Apache-2.0
MODCARGO_CRATES +=	env_logger	0.11.10	# MIT OR Apache-2.0
MODCARGO_CRATES +=	equivalent	1.0.2	# Apache-2.0 OR MIT
MODCARGO_CRATES +=	errno	0.3.14	# MIT OR Apache-2.0
MODCARGO_CRATES +=	euclid	0.22.14	# MIT OR Apache-2.0
MODCARGO_CRATES +=	eyre	0.6.12	# MIT OR Apache-2.0
MODCARGO_CRATES +=	fancy-regex	0.11.0	# MIT
MODCARGO_CRATES +=	fastrand	2.4.1	# Apache-2.0 OR MIT
MODCARGO_CRATES +=	filedescriptor	0.8.3	# MIT
MODCARGO_CRATES +=	find-msvc-tools	0.1.9	# MIT OR Apache-2.0
MODCARGO_CRATES +=	finl_unicode	1.4.0	# (MIT OR Apache-2.0) AND Unicode-DFS-2016
MODCARGO_CRATES +=	fixedbitset	0.4.2	# MIT/Apache-2.0
MODCARGO_CRATES +=	fnv	1.0.7	# Apache-2.0 / MIT
MODCARGO_CRATES +=	foldhash	0.1.5	# Zlib
MODCARGO_CRATES +=	foldhash	0.2.0	# Zlib
MODCARGO_CRATES +=	frizbee	0.9.0	# MIT
MODCARGO_CRATES +=	futures	0.3.32	# MIT OR Apache-2.0
MODCARGO_CRATES +=	futures-channel	0.3.32	# MIT OR Apache-2.0
MODCARGO_CRATES +=	futures-core	0.3.32	# MIT OR Apache-2.0
MODCARGO_CRATES +=	futures-executor	0.3.32	# MIT OR Apache-2.0
MODCARGO_CRATES +=	futures-io	0.3.32	# MIT OR Apache-2.0
MODCARGO_CRATES +=	futures-macro	0.3.32	# MIT OR Apache-2.0
MODCARGO_CRATES +=	futures-sink	0.3.32	# MIT OR Apache-2.0
MODCARGO_CRATES +=	futures-task	0.3.32	# MIT OR Apache-2.0
MODCARGO_CRATES +=	futures-util	0.3.32	# MIT OR Apache-2.0
MODCARGO_CRATES +=	generic-array	0.14.7	# MIT
MODCARGO_CRATES +=	getrandom	0.3.4	# MIT OR Apache-2.0
MODCARGO_CRATES +=	getrandom	0.4.2	# MIT OR Apache-2.0
MODCARGO_CRATES +=	gimli	0.32.3	# MIT OR Apache-2.0
MODCARGO_CRATES +=	gnuplot	0.0.46	# LGPL-3.0
MODCARGO_CRATES +=	gungraun	0.18.1	# Apache-2.0 OR MIT
MODCARGO_CRATES +=	gungraun-macros	0.8.0	# Apache-2.0 OR MIT
MODCARGO_CRATES +=	gungraun-runner	0.18.1	# Apache-2.0 OR MIT
MODCARGO_CRATES +=	half	2.7.1	# MIT OR Apache-2.0
MODCARGO_CRATES +=	hashbrown	0.15.5	# MIT OR Apache-2.0
MODCARGO_CRATES +=	hashbrown	0.16.1	# MIT OR Apache-2.0
MODCARGO_CRATES +=	hashbrown	0.17.0	# MIT OR Apache-2.0
MODCARGO_CRATES +=	heck	0.5.0	# MIT OR Apache-2.0
MODCARGO_CRATES +=	hex	0.4.3	# MIT OR Apache-2.0
MODCARGO_CRATES +=	id-arena	2.3.0	# MIT/Apache-2.0
MODCARGO_CRATES +=	ident_case	1.0.1	# MIT/Apache-2.0
MODCARGO_CRATES +=	indenter	0.3.4	# MIT OR Apache-2.0
MODCARGO_CRATES +=	indexmap	2.14.0	# Apache-2.0 OR MIT
MODCARGO_CRATES +=	indoc	2.0.7	# MIT OR Apache-2.0
MODCARGO_CRATES +=	insta	1.47.2	# Apache-2.0
MODCARGO_CRATES +=	instability	0.3.12	# MIT
MODCARGO_CRATES +=	interprocess	2.4.2	# 0BSD OR Apache-2.0
MODCARGO_CRATES +=	is_terminal_polyfill	1.70.2	# MIT OR Apache-2.0
MODCARGO_CRATES +=	itertools	0.13.0	# MIT OR Apache-2.0
MODCARGO_CRATES +=	itertools	0.14.0	# MIT OR Apache-2.0
MODCARGO_CRATES +=	itoa	1.0.18	# MIT OR Apache-2.0
MODCARGO_CRATES +=	jiff	0.2.24	# Unlicense OR MIT
MODCARGO_CRATES +=	jiff-static	0.2.24	# Unlicense OR MIT
MODCARGO_CRATES +=	js-sys	0.3.95	# MIT OR Apache-2.0
MODCARGO_CRATES +=	kanal	0.1.1	# MIT
MODCARGO_CRATES +=	kasuari	0.4.12	# MIT OR Apache-2.0
MODCARGO_CRATES +=	lab	0.11.0	# MIT
MODCARGO_CRATES +=	lazy_static	1.5.0	# MIT OR Apache-2.0
MODCARGO_CRATES +=	leb128fmt	0.1.0	# MIT OR Apache-2.0
MODCARGO_CRATES +=	libc	0.2.186	# MIT OR Apache-2.0
MODCARGO_CRATES +=	libmimalloc-sys	0.1.44	# MIT
MODCARGO_CRATES +=	line-clipping	0.3.7	# MIT OR Apache-2.0
MODCARGO_CRATES +=	linux-raw-sys	0.12.1	# Apache-2.0 WITH LLVM-exception OR Apache-2.0 OR MIT
MODCARGO_CRATES +=	litrs	1.0.0	# MIT OR Apache-2.0
MODCARGO_CRATES +=	lock_api	0.4.14	# MIT OR Apache-2.0
MODCARGO_CRATES +=	log	0.4.29	# MIT OR Apache-2.0
MODCARGO_CRATES +=	lru	0.16.4	# MIT
MODCARGO_CRATES +=	mac_address	1.1.8	# MIT OR Apache-2.0
MODCARGO_CRATES +=	memchr	2.8.0	# Unlicense OR MIT
MODCARGO_CRATES +=	memmem	0.1.1	# MIT/Apache-2.0
MODCARGO_CRATES +=	memoffset	0.9.1	# MIT
MODCARGO_CRATES +=	mimalloc	0.1.48	# MIT
MODCARGO_CRATES +=	minimal-lexical	0.2.1	# MIT/Apache-2.0
MODCARGO_CRATES +=	miniz_oxide	0.8.9	# MIT OR Zlib OR Apache-2.0
MODCARGO_CRATES +=	mio	1.2.0	# MIT
MODCARGO_CRATES +=	nix	0.28.0	# MIT
MODCARGO_CRATES +=	nix	0.29.0	# MIT
MODCARGO_CRATES +=	nix	0.31.2	# MIT
MODCARGO_CRATES +=	nom	7.1.3	# MIT
MODCARGO_CRATES +=	nom	8.0.0	# MIT
MODCARGO_CRATES +=	num-conv	0.2.1	# MIT OR Apache-2.0
MODCARGO_CRATES +=	num-derive	0.4.2	# MIT OR Apache-2.0
MODCARGO_CRATES +=	num-traits	0.2.19	# MIT OR Apache-2.0
MODCARGO_CRATES +=	num_threads	0.1.7	# MIT OR Apache-2.0
MODCARGO_CRATES +=	object	0.37.3	# Apache-2.0 OR MIT
MODCARGO_CRATES +=	once_cell	1.21.4	# MIT OR Apache-2.0
MODCARGO_CRATES +=	once_cell_polyfill	1.70.2	# MIT OR Apache-2.0
MODCARGO_CRATES +=	oorandom	11.1.5	# MIT
MODCARGO_CRATES +=	ordered-float	4.6.0	# MIT
MODCARGO_CRATES +=	owo-colors	4.3.0	# MIT
MODCARGO_CRATES +=	page_size	0.6.0	# MIT/Apache-2.0
MODCARGO_CRATES +=	parking_lot	0.12.5	# MIT OR Apache-2.0
MODCARGO_CRATES +=	parking_lot_core	0.9.12	# MIT OR Apache-2.0
MODCARGO_CRATES +=	pest	2.8.6	# MIT OR Apache-2.0
MODCARGO_CRATES +=	pest_derive	2.8.6	# MIT OR Apache-2.0
MODCARGO_CRATES +=	pest_generator	2.8.6	# MIT OR Apache-2.0
MODCARGO_CRATES +=	pest_meta	2.8.6	# MIT OR Apache-2.0
MODCARGO_CRATES +=	phf	0.11.3	# MIT
MODCARGO_CRATES +=	phf_codegen	0.11.3	# MIT
MODCARGO_CRATES +=	phf_generator	0.11.3	# MIT
MODCARGO_CRATES +=	phf_macros	0.11.3	# MIT
MODCARGO_CRATES +=	phf_shared	0.11.3	# MIT
MODCARGO_CRATES +=	pin-project-lite	0.2.17	# Apache-2.0 OR MIT
MODCARGO_CRATES +=	plotters	0.3.7	# MIT
MODCARGO_CRATES +=	plotters-backend	0.3.7	# MIT
MODCARGO_CRATES +=	plotters-svg	0.3.7	# MIT
MODCARGO_CRATES +=	portable-atomic	1.13.1	# Apache-2.0 OR MIT
MODCARGO_CRATES +=	portable-atomic-util	0.2.7	# Apache-2.0 OR MIT
MODCARGO_CRATES +=	portable-pty	0.9.0	# MIT
MODCARGO_CRATES +=	powerfmt	0.2.0	# MIT OR Apache-2.0
MODCARGO_CRATES +=	prettyplease	0.2.37	# MIT OR Apache-2.0
MODCARGO_CRATES +=	proc-macro-error-attr2	2.0.0	# MIT OR Apache-2.0
MODCARGO_CRATES +=	proc-macro-error2	2.0.1	# MIT OR Apache-2.0
MODCARGO_CRATES +=	proc-macro2	1.0.106	# MIT OR Apache-2.0
MODCARGO_CRATES +=	pulldown-cmark	0.13.3	# MIT
MODCARGO_CRATES +=	quote	1.0.45	# MIT OR Apache-2.0
MODCARGO_CRATES +=	r-efi	5.3.0	# MIT OR Apache-2.0 OR LGPL-2.1-or-later
MODCARGO_CRATES +=	r-efi	6.0.0	# MIT OR Apache-2.0 OR LGPL-2.1-or-later
MODCARGO_CRATES +=	rand	0.8.6	# MIT OR Apache-2.0
MODCARGO_CRATES +=	rand	0.10.1	# MIT OR Apache-2.0
MODCARGO_CRATES +=	rand_core	0.6.4	# MIT OR Apache-2.0
MODCARGO_CRATES +=	rand_core	0.10.1	# MIT OR Apache-2.0
MODCARGO_CRATES +=	ratatui	0.30.0	# MIT
MODCARGO_CRATES +=	ratatui-core	0.1.0	# MIT
MODCARGO_CRATES +=	ratatui-crossterm	0.1.0	# MIT
MODCARGO_CRATES +=	ratatui-macros	0.7.0	# MIT
MODCARGO_CRATES +=	ratatui-termwiz	0.1.0	# MIT
MODCARGO_CRATES +=	ratatui-widgets	0.3.0	# MIT
MODCARGO_CRATES +=	raw-cpuid	11.6.0	# MIT
MODCARGO_CRATES +=	rayon	1.12.0	# MIT OR Apache-2.0
MODCARGO_CRATES +=	rayon-core	1.13.0	# MIT OR Apache-2.0
MODCARGO_CRATES +=	recvmsg	1.0.0	# 0BSD
MODCARGO_CRATES +=	redox_syscall	0.5.18	# MIT
MODCARGO_CRATES +=	regex	1.12.3	# MIT OR Apache-2.0
MODCARGO_CRATES +=	regex-automata	0.4.14	# MIT OR Apache-2.0
MODCARGO_CRATES +=	regex-syntax	0.8.10	# MIT OR Apache-2.0
MODCARGO_CRATES +=	roff	1.1.1	# MIT OR Apache-2.0
MODCARGO_CRATES +=	ron	0.12.1	# MIT OR Apache-2.0
MODCARGO_CRATES +=	rustc-demangle	0.1.27	# MIT/Apache-2.0
MODCARGO_CRATES +=	rustc_version	0.4.1	# MIT OR Apache-2.0
MODCARGO_CRATES +=	rustix	1.1.4	# Apache-2.0 WITH LLVM-exception OR Apache-2.0 OR MIT
MODCARGO_CRATES +=	rustversion	1.0.22	# MIT OR Apache-2.0
MODCARGO_CRATES +=	ryu	1.0.23	# Apache-2.0 OR BSL-1.0
MODCARGO_CRATES +=	same-file	1.0.6	# Unlicense/MIT
MODCARGO_CRATES +=	scc	2.4.0	# Apache-2.0
MODCARGO_CRATES +=	scopeguard	1.2.0	# MIT OR Apache-2.0
MODCARGO_CRATES +=	sdd	3.0.10	# Apache-2.0
MODCARGO_CRATES +=	semver	1.0.28	# MIT OR Apache-2.0
MODCARGO_CRATES +=	serde	1.0.228	# MIT OR Apache-2.0
MODCARGO_CRATES +=	serde_core	1.0.228	# MIT OR Apache-2.0
MODCARGO_CRATES +=	serde_derive	1.0.228	# MIT OR Apache-2.0
MODCARGO_CRATES +=	serde_json	1.0.149	# MIT OR Apache-2.0
MODCARGO_CRATES +=	serial2	0.2.36	# BSD-2-Clause OR Apache-2.0
MODCARGO_CRATES +=	serial_test	3.4.0	# MIT
MODCARGO_CRATES +=	serial_test_derive	3.4.0	# MIT
MODCARGO_CRATES +=	sha2	0.10.9	# MIT OR Apache-2.0
MODCARGO_CRATES +=	sharded-slab	0.1.7	# MIT
MODCARGO_CRATES +=	shared_library	0.1.9	# Apache-2.0/MIT
MODCARGO_CRATES +=	shell-quote	0.7.2	# Apache-2.0
MODCARGO_CRATES +=	shell-words	1.1.1	# MIT/Apache-2.0
MODCARGO_CRATES +=	shlex	1.3.0	# MIT OR Apache-2.0
MODCARGO_CRATES +=	signal-hook	0.3.18	# Apache-2.0/MIT
MODCARGO_CRATES +=	signal-hook-mio	0.2.5	# MIT OR Apache-2.0
MODCARGO_CRATES +=	signal-hook-registry	1.4.8	# MIT OR Apache-2.0
MODCARGO_CRATES +=	simdutf8	0.1.5	# MIT OR Apache-2.0
MODCARGO_CRATES +=	similar	2.7.0	# Apache-2.0
MODCARGO_CRATES +=	siphasher	1.0.2	# MIT/Apache-2.0
MODCARGO_CRATES +=	slab	0.4.12	# MIT
MODCARGO_CRATES +=	smallvec	1.15.1	# MIT OR Apache-2.0
MODCARGO_CRATES +=	socket2	0.6.3	# MIT OR Apache-2.0
MODCARGO_CRATES +=	static_assertions	1.1.0	# MIT OR Apache-2.0
MODCARGO_CRATES +=	strsim	0.11.1	# MIT
MODCARGO_CRATES +=	strum	0.27.2	# MIT
MODCARGO_CRATES +=	strum_macros	0.27.2	# MIT
MODCARGO_CRATES +=	syn	1.0.109	# MIT OR Apache-2.0
MODCARGO_CRATES +=	syn	2.0.117	# MIT OR Apache-2.0
MODCARGO_CRATES +=	tempfile	3.27.0	# MIT OR Apache-2.0
MODCARGO_CRATES +=	terminfo	0.9.0	# WTFPL
MODCARGO_CRATES +=	termios	0.3.3	# MIT
MODCARGO_CRATES +=	termwiz	0.23.3	# MIT
MODCARGO_CRATES +=	thiserror	1.0.69	# MIT OR Apache-2.0
MODCARGO_CRATES +=	thiserror	2.0.18	# MIT OR Apache-2.0
MODCARGO_CRATES +=	thiserror-impl	1.0.69	# MIT OR Apache-2.0
MODCARGO_CRATES +=	thiserror-impl	2.0.18	# MIT OR Apache-2.0
MODCARGO_CRATES +=	thread_local	1.1.9	# MIT OR Apache-2.0
MODCARGO_CRATES +=	time	0.3.47	# MIT OR Apache-2.0
MODCARGO_CRATES +=	time-core	0.1.8	# MIT OR Apache-2.0
MODCARGO_CRATES +=	tinytemplate	1.2.1	# Apache-2.0 OR MIT
MODCARGO_CRATES +=	tinyvec	1.11.0	# Zlib OR Apache-2.0 OR MIT
MODCARGO_CRATES +=	tinyvec_macros	0.1.1	# MIT OR Apache-2.0 OR Zlib
MODCARGO_CRATES +=	tokio	1.52.1	# MIT
MODCARGO_CRATES +=	tokio-macros	2.7.0	# MIT
MODCARGO_CRATES +=	tokio-util	0.7.18	# MIT
MODCARGO_CRATES +=	tracing	0.1.44	# MIT
MODCARGO_CRATES +=	tracing-core	0.1.36	# MIT
MODCARGO_CRATES +=	tracing-error	0.2.1	# MIT
MODCARGO_CRATES +=	tracing-subscriber	0.3.23	# MIT
MODCARGO_CRATES +=	tui-term	0.3.4	# MIT
MODCARGO_CRATES +=	typeid	1.0.3	# MIT OR Apache-2.0
MODCARGO_CRATES +=	typenum	1.20.0	# MIT OR Apache-2.0
MODCARGO_CRATES +=	ucd-trie	0.1.7	# MIT OR Apache-2.0
MODCARGO_CRATES +=	unicase	2.9.0	# MIT OR Apache-2.0
MODCARGO_CRATES +=	unicode-display-width	0.3.0	# MIT
MODCARGO_CRATES +=	unicode-ident	1.0.24	# (MIT OR Apache-2.0) AND Unicode-3.0
MODCARGO_CRATES +=	unicode-normalization	0.1.25	# MIT OR Apache-2.0
MODCARGO_CRATES +=	unicode-segmentation	1.13.2	# MIT OR Apache-2.0
MODCARGO_CRATES +=	unicode-truncate	2.0.1	# MIT OR Apache-2.0
MODCARGO_CRATES +=	unicode-width	0.2.2	# MIT OR Apache-2.0
MODCARGO_CRATES +=	unicode-xid	0.2.6	# MIT OR Apache-2.0
MODCARGO_CRATES +=	utf8parse	0.2.2	# Apache-2.0 OR MIT
MODCARGO_CRATES +=	uuid	1.23.1	# Apache-2.0 OR MIT
MODCARGO_CRATES +=	valuable	0.1.1	# MIT
MODCARGO_CRATES +=	version_check	0.9.5	# MIT/Apache-2.0
MODCARGO_CRATES +=	vt100	0.16.2	# MIT
MODCARGO_CRATES +=	vte	0.15.0	# Apache-2.0 OR MIT
MODCARGO_CRATES +=	vtparse	0.6.2	# MIT
MODCARGO_CRATES +=	walkdir	2.5.0	# Unlicense/MIT
MODCARGO_CRATES +=	wasi	0.11.1+wasi-snapshot-preview1	# Apache-2.0 WITH LLVM-exception OR Apache-2.0 OR MIT
MODCARGO_CRATES +=	wasip2	1.0.3+wasi-0.2.9	# Apache-2.0 WITH LLVM-exception OR Apache-2.0 OR MIT
MODCARGO_CRATES +=	wasip3	0.4.0+wasi-0.3.0-rc-2026-01-06	# Apache-2.0 WITH LLVM-exception OR Apache-2.0 OR MIT
MODCARGO_CRATES +=	wasm-bindgen	0.2.118	# MIT OR Apache-2.0
MODCARGO_CRATES +=	wasm-bindgen-macro	0.2.118	# MIT OR Apache-2.0
MODCARGO_CRATES +=	wasm-bindgen-macro-support	0.2.118	# MIT OR Apache-2.0
MODCARGO_CRATES +=	wasm-bindgen-shared	0.2.118	# MIT OR Apache-2.0
MODCARGO_CRATES +=	wasm-encoder	0.244.0	# Apache-2.0 WITH LLVM-exception OR Apache-2.0 OR MIT
MODCARGO_CRATES +=	wasm-metadata	0.244.0	# Apache-2.0 WITH LLVM-exception OR Apache-2.0 OR MIT
MODCARGO_CRATES +=	wasmparser	0.244.0	# Apache-2.0 WITH LLVM-exception OR Apache-2.0 OR MIT
MODCARGO_CRATES +=	web-sys	0.3.95	# MIT OR Apache-2.0
MODCARGO_CRATES +=	wezterm-bidi	0.2.3	# MIT AND Unicode-DFS-2016
MODCARGO_CRATES +=	wezterm-blob-leases	0.1.1	# MIT
MODCARGO_CRATES +=	wezterm-color-types	0.3.0	# MIT
MODCARGO_CRATES +=	wezterm-dynamic	0.2.1	# MIT
MODCARGO_CRATES +=	wezterm-dynamic-derive	0.1.1	# MIT
MODCARGO_CRATES +=	wezterm-input-types	0.1.0	# MIT
MODCARGO_CRATES +=	which	8.0.2	# MIT
MODCARGO_CRATES +=	widestring	1.2.1	# MIT OR Apache-2.0
MODCARGO_CRATES +=	winapi	0.3.9	# MIT/Apache-2.0
MODCARGO_CRATES +=	winapi-i686-pc-windows-gnu	0.4.0	# MIT/Apache-2.0
MODCARGO_CRATES +=	winapi-util	0.1.11	# Unlicense OR MIT
MODCARGO_CRATES +=	winapi-x86_64-pc-windows-gnu	0.4.0	# MIT/Apache-2.0
MODCARGO_CRATES +=	windows-link	0.2.1	# MIT OR Apache-2.0
MODCARGO_CRATES +=	windows-sys	0.61.2	# MIT OR Apache-2.0
MODCARGO_CRATES +=	winreg	0.10.1	# MIT
MODCARGO_CRATES +=	wit-bindgen	0.51.0	# Apache-2.0 WITH LLVM-exception OR Apache-2.0 OR MIT
MODCARGO_CRATES +=	wit-bindgen	0.57.1	# Apache-2.0 WITH LLVM-exception OR Apache-2.0 OR MIT
MODCARGO_CRATES +=	wit-bindgen-core	0.51.0	# Apache-2.0 WITH LLVM-exception OR Apache-2.0 OR MIT
MODCARGO_CRATES +=	wit-bindgen-rust	0.51.0	# Apache-2.0 WITH LLVM-exception OR Apache-2.0 OR MIT
MODCARGO_CRATES +=	wit-bindgen-rust-macro	0.51.0	# Apache-2.0 WITH LLVM-exception OR Apache-2.0 OR MIT
MODCARGO_CRATES +=	wit-component	0.244.0	# Apache-2.0 WITH LLVM-exception OR Apache-2.0 OR MIT
MODCARGO_CRATES +=	wit-parser	0.244.0	# Apache-2.0 WITH LLVM-exception OR Apache-2.0 OR MIT
MODCARGO_CRATES +=	zerocopy	0.8.48	# BSD-2-Clause OR Apache-2.0 OR MIT
MODCARGO_CRATES +=	zerocopy-derive	0.8.48	# BSD-2-Clause OR Apache-2.0 OR MIT
MODCARGO_CRATES +=	zmij	1.0.21	# MIT
