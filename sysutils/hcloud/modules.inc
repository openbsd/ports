MODGO_MODULES =	\
	github.com/!burnt!sushi/toml			 v1.6.0 \
	github.com/!vivid!cortex/ewma			 v1.2.0 \
	github.com/alecthomas/kingpin/v2		 v2.4.0 \
	github.com/alecthomas/units			 v0.0.0-20211218093645-b94a6e3cc137 \
	github.com/beorn7/perks				 v1.0.1 \
	github.com/bool64/dev				 v0.2.43 \
	github.com/bool64/shared			 v0.1.6 \
	github.com/cespare/xxhash/v2			 v2.3.0 \
	github.com/cheggaaa/pb/v3			 v3.1.7 \
	github.com/cpuguy83/go-md2man/v2		 v2.0.7 \
	github.com/davecgh/go-spew			 v1.1.2-0.20180830191138-d8f796af33cc \
	github.com/dustin/go-humanize			 v1.0.1 \
	github.com/fatih/color				 v1.19.0 \
	github.com/fatih/structs			 v1.1.0 \
	github.com/felixge/fgprof			 v0.9.5 \
	github.com/frankban/quicktest			 v1.14.6 \
	github.com/fsnotify/fsnotify			 v1.9.0 \
	github.com/go-viper/mapstructure/v2		 v2.4.0 \
	github.com/goccy/go-yaml			 v1.19.2 \
	github.com/golang/protobuf			 v1.5.0 \
	github.com/google/go-cmp			 v0.7.0 \
	github.com/google/pprof				 v0.0.0-20240227163752-401108e1b7e7 \
	github.com/guptarohit/asciigraph		 v0.9.0 \
	github.com/hetznercloud/hcloud-go/v2		 v2.44.0 \
	github.com/iancoleman/orderedmap		 v0.3.0 \
	github.com/inconshreveable/mousetrap		 v1.1.0 \
	github.com/jedib0t/go-pretty/v6			 v6.8.1 \
	github.com/jpillora/backoff			 v1.0.0 \
	github.com/json-iterator/go			 v1.1.12 \
	github.com/julienschmidt/httprouter		 v1.3.0 \
	github.com/klauspost/compress			 v1.18.0 \
	github.com/kr/pretty				 v0.3.1 \
	github.com/kr/pty				 v1.1.1 \
	github.com/kr/text				 v0.2.0 \
	github.com/kylelemons/godebug			 v1.1.0 \
	github.com/mattn/go-colorable			 v0.1.14 \
	github.com/mattn/go-isatty			 v0.0.20 \
	github.com/mattn/go-runewidth			 v0.0.16 \
	github.com/modern-go/concurrent			 v0.0.0-20180306012644-bacd9c7ef1dd \
	github.com/modern-go/reflect2			 v1.0.2 \
	github.com/munnerz/goautoneg			 v0.0.0-20191010083416-a7dc8b61c822 \
	github.com/mwitkow/go-conntrack			 v0.0.0-20190716064945-2f068394615f \
	github.com/pelletier/go-toml/v2			 v2.2.4 \
	github.com/pkg/profile				 v1.7.0 \
	github.com/pmezard/go-difflib			 v1.0.1-0.20181226105442-5d4384ee4fb2 \
	github.com/prometheus/client_golang		 v1.23.2 \
	github.com/prometheus/client_model		 v0.6.2 \
	github.com/prometheus/common			 v0.66.1 \
	github.com/prometheus/procfs			 v0.16.1 \
	github.com/rivo/uniseg				 v0.4.7 \
	github.com/rogpeppe/go-internal			 v1.11.0 \
	github.com/russross/blackfriday/v2		 v2.1.0 \
	github.com/sagikazarmark/locafero		 v0.11.0 \
	github.com/sergi/go-diff			 v1.4.0 \
	github.com/sourcegraph/conc			 v0.3.1-0.20240121214520-5f936abd7ae8 \
	github.com/spf13/afero				 v1.15.0 \
	github.com/spf13/cast				 v1.10.0 \
	github.com/spf13/cobra				 v1.10.2 \
	github.com/spf13/pflag				 v1.0.10 \
	github.com/spf13/viper				 v1.21.0 \
	github.com/stretchr/objx			 v0.5.2 \
	github.com/stretchr/testify			 v1.11.1 \
	github.com/subosito/gotenv			 v1.6.0 \
	github.com/swaggest/assertjson			 v1.10.0 \
	github.com/xhit/go-str2duration/v2		 v2.1.0 \
	github.com/yosuke-furukawa/json5		 v0.1.2-0.20201207051438-cf7bb3f354ff \
	github.com/yudai/golcs				 v0.0.0-20170316035057-ecda9a501e82 \
	github.com/yuin/goldmark			 v1.4.13 \
	go.uber.org/goleak				 v1.3.0 \
	go.uber.org/mock				 v0.6.0 \
	go.yaml.in/yaml/v2				 v2.4.2 \
	go.yaml.in/yaml/v3				 v3.0.4 \
	golang.org/x/crypto				 v0.53.0 \
	golang.org/x/exp				 v0.0.0-20260611194520-c48552f49976 \
	golang.org/x/mod				 v0.37.0 \
	golang.org/x/net				 v0.56.0 \
	golang.org/x/oauth2				 v0.30.0 \
	golang.org/x/sync				 v0.21.0 \
	golang.org/x/sys				 v0.46.0 \
	golang.org/x/term				 v0.44.0 \
	golang.org/x/text				 v0.38.0 \
	golang.org/x/tools				 v0.46.0 \
	golang.org/x/tools/go/expect			 v0.1.1-deprecated \
	golang.org/x/tools/go/packages/packagestest	 v0.1.1-deprecated \
	golang.org/x/xerrors				 v0.0.0-20191204190536-9bdfabe68543 \
	google.golang.org/protobuf			 v1.36.8 \
	gopkg.in/check.v1				 v1.0.0-20201130134442-10cb98267c6c \
	gopkg.in/yaml.v2				 v2.4.0 \
	gopkg.in/yaml.v3				 v3.0.1

MODGO_MODFILES =	\
	github.com/cpuguy83/go-md2man/v2	 v2.0.6 \
	github.com/davecgh/go-spew		 v1.1.0 \
	github.com/davecgh/go-spew		 v1.1.1 \
	github.com/fatih/color			 v1.18.0 \
	github.com/google/go-cmp		 v0.5.5 \
	github.com/google/go-cmp		 v0.5.9 \
	github.com/google/go-cmp		 v0.6.0 \
	github.com/kr/pretty			 v0.1.0 \
	github.com/kr/pretty			 v0.3.0 \
	github.com/kr/text			 v0.1.0 \
	github.com/pmezard/go-difflib		 v1.0.0 \
	github.com/prometheus/client_golang	 v1.20.4 \
	github.com/prometheus/procfs		 v0.15.1 \
	github.com/rivo/uniseg			 v0.2.0 \
	github.com/rogpeppe/go-internal		 v1.10.0 \
	github.com/rogpeppe/go-internal		 v1.9.0 \
	github.com/spf13/pflag			 v1.0.9 \
	github.com/stretchr/objx		 v0.1.0 \
	github.com/stretchr/testify		 v1.10.0 \
	github.com/stretchr/testify		 v1.4.0 \
	github.com/stretchr/testify		 v1.7.5 \
	github.com/stretchr/testify		 v1.8.1 \
	github.com/stretchr/testify		 v1.9.0 \
	golang.org/x/crypto			 v0.52.0 \
	golang.org/x/mod			 v0.27.0 \
	golang.org/x/mod			 v0.36.0 \
	golang.org/x/net			 v0.43.0 \
	golang.org/x/net			 v0.55.0 \
	golang.org/x/sync			 v0.13.0 \
	golang.org/x/sync			 v0.16.0 \
	golang.org/x/sys			 v0.13.0 \
	golang.org/x/sys			 v0.29.0 \
	golang.org/x/sys			 v0.30.0 \
	golang.org/x/sys			 v0.32.0 \
	golang.org/x/sys			 v0.35.0 \
	golang.org/x/sys			 v0.42.0 \
	golang.org/x/sys			 v0.45.0 \
	golang.org/x/sys			 v0.6.0 \
	golang.org/x/term			 v0.29.0 \
	golang.org/x/text			 v0.12.0 \
	golang.org/x/text			 v0.22.0 \
	golang.org/x/text			 v0.28.0 \
	golang.org/x/text			 v0.37.0 \
	golang.org/x/tools			 v0.36.0 \
	golang.org/x/tools			 v0.45.0 \
	google.golang.org/protobuf		 v1.36.6 \
	gopkg.in/check.v1			 v0.0.0-20161208181325-20d25e280405 \
	gopkg.in/check.v1			 v1.0.0-20190902080502-41f04d3bba15 \
	gopkg.in/yaml.v2			 v2.2.2

