MODGO_MODULES =	\
	github.com/alecthomas/kingpin/v2	 v2.4.0 \
	github.com/alecthomas/units		 v0.0.0-20211218093645-b94a6e3cc137 \
	github.com/beorn7/perks			 v1.0.1 \
	github.com/cespare/xxhash/v2		 v2.2.0 \
	github.com/creack/pty			 v1.1.9 \
	github.com/davecgh/go-spew		 v1.1.1 \
	github.com/go-kit/log			 v0.2.1 \
	github.com/go-logfmt/logfmt		 v0.5.1 \
	github.com/golang/protobuf		 v1.5.3 \
	github.com/google/go-cmp		 v0.6.0 \
	github.com/jpillora/backoff		 v1.0.0 \
	github.com/json-iterator/go		 v1.1.12 \
	github.com/julienschmidt/httprouter	 v1.3.0 \
	github.com/kr/pretty			 v0.3.1 \
	github.com/kr/text			 v0.2.0 \
	github.com/modern-go/concurrent		 v0.0.0-20180306012644-bacd9c7ef1dd \
	github.com/modern-go/reflect2		 v1.0.2 \
	github.com/mwitkow/go-conntrack		 v0.0.0-20190716064945-2f068394615f \
	github.com/prometheus/client_golang	 v1.19.0 \
	github.com/prometheus/client_model	 v0.6.0 \
	github.com/prometheus/common		 v0.48.0 \
	github.com/prometheus/procfs		 v0.12.0 \
	github.com/rogpeppe/go-internal		 v1.10.0 \
	github.com/xhit/go-str2duration/v2	 v2.1.0 \
	golang.org/x/net			 v0.20.0 \
	golang.org/x/oauth2			 v0.16.0 \
	golang.org/x/sync			 v0.3.0 \
	golang.org/x/sys			 v0.18.0 \
	golang.org/x/text			 v0.14.0 \
	golang.org/x/xerrors			 v0.0.0-20191204190536-9bdfabe68543 \
	google.golang.org/appengine		 v1.6.7 \
	google.golang.org/protobuf		 v1.33.0 \
	gopkg.in/check.v1			 v1.0.0-20201130134442-10cb98267c6c \
	gopkg.in/yaml.v2			 v2.4.0 \
	gopkg.in/yaml.v3			 v3.0.1

MODGO_MODFILES =	\
	github.com/golang/protobuf		 v1.5.0 \
	github.com/google/go-cmp		 v0.5.5 \
	github.com/google/go-cmp		 v0.5.9 \
	github.com/prometheus/client_golang	 v1.18.0 \
	github.com/prometheus/client_model	 v0.5.0 \
	golang.org/x/sys			 v0.12.0 \
	golang.org/x/sys			 v0.16.0 \
	google.golang.org/protobuf		 v1.32.0 \
	gopkg.in/check.v1			 v0.0.0-20161208181325-20d25e280405

