MODGO_MODULES =	\
	cel.dev/expr									 v0.25.2 \
	cloud.google.com/go/auth							 v0.20.0 \
	cloud.google.com/go/compute/metadata						 v0.9.0 \
	github.com/!google!cloud!platform/opentelemetry-operations-go/detectors/gcp	 v1.34.0 \
	github.com/alecthomas/kingpin/v2						 v2.4.0 \
	github.com/alecthomas/units							 v0.0.0-20240927000941-0f3dac36c52b \
	github.com/andybalholm/brotli							 v1.2.5 \
	github.com/antlr4-go/antlr/v4							 v4.13.1 \
	github.com/beorn7/perks								 v1.0.1 \
	github.com/cespare/xxhash/v2							 v2.3.0 \
	github.com/cncf/xds/go								 v0.0.0-20260202195803-dba9d589def2 \
	github.com/coreos/go-systemd/v22						 v22.7.0 \
	github.com/davecgh/go-spew							 v1.1.1 \
	github.com/envoyproxy/go-control-plane						 v0.14.0 \
	github.com/envoyproxy/go-control-plane/envoy					 v1.37.0 \
	github.com/envoyproxy/go-control-plane/ratelimit				 v0.1.0 \
	github.com/envoyproxy/protoc-gen-validate					 v1.3.3 \
	github.com/felixge/httpsnoop							 v1.1.0 \
	github.com/go-jose/go-jose/v4							 v4.1.4 \
	github.com/go-logr/logr								 v1.4.3 \
	github.com/go-logr/stdr								 v1.2.2 \
	github.com/godbus/dbus/v5							 v5.1.0 \
	github.com/golang-jwt/jwt/v5							 v5.3.1 \
	github.com/golang/glog								 v1.2.5 \
	github.com/golang/protobuf							 v1.5.4 \
	github.com/google/cel-go							 v0.30.0 \
	github.com/google/go-cmp							 v0.7.0 \
	github.com/google/s2a-go							 v0.1.9 \
	github.com/google/uuid								 v1.6.0 \
	github.com/googleapis/enterprise-certificate-proxy				 v0.3.15 \
	github.com/googleapis/gax-go/v2							 v2.22.0 \
	github.com/gorilla/websocket							 v1.5.3 \
	github.com/jordanlewis/gcassert							 v0.0.0-20250430164644-389ef753e22e \
	github.com/jpillora/backoff							 v1.0.0 \
	github.com/json-iterator/go							 v1.1.12 \
	github.com/julienschmidt/httprouter						 v1.3.0 \
	github.com/klauspost/compress							 v1.19.1 \
	github.com/kylelemons/godebug							 v1.1.0 \
	github.com/mdlayher/socket							 v0.6.0 \
	github.com/mdlayher/vsock							 v1.3.0 \
	github.com/miekg/dns								 v1.1.73 \
	github.com/modern-go/concurrent							 v0.0.0-20180306012644-bacd9c7ef1dd \
	github.com/modern-go/reflect2							 v1.0.2 \
	github.com/munnerz/goautoneg							 v0.0.0-20191010083416-a7dc8b61c822 \
	github.com/mwitkow/go-conntrack							 v0.0.0-20190716064945-2f068394615f \
	github.com/planetscale/vtprotobuf						 v0.6.1-0.20240319094008-0393e58bdf10 \
	github.com/pmezard/go-difflib							 v1.0.0 \
	github.com/prometheus/client_golang						 v1.24.1 \
	github.com/prometheus/client_model						 v0.6.3 \
	github.com/prometheus/common							 v0.72.0 \
	github.com/prometheus/exporter-toolkit						 v0.20.0 \
	github.com/prometheus/procfs							 v0.21.1 \
	github.com/quic-go/go-ossfuzz-seeds						 v0.1.0 \
	github.com/quic-go/qpack							 v0.6.0 \
	github.com/quic-go/quic-go							 v0.63.0 \
	github.com/spiffe/go-spiffe/v2							 v2.8.1 \
	github.com/stretchr/objx							 v0.5.2 \
	github.com/stretchr/testify							 v1.12.1 \
	github.com/xhit/go-str2duration/v2						 v2.1.0 \
	github.com/xyproto/randomstring							 v1.0.5 \
	go.opentelemetry.io/auto/sdk							 v1.2.1 \
	go.opentelemetry.io/contrib/detectors/gcp					 v1.44.0 \
	go.opentelemetry.io/contrib/instrumentation/net/http/otelhttp			 v0.69.0 \
	go.opentelemetry.io/otel							 v1.44.0 \
	go.opentelemetry.io/otel/metric							 v1.44.0 \
	go.opentelemetry.io/otel/sdk							 v1.44.0 \
	go.opentelemetry.io/otel/sdk/metric						 v1.44.0 \
	go.opentelemetry.io/otel/trace							 v1.44.0 \
	go.uber.org/goleak								 v1.3.0 \
	go.uber.org/mock								 v0.5.2 \
	go.yaml.in/yaml/v2								 v2.4.4 \
	go.yaml.in/yaml/v3								 v3.0.5 \
	golang.org/x/crypto								 v0.57.0 \
	golang.org/x/exp								 v0.0.0-20240823005443-9b4947da3948 \
	golang.org/x/mod								 v0.41.0 \
	golang.org/x/net								 v0.59.0 \
	golang.org/x/oauth2								 v0.37.0 \
	golang.org/x/sync								 v0.23.0 \
	golang.org/x/sys								 v0.48.0 \
	golang.org/x/term								 v0.46.0 \
	golang.org/x/text								 v0.42.0 \
	golang.org/x/time								 v0.15.0 \
	golang.org/x/tools								 v0.49.0 \
	gonum.org/v1/gonum								 v0.17.0 \
	google.golang.org/api								 v0.278.0 \
	google.golang.org/genproto/googleapis/api					 v0.0.0-20260706201446-f0a921348800 \
	google.golang.org/genproto/googleapis/rpc					 v0.0.0-20260706201446-f0a921348800 \
	google.golang.org/grpc								 v1.84.0 \
	google.golang.org/protobuf							 v1.36.12 \
	gopkg.in/check.v1								 v0.0.0-20161208181325-20d25e280405 \
	gopkg.in/yaml.v3								 v3.0.1

MODGO_MODFILES =	\
	cel.dev/expr					 v0.25.1 \
	cloud.google.com/go/compute/metadata		 v0.3.0 \
	github.com/alecthomas/units			 v0.0.0-20211218093645-b94a6e3cc137 \
	github.com/davecgh/go-spew			 v1.1.0 \
	github.com/golang/protobuf			 v1.5.0 \
	github.com/google/go-cmp			 v0.6.0 \
	github.com/prometheus/client_golang		 v1.23.2 \
	github.com/prometheus/client_model		 v0.6.2 \
	github.com/prometheus/common			 v0.70.1 \
	github.com/prometheus/procfs			 v0.21.0 \
	github.com/stretchr/objx			 v0.1.0 \
	github.com/stretchr/objx			 v0.4.0 \
	github.com/stretchr/objx			 v0.5.0 \
	github.com/stretchr/testify			 v1.7.1 \
	github.com/stretchr/testify			 v1.8.0 \
	github.com/stretchr/testify			 v1.8.2 \
	github.com/stretchr/testify			 v1.8.4 \
	github.com/stretchr/testify			 v1.9.0 \
	go.yaml.in/yaml/v3				 v3.0.4 \
	golang.org/x/crypto				 v0.54.0 \
	golang.org/x/crypto				 v0.55.0 \
	golang.org/x/exp				 v0.0.0-20240506185415-9bf2ced13842 \
	golang.org/x/mod				 v0.20.0 \
	golang.org/x/mod				 v0.37.0 \
	golang.org/x/mod				 v0.38.0 \
	golang.org/x/net				 v0.28.0 \
	golang.org/x/net				 v0.52.0 \
	golang.org/x/net				 v0.55.0 \
	golang.org/x/net				 v0.56.0 \
	golang.org/x/net				 v0.57.0 \
	golang.org/x/net				 v0.58.0 \
	golang.org/x/oauth2				 v0.36.0 \
	golang.org/x/sync				 v0.20.0 \
	golang.org/x/sync				 v0.21.0 \
	golang.org/x/sync				 v0.22.0 \
	golang.org/x/sync				 v0.8.0 \
	golang.org/x/sys				 v0.1.0 \
	golang.org/x/sys				 v0.42.0 \
	golang.org/x/sys				 v0.45.0 \
	golang.org/x/sys				 v0.46.0 \
	golang.org/x/sys				 v0.47.0 \
	golang.org/x/text				 v0.22.0 \
	golang.org/x/text				 v0.37.0 \
	golang.org/x/text				 v0.40.0 \
	golang.org/x/text				 v0.41.0 \
	golang.org/x/tools				 v0.24.0 \
	golang.org/x/tools				 v0.47.0 \
	golang.org/x/tools				 v0.48.0 \
	google.golang.org/genproto/googleapis/api	 v0.0.0-20240826202546-f6391c0de4c7 \
	google.golang.org/genproto/googleapis/rpc	 v0.0.0-20240826202546-f6391c0de4c7 \
	google.golang.org/genproto/googleapis/rpc	 v0.0.0-20260630182238-925bb5da69e7 \
	google.golang.org/grpc				 v1.79.3 \
	google.golang.org/protobuf			 v1.36.10 \
	google.golang.org/protobuf			 v1.36.11 \
	gopkg.in/yaml.v3				 v3.0.0-20200313102051-9f266ea9e77c

