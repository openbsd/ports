MODGO_MODULES =	\
	github.com/!burnt!sushi/toml			 v0.3.1 \
	github.com/!one!of!one/xxhash			 v1.2.8 \
	github.com/cespare/xxhash			 v1.1.0 \
	github.com/chzyer/logex				 v1.2.1 \
	github.com/chzyer/readline			 v1.5.1 \
	github.com/chzyer/test				 v1.0.0 \
	github.com/cpuguy83/go-md2man/v2		 v2.0.4 \
	github.com/davecgh/go-spew			 v1.1.1 \
	github.com/denisbrodbeck/machineid		 v1.0.1 \
	github.com/k0kubun/go-ansi			 v0.0.0-20180517002512-3bf9e2903213 \
	github.com/kalafut/imohash			 v1.0.3 \
	github.com/kr/pretty				 v0.2.1 \
	github.com/kr/pty				 v1.1.1 \
	github.com/kr/text				 v0.1.0 \
	github.com/magisterquis/connectproxy		 v0.0.0-20200725203833-3582e84f0c9b \
	github.com/mattn/go-isatty			 v0.0.20 \
	github.com/mitchellh/colorstring		 v0.0.0-20190213212951-d06e56a500db \
	github.com/pmezard/go-difflib			 v1.0.0 \
	github.com/rivo/uniseg				 v0.4.7 \
	github.com/russross/blackfriday/v2		 v2.1.0 \
	github.com/sabhiram/go-gitignore		 v0.0.0-20210923224102-525f6e181f06 \
	github.com/schollz/cli/v2			 v2.2.1 \
	github.com/schollz/logger			 v1.2.0 \
	github.com/schollz/mnemonicode			 v1.0.2-0.20190421205639-63fa713ece0d \
	github.com/schollz/pake/v3			 v3.0.5 \
	github.com/schollz/peerdiscovery		 v1.7.2 \
	github.com/schollz/progressbar/v3		 v3.14.2 \
	github.com/shurcoo!l/sanitized_anchor_name	 v1.0.0 \
	github.com/spaolacci/murmur3			 v1.1.0 \
	github.com/stretchr/objx			 v0.5.2 \
	github.com/stretchr/testify			 v1.9.0 \
	github.com/tscholl2/siec			 v0.0.0-20240310163802-c2c6f6198406 \
	github.com/twmb/murmur3				 v1.1.8 \
	github.com/yuin/goldmark			 v1.4.13 \
	golang.org/x/crypto				 v0.22.0 \
	golang.org/x/mod				 v0.8.0 \
	golang.org/x/net				 v0.24.0 \
	golang.org/x/sync				 v0.1.0 \
	golang.org/x/sys				 v0.19.0 \
	golang.org/x/term				 v0.19.0 \
	golang.org/x/text				 v0.14.0 \
	golang.org/x/time				 v0.5.0 \
	golang.org/x/tools				 v0.6.0 \
	golang.org/x/xerrors				 v0.0.0-20190717185122-a985d3407aa7 \
	gopkg.in/check.v1				 v1.0.0-20201130134442-10cb98267c6c \
	gopkg.in/yaml.v2				 v2.2.2 \
	gopkg.in/yaml.v3				 v3.0.1

MODGO_MODFILES =	\
	github.com/!one!of!one/xxhash		 v1.2.2 \
	github.com/cpuguy83/go-md2man/v2	 v2.0.0-20190314233015-f79a8a8ca69d \
	github.com/davecgh/go-spew		 v1.1.0 \
	github.com/russross/blackfriday/v2	 v2.0.1 \
	github.com/spaolacci/murmur3		 v0.0.0-20180118202830-f09979ecbc72 \
	github.com/stretchr/objx		 v0.1.0 \
	github.com/stretchr/testify		 v1.3.0 \
	github.com/stretchr/testify		 v1.6.1 \
	github.com/tscholl2/siec		 v0.0.0-20210707234609-9bdfc483d499 \
	github.com/twmb/murmur3			 v1.1.5 \
	golang.org/x/crypto			 v0.0.0-20190308221718-c2843e01d9a2 \
	golang.org/x/crypto			 v0.0.0-20210921155107-089bfa567519 \
	golang.org/x/crypto			 v0.15.0 \
	golang.org/x/mod			 v0.6.0-dev.0.20220419223038-86c51ed26bb4 \
	golang.org/x/net			 v0.0.0-20190620200207-3b0461eec859 \
	golang.org/x/net			 v0.0.0-20210226172049-e18ecbb05110 \
	golang.org/x/net			 v0.0.0-20220722155237-a158d28d115b \
	golang.org/x/net			 v0.10.0 \
	golang.org/x/net			 v0.18.0 \
	golang.org/x/net			 v0.21.0 \
	golang.org/x/net			 v0.6.0 \
	golang.org/x/sync			 v0.0.0-20190423024810-112230192c58 \
	golang.org/x/sync			 v0.0.0-20220722155255-886fb9371eb4 \
	golang.org/x/sys			 v0.0.0-20190215142949-d0b11bdaac8a \
	golang.org/x/sys			 v0.0.0-20201119102817-f84b799fce68 \
	golang.org/x/sys			 v0.0.0-20210615035016-665e8c7367d1 \
	golang.org/x/sys			 v0.0.0-20220310020820-b874c991c1a5 \
	golang.org/x/sys			 v0.0.0-20220520151302-bc2c85ada10a \
	golang.org/x/sys			 v0.0.0-20220722155257-8c9f86f7a55f \
	golang.org/x/sys			 v0.14.0 \
	golang.org/x/sys			 v0.17.0 \
	golang.org/x/sys			 v0.5.0 \
	golang.org/x/sys			 v0.6.0 \
	golang.org/x/sys			 v0.8.0 \
	golang.org/x/term			 v0.0.0-20201126162022-7de9c90e9dd1 \
	golang.org/x/term			 v0.0.0-20210927222741-03fcf44c2211 \
	golang.org/x/term			 v0.14.0 \
	golang.org/x/term			 v0.17.0 \
	golang.org/x/term			 v0.5.0 \
	golang.org/x/term			 v0.8.0 \
	golang.org/x/text			 v0.3.0 \
	golang.org/x/text			 v0.3.3 \
	golang.org/x/text			 v0.3.7 \
	golang.org/x/text			 v0.7.0 \
	golang.org/x/text			 v0.9.0 \
	golang.org/x/tools			 v0.0.0-20180917221912-90fa682c2a6e \
	golang.org/x/tools			 v0.0.0-20191119224855-298f0cb1881e \
	golang.org/x/tools			 v0.1.12 \
	gopkg.in/check.v1			 v0.0.0-20161208181325-20d25e280405 \
	gopkg.in/yaml.v3			 v3.0.0-20200313102051-9f266ea9e77c

