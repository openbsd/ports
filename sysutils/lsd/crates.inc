MODCARGO_CRATES +=	aho-corasick	1.1.3	# Unlicense OR MIT
MODCARGO_CRATES +=	android-tzdata	0.1.1	# MIT OR Apache-2.0
MODCARGO_CRATES +=	android_system_properties	0.1.5	# MIT/Apache-2.0
MODCARGO_CRATES +=	anstream	0.3.2	# MIT OR Apache-2.0
MODCARGO_CRATES +=	anstyle	1.0.6	# MIT OR Apache-2.0
MODCARGO_CRATES +=	anstyle-parse	0.2.3	# MIT OR Apache-2.0
MODCARGO_CRATES +=	anstyle-query	1.0.2	# MIT OR Apache-2.0
MODCARGO_CRATES +=	anstyle-wincon	1.0.2	# MIT OR Apache-2.0
MODCARGO_CRATES +=	assert_cmd	2.0.14	# MIT OR Apache-2.0
MODCARGO_CRATES +=	assert_fs	1.1.1	# MIT OR Apache-2.0
MODCARGO_CRATES +=	autocfg	1.2.0	# Apache-2.0 OR MIT
MODCARGO_CRATES +=	bitflags	1.3.2	# MIT/Apache-2.0
MODCARGO_CRATES +=	bitflags	2.5.0	# MIT OR Apache-2.0
MODCARGO_CRATES +=	bstr	1.9.1	# MIT OR Apache-2.0
MODCARGO_CRATES +=	bumpalo	3.15.4	# MIT OR Apache-2.0
MODCARGO_CRATES +=	cc	1.0.90	# MIT OR Apache-2.0
MODCARGO_CRATES +=	cfg-if	1.0.0	# MIT/Apache-2.0
MODCARGO_CRATES +=	chrono	0.4.37	# MIT OR Apache-2.0
MODCARGO_CRATES +=	chrono-humanize	0.2.3	# MIT/Apache-2.0
MODCARGO_CRATES +=	clap	4.3.24	# MIT OR Apache-2.0
MODCARGO_CRATES +=	clap_builder	4.3.24	# MIT OR Apache-2.0
MODCARGO_CRATES +=	clap_complete	4.5.1	# MIT OR Apache-2.0
MODCARGO_CRATES +=	clap_derive	4.3.12	# MIT OR Apache-2.0
MODCARGO_CRATES +=	clap_lex	0.5.1	# MIT OR Apache-2.0
MODCARGO_CRATES +=	colorchoice	1.0.0	# MIT OR Apache-2.0
MODCARGO_CRATES +=	core-foundation-sys	0.8.6	# MIT OR Apache-2.0
MODCARGO_CRATES +=	crossbeam-deque	0.8.5	# MIT OR Apache-2.0
MODCARGO_CRATES +=	crossbeam-epoch	0.9.18	# MIT OR Apache-2.0
MODCARGO_CRATES +=	crossbeam-utils	0.8.19	# MIT OR Apache-2.0
MODCARGO_CRATES +=	crossterm	0.27.0	# MIT
MODCARGO_CRATES +=	crossterm_winapi	0.9.1	# MIT
MODCARGO_CRATES +=	dashmap	5.5.3	# MIT
MODCARGO_CRATES +=	difflib	0.4.0	# MIT
MODCARGO_CRATES +=	dirs	5.0.1	# MIT OR Apache-2.0
MODCARGO_CRATES +=	dirs-sys	0.4.1	# MIT OR Apache-2.0
MODCARGO_CRATES +=	doc-comment	0.3.3	# MIT
MODCARGO_CRATES +=	equivalent	1.0.1	# Apache-2.0 OR MIT
MODCARGO_CRATES +=	errno	0.3.8	# MIT OR Apache-2.0
MODCARGO_CRATES +=	fastrand	2.0.2	# Apache-2.0 OR MIT
MODCARGO_CRATES +=	float-cmp	0.9.0	# MIT
MODCARGO_CRATES +=	form_urlencoded	1.2.1	# MIT OR Apache-2.0
MODCARGO_CRATES +=	futures	0.3.30	# MIT OR Apache-2.0
MODCARGO_CRATES +=	futures-channel	0.3.30	# MIT OR Apache-2.0
MODCARGO_CRATES +=	futures-core	0.3.30	# MIT OR Apache-2.0
MODCARGO_CRATES +=	futures-executor	0.3.30	# MIT OR Apache-2.0
MODCARGO_CRATES +=	futures-io	0.3.30	# MIT OR Apache-2.0
MODCARGO_CRATES +=	futures-sink	0.3.30	# MIT OR Apache-2.0
MODCARGO_CRATES +=	futures-task	0.3.30	# MIT OR Apache-2.0
MODCARGO_CRATES +=	futures-util	0.3.30	# MIT OR Apache-2.0
MODCARGO_CRATES +=	getrandom	0.2.12	# MIT OR Apache-2.0
MODCARGO_CRATES +=	git2	0.18.3	# MIT OR Apache-2.0
MODCARGO_CRATES +=	glob	0.3.1	# MIT OR Apache-2.0
MODCARGO_CRATES +=	globset	0.4.14	# Unlicense OR MIT
MODCARGO_CRATES +=	globwalk	0.9.1	# MIT
MODCARGO_CRATES +=	hashbrown	0.14.3	# MIT OR Apache-2.0
MODCARGO_CRATES +=	heck	0.4.1	# MIT OR Apache-2.0
MODCARGO_CRATES +=	hermit-abi	0.3.9	# MIT OR Apache-2.0
MODCARGO_CRATES +=	human-sort	0.2.2	# MIT
MODCARGO_CRATES +=	iana-time-zone	0.1.60	# MIT OR Apache-2.0
MODCARGO_CRATES +=	iana-time-zone-haiku	0.1.2	# MIT OR Apache-2.0
MODCARGO_CRATES +=	idna	0.5.0	# MIT OR Apache-2.0
MODCARGO_CRATES +=	ignore	0.4.22	# Unlicense OR MIT
MODCARGO_CRATES +=	indexmap	2.2.6	# Apache-2.0 OR MIT
MODCARGO_CRATES +=	io-lifetimes	1.0.11	# Apache-2.0 WITH LLVM-exception OR Apache-2.0 OR MIT
MODCARGO_CRATES +=	is-terminal	0.4.12	# MIT
MODCARGO_CRATES +=	itoa	1.0.11	# MIT OR Apache-2.0
MODCARGO_CRATES +=	jobserver	0.1.28	# MIT OR Apache-2.0
MODCARGO_CRATES +=	js-sys	0.3.69	# MIT OR Apache-2.0
MODCARGO_CRATES +=	lazy_static	1.4.0	# MIT/Apache-2.0
MODCARGO_CRATES +=	libc	0.2.153	# MIT OR Apache-2.0
MODCARGO_CRATES +=	libgit2-sys	0.16.2+1.7.2	# MIT OR Apache-2.0
MODCARGO_CRATES +=	libredox	0.1.3	# MIT
MODCARGO_CRATES +=	libz-sys	1.1.16	# MIT OR Apache-2.0
MODCARGO_CRATES +=	linked-hash-map	0.5.6	# MIT/Apache-2.0
MODCARGO_CRATES +=	linux-raw-sys	0.3.8	# Apache-2.0 WITH LLVM-exception OR Apache-2.0 OR MIT
MODCARGO_CRATES +=	linux-raw-sys	0.4.13	# Apache-2.0 WITH LLVM-exception OR Apache-2.0 OR MIT
MODCARGO_CRATES +=	lock_api	0.4.11	# MIT OR Apache-2.0
MODCARGO_CRATES +=	log	0.4.21	# MIT OR Apache-2.0
MODCARGO_CRATES +=	lscolors	0.16.0	# MIT/Apache-2.0
MODCARGO_CRATES +=	memchr	2.7.2	# Unlicense OR MIT
MODCARGO_CRATES +=	mio	0.8.11	# MIT
MODCARGO_CRATES +=	normalize-line-endings	0.3.0	# Apache-2.0
MODCARGO_CRATES +=	nu-ansi-term	0.49.0	# MIT
MODCARGO_CRATES +=	num-traits	0.2.18	# MIT OR Apache-2.0
MODCARGO_CRATES +=	once_cell	1.19.0	# MIT OR Apache-2.0
MODCARGO_CRATES +=	option-ext	0.2.0	# MPL-2.0
MODCARGO_CRATES +=	parking_lot	0.12.1	# MIT OR Apache-2.0
MODCARGO_CRATES +=	parking_lot_core	0.9.9	# MIT OR Apache-2.0
MODCARGO_CRATES +=	percent-encoding	2.3.1	# MIT OR Apache-2.0
MODCARGO_CRATES +=	pin-project-lite	0.2.14	# Apache-2.0 OR MIT
MODCARGO_CRATES +=	pin-utils	0.1.0	# MIT OR Apache-2.0
MODCARGO_CRATES +=	pkg-config	0.3.30	# MIT OR Apache-2.0
MODCARGO_CRATES +=	predicates	3.1.0	# MIT OR Apache-2.0
MODCARGO_CRATES +=	predicates-core	1.0.6	# MIT OR Apache-2.0
MODCARGO_CRATES +=	predicates-tree	1.0.9	# MIT OR Apache-2.0
MODCARGO_CRATES +=	proc-macro2	1.0.79	# MIT OR Apache-2.0
MODCARGO_CRATES +=	pure-rust-locales	0.8.1	# MIT OR Apache-2.0
MODCARGO_CRATES +=	quote	1.0.35	# MIT OR Apache-2.0
MODCARGO_CRATES +=	redox_syscall	0.4.1	# MIT
MODCARGO_CRATES +=	redox_users	0.4.5	# MIT
MODCARGO_CRATES +=	regex	1.10.4	# MIT OR Apache-2.0
MODCARGO_CRATES +=	regex-automata	0.4.6	# MIT OR Apache-2.0
MODCARGO_CRATES +=	regex-syntax	0.8.3	# MIT OR Apache-2.0
MODCARGO_CRATES +=	rustix	0.37.27	# Apache-2.0 WITH LLVM-exception OR Apache-2.0 OR MIT
MODCARGO_CRATES +=	rustix	0.38.32	# Apache-2.0 WITH LLVM-exception OR Apache-2.0 OR MIT
MODCARGO_CRATES +=	ryu	1.0.17	# Apache-2.0 OR BSL-1.0
MODCARGO_CRATES +=	same-file	1.0.6	# Unlicense/MIT
MODCARGO_CRATES +=	scopeguard	1.2.0	# MIT OR Apache-2.0
MODCARGO_CRATES +=	serde	1.0.197	# MIT OR Apache-2.0
MODCARGO_CRATES +=	serde_derive	1.0.197	# MIT OR Apache-2.0
MODCARGO_CRATES +=	serde_yaml	0.9.34+deprecated	# MIT OR Apache-2.0
MODCARGO_CRATES +=	serial_test	2.0.0	# MIT
MODCARGO_CRATES +=	serial_test_derive	2.0.0	# MIT
MODCARGO_CRATES +=	signal-hook	0.3.17	# Apache-2.0/MIT
MODCARGO_CRATES +=	signal-hook-mio	0.2.3	# Apache-2.0/MIT
MODCARGO_CRATES +=	signal-hook-registry	1.4.1	# Apache-2.0/MIT
MODCARGO_CRATES +=	slab	0.4.9	# MIT
MODCARGO_CRATES +=	smallvec	1.13.2	# MIT OR Apache-2.0
MODCARGO_CRATES +=	strsim	0.10.0	# MIT
MODCARGO_CRATES +=	syn	2.0.57	# MIT OR Apache-2.0
MODCARGO_CRATES +=	sys-locale	0.3.1	# MIT OR Apache-2.0
MODCARGO_CRATES +=	tempfile	3.10.1	# MIT OR Apache-2.0
MODCARGO_CRATES +=	term_grid	0.1.7	# MIT
MODCARGO_CRATES +=	terminal_size	0.2.6	# MIT OR Apache-2.0
MODCARGO_CRATES +=	terminal_size	0.3.0	# MIT OR Apache-2.0
MODCARGO_CRATES +=	termtree	0.4.1	# MIT
MODCARGO_CRATES +=	thiserror	1.0.58	# MIT OR Apache-2.0
MODCARGO_CRATES +=	thiserror-impl	1.0.58	# MIT OR Apache-2.0
MODCARGO_CRATES +=	tinyvec	1.6.0	# Zlib OR Apache-2.0 OR MIT
MODCARGO_CRATES +=	tinyvec_macros	0.1.1	# MIT OR Apache-2.0 OR Zlib
MODCARGO_CRATES +=	unicode-bidi	0.3.15	# MIT OR Apache-2.0
MODCARGO_CRATES +=	unicode-ident	1.0.12	# (MIT OR Apache-2.0) AND Unicode-DFS-2016
MODCARGO_CRATES +=	unicode-normalization	0.1.23	# MIT/Apache-2.0
MODCARGO_CRATES +=	unicode-width	0.1.13	# MIT OR Apache-2.0
MODCARGO_CRATES +=	unsafe-libyaml	0.2.11	# MIT
MODCARGO_CRATES +=	url	2.5.0	# MIT OR Apache-2.0
MODCARGO_CRATES +=	utf8parse	0.2.1	# Apache-2.0 OR MIT
MODCARGO_CRATES +=	uzers	0.11.3	# MIT
MODCARGO_CRATES +=	vcpkg	0.2.15	# MIT/Apache-2.0
MODCARGO_CRATES +=	version_check	0.9.4	# MIT/Apache-2.0
MODCARGO_CRATES +=	vsort	0.2.0	# MIT
MODCARGO_CRATES +=	wait-timeout	0.2.0	# MIT/Apache-2.0
MODCARGO_CRATES +=	walkdir	2.5.0	# Unlicense/MIT
MODCARGO_CRATES +=	wasi	0.11.0+wasi-snapshot-preview1	# Apache-2.0 WITH LLVM-exception OR Apache-2.0 OR MIT
MODCARGO_CRATES +=	wasm-bindgen	0.2.92	# MIT OR Apache-2.0
MODCARGO_CRATES +=	wasm-bindgen-backend	0.2.92	# MIT OR Apache-2.0
MODCARGO_CRATES +=	wasm-bindgen-macro	0.2.92	# MIT OR Apache-2.0
MODCARGO_CRATES +=	wasm-bindgen-macro-support	0.2.92	# MIT OR Apache-2.0
MODCARGO_CRATES +=	wasm-bindgen-shared	0.2.92	# MIT OR Apache-2.0
MODCARGO_CRATES +=	wild	2.2.1	# Apache-2.0 OR MIT
MODCARGO_CRATES +=	winapi	0.3.9	# MIT/Apache-2.0
MODCARGO_CRATES +=	winapi-i686-pc-windows-gnu	0.4.0	# MIT/Apache-2.0
MODCARGO_CRATES +=	winapi-util	0.1.6	# Unlicense/MIT
MODCARGO_CRATES +=	winapi-x86_64-pc-windows-gnu	0.4.0	# MIT/Apache-2.0
MODCARGO_CRATES +=	windows	0.43.0	# MIT OR Apache-2.0
MODCARGO_CRATES +=	windows-core	0.52.0	# MIT OR Apache-2.0
MODCARGO_CRATES +=	windows-sys	0.48.0	# MIT OR Apache-2.0
MODCARGO_CRATES +=	windows-sys	0.52.0	# MIT OR Apache-2.0
MODCARGO_CRATES +=	windows-targets	0.48.5	# MIT OR Apache-2.0
MODCARGO_CRATES +=	windows-targets	0.52.4	# MIT OR Apache-2.0
MODCARGO_CRATES +=	windows_aarch64_gnullvm	0.42.2	# MIT OR Apache-2.0
MODCARGO_CRATES +=	windows_aarch64_gnullvm	0.48.5	# MIT OR Apache-2.0
MODCARGO_CRATES +=	windows_aarch64_gnullvm	0.52.4	# MIT OR Apache-2.0
MODCARGO_CRATES +=	windows_aarch64_msvc	0.42.2	# MIT OR Apache-2.0
MODCARGO_CRATES +=	windows_aarch64_msvc	0.48.5	# MIT OR Apache-2.0
MODCARGO_CRATES +=	windows_aarch64_msvc	0.52.4	# MIT OR Apache-2.0
MODCARGO_CRATES +=	windows_i686_gnu	0.42.2	# MIT OR Apache-2.0
MODCARGO_CRATES +=	windows_i686_gnu	0.48.5	# MIT OR Apache-2.0
MODCARGO_CRATES +=	windows_i686_gnu	0.52.4	# MIT OR Apache-2.0
MODCARGO_CRATES +=	windows_i686_msvc	0.42.2	# MIT OR Apache-2.0
MODCARGO_CRATES +=	windows_i686_msvc	0.48.5	# MIT OR Apache-2.0
MODCARGO_CRATES +=	windows_i686_msvc	0.52.4	# MIT OR Apache-2.0
MODCARGO_CRATES +=	windows_x86_64_gnu	0.42.2	# MIT OR Apache-2.0
MODCARGO_CRATES +=	windows_x86_64_gnu	0.48.5	# MIT OR Apache-2.0
MODCARGO_CRATES +=	windows_x86_64_gnu	0.52.4	# MIT OR Apache-2.0
MODCARGO_CRATES +=	windows_x86_64_gnullvm	0.42.2	# MIT OR Apache-2.0
MODCARGO_CRATES +=	windows_x86_64_gnullvm	0.48.5	# MIT OR Apache-2.0
MODCARGO_CRATES +=	windows_x86_64_gnullvm	0.52.4	# MIT OR Apache-2.0
MODCARGO_CRATES +=	windows_x86_64_msvc	0.42.2	# MIT OR Apache-2.0
MODCARGO_CRATES +=	windows_x86_64_msvc	0.48.5	# MIT OR Apache-2.0
MODCARGO_CRATES +=	windows_x86_64_msvc	0.52.4	# MIT OR Apache-2.0
MODCARGO_CRATES +=	xattr	1.3.1	# MIT/Apache-2.0
MODCARGO_CRATES +=	xdg	2.5.2	# Apache-2.0 OR MIT
MODCARGO_CRATES +=	yaml-rust	0.4.5	# MIT/Apache-2.0
