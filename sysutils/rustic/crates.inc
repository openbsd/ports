MODCARGO_CRATES +=	abscissa_core	0.7.0	# Apache-2.0
MODCARGO_CRATES +=	abscissa_derive	0.7.0	# Apache-2.0
MODCARGO_CRATES +=	addr2line	0.21.0	# Apache-2.0 OR MIT
MODCARGO_CRATES +=	adler	1.0.2	# 0BSD OR MIT OR Apache-2.0
MODCARGO_CRATES +=	aead	0.5.2	# MIT OR Apache-2.0
MODCARGO_CRATES +=	aes	0.8.4	# MIT OR Apache-2.0
MODCARGO_CRATES +=	aes256ctr_poly1305aes	0.2.0	# Apache-2.0 OR MIT
MODCARGO_CRATES +=	ahash	0.8.11	# MIT OR Apache-2.0
MODCARGO_CRATES +=	aho-corasick	1.1.3	# Unlicense OR MIT
MODCARGO_CRATES +=	allocator-api2	0.2.18	# MIT OR Apache-2.0
MODCARGO_CRATES +=	android-tzdata	0.1.1	# MIT OR Apache-2.0
MODCARGO_CRATES +=	android_system_properties	0.1.5	# MIT/Apache-2.0
MODCARGO_CRATES +=	anstream	0.6.15	# MIT OR Apache-2.0
MODCARGO_CRATES +=	anstyle	1.0.8	# MIT OR Apache-2.0
MODCARGO_CRATES +=	anstyle-parse	0.2.5	# MIT OR Apache-2.0
MODCARGO_CRATES +=	anstyle-query	1.1.1	# MIT OR Apache-2.0
MODCARGO_CRATES +=	anstyle-wincon	3.0.4	# MIT OR Apache-2.0
MODCARGO_CRATES +=	anyhow	1.0.86	# MIT OR Apache-2.0
MODCARGO_CRATES +=	arc-swap	1.7.1	# MIT OR Apache-2.0
MODCARGO_CRATES +=	array-init	2.1.0	# MIT OR Apache-2.0
MODCARGO_CRATES +=	assert_cmd	2.0.16	# MIT OR Apache-2.0
MODCARGO_CRATES +=	async-trait	0.1.81	# MIT OR Apache-2.0
MODCARGO_CRATES +=	autocfg	1.3.0	# Apache-2.0 OR MIT
MODCARGO_CRATES +=	awaitable	0.4.0	# MIT
MODCARGO_CRATES +=	awaitable-error	0.1.0	# MIT
MODCARGO_CRATES +=	backoff	0.4.0	# MIT/Apache-2.0
MODCARGO_CRATES +=	backon	0.4.4	# Apache-2.0
MODCARGO_CRATES +=	backtrace	0.3.71	# MIT OR Apache-2.0
MODCARGO_CRATES +=	base64	0.21.7	# MIT OR Apache-2.0
MODCARGO_CRATES +=	base64	0.22.1	# MIT OR Apache-2.0
MODCARGO_CRATES +=	base64ct	1.6.0	# Apache-2.0 OR MIT
MODCARGO_CRATES +=	bb8	0.8.5	# MIT
MODCARGO_CRATES +=	binrw	0.14.0	# MIT
MODCARGO_CRATES +=	binrw_derive	0.14.0	# MIT
MODCARGO_CRATES +=	bitflags	2.6.0	# MIT OR Apache-2.0
MODCARGO_CRATES +=	block-buffer	0.10.4	# MIT OR Apache-2.0
MODCARGO_CRATES +=	block-padding	0.3.3	# MIT OR Apache-2.0
MODCARGO_CRATES +=	bstr	1.10.0	# MIT OR Apache-2.0
MODCARGO_CRATES +=	bumpalo	3.16.0	# MIT OR Apache-2.0
MODCARGO_CRATES +=	bytemuck	1.17.0	# Zlib OR Apache-2.0 OR MIT
MODCARGO_CRATES +=	byteorder	1.5.0	# Unlicense OR MIT
MODCARGO_CRATES +=	bytes	1.7.1	# MIT
MODCARGO_CRATES +=	bytesize	1.3.0	# Apache-2.0
MODCARGO_CRATES +=	cached	0.53.1	# MIT
MODCARGO_CRATES +=	cached_proc_macro	0.23.0	# MIT
MODCARGO_CRATES +=	cached_proc_macro_types	0.1.1	# MIT
MODCARGO_CRATES +=	cachedir	0.3.1	# MIT
MODCARGO_CRATES +=	canonical-path	2.0.2	# Apache-2.0
MODCARGO_CRATES +=	cassowary	0.3.0	# MIT / Apache-2.0
MODCARGO_CRATES +=	castaway	0.2.3	# MIT
MODCARGO_CRATES +=	cbc	0.1.2	# MIT OR Apache-2.0
MODCARGO_CRATES +=	cc	1.1.13	# MIT OR Apache-2.0
MODCARGO_CRATES +=	cfg-if	0.1.10	# MIT/Apache-2.0
MODCARGO_CRATES +=	cfg-if	1.0.0	# MIT/Apache-2.0
MODCARGO_CRATES +=	cfg_aliases	0.2.1	# MIT
MODCARGO_CRATES +=	chrono	0.4.38	# MIT OR Apache-2.0
MODCARGO_CRATES +=	cipher	0.4.4	# MIT OR Apache-2.0
MODCARGO_CRATES +=	clap	4.5.16	# MIT OR Apache-2.0
MODCARGO_CRATES +=	clap_builder	4.5.15	# MIT OR Apache-2.0
MODCARGO_CRATES +=	clap_complete	4.5.18	# MIT OR Apache-2.0
MODCARGO_CRATES +=	clap_derive	4.5.13	# MIT OR Apache-2.0
MODCARGO_CRATES +=	clap_lex	0.7.2	# MIT OR Apache-2.0
MODCARGO_CRATES +=	color-eyre	0.6.3	# MIT OR Apache-2.0
MODCARGO_CRATES +=	colorchoice	1.0.2	# MIT OR Apache-2.0
MODCARGO_CRATES +=	comfy-table	7.1.1	# MIT
MODCARGO_CRATES +=	compact_str	0.8.0	# MIT
MODCARGO_CRATES +=	concurrent_arena	0.1.8	# MIT
MODCARGO_CRATES +=	console	0.15.8	# MIT
MODCARGO_CRATES +=	const-oid	0.9.6	# Apache-2.0 OR MIT
MODCARGO_CRATES +=	const-random	0.1.18	# MIT OR Apache-2.0
MODCARGO_CRATES +=	const-random-macro	0.1.16	# MIT OR Apache-2.0
MODCARGO_CRATES +=	convert_case	0.6.0	# MIT
MODCARGO_CRATES +=	core-foundation	0.9.4	# MIT OR Apache-2.0
MODCARGO_CRATES +=	core-foundation-sys	0.8.7	# MIT OR Apache-2.0
MODCARGO_CRATES +=	cpufeatures	0.2.13	# MIT OR Apache-2.0
MODCARGO_CRATES +=	crc32c	0.6.8	# Apache-2.0/MIT
MODCARGO_CRATES +=	crc32fast	1.4.2	# MIT OR Apache-2.0
MODCARGO_CRATES +=	crossbeam	0.8.4	# MIT OR Apache-2.0
MODCARGO_CRATES +=	crossbeam-channel	0.5.13	# MIT OR Apache-2.0
MODCARGO_CRATES +=	crossbeam-deque	0.8.5	# MIT OR Apache-2.0
MODCARGO_CRATES +=	crossbeam-epoch	0.9.18	# MIT OR Apache-2.0
MODCARGO_CRATES +=	crossbeam-queue	0.3.11	# MIT OR Apache-2.0
MODCARGO_CRATES +=	crossbeam-utils	0.8.20	# MIT OR Apache-2.0
MODCARGO_CRATES +=	crossterm	0.27.0	# MIT
MODCARGO_CRATES +=	crossterm	0.28.1	# MIT
MODCARGO_CRATES +=	crossterm_winapi	0.9.1	# MIT
MODCARGO_CRATES +=	crunchy	0.2.2	# MIT
MODCARGO_CRATES +=	crypto-common	0.1.6	# MIT OR Apache-2.0
MODCARGO_CRATES +=	ctr	0.9.2	# MIT OR Apache-2.0
MODCARGO_CRATES +=	curve25519-dalek	4.1.3	# BSD-3-Clause
MODCARGO_CRATES +=	curve25519-dalek-derive	0.1.1	# MIT/Apache-2.0
MODCARGO_CRATES +=	darling	0.20.10	# MIT
MODCARGO_CRATES +=	darling_core	0.20.10	# MIT
MODCARGO_CRATES +=	darling_macro	0.20.10	# MIT
MODCARGO_CRATES +=	dashmap	5.5.3	# MIT
MODCARGO_CRATES +=	data-encoding	2.6.0	# MIT
MODCARGO_CRATES +=	dav-server	0.7.0	# Apache-2.0
MODCARGO_CRATES +=	der	0.7.9	# Apache-2.0 OR MIT
MODCARGO_CRATES +=	deranged	0.3.11	# MIT OR Apache-2.0
MODCARGO_CRATES +=	derivative	2.2.0	# MIT/Apache-2.0
MODCARGO_CRATES +=	derive_destructure2	0.1.3	# MIT OR Apache-2.0
MODCARGO_CRATES +=	derive_more	1.0.0	# MIT
MODCARGO_CRATES +=	derive_more-impl	1.0.0	# MIT
MODCARGO_CRATES +=	derive_setters	0.1.6	# MIT/Apache-2.0
MODCARGO_CRATES +=	dialoguer	0.11.0	# MIT
MODCARGO_CRATES +=	diff	0.1.13	# MIT OR Apache-2.0
MODCARGO_CRATES +=	difflib	0.4.0	# MIT
MODCARGO_CRATES +=	digest	0.10.7	# MIT OR Apache-2.0
MODCARGO_CRATES +=	dircmp	0.2.0	# Apache-2.0
MODCARGO_CRATES +=	directories	5.0.1	# MIT OR Apache-2.0
MODCARGO_CRATES +=	dirs	5.0.1	# MIT OR Apache-2.0
MODCARGO_CRATES +=	dirs-sys	0.4.1	# MIT OR Apache-2.0
MODCARGO_CRATES +=	displaydoc	0.2.5	# MIT OR Apache-2.0
MODCARGO_CRATES +=	dlv-list	0.5.2	# MIT OR Apache-2.0
MODCARGO_CRATES +=	doc-comment	0.3.3	# MIT
MODCARGO_CRATES +=	dunce	1.0.5	# CC0-1.0 OR MIT-0 OR Apache-2.0
MODCARGO_CRATES +=	ed25519	2.2.3	# Apache-2.0 OR MIT
MODCARGO_CRATES +=	ed25519-dalek	2.1.1	# BSD-3-Clause
MODCARGO_CRATES +=	either	1.13.0	# MIT OR Apache-2.0
MODCARGO_CRATES +=	encode_unicode	0.3.6	# MIT/Apache-2.0
MODCARGO_CRATES +=	encoding_rs	0.8.34	# (Apache-2.0 OR MIT) AND BSD-3-Clause
MODCARGO_CRATES +=	enum-map	2.7.3	# MIT OR Apache-2.0
MODCARGO_CRATES +=	enum-map-derive	0.17.0	# MIT OR Apache-2.0
MODCARGO_CRATES +=	enumset	1.1.5	# MIT/Apache-2.0
MODCARGO_CRATES +=	enumset_derive	0.10.0	# MIT/Apache-2.0
MODCARGO_CRATES +=	env_logger	0.8.4	# MIT/Apache-2.0
MODCARGO_CRATES +=	equivalent	1.0.1	# Apache-2.0 OR MIT
MODCARGO_CRATES +=	errno	0.3.9	# MIT OR Apache-2.0
MODCARGO_CRATES +=	eyre	0.6.12	# MIT OR Apache-2.0
MODCARGO_CRATES +=	fastrand	1.9.0	# Apache-2.0 OR MIT
MODCARGO_CRATES +=	fastrand	2.1.0	# Apache-2.0 OR MIT
MODCARGO_CRATES +=	fiat-crypto	0.2.9	# MIT OR Apache-2.0 OR BSD-1-Clause
MODCARGO_CRATES +=	filetime	0.2.24	# MIT/Apache-2.0
MODCARGO_CRATES +=	flagset	0.4.6	# Apache-2.0
MODCARGO_CRATES +=	flate2	1.0.31	# MIT OR Apache-2.0
MODCARGO_CRATES +=	float-cmp	0.9.0	# MIT
MODCARGO_CRATES +=	fnv	1.0.7	# Apache-2.0 / MIT
MODCARGO_CRATES +=	form_urlencoded	1.2.1	# MIT OR Apache-2.0
MODCARGO_CRATES +=	fs-err	2.11.0	# MIT/Apache-2.0
MODCARGO_CRATES +=	fs_extra	1.3.0	# MIT
MODCARGO_CRATES +=	futures	0.3.30	# MIT OR Apache-2.0
MODCARGO_CRATES +=	futures-channel	0.3.30	# MIT OR Apache-2.0
MODCARGO_CRATES +=	futures-core	0.3.30	# MIT OR Apache-2.0
MODCARGO_CRATES +=	futures-executor	0.3.30	# MIT OR Apache-2.0
MODCARGO_CRATES +=	futures-io	0.3.30	# MIT OR Apache-2.0
MODCARGO_CRATES +=	futures-macro	0.3.30	# MIT OR Apache-2.0
MODCARGO_CRATES +=	futures-sink	0.3.30	# MIT OR Apache-2.0
MODCARGO_CRATES +=	futures-task	0.3.30	# MIT OR Apache-2.0
MODCARGO_CRATES +=	futures-timer	3.0.3	# MIT/Apache-2.0
MODCARGO_CRATES +=	futures-util	0.3.30	# MIT OR Apache-2.0
MODCARGO_CRATES +=	generic-array	0.14.7	# MIT
MODCARGO_CRATES +=	gethostname	0.5.0	# Apache-2.0
MODCARGO_CRATES +=	getrandom	0.2.15	# MIT OR Apache-2.0
MODCARGO_CRATES +=	gimli	0.28.1	# MIT OR Apache-2.0
MODCARGO_CRATES +=	glob	0.3.1	# MIT OR Apache-2.0
MODCARGO_CRATES +=	globset	0.4.14	# Unlicense OR MIT
MODCARGO_CRATES +=	governor	0.6.3	# MIT
MODCARGO_CRATES +=	h2	0.3.26	# MIT
MODCARGO_CRATES +=	hashbrown	0.12.3	# MIT OR Apache-2.0
MODCARGO_CRATES +=	hashbrown	0.14.5	# MIT OR Apache-2.0
MODCARGO_CRATES +=	headers	0.3.9	# MIT
MODCARGO_CRATES +=	headers	0.4.0	# MIT
MODCARGO_CRATES +=	headers-core	0.2.0	# MIT
MODCARGO_CRATES +=	headers-core	0.3.0	# MIT
MODCARGO_CRATES +=	heck	0.5.0	# MIT OR Apache-2.0
MODCARGO_CRATES +=	hermit-abi	0.3.9	# MIT OR Apache-2.0
MODCARGO_CRATES +=	hex	0.4.3	# MIT OR Apache-2.0
MODCARGO_CRATES +=	hmac	0.12.1	# MIT OR Apache-2.0
MODCARGO_CRATES +=	home	0.5.9	# MIT OR Apache-2.0
MODCARGO_CRATES +=	htmlescape	0.3.1	# Apache-2.0 / MIT / MPL-2.0
MODCARGO_CRATES +=	http	0.2.12	# MIT OR Apache-2.0
MODCARGO_CRATES +=	http	1.1.0	# MIT OR Apache-2.0
MODCARGO_CRATES +=	http-body	0.4.6	# MIT
MODCARGO_CRATES +=	http-body	1.0.1	# MIT
MODCARGO_CRATES +=	http-body-util	0.1.2	# MIT
MODCARGO_CRATES +=	httparse	1.9.4	# MIT OR Apache-2.0
MODCARGO_CRATES +=	httpdate	1.0.3	# MIT OR Apache-2.0
MODCARGO_CRATES +=	human-panic	2.0.1	# MIT OR Apache-2.0
MODCARGO_CRATES +=	humantime	2.1.0	# MIT/Apache-2.0
MODCARGO_CRATES +=	hyper	0.14.30	# MIT
MODCARGO_CRATES +=	hyper	1.4.1	# MIT
MODCARGO_CRATES +=	hyper-rustls	0.27.2	# Apache-2.0 OR ISC OR MIT
MODCARGO_CRATES +=	hyper-util	0.1.7	# MIT
MODCARGO_CRATES +=	iana-time-zone	0.1.60	# MIT OR Apache-2.0
MODCARGO_CRATES +=	iana-time-zone-haiku	0.1.2	# MIT OR Apache-2.0
MODCARGO_CRATES +=	ident_case	1.0.1	# MIT/Apache-2.0
MODCARGO_CRATES +=	idna	0.5.0	# MIT OR Apache-2.0
MODCARGO_CRATES +=	ignore	0.4.22	# Unlicense OR MIT
MODCARGO_CRATES +=	indenter	0.3.3	# MIT OR Apache-2.0
MODCARGO_CRATES +=	indexmap	1.9.3	# Apache-2.0 OR MIT
MODCARGO_CRATES +=	indexmap	2.4.0	# Apache-2.0 OR MIT
MODCARGO_CRATES +=	indicatif	0.17.8	# MIT
MODCARGO_CRATES +=	inout	0.1.3	# MIT OR Apache-2.0
MODCARGO_CRATES +=	instability	0.3.2	# MIT
MODCARGO_CRATES +=	instant	0.1.13	# BSD-3-Clause
MODCARGO_CRATES +=	integer-sqrt	0.1.5	# Apache-2.0/MIT
MODCARGO_CRATES +=	ipnet	2.9.0	# MIT OR Apache-2.0
MODCARGO_CRATES +=	is_terminal_polyfill	1.70.1	# MIT OR Apache-2.0
MODCARGO_CRATES +=	itertools	0.13.0	# MIT OR Apache-2.0
MODCARGO_CRATES +=	itoa	1.0.11	# MIT OR Apache-2.0
MODCARGO_CRATES +=	jemalloc-sys	0.3.2	# MIT/Apache-2.0
MODCARGO_CRATES +=	jemallocator	0.3.2	# MIT/Apache-2.0
MODCARGO_CRATES +=	jemallocator-global	0.3.2	# MIT/Apache-2.0
MODCARGO_CRATES +=	jobserver	0.1.32	# MIT OR Apache-2.0
MODCARGO_CRATES +=	js-sys	0.3.70	# MIT OR Apache-2.0
MODCARGO_CRATES +=	jsonwebtoken	9.3.0	# MIT
MODCARGO_CRATES +=	lazy_static	1.5.0	# MIT OR Apache-2.0
MODCARGO_CRATES +=	libc	0.2.157	# MIT OR Apache-2.0
MODCARGO_CRATES +=	libm	0.2.8	# MIT OR Apache-2.0
MODCARGO_CRATES +=	libmimalloc-sys	0.1.39	# MIT
MODCARGO_CRATES +=	libredox	0.1.3	# MIT
MODCARGO_CRATES +=	linux-raw-sys	0.4.14	# Apache-2.0 WITH LLVM-exception OR Apache-2.0 OR MIT
MODCARGO_CRATES +=	lock_api	0.4.12	# MIT OR Apache-2.0
MODCARGO_CRATES +=	log	0.4.22	# MIT OR Apache-2.0
MODCARGO_CRATES +=	lru	0.12.4	# MIT
MODCARGO_CRATES +=	matchers	0.1.0	# MIT
MODCARGO_CRATES +=	md-5	0.10.6	# MIT OR Apache-2.0
MODCARGO_CRATES +=	memchr	2.7.4	# Unlicense OR MIT
MODCARGO_CRATES +=	merge	0.1.0	# Apache-2.0 OR MIT
MODCARGO_CRATES +=	merge_derive	0.1.0	# Apache-2.0 OR MIT
MODCARGO_CRATES +=	mimalloc	0.1.43	# MIT
MODCARGO_CRATES +=	mime	0.3.17	# MIT OR Apache-2.0
MODCARGO_CRATES +=	mime_guess	2.0.5	# MIT
MODCARGO_CRATES +=	miniz_oxide	0.7.4	# MIT OR Zlib OR Apache-2.0
MODCARGO_CRATES +=	mio	1.0.2	# MIT
MODCARGO_CRATES +=	multer	2.1.0	# MIT
MODCARGO_CRATES +=	nix	0.29.0	# MIT
MODCARGO_CRATES +=	no-std-compat	0.4.1	# MIT
MODCARGO_CRATES +=	nonzero_ext	0.3.0	# Apache-2.0
MODCARGO_CRATES +=	normalize-line-endings	0.3.0	# Apache-2.0
MODCARGO_CRATES +=	nu-ansi-term	0.46.0	# MIT
MODCARGO_CRATES +=	num-bigint	0.4.6	# MIT OR Apache-2.0
MODCARGO_CRATES +=	num-bigint-dig	0.8.4	# MIT/Apache-2.0
MODCARGO_CRATES +=	num-conv	0.1.0	# MIT OR Apache-2.0
MODCARGO_CRATES +=	num-derive	0.3.3	# MIT OR Apache-2.0
MODCARGO_CRATES +=	num-integer	0.1.46	# MIT OR Apache-2.0
MODCARGO_CRATES +=	num-iter	0.1.45	# MIT OR Apache-2.0
MODCARGO_CRATES +=	num-traits	0.2.19	# MIT OR Apache-2.0
MODCARGO_CRATES +=	num_cpus	1.16.0	# MIT OR Apache-2.0
MODCARGO_CRATES +=	num_threads	0.1.7	# MIT OR Apache-2.0
MODCARGO_CRATES +=	number_prefix	0.4.0	# MIT
MODCARGO_CRATES +=	object	0.32.2	# Apache-2.0 OR MIT
MODCARGO_CRATES +=	once_cell	1.19.0	# MIT OR Apache-2.0
MODCARGO_CRATES +=	opaque-debug	0.3.1	# MIT OR Apache-2.0
MODCARGO_CRATES +=	opendal	0.49.0	# Apache-2.0
MODCARGO_CRATES +=	openssh	0.10.5	# MIT OR Apache-2.0
MODCARGO_CRATES +=	openssh-sftp-client	0.14.6	# MIT
MODCARGO_CRATES +=	openssh-sftp-client-lowlevel	0.6.0	# MIT
MODCARGO_CRATES +=	openssh-sftp-error	0.4.0	# MIT
MODCARGO_CRATES +=	openssh-sftp-protocol	0.24.0	# MIT
MODCARGO_CRATES +=	openssh-sftp-protocol-error	0.1.0	# MIT
MODCARGO_CRATES +=	openssl-probe	0.1.5	# MIT/Apache-2.0
MODCARGO_CRATES +=	option-ext	0.2.0	# MPL-2.0
MODCARGO_CRATES +=	ordered-multimap	0.7.3	# MIT
MODCARGO_CRATES +=	os_info	3.8.2	# MIT
MODCARGO_CRATES +=	overload	0.1.1	# MIT
MODCARGO_CRATES +=	owo-colors	3.5.0	# MIT
MODCARGO_CRATES +=	pariter	0.5.1	# MPL-2.0 OR MIT OR Apache-2.0
MODCARGO_CRATES +=	parking_lot	0.12.3	# MIT OR Apache-2.0
MODCARGO_CRATES +=	parking_lot_core	0.9.10	# MIT OR Apache-2.0
MODCARGO_CRATES +=	paste	1.0.15	# MIT OR Apache-2.0
MODCARGO_CRATES +=	path-dedot	3.1.1	# MIT
MODCARGO_CRATES +=	pbkdf2	0.12.2	# MIT OR Apache-2.0
MODCARGO_CRATES +=	pem	3.0.4	# MIT
MODCARGO_CRATES +=	pem-rfc7468	0.7.0	# Apache-2.0 OR MIT
MODCARGO_CRATES +=	percent-encoding	2.3.1	# MIT OR Apache-2.0
MODCARGO_CRATES +=	pin-project	1.1.5	# Apache-2.0 OR MIT
MODCARGO_CRATES +=	pin-project-internal	1.1.5	# Apache-2.0 OR MIT
MODCARGO_CRATES +=	pin-project-lite	0.2.14	# Apache-2.0 OR MIT
MODCARGO_CRATES +=	pin-utils	0.1.0	# MIT OR Apache-2.0
MODCARGO_CRATES +=	pkcs1	0.7.5	# Apache-2.0 OR MIT
MODCARGO_CRATES +=	pkcs5	0.7.1	# Apache-2.0 OR MIT
MODCARGO_CRATES +=	pkcs8	0.10.2	# Apache-2.0 OR MIT
MODCARGO_CRATES +=	pkg-config	0.3.30	# MIT OR Apache-2.0
MODCARGO_CRATES +=	poly1305	0.8.0	# Apache-2.0 OR MIT
MODCARGO_CRATES +=	portable-atomic	1.7.0	# Apache-2.0 OR MIT
MODCARGO_CRATES +=	powerfmt	0.2.0	# MIT OR Apache-2.0
MODCARGO_CRATES +=	ppv-lite86	0.2.20	# MIT/Apache-2.0
MODCARGO_CRATES +=	predicates	3.1.2	# MIT OR Apache-2.0
MODCARGO_CRATES +=	predicates-core	1.0.8	# MIT OR Apache-2.0
MODCARGO_CRATES +=	predicates-tree	1.0.11	# MIT OR Apache-2.0
MODCARGO_CRATES +=	pretty_assertions	1.4.0	# MIT OR Apache-2.0
MODCARGO_CRATES +=	proc-macro-crate	3.1.0	# MIT OR Apache-2.0
MODCARGO_CRATES +=	proc-macro-error	1.0.4	# MIT OR Apache-2.0
MODCARGO_CRATES +=	proc-macro-error-attr	1.0.4	# MIT OR Apache-2.0
MODCARGO_CRATES +=	proc-macro2	1.0.86	# MIT OR Apache-2.0
MODCARGO_CRATES +=	quanta	0.12.3	# MIT
MODCARGO_CRATES +=	quick-xml	0.23.1	# MIT
MODCARGO_CRATES +=	quick-xml	0.35.0	# MIT
MODCARGO_CRATES +=	quick-xml	0.36.1	# MIT
MODCARGO_CRATES +=	quick_cache	0.6.2	# MIT
MODCARGO_CRATES +=	quickcheck	1.0.3	# Unlicense/MIT
MODCARGO_CRATES +=	quickcheck_macros	1.0.0	# Unlicense/MIT
MODCARGO_CRATES +=	quinn	0.11.3	# MIT OR Apache-2.0
MODCARGO_CRATES +=	quinn-proto	0.11.6	# MIT OR Apache-2.0
MODCARGO_CRATES +=	quinn-udp	0.5.4	# MIT OR Apache-2.0
MODCARGO_CRATES +=	quote	1.0.36	# MIT OR Apache-2.0
MODCARGO_CRATES +=	rand	0.8.5	# MIT OR Apache-2.0
MODCARGO_CRATES +=	rand_chacha	0.3.1	# MIT OR Apache-2.0
MODCARGO_CRATES +=	rand_core	0.6.4	# MIT OR Apache-2.0
MODCARGO_CRATES +=	ratatui	0.28.0	# MIT
MODCARGO_CRATES +=	raw-cpuid	11.1.0	# MIT
MODCARGO_CRATES +=	rayon	1.10.0	# MIT OR Apache-2.0
MODCARGO_CRATES +=	rayon-core	1.12.1	# MIT OR Apache-2.0
MODCARGO_CRATES +=	redox_syscall	0.5.3	# MIT
MODCARGO_CRATES +=	redox_users	0.4.5	# MIT
MODCARGO_CRATES +=	regex	1.10.6	# MIT OR Apache-2.0
MODCARGO_CRATES +=	regex-automata	0.1.10	# Unlicense/MIT
MODCARGO_CRATES +=	regex-automata	0.4.7	# MIT OR Apache-2.0
MODCARGO_CRATES +=	regex-syntax	0.6.29	# MIT OR Apache-2.0
MODCARGO_CRATES +=	regex-syntax	0.8.4	# MIT OR Apache-2.0
MODCARGO_CRATES +=	relative-path	1.9.3	# MIT OR Apache-2.0
MODCARGO_CRATES +=	reqsign	0.16.0	# Apache-2.0
MODCARGO_CRATES +=	reqwest	0.12.5	# MIT OR Apache-2.0
MODCARGO_CRATES +=	rhai	1.19.0	# MIT OR Apache-2.0
MODCARGO_CRATES +=	rhai_codegen	2.2.0	# MIT OR Apache-2.0
MODCARGO_CRATES +=	ring	0.17.8	# LICENSE
MODCARGO_CRATES +=	rsa	0.9.6	# MIT OR Apache-2.0
MODCARGO_CRATES +=	rstest	0.22.0	# MIT OR Apache-2.0
MODCARGO_CRATES +=	rstest_macros	0.22.0	# MIT OR Apache-2.0
MODCARGO_CRATES +=	runtime-format	0.1.3	# MIT
MODCARGO_CRATES +=	rust-ini	0.21.1	# MIT
MODCARGO_CRATES +=	rustc-demangle	0.1.24	# MIT/Apache-2.0
MODCARGO_CRATES +=	rustc-hash	2.0.0	# Apache-2.0/MIT
MODCARGO_CRATES +=	rustc_version	0.4.0	# MIT/Apache-2.0
MODCARGO_CRATES +=	rustic_backend	0.2.0	# Apache-2.0 OR MIT
MODCARGO_CRATES +=	rustic_core	0.3.0	# Apache-2.0 OR MIT
MODCARGO_CRATES +=	rustic_testing	0.2.0	# Apache-2.0 OR MIT
MODCARGO_CRATES +=	rustix	0.38.34	# Apache-2.0 WITH LLVM-exception OR Apache-2.0 OR MIT
MODCARGO_CRATES +=	rustls	0.23.12	# Apache-2.0 OR ISC OR MIT
MODCARGO_CRATES +=	rustls-native-certs	0.7.1	# Apache-2.0 OR ISC OR MIT
MODCARGO_CRATES +=	rustls-pemfile	2.1.3	# Apache-2.0 OR ISC OR MIT
MODCARGO_CRATES +=	rustls-pki-types	1.8.0	# MIT OR Apache-2.0
MODCARGO_CRATES +=	rustls-webpki	0.102.6	# ISC
MODCARGO_CRATES +=	rustversion	1.0.17	# MIT OR Apache-2.0
MODCARGO_CRATES +=	ryu	1.0.18	# Apache-2.0 OR BSL-1.0
MODCARGO_CRATES +=	salsa20	0.10.2	# MIT OR Apache-2.0
MODCARGO_CRATES +=	same-file	1.0.6	# Unlicense/MIT
MODCARGO_CRATES +=	schannel	0.1.23	# MIT
MODCARGO_CRATES +=	scoped-tls	1.0.1	# MIT/Apache-2.0
MODCARGO_CRATES +=	scopeguard	1.2.0	# MIT OR Apache-2.0
MODCARGO_CRATES +=	scrypt	0.11.0	# MIT OR Apache-2.0
MODCARGO_CRATES +=	secrecy	0.8.0	# Apache-2.0 OR MIT
MODCARGO_CRATES +=	security-framework	2.11.1	# MIT OR Apache-2.0
MODCARGO_CRATES +=	security-framework-sys	2.11.1	# MIT OR Apache-2.0
MODCARGO_CRATES +=	self-replace	1.4.0	# Apache-2.0
MODCARGO_CRATES +=	self_update	0.41.0	# MIT
MODCARGO_CRATES +=	semver	1.0.23	# MIT OR Apache-2.0
MODCARGO_CRATES +=	serde	1.0.208	# MIT OR Apache-2.0
MODCARGO_CRATES +=	serde-aux	4.5.0	# MIT
MODCARGO_CRATES +=	serde_derive	1.0.208	# MIT OR Apache-2.0
MODCARGO_CRATES +=	serde_json	1.0.125	# MIT OR Apache-2.0
MODCARGO_CRATES +=	serde_spanned	0.6.7	# MIT OR Apache-2.0
MODCARGO_CRATES +=	serde_urlencoded	0.7.1	# MIT/Apache-2.0
MODCARGO_CRATES +=	serde_with	3.9.0	# MIT OR Apache-2.0
MODCARGO_CRATES +=	serde_with_macros	3.9.0	# MIT OR Apache-2.0
MODCARGO_CRATES +=	sha1	0.10.6	# MIT OR Apache-2.0
MODCARGO_CRATES +=	sha2	0.10.8	# MIT OR Apache-2.0
MODCARGO_CRATES +=	sha2-asm	0.6.4	# MIT
MODCARGO_CRATES +=	sharded-slab	0.1.7	# MIT
MODCARGO_CRATES +=	shell-escape	0.1.5	# MIT/Apache-2.0
MODCARGO_CRATES +=	shell-words	1.1.0	# MIT/Apache-2.0
MODCARGO_CRATES +=	shlex	1.3.0	# MIT OR Apache-2.0
MODCARGO_CRATES +=	signal-hook	0.3.17	# Apache-2.0/MIT
MODCARGO_CRATES +=	signal-hook-mio	0.2.4	# Apache-2.0/MIT
MODCARGO_CRATES +=	signal-hook-registry	1.4.2	# Apache-2.0/MIT
MODCARGO_CRATES +=	signature	2.2.0	# Apache-2.0 OR MIT
MODCARGO_CRATES +=	simple_asn1	0.6.2	# ISC
MODCARGO_CRATES +=	simplelog	0.12.2	# MIT OR Apache-2.0
MODCARGO_CRATES +=	slab	0.4.9	# MIT
MODCARGO_CRATES +=	smallvec	1.13.2	# MIT OR Apache-2.0
MODCARGO_CRATES +=	smartstring	1.0.1	# MPL-2.0+
MODCARGO_CRATES +=	socket2	0.5.7	# MIT OR Apache-2.0
MODCARGO_CRATES +=	spin	0.9.8	# MIT
MODCARGO_CRATES +=	spinning_top	0.3.0	# MIT/Apache-2.0
MODCARGO_CRATES +=	spki	0.7.3	# Apache-2.0 OR MIT
MODCARGO_CRATES +=	ssh_format	0.14.1	# MIT
MODCARGO_CRATES +=	ssh_format_error	0.1.0	# MIT
MODCARGO_CRATES +=	stable_deref_trait	1.2.0	# MIT/Apache-2.0
MODCARGO_CRATES +=	static_assertions	1.1.0	# MIT OR Apache-2.0
MODCARGO_CRATES +=	strsim	0.11.1	# MIT
MODCARGO_CRATES +=	strum	0.26.3	# MIT
MODCARGO_CRATES +=	strum_macros	0.26.4	# MIT
MODCARGO_CRATES +=	subtle	2.6.1	# BSD-3-Clause
MODCARGO_CRATES +=	syn	1.0.109	# MIT OR Apache-2.0
MODCARGO_CRATES +=	syn	2.0.75	# MIT OR Apache-2.0
MODCARGO_CRATES +=	sync_wrapper	1.0.1	# Apache-2.0
MODCARGO_CRATES +=	synstructure	0.12.6	# MIT
MODCARGO_CRATES +=	tar	0.4.41	# MIT OR Apache-2.0
MODCARGO_CRATES +=	tempfile	3.12.0	# MIT OR Apache-2.0
MODCARGO_CRATES +=	termcolor	1.4.1	# Unlicense OR MIT
MODCARGO_CRATES +=	terminal_size	0.3.0	# MIT OR Apache-2.0
MODCARGO_CRATES +=	termtree	0.4.1	# MIT
MODCARGO_CRATES +=	thin-vec	0.2.13	# MIT/Apache-2.0
MODCARGO_CRATES +=	thiserror	1.0.63	# MIT OR Apache-2.0
MODCARGO_CRATES +=	thiserror-impl	1.0.63	# MIT OR Apache-2.0
MODCARGO_CRATES +=	thread_local	1.1.8	# MIT OR Apache-2.0
MODCARGO_CRATES +=	time	0.3.36	# MIT OR Apache-2.0
MODCARGO_CRATES +=	time-core	0.1.2	# MIT OR Apache-2.0
MODCARGO_CRATES +=	time-macros	0.2.18	# MIT OR Apache-2.0
MODCARGO_CRATES +=	tiny-keccak	2.0.2	# CC0-1.0
MODCARGO_CRATES +=	tinyvec	1.8.0	# Zlib OR Apache-2.0 OR MIT
MODCARGO_CRATES +=	tinyvec_macros	0.1.1	# MIT OR Apache-2.0 OR Zlib
MODCARGO_CRATES +=	tokio	1.39.3	# MIT
MODCARGO_CRATES +=	tokio-io-utility	0.7.6	# MIT
MODCARGO_CRATES +=	tokio-macros	2.4.0	# MIT
MODCARGO_CRATES +=	tokio-pipe	0.2.12	# MIT/Apache-2.0
MODCARGO_CRATES +=	tokio-rustls	0.26.0	# MIT/Apache-2.0
MODCARGO_CRATES +=	tokio-tungstenite	0.21.0	# MIT
MODCARGO_CRATES +=	tokio-util	0.7.11	# MIT
MODCARGO_CRATES +=	toml	0.5.11	# MIT/Apache-2.0
MODCARGO_CRATES +=	toml	0.8.19	# MIT OR Apache-2.0
MODCARGO_CRATES +=	toml_datetime	0.6.8	# MIT OR Apache-2.0
MODCARGO_CRATES +=	toml_edit	0.21.1	# MIT OR Apache-2.0
MODCARGO_CRATES +=	toml_edit	0.22.20	# MIT OR Apache-2.0
MODCARGO_CRATES +=	tower	0.4.13	# MIT
MODCARGO_CRATES +=	tower-layer	0.3.3	# MIT
MODCARGO_CRATES +=	tower-service	0.3.3	# MIT
MODCARGO_CRATES +=	tracing	0.1.40	# MIT
MODCARGO_CRATES +=	tracing-attributes	0.1.27	# MIT
MODCARGO_CRATES +=	tracing-core	0.1.32	# MIT
MODCARGO_CRATES +=	tracing-log	0.1.4	# MIT
MODCARGO_CRATES +=	tracing-log	0.2.0	# MIT
MODCARGO_CRATES +=	tracing-subscriber	0.3.18	# MIT
MODCARGO_CRATES +=	trim-in-place	0.1.7	# MIT
MODCARGO_CRATES +=	triomphe	0.1.13	# MIT OR Apache-2.0
MODCARGO_CRATES +=	try-lock	0.2.5	# MIT
MODCARGO_CRATES +=	tui-textarea	0.6.1	# MIT
MODCARGO_CRATES +=	tungstenite	0.21.0	# MIT OR Apache-2.0
MODCARGO_CRATES +=	typenum	1.17.0	# MIT OR Apache-2.0
MODCARGO_CRATES +=	unicase	2.7.0	# MIT/Apache-2.0
MODCARGO_CRATES +=	unicode-bidi	0.3.15	# MIT OR Apache-2.0
MODCARGO_CRATES +=	unicode-ident	1.0.12	# (MIT OR Apache-2.0) AND Unicode-DFS-2016
MODCARGO_CRATES +=	unicode-normalization	0.1.23	# MIT/Apache-2.0
MODCARGO_CRATES +=	unicode-segmentation	1.11.0	# MIT/Apache-2.0
MODCARGO_CRATES +=	unicode-truncate	1.1.0	# MIT OR Apache-2.0
MODCARGO_CRATES +=	unicode-width	0.1.13	# MIT OR Apache-2.0
MODCARGO_CRATES +=	unicode-xid	0.2.4	# MIT OR Apache-2.0
MODCARGO_CRATES +=	universal-hash	0.5.1	# MIT OR Apache-2.0
MODCARGO_CRATES +=	untrusted	0.9.0	# ISC
MODCARGO_CRATES +=	url	2.5.2	# MIT OR Apache-2.0
MODCARGO_CRATES +=	urlencoding	2.1.3	# MIT
MODCARGO_CRATES +=	utf-8	0.7.6	# MIT OR Apache-2.0
MODCARGO_CRATES +=	utf8parse	0.2.2	# Apache-2.0 OR MIT
MODCARGO_CRATES +=	uuid	1.10.0	# Apache-2.0 OR MIT
MODCARGO_CRATES +=	valuable	0.1.0	# MIT
MODCARGO_CRATES +=	vec-strings	0.4.8	# MIT
MODCARGO_CRATES +=	version_check	0.9.5	# MIT/Apache-2.0
MODCARGO_CRATES +=	wait-timeout	0.2.0	# MIT/Apache-2.0
MODCARGO_CRATES +=	walkdir	2.5.0	# Unlicense/MIT
MODCARGO_CRATES +=	want	0.3.1	# MIT
MODCARGO_CRATES +=	warp	0.3.7	# MIT
MODCARGO_CRATES +=	wasi	0.11.0+wasi-snapshot-preview1	# Apache-2.0 WITH LLVM-exception OR Apache-2.0 OR MIT
MODCARGO_CRATES +=	wasm-bindgen	0.2.93	# MIT OR Apache-2.0
MODCARGO_CRATES +=	wasm-bindgen-backend	0.2.93	# MIT OR Apache-2.0
MODCARGO_CRATES +=	wasm-bindgen-futures	0.4.43	# MIT OR Apache-2.0
MODCARGO_CRATES +=	wasm-bindgen-macro	0.2.93	# MIT OR Apache-2.0
MODCARGO_CRATES +=	wasm-bindgen-macro-support	0.2.93	# MIT OR Apache-2.0
MODCARGO_CRATES +=	wasm-bindgen-shared	0.2.93	# MIT OR Apache-2.0
MODCARGO_CRATES +=	wasm-streams	0.4.0	# MIT OR Apache-2.0
MODCARGO_CRATES +=	web-sys	0.3.70	# MIT OR Apache-2.0
MODCARGO_CRATES +=	web-time	1.1.0	# MIT OR Apache-2.0
MODCARGO_CRATES +=	webpki-roots	0.26.3	# MPL-2.0
MODCARGO_CRATES +=	winapi	0.3.9	# MIT/Apache-2.0
MODCARGO_CRATES +=	winapi-i686-pc-windows-gnu	0.4.0	# MIT/Apache-2.0
MODCARGO_CRATES +=	winapi-util	0.1.9	# Unlicense OR MIT
MODCARGO_CRATES +=	winapi-x86_64-pc-windows-gnu	0.4.0	# MIT/Apache-2.0
MODCARGO_CRATES +=	windows-core	0.52.0	# MIT OR Apache-2.0
MODCARGO_CRATES +=	windows-sys	0.48.0	# MIT OR Apache-2.0
MODCARGO_CRATES +=	windows-sys	0.52.0	# MIT OR Apache-2.0
MODCARGO_CRATES +=	windows-sys	0.59.0	# MIT OR Apache-2.0
MODCARGO_CRATES +=	windows-targets	0.48.5	# MIT OR Apache-2.0
MODCARGO_CRATES +=	windows-targets	0.52.6	# MIT OR Apache-2.0
MODCARGO_CRATES +=	windows_aarch64_gnullvm	0.48.5	# MIT OR Apache-2.0
MODCARGO_CRATES +=	windows_aarch64_gnullvm	0.52.6	# MIT OR Apache-2.0
MODCARGO_CRATES +=	windows_aarch64_msvc	0.48.5	# MIT OR Apache-2.0
MODCARGO_CRATES +=	windows_aarch64_msvc	0.52.6	# MIT OR Apache-2.0
MODCARGO_CRATES +=	windows_i686_gnu	0.48.5	# MIT OR Apache-2.0
MODCARGO_CRATES +=	windows_i686_gnu	0.52.6	# MIT OR Apache-2.0
MODCARGO_CRATES +=	windows_i686_gnullvm	0.52.6	# MIT OR Apache-2.0
MODCARGO_CRATES +=	windows_i686_msvc	0.48.5	# MIT OR Apache-2.0
MODCARGO_CRATES +=	windows_i686_msvc	0.52.6	# MIT OR Apache-2.0
MODCARGO_CRATES +=	windows_x86_64_gnu	0.48.5	# MIT OR Apache-2.0
MODCARGO_CRATES +=	windows_x86_64_gnu	0.52.6	# MIT OR Apache-2.0
MODCARGO_CRATES +=	windows_x86_64_gnullvm	0.48.5	# MIT OR Apache-2.0
MODCARGO_CRATES +=	windows_x86_64_gnullvm	0.52.6	# MIT OR Apache-2.0
MODCARGO_CRATES +=	windows_x86_64_msvc	0.48.5	# MIT OR Apache-2.0
MODCARGO_CRATES +=	windows_x86_64_msvc	0.52.6	# MIT OR Apache-2.0
MODCARGO_CRATES +=	winnow	0.5.40	# MIT
MODCARGO_CRATES +=	winnow	0.6.18	# MIT
MODCARGO_CRATES +=	winreg	0.52.0	# MIT
MODCARGO_CRATES +=	xattr	1.3.1	# MIT/Apache-2.0
MODCARGO_CRATES +=	xml-rs	0.8.21	# MIT
MODCARGO_CRATES +=	xmltree	0.10.3	# MIT
MODCARGO_CRATES +=	yansi	0.5.1	# MIT/Apache-2.0
MODCARGO_CRATES +=	zerocopy	0.7.35	# BSD-2-Clause OR Apache-2.0 OR MIT
MODCARGO_CRATES +=	zerocopy-derive	0.7.35	# BSD-2-Clause OR Apache-2.0 OR MIT
MODCARGO_CRATES +=	zeroize	1.8.1	# Apache-2.0 OR MIT
MODCARGO_CRATES +=	zipsign-api	0.1.2	# Apache-2.0 WITH LLVM-exception
MODCARGO_CRATES +=	zstd	0.13.2	# MIT
MODCARGO_CRATES +=	zstd-safe	7.2.1	# MIT/Apache-2.0
MODCARGO_CRATES +=	zstd-sys	2.0.13+zstd.1.5.6	# MIT/Apache-2.0
