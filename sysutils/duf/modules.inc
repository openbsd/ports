MODGO_MODULES =	\
	github.com/!i!g!l!o!u-!e!u/go-wildcard	 v1.0.3 \
	github.com/aymanbagabas/go-osc52/v2	 v2.0.1 \
	github.com/davecgh/go-spew		 v1.1.1 \
	github.com/felixge/fgprof		 v0.9.5 \
	github.com/google/pprof			 v0.0.0-20240227163752-401108e1b7e7 \
	github.com/jedib0t/go-pretty/v6		 v6.6.8 \
	github.com/lucasb-eyer/go-colorful	 v1.2.0 \
	github.com/mattn/go-isatty		 v0.0.20 \
	github.com/mattn/go-runewidth		 v0.0.16 \
	github.com/muesli/mango			 v0.2.0 \
	github.com/muesli/roff			 v0.1.0 \
	github.com/muesli/termenv		 v0.16.0 \
	github.com/pkg/profile			 v1.7.0 \
	github.com/pmezard/go-difflib		 v1.0.0 \
	github.com/rivo/uniseg			 v0.4.7 \
	github.com/stretchr/testify		 v1.10.0 \
	golang.org/x/mod			 v0.17.0 \
	golang.org/x/sync			 v0.11.0 \
	golang.org/x/sys			 v0.35.0 \
	golang.org/x/term			 v0.34.0 \
	golang.org/x/text			 v0.22.0 \
	golang.org/x/tools			 v0.21.1-0.20240508182429-e35e4ccd0d2d \
	gopkg.in/yaml.v3			 v3.0.1

MODGO_MODFILES =	\
	github.com/rivo/uniseg	 v0.2.0 \
	golang.org/x/sys	 v0.30.0 \
	golang.org/x/sys	 v0.6.0 \
	golang.org/x/term	 v0.29.0

