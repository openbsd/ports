MODGO_MODULES =	\
	github.com/arl/gitstatus	 v0.6.0 \
	github.com/davecgh/go-spew	 v1.1.0 \
	github.com/kr/pretty		 v0.1.0 \
	github.com/kr/pty		 v1.1.1 \
	github.com/kr/text		 v0.1.0 \
	github.com/pkg/diff		 v0.0.0-20210226163009-20ebb0f2a09e \
	github.com/pmezard/go-difflib	 v1.0.0 \
	github.com/rogpeppe/go-internal	 v1.9.0 \
	github.com/stretchr/objx	 v0.1.0 \
	github.com/stretchr/testify	 v1.7.0 \
	golang.org/x/exp		 v0.0.0-20230210204819-062eb4c674ab \
	gopkg.in/check.v1		 v1.0.0-20180628173108-788fd7840127 \
	gopkg.in/yaml.v3		 v3.0.0

MODGO_MODFILES =	\
	github.com/stretchr/testify	 v1.3.0 \
	gopkg.in/check.v1		 v0.0.0-20161208181325-20d25e280405 \
	gopkg.in/yaml.v3		 v3.0.0-20200313102051-9f266ea9e77c

