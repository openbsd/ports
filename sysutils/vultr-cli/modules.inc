MODGO_MODULES =	\
	cloud.google.com/go/compute/metadata	 v0.3.0 \
	github.com/cpuguy83/go-md2man/v2	 v2.0.6 \
	github.com/davecgh/go-spew		 v1.1.1 \
	github.com/fatih/color			 v1.16.0 \
	github.com/frankban/quicktest		 v1.14.6 \
	github.com/fsnotify/fsnotify		 v1.9.0 \
	github.com/go-viper/mapstructure/v2	 v2.4.0 \
	github.com/google/go-cmp		 v0.6.0 \
	github.com/google/go-querystring	 v1.2.0 \
	github.com/hashicorp/go-cleanhttp	 v0.5.2 \
	github.com/hashicorp/go-hclog		 v1.6.3 \
	github.com/hashicorp/go-retryablehttp	 v0.7.8 \
	github.com/inconshreveable/mousetrap	 v1.1.0 \
	github.com/kr/pretty			 v0.3.1 \
	github.com/kr/pty			 v1.1.1 \
	github.com/kr/text			 v0.2.0 \
	github.com/mattn/go-colorable		 v0.1.13 \
	github.com/mattn/go-isatty		 v0.0.20 \
	github.com/pelletier/go-toml/v2		 v2.2.4 \
	github.com/pmezard/go-difflib		 v1.0.0 \
	github.com/rogpeppe/go-internal		 v1.9.0 \
	github.com/russross/blackfriday/v2	 v2.1.0 \
	github.com/sagikazarmark/locafero	 v0.11.0 \
	github.com/sourcegraph/conc		 v0.3.1-0.20240121214520-5f936abd7ae8 \
	github.com/spf13/afero			 v1.15.0 \
	github.com/spf13/cast			 v1.10.0 \
	github.com/spf13/cobra			 v1.10.2 \
	github.com/spf13/pflag			 v1.0.10 \
	github.com/spf13/viper			 v1.21.0 \
	github.com/stretchr/testify		 v1.11.1 \
	github.com/subosito/gotenv		 v1.6.0 \
	github.com/vultr/govultr/v3		 v3.28.1 \
	go.yaml.in/yaml/v3			 v3.0.4 \
	golang.org/x/mod			 v0.26.0 \
	golang.org/x/oauth2			 v0.36.0 \
	golang.org/x/sync			 v0.16.0 \
	golang.org/x/sys			 v0.29.0 \
	golang.org/x/text			 v0.28.0 \
	golang.org/x/tools			 v0.35.0 \
	gopkg.in/check.v1			 v1.0.0-20201130134442-10cb98267c6c \
	gopkg.in/yaml.v3			 v3.0.1

MODGO_MODFILES =	\
	github.com/google/go-cmp	 v0.5.9 \
	github.com/kr/pretty		 v0.2.1 \
	github.com/kr/pretty		 v0.3.0 \
	github.com/kr/text		 v0.1.0 \
	github.com/spf13/pflag		 v1.0.9 \
	github.com/stretchr/testify	 v1.10.0 \
	github.com/stretchr/testify	 v1.7.5 \
	github.com/stretchr/testify	 v1.8.1 \
	golang.org/x/sys		 v0.13.0 \
	golang.org/x/sys		 v0.20.0 \
	golang.org/x/text		 v0.12.0 \
	gopkg.in/check.v1		 v0.0.0-20161208181325-20d25e280405 \
	gopkg.in/check.v1		 v1.0.0-20190902080502-41f04d3bba15

