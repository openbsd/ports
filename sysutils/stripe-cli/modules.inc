MODGO_MODULES =	\
	cel.dev/expr									 v0.19.1 \
	cloud.google.com/go/compute/metadata						 v0.6.0 \
	dario.cat/mergo									 v1.0.1 \
	github.com/!burnt!sushi/toml							 v1.5.0 \
	github.com/!google!cloud!platform/opentelemetry-operations-go/detectors/gcp	 v1.25.0 \
	github.com/!microsoft/go-winio							 v0.6.2 \
	github.com/!proton!mail/go-crypto						 v1.1.6 \
	github.com/99designs/go-keychain						 v0.0.0-20191008050251-8e49817e8af4 \
	github.com/99designs/keyring							 v1.2.2 \
	github.com/acarl005/stripansi							 v0.0.0-20180116102854-5a71ef0e047d \
	github.com/anmitsu/go-shlex							 v0.0.0-20200514113438-38f4b401e2be \
	github.com/armon/go-socks5							 v0.0.0-20160902184237-e75332964ef5 \
	github.com/briandowns/spinner							 v1.23.2 \
	github.com/bufbuild/protocompile						 v0.4.0 \
	github.com/bwesterb/go-ristretto						 v1.2.3 \
	github.com/cespare/xxhash/v2							 v2.3.0 \
	github.com/chzyer/logex								 v1.2.1 \
	github.com/chzyer/readline							 v1.5.1 \
	github.com/chzyer/test								 v1.0.0 \
	github.com/cloudflare/circl							 v1.6.1 \
	github.com/cncf/xds/go								 v0.0.0-20241223141626-cff3c89139a3 \
	github.com/cpuguy83/go-md2man/v2						 v2.0.6 \
	github.com/cyphar/filepath-securejoin						 v0.4.1 \
	github.com/danieljoos/wincred							 v1.2.2 \
	github.com/davecgh/go-spew							 v1.1.1 \
	github.com/dvsekhvalnov/jose2go							 v1.8.0 \
	github.com/elazarl/goproxy							 v1.7.2 \
	github.com/emirpasic/gods							 v1.18.1 \
	github.com/envoyproxy/go-control-plane						 v0.13.4 \
	github.com/envoyproxy/go-control-plane/envoy					 v1.32.4 \
	github.com/envoyproxy/go-control-plane/ratelimit				 v0.1.0 \
	github.com/envoyproxy/protoc-gen-validate					 v1.2.1 \
	github.com/fatih/color								 v1.18.0 \
	github.com/felixge/httpsnoop							 v1.0.4 \
	github.com/frankban/quicktest							 v1.14.6 \
	github.com/fsnotify/fsnotify							 v1.8.0 \
	github.com/gliderlabs/ssh							 v0.3.8 \
	github.com/go-git/gcfg								 v1.5.1-0.20230307220236-3a3c6141e376 \
	github.com/go-git/go-billy/v5							 v5.6.2 \
	github.com/go-git/go-git-fixtures/v4						 v4.3.2-0.20231010084843-55a94097c399 \
	github.com/go-git/go-git/v5							 v5.14.0 \
	github.com/go-logr/logr								 v1.4.2 \
	github.com/go-logr/stdr								 v1.2.2 \
	github.com/go-task/slim-sprig							 v0.0.0-20210107165309-348f09dbbbc0 \
	github.com/go-viper/mapstructure/v2						 v2.2.1 \
	github.com/godbus/dbus								 v0.0.0-20190726142602-4481cbc300e2 \
	github.com/golang/glog								 v1.2.4 \
	github.com/golang/groupcache							 v0.0.0-20241129210726-2c02b8208cf8 \
	github.com/golang/protobuf							 v1.5.4 \
	github.com/google/go-cmp							 v0.7.0 \
	github.com/google/go-github/v28							 v28.1.1 \
	github.com/google/go-querystring						 v1.1.0 \
	github.com/google/uuid								 v1.6.0 \
	github.com/gorilla/handlers							 v1.5.2 \
	github.com/gorilla/websocket							 v1.5.3 \
	github.com/gsterjov/go-libsecret						 v0.0.0-20161001094733-a6f4afe4910c \
	github.com/hashicorp/go-hclog							 v1.6.3 \
	github.com/hashicorp/go-plugin							 v1.6.3 \
	github.com/hashicorp/yamux							 v0.1.2 \
	github.com/hpcloud/tail								 v1.0.0 \
	github.com/iancoleman/strcase							 v0.3.0 \
	github.com/imdario/mergo							 v0.3.16 \
	github.com/inconshreveable/mousetrap						 v1.1.0 \
	github.com/jbenet/go-context							 v0.0.0-20150711004518-d14ea06fba99 \
	github.com/jhump/protoreflect							 v1.15.1 \
	github.com/joho/godotenv							 v1.5.1 \
	github.com/kballard/go-shellquote						 v0.0.0-20180428030007-95032a82bc51 \
	github.com/kevinburke/ssh_config						 v1.2.0 \
	github.com/kr/pretty								 v0.3.1 \
	github.com/kr/pty								 v1.1.1 \
	github.com/kr/text								 v0.2.0 \
	github.com/logrusorgru/aurora							 v2.0.3+incompatible \
	github.com/manifoldco/promptui							 v0.9.0 \
	github.com/mattn/go-colorable							 v0.1.14 \
	github.com/mattn/go-isatty							 v0.0.20 \
	github.com/mgutz/ansi								 v0.0.0-20200706080929-d51e80ef957d \
	github.com/mitchellh/go-homedir							 v1.1.0 \
	github.com/mtibben/percent							 v0.2.1 \
	github.com/niemeyer/pretty							 v0.0.0-20200227124842-a10e7caefd8e \
	github.com/nxadm/tail								 v1.4.8 \
	github.com/oklog/run								 v1.1.0 \
	github.com/onsi/ginkgo								 v1.16.5 \
	github.com/onsi/gomega								 v1.34.1 \
	github.com/otiai10/copy								 v1.14.1 \
	github.com/otiai10/mint								 v1.6.3 \
	github.com/pelletier/go-toml/v2							 v2.2.3 \
	github.com/pjbgf/sha1cd								 v0.3.2 \
	github.com/pkg/errors								 v0.9.1 \
	github.com/planetscale/vtprotobuf						 v0.6.1-0.20240319094008-0393e58bdf10 \
	github.com/pmezard/go-difflib							 v1.0.0 \
	github.com/rogpeppe/go-internal							 v1.14.1 \
	github.com/russross/blackfriday/v2						 v2.1.0 \
	github.com/sagikazarmark/locafero						 v0.9.0 \
	github.com/sergi/go-diff							 v1.3.2-0.20230802210424-5b0b94c5c0d3 \
	github.com/sirupsen/logrus							 v1.9.3 \
	github.com/skeema/knownhosts							 v1.3.1 \
	github.com/sourcegraph/conc							 v0.3.0 \
	github.com/spf13/afero								 v1.14.0 \
	github.com/spf13/cast								 v1.7.1 \
	github.com/spf13/cobra								 v1.9.1 \
	github.com/spf13/pflag								 v1.0.6 \
	github.com/spf13/viper								 v1.20.1 \
	github.com/stretchr/objx							 v0.5.2 \
	github.com/stretchr/testify							 v1.10.0 \
	github.com/subosito/gotenv							 v1.6.0 \
	github.com/tidwall/gjson							 v1.18.0 \
	github.com/tidwall/match							 v1.1.1 \
	github.com/tidwall/pretty							 v1.2.1 \
	github.com/x-cray/logrus-prefixed-formatter					 v0.5.2 \
	github.com/xanzy/ssh-agent							 v0.3.3 \
	github.com/yuin/goldmark							 v1.2.1 \
	go.opentelemetry.io/auto/sdk							 v1.1.0 \
	go.opentelemetry.io/contrib/detectors/gcp					 v1.34.0 \
	go.opentelemetry.io/otel							 v1.34.0 \
	go.opentelemetry.io/otel/metric							 v1.34.0 \
	go.opentelemetry.io/otel/sdk							 v1.34.0 \
	go.opentelemetry.io/otel/sdk/metric						 v1.34.0 \
	go.opentelemetry.io/otel/trace							 v1.34.0 \
	go.uber.org/atomic								 v1.9.0 \
	go.uber.org/multierr								 v1.11.0 \
	golang.org/x/crypto								 v0.36.0 \
	golang.org/x/exp								 v0.0.0-20240719175910-8a7402abbf56 \
	golang.org/x/mod								 v0.17.0 \
	golang.org/x/net								 v0.38.0 \
	golang.org/x/oauth2								 v0.25.0 \
	golang.org/x/sync								 v0.12.0 \
	golang.org/x/sys								 v0.31.0 \
	golang.org/x/term								 v0.30.0 \
	golang.org/x/text								 v0.23.0 \
	golang.org/x/tools								 v0.21.1-0.20240508182429-e35e4ccd0d2d \
	golang.org/x/xerrors								 v0.0.0-20200804184101-5ec99f83aff1 \
	google.golang.org/appengine							 v1.1.0 \
	google.golang.org/genproto/googleapis/api					 v0.0.0-20250106144421-5f5ef82da422 \
	google.golang.org/genproto/googleapis/rpc					 v0.0.0-20250324211829-b45e905df463 \
	google.golang.org/grpc								 v1.71.1 \
	google.golang.org/protobuf							 v1.36.6 \
	gopkg.in/check.v1								 v1.0.0-20201130134442-10cb98267c6c \
	gopkg.in/fsnotify.v1								 v1.4.7 \
	gopkg.in/tomb.v1								 v1.0.0-20141024135613-dd632973f1e7 \
	gopkg.in/warnings.v0								 v0.1.2 \
	gopkg.in/yaml.v2								 v2.4.0 \
	gopkg.in/yaml.v3								 v3.0.1

MODGO_MODFILES =	\
	dario.cat/mergo					 v1.0.0 \
	github.com/!microsoft/go-winio			 v0.5.2 \
	github.com/!proton!mail/go-crypto		 v1.1.5 \
	github.com/chzyer/logex				 v1.1.10 \
	github.com/chzyer/readline			 v0.0.0-20180603132655-2972be24d48e \
	github.com/chzyer/test				 v0.0.0-20180213035817-a1ea475d72b1 \
	github.com/cloudflare/circl			 v1.3.7 \
	github.com/cloudflare/circl			 v1.6.0 \
	github.com/cyphar/filepath-securejoin		 v0.3.6 \
	github.com/danieljoos/wincred			 v1.1.2 \
	github.com/davecgh/go-spew			 v1.1.0 \
	github.com/dvsekhvalnov/jose2go			 v1.5.0 \
	github.com/fatih/color				 v1.13.0 \
	github.com/fatih/color				 v1.7.0 \
	github.com/felixge/httpsnoop			 v1.0.3 \
	github.com/fsnotify/fsnotify			 v1.4.7 \
	github.com/fsnotify/fsnotify			 v1.4.9 \
	github.com/golang/protobuf			 v1.2.0 \
	github.com/golang/protobuf			 v1.4.0 \
	github.com/golang/protobuf			 v1.4.0-rc.1 \
	github.com/golang/protobuf			 v1.4.0-rc.1.0.20200221234624-67d41d38c208 \
	github.com/golang/protobuf			 v1.4.0-rc.2 \
	github.com/golang/protobuf			 v1.4.0-rc.4.0.20200313231945-b860323f09d0 \
	github.com/golang/protobuf			 v1.4.2 \
	github.com/golang/protobuf			 v1.5.0 \
	github.com/golang/protobuf			 v1.5.3 \
	github.com/google/go-cmp			 v0.3.0 \
	github.com/google/go-cmp			 v0.3.1 \
	github.com/google/go-cmp			 v0.4.0 \
	github.com/google/go-cmp			 v0.5.2 \
	github.com/google/go-cmp			 v0.5.5 \
	github.com/google/go-cmp			 v0.5.9 \
	github.com/google/go-cmp			 v0.6.0 \
	github.com/google/go-querystring		 v1.0.0 \
	github.com/hashicorp/go-hclog			 v0.14.1 \
	github.com/hashicorp/yamux			 v0.1.1 \
	github.com/kr/pretty				 v0.1.0 \
	github.com/kr/pretty				 v0.3.0 \
	github.com/kr/text				 v0.1.0 \
	github.com/mattn/go-colorable			 v0.1.12 \
	github.com/mattn/go-colorable			 v0.1.13 \
	github.com/mattn/go-colorable			 v0.1.2 \
	github.com/mattn/go-colorable			 v0.1.4 \
	github.com/mattn/go-colorable			 v0.1.9 \
	github.com/mattn/go-isatty			 v0.0.12 \
	github.com/mattn/go-isatty			 v0.0.14 \
	github.com/mattn/go-isatty			 v0.0.17 \
	github.com/mattn/go-isatty			 v0.0.8 \
	github.com/nxadm/tail				 v1.4.4 \
	github.com/oklog/run				 v1.0.0 \
	github.com/onsi/ginkgo				 v1.12.1 \
	github.com/onsi/ginkgo				 v1.6.0 \
	github.com/onsi/gomega				 v1.10.1 \
	github.com/onsi/gomega				 v1.7.1 \
	github.com/rogpeppe/go-internal			 v1.12.0 \
	github.com/rogpeppe/go-internal			 v1.9.0 \
	github.com/sagikazarmark/locafero		 v0.7.0 \
	github.com/sirupsen/logrus			 v1.7.0 \
	github.com/spf13/afero				 v1.12.0 \
	github.com/stretchr/objx			 v0.1.0 \
	github.com/stretchr/objx			 v0.3.0 \
	github.com/stretchr/testify			 v1.2.2 \
	github.com/stretchr/testify			 v1.4.0 \
	github.com/stretchr/testify			 v1.5.1 \
	github.com/stretchr/testify			 v1.7.0 \
	github.com/stretchr/testify			 v1.7.1 \
	github.com/stretchr/testify			 v1.7.2 \
	github.com/stretchr/testify			 v1.7.5 \
	github.com/stretchr/testify			 v1.8.1 \
	github.com/stretchr/testify			 v1.8.3 \
	github.com/stretchr/testify			 v1.9.0 \
	github.com/tidwall/pretty			 v1.2.0 \
	go.uber.org/atomic				 v1.7.0 \
	go.uber.org/multierr				 v1.9.0 \
	golang.org/x/crypto				 v0.0.0-20190308221718-c2843e01d9a2 \
	golang.org/x/crypto				 v0.0.0-20191011191535-87dc89f01550 \
	golang.org/x/crypto				 v0.0.0-20200622213623-75b288015ac9 \
	golang.org/x/crypto				 v0.0.0-20220622213112-05595931fe9d \
	golang.org/x/crypto				 v0.11.1-0.20230711161743-2e82bdd1719d \
	golang.org/x/crypto				 v0.17.0 \
	golang.org/x/crypto				 v0.32.0 \
	golang.org/x/crypto				 v0.35.0 \
	golang.org/x/mod				 v0.12.0 \
	golang.org/x/mod				 v0.3.0 \
	golang.org/x/net				 v0.0.0-20180906233101-161cd47e91fd \
	golang.org/x/net				 v0.0.0-20190311183353-d8887717615a \
	golang.org/x/net				 v0.0.0-20190404232315-eb5bcb51f2a3 \
	golang.org/x/net				 v0.0.0-20190620200207-3b0461eec859 \
	golang.org/x/net				 v0.0.0-20200520004742-59133d7f0dd7 \
	golang.org/x/net				 v0.0.0-20201021035429-f5854403a974 \
	golang.org/x/net				 v0.0.0-20211112202133-69e39bad7dc2 \
	golang.org/x/net				 v0.21.0 \
	golang.org/x/net				 v0.34.0 \
	golang.org/x/net				 v0.35.0 \
	golang.org/x/oauth2				 v0.0.0-20180821212333-d2e6202438be \
	golang.org/x/sync				 v0.0.0-20180314180146-1d60e4601c6f \
	golang.org/x/sync				 v0.0.0-20190227155943-e225da77a7e6 \
	golang.org/x/sync				 v0.0.0-20190423024810-112230192c58 \
	golang.org/x/sync				 v0.0.0-20201020160332-67f06af15bc9 \
	golang.org/x/sync				 v0.10.0 \
	golang.org/x/sync				 v0.8.0 \
	golang.org/x/sys				 v0.0.0-20180909124046-d0be0721c37e \
	golang.org/x/sys				 v0.0.0-20181122145206-62eef0e2fa9b \
	golang.org/x/sys				 v0.0.0-20190215142949-d0b11bdaac8a \
	golang.org/x/sys				 v0.0.0-20190412213103-97732733099d \
	golang.org/x/sys				 v0.0.0-20190904154756-749cb33beabd \
	golang.org/x/sys				 v0.0.0-20191005200804-aed5e4c7ecf9 \
	golang.org/x/sys				 v0.0.0-20191026070338-33540a1f6037 \
	golang.org/x/sys				 v0.0.0-20191120155948-bd437916bb0e \
	golang.org/x/sys				 v0.0.0-20200116001909-b77594299b42 \
	golang.org/x/sys				 v0.0.0-20200223170610-d5e6a3e2c0ae \
	golang.org/x/sys				 v0.0.0-20200323222414-85ca7c5b95cd \
	golang.org/x/sys				 v0.0.0-20200930185726-fdedc70b468f \
	golang.org/x/sys				 v0.0.0-20201119102817-f84b799fce68 \
	golang.org/x/sys				 v0.0.0-20210112080510-489259a85091 \
	golang.org/x/sys				 v0.0.0-20210124154548-22da62e12c0c \
	golang.org/x/sys				 v0.0.0-20210423082822-04245dca01da \
	golang.org/x/sys				 v0.0.0-20210615035016-665e8c7367d1 \
	golang.org/x/sys				 v0.0.0-20210630005230-0f9fa26af87c \
	golang.org/x/sys				 v0.0.0-20210927094055-39ccf1dd6fa6 \
	golang.org/x/sys				 v0.0.0-20220310020820-b874c991c1a5 \
	golang.org/x/sys				 v0.0.0-20220412211240-33da011f77ad \
	golang.org/x/sys				 v0.0.0-20220503163025-988cb79eb6c6 \
	golang.org/x/sys				 v0.0.0-20220715151400-c0bba94af5f8 \
	golang.org/x/sys				 v0.10.0 \
	golang.org/x/sys				 v0.13.0 \
	golang.org/x/sys				 v0.16.0 \
	golang.org/x/sys				 v0.18.0 \
	golang.org/x/sys				 v0.20.0 \
	golang.org/x/sys				 v0.24.0 \
	golang.org/x/sys				 v0.25.0 \
	golang.org/x/sys				 v0.29.0 \
	golang.org/x/sys				 v0.3.0 \
	golang.org/x/sys				 v0.30.0 \
	golang.org/x/sys				 v0.6.0 \
	golang.org/x/term				 v0.0.0-20201126162022-7de9c90e9dd1 \
	golang.org/x/term				 v0.1.0 \
	golang.org/x/term				 v0.3.0 \
	golang.org/x/text				 v0.12.0 \
	golang.org/x/text				 v0.21.0 \
	golang.org/x/text				 v0.22.0 \
	golang.org/x/text				 v0.3.0 \
	golang.org/x/text				 v0.3.3 \
	golang.org/x/text				 v0.3.6 \
	golang.org/x/tools				 v0.0.0-20180917221912-90fa682c2a6e \
	golang.org/x/tools				 v0.0.0-20191119224855-298f0cb1881e \
	golang.org/x/tools				 v0.0.0-20201224043029-2b0845dc783e \
	golang.org/x/tools				 v0.11.0 \
	golang.org/x/xerrors				 v0.0.0-20190717185122-a985d3407aa7 \
	golang.org/x/xerrors				 v0.0.0-20191011141410-1b5146add898 \
	golang.org/x/xerrors				 v0.0.0-20191204190536-9bdfabe68543 \
	google.golang.org/genproto/googleapis/rpc	 v0.0.0-20230711160842-782d3b101e98 \
	google.golang.org/genproto/googleapis/rpc	 v0.0.0-20250115164207-1a7da9e5054f \
	google.golang.org/grpc				 v1.58.3 \
	google.golang.org/protobuf			 v0.0.0-20200109180630-ec00e32a8dfd \
	google.golang.org/protobuf			 v0.0.0-20200221191635-4d8936d0db64 \
	google.golang.org/protobuf			 v0.0.0-20200228230310-ab0ca4ff8a60 \
	google.golang.org/protobuf			 v1.20.1-0.20200309200217-e05f789c0967 \
	google.golang.org/protobuf			 v1.21.0 \
	google.golang.org/protobuf			 v1.23.0 \
	google.golang.org/protobuf			 v1.33.0 \
	google.golang.org/protobuf			 v1.36.1 \
	google.golang.org/protobuf			 v1.36.4 \
	gopkg.in/check.v1				 v0.0.0-20161208181325-20d25e280405 \
	gopkg.in/check.v1				 v1.0.0-20190902080502-41f04d3bba15 \
	gopkg.in/check.v1				 v1.0.0-20200902074654-038fdea0a05b \
	gopkg.in/yaml.v2				 v2.2.2 \
	gopkg.in/yaml.v2				 v2.2.4 \
	gopkg.in/yaml.v2				 v2.3.0 \
	gopkg.in/yaml.v3				 v3.0.0-20200313102051-9f266ea9e77c \
	gopkg.in/yaml.v3				 v3.0.0-20210107192922-496545a6307b

