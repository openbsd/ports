MODCARGO_CRATES +=	ab_glyph	0.2.29	# Apache-2.0
MODCARGO_CRATES +=	ab_glyph_rasterizer	0.1.8	# Apache-2.0
MODCARGO_CRATES +=	adler	1.0.2	# 0BSD OR MIT OR Apache-2.0
MODCARGO_CRATES +=	adler2	2.0.0	# 0BSD OR MIT OR Apache-2.0
MODCARGO_CRATES +=	adler32	1.2.0	# Zlib
MODCARGO_CRATES +=	aes	0.8.4	# MIT OR Apache-2.0
MODCARGO_CRATES +=	ahash	0.8.11	# MIT OR Apache-2.0
MODCARGO_CRATES +=	aho-corasick	1.1.3	# Unlicense OR MIT
MODCARGO_CRATES +=	aligned-vec	0.5.0	# MIT
MODCARGO_CRATES +=	allocator-api2	0.2.18	# MIT OR Apache-2.0
MODCARGO_CRATES +=	android-activity	0.6.0	# MIT OR Apache-2.0
MODCARGO_CRATES +=	android-properties	0.2.2	# MIT
MODCARGO_CRATES +=	android-tzdata	0.1.1	# MIT OR Apache-2.0
MODCARGO_CRATES +=	android_system_properties	0.1.5	# MIT/Apache-2.0
MODCARGO_CRATES +=	anstream	0.6.15	# MIT OR Apache-2.0
MODCARGO_CRATES +=	anstyle	1.0.8	# MIT OR Apache-2.0
MODCARGO_CRATES +=	anstyle-parse	0.2.5	# MIT OR Apache-2.0
MODCARGO_CRATES +=	anstyle-query	1.1.1	# MIT OR Apache-2.0
MODCARGO_CRATES +=	anstyle-wincon	3.0.4	# MIT OR Apache-2.0
MODCARGO_CRATES +=	anyhow	1.0.89	# MIT OR Apache-2.0
MODCARGO_CRATES +=	arbitrary	1.3.2	# MIT OR Apache-2.0
MODCARGO_CRATES +=	arc-swap	1.7.1	# MIT OR Apache-2.0
MODCARGO_CRATES +=	arg_enum_proc_macro	0.3.4	# MIT
MODCARGO_CRATES +=	arrayref	0.3.9	# BSD-2-Clause
MODCARGO_CRATES +=	arrayvec	0.7.6	# MIT OR Apache-2.0
MODCARGO_CRATES +=	as-raw-xcb-connection	1.0.1	# MIT OR Apache-2.0
MODCARGO_CRATES +=	ash	0.37.3+1.3.251	# MIT OR Apache-2.0
MODCARGO_CRATES +=	ashpd	0.9.2	# MIT
MODCARGO_CRATES +=	async-broadcast	0.7.1	# MIT OR Apache-2.0
MODCARGO_CRATES +=	async-channel	2.3.1	# Apache-2.0 OR MIT
MODCARGO_CRATES +=	async-executor	1.13.1	# Apache-2.0 OR MIT
MODCARGO_CRATES +=	async-fs	2.1.2	# Apache-2.0 OR MIT
MODCARGO_CRATES +=	async-io	2.3.4	# Apache-2.0 OR MIT
MODCARGO_CRATES +=	async-lock	3.4.0	# Apache-2.0 OR MIT
MODCARGO_CRATES +=	async-net	2.0.0	# Apache-2.0 OR MIT
MODCARGO_CRATES +=	async-process	2.3.0	# Apache-2.0 OR MIT
MODCARGO_CRATES +=	async-recursion	1.1.1	# MIT OR Apache-2.0
MODCARGO_CRATES +=	async-signal	0.2.10	# Apache-2.0 OR MIT
MODCARGO_CRATES +=	async-task	4.7.1	# Apache-2.0 OR MIT
MODCARGO_CRATES +=	async-trait	0.1.83	# MIT OR Apache-2.0
MODCARGO_CRATES +=	atomic-waker	1.1.2	# Apache-2.0 OR MIT
MODCARGO_CRATES +=	audio_checker	0.1.0	# MIT
MODCARGO_CRATES +=	auto_enums	0.8.6	# Apache-2.0 OR MIT
MODCARGO_CRATES +=	autocfg	1.4.0	# Apache-2.0 OR MIT
MODCARGO_CRATES +=	av-data	0.4.3	# MIT
MODCARGO_CRATES +=	av1-grain	0.2.3	# BSD-2-Clause
MODCARGO_CRATES +=	avif-serialize	0.8.1	# BSD-3-Clause
MODCARGO_CRATES +=	base64	0.22.1	# MIT OR Apache-2.0
MODCARGO_CRATES +=	basic-toml	0.1.9	# MIT OR Apache-2.0
MODCARGO_CRATES +=	bincode	1.3.3	# MIT
MODCARGO_CRATES +=	bindgen	0.69.5	# BSD-3-Clause
MODCARGO_CRATES +=	bit_field	0.10.2	# Apache-2.0/MIT
MODCARGO_CRATES +=	bitflags	1.3.2	# MIT/Apache-2.0
MODCARGO_CRATES +=	bitflags	2.6.0	# MIT OR Apache-2.0
MODCARGO_CRATES +=	bitreader	0.3.10	# MIT OR Apache-2.0
MODCARGO_CRATES +=	bitstream-io	2.5.3	# MIT/Apache-2.0
MODCARGO_CRATES +=	bk-tree	0.5.0	# MIT
MODCARGO_CRATES +=	blake3	1.5.4	# CC0-1.0 OR Apache-2.0 OR Apache-2.0 WITH LLVM-exception
MODCARGO_CRATES +=	block	0.1.6	# MIT
MODCARGO_CRATES +=	block-buffer	0.10.4	# MIT OR Apache-2.0
MODCARGO_CRATES +=	block-padding	0.3.3	# MIT OR Apache-2.0
MODCARGO_CRATES +=	block2	0.5.1	# MIT
MODCARGO_CRATES +=	blocking	1.6.1	# Apache-2.0 OR MIT
MODCARGO_CRATES +=	borsh	1.5.1	# MIT OR Apache-2.0
MODCARGO_CRATES +=	built	0.7.4	# MIT
MODCARGO_CRATES +=	bumpalo	3.16.0	# MIT OR Apache-2.0
MODCARGO_CRATES +=	by_address	1.2.1	# MIT OR Apache-2.0
MODCARGO_CRATES +=	byte-slice-cast	1.2.2	# MIT
MODCARGO_CRATES +=	bytemuck	1.18.0	# Zlib OR Apache-2.0 OR MIT
MODCARGO_CRATES +=	bytemuck_derive	1.8.0	# Zlib OR Apache-2.0 OR MIT
MODCARGO_CRATES +=	byteorder	1.5.0	# Unlicense OR MIT
MODCARGO_CRATES +=	byteorder-lite	0.1.0	# Unlicense OR MIT
MODCARGO_CRATES +=	bytes	1.7.2	# MIT
MODCARGO_CRATES +=	bzip2	0.4.4	# MIT/Apache-2.0
MODCARGO_CRATES +=	bzip2-sys	0.1.11+1.0.8	# MIT/Apache-2.0
MODCARGO_CRATES +=	cairo-rs	0.20.1	# MIT
MODCARGO_CRATES +=	cairo-sys-rs	0.20.0	# MIT
MODCARGO_CRATES +=	calloop	0.13.0	# MIT
MODCARGO_CRATES +=	calloop	0.14.1	# MIT
MODCARGO_CRATES +=	calloop-wayland-source	0.3.0	# MIT
MODCARGO_CRATES +=	cbc	0.1.2	# MIT OR Apache-2.0
MODCARGO_CRATES +=	cc	1.1.28	# MIT OR Apache-2.0
MODCARGO_CRATES +=	cesu8	1.1.0	# Apache-2.0/MIT
MODCARGO_CRATES +=	cexpr	0.6.0	# Apache-2.0/MIT
MODCARGO_CRATES +=	cfb	0.7.3	# MIT
MODCARGO_CRATES +=	cfg-expr	0.15.8	# MIT OR Apache-2.0
MODCARGO_CRATES +=	cfg-expr	0.17.0	# MIT OR Apache-2.0
MODCARGO_CRATES +=	cfg-if	1.0.0	# MIT/Apache-2.0
MODCARGO_CRATES +=	cfg_aliases	0.2.1	# MIT
MODCARGO_CRATES +=	cgl	0.3.2	# MIT / Apache-2.0
MODCARGO_CRATES +=	chrono	0.4.38	# MIT OR Apache-2.0
MODCARGO_CRATES +=	cipher	0.4.4	# MIT OR Apache-2.0
MODCARGO_CRATES +=	clang-sys	1.8.1	# Apache-2.0
MODCARGO_CRATES +=	clap	4.5.20	# MIT OR Apache-2.0
MODCARGO_CRATES +=	clap_builder	4.5.20	# MIT OR Apache-2.0
MODCARGO_CRATES +=	clap_derive	4.5.18	# MIT OR Apache-2.0
MODCARGO_CRATES +=	clap_lex	0.7.2	# MIT OR Apache-2.0
MODCARGO_CRATES +=	clipboard-win	3.1.1	# MIT
MODCARGO_CRATES +=	clru	0.6.2	# MIT
MODCARGO_CRATES +=	cocoa	0.25.0	# MIT OR Apache-2.0
MODCARGO_CRATES +=	cocoa-foundation	0.1.2	# MIT OR Apache-2.0
MODCARGO_CRATES +=	codemap	0.1.3	# MIT/Apache-2.0
MODCARGO_CRATES +=	codemap-diagnostic	0.1.2	# MIT/Apache-2.0
MODCARGO_CRATES +=	color_quant	1.1.0	# MIT
MODCARGO_CRATES +=	colorchoice	1.0.2	# MIT OR Apache-2.0
MODCARGO_CRATES +=	combine	4.6.7	# MIT
MODCARGO_CRATES +=	concurrent-queue	2.5.0	# Apache-2.0 OR MIT
MODCARGO_CRATES +=	console	0.15.8	# MIT
MODCARGO_CRATES +=	const-field-offset	0.1.5	# MIT OR Apache-2.0
MODCARGO_CRATES +=	const-field-offset-macro	0.1.5	# MIT OR Apache-2.0
MODCARGO_CRATES +=	const_fn	0.4.10	# Apache-2.0 OR MIT
MODCARGO_CRATES +=	constant_time_eq	0.3.1	# CC0-1.0 OR MIT-0 OR Apache-2.0
MODCARGO_CRATES +=	convert_case	0.4.0	# MIT
MODCARGO_CRATES +=	copypasta	0.10.1	# MIT / Apache-2.0
MODCARGO_CRATES +=	core-foundation	0.9.4	# MIT OR Apache-2.0
MODCARGO_CRATES +=	core-foundation	0.10.0	# MIT OR Apache-2.0
MODCARGO_CRATES +=	core-foundation-sys	0.8.7	# MIT OR Apache-2.0
MODCARGO_CRATES +=	core-graphics	0.23.2	# MIT OR Apache-2.0
MODCARGO_CRATES +=	core-graphics	0.24.0	# MIT OR Apache-2.0
MODCARGO_CRATES +=	core-graphics-types	0.1.3	# MIT OR Apache-2.0
MODCARGO_CRATES +=	core-graphics-types	0.2.0	# MIT OR Apache-2.0
MODCARGO_CRATES +=	core-text	20.1.0	# MIT OR Apache-2.0
MODCARGO_CRATES +=	core2	0.4.0	# Apache-2.0 OR MIT
MODCARGO_CRATES +=	countme	3.0.1	# MIT OR Apache-2.0
MODCARGO_CRATES +=	cpufeatures	0.2.14	# MIT OR Apache-2.0
MODCARGO_CRATES +=	crc32fast	1.4.2	# MIT OR Apache-2.0
MODCARGO_CRATES +=	critical-section	1.1.3	# MIT OR Apache-2.0
MODCARGO_CRATES +=	crossbeam-channel	0.5.13	# MIT OR Apache-2.0
MODCARGO_CRATES +=	crossbeam-deque	0.8.5	# MIT OR Apache-2.0
MODCARGO_CRATES +=	crossbeam-epoch	0.9.18	# MIT OR Apache-2.0
MODCARGO_CRATES +=	crossbeam-queue	0.3.11	# MIT OR Apache-2.0
MODCARGO_CRATES +=	crossbeam-utils	0.8.20	# MIT OR Apache-2.0
MODCARGO_CRATES +=	crunchy	0.2.2	# MIT
MODCARGO_CRATES +=	crypto-common	0.1.6	# MIT OR Apache-2.0
MODCARGO_CRATES +=	ctor-lite	0.1.0	# MIT OR Apache-2.0
MODCARGO_CRATES +=	ctrlc	3.4.5	# MIT/Apache-2.0
MODCARGO_CRATES +=	cursor-icon	1.1.0	# MIT OR Apache-2.0 OR Zlib
MODCARGO_CRATES +=	darling	0.14.4	# MIT
MODCARGO_CRATES +=	darling_core	0.14.4	# MIT
MODCARGO_CRATES +=	darling_macro	0.14.4	# MIT
MODCARGO_CRATES +=	dary_heap	0.3.6	# MIT OR Apache-2.0
MODCARGO_CRATES +=	dashmap	6.1.0	# MIT
MODCARGO_CRATES +=	data-encoding	2.6.0	# MIT
MODCARGO_CRATES +=	data-url	0.3.1	# MIT OR Apache-2.0
MODCARGO_CRATES +=	datasize	0.2.15	# MIT OR Apache-2.0
MODCARGO_CRATES +=	datasize_derive	0.2.15	# MIT OR Apache-2.0
MODCARGO_CRATES +=	dav1d	0.10.3	# MIT
MODCARGO_CRATES +=	dav1d-sys	0.8.2	# MIT
MODCARGO_CRATES +=	dcv-color-primitives	0.6.1	# MIT-0
MODCARGO_CRATES +=	deflate	1.0.0	# MIT/Apache-2.0
MODCARGO_CRATES +=	deranged	0.3.11	# MIT OR Apache-2.0
MODCARGO_CRATES +=	derive_arbitrary	1.3.2	# MIT/Apache-2.0
MODCARGO_CRATES +=	derive_more	0.99.18	# MIT
MODCARGO_CRATES +=	derive_utils	0.14.2	# Apache-2.0 OR MIT
MODCARGO_CRATES +=	digest	0.10.7	# MIT OR Apache-2.0
MODCARGO_CRATES +=	directories-next	2.0.0	# MIT OR Apache-2.0
MODCARGO_CRATES +=	dirs-sys-next	0.1.2	# MIT OR Apache-2.0
MODCARGO_CRATES +=	dispatch	0.2.0	# MIT
MODCARGO_CRATES +=	displaydoc	0.2.5	# MIT OR Apache-2.0
MODCARGO_CRATES +=	dlib	0.5.2	# MIT
MODCARGO_CRATES +=	doc-comment	0.3.3	# MIT
MODCARGO_CRATES +=	downcast-rs	1.2.1	# MIT/Apache-2.0
MODCARGO_CRATES +=	dpi	0.1.1	# Apache-2.0
MODCARGO_CRATES +=	drm	0.12.0	# MIT
MODCARGO_CRATES +=	drm-ffi	0.8.0	# MIT
MODCARGO_CRATES +=	drm-fourcc	2.2.0	# MIT
MODCARGO_CRATES +=	drm-sys	0.7.0	# MIT
MODCARGO_CRATES +=	dwrote	0.11.2	# MPL-2.0
MODCARGO_CRATES +=	either	1.13.0	# MIT OR Apache-2.0
MODCARGO_CRATES +=	encode_unicode	0.3.6	# MIT/Apache-2.0
MODCARGO_CRATES +=	encoding_rs	0.8.34	# (Apache-2.0 OR MIT) AND BSD-3-Clause
MODCARGO_CRATES +=	endi	1.1.0	# MIT
MODCARGO_CRATES +=	enumflags2	0.7.10	# MIT OR Apache-2.0
MODCARGO_CRATES +=	enumflags2_derive	0.7.10	# MIT OR Apache-2.0
MODCARGO_CRATES +=	enumn	0.1.14	# MIT OR Apache-2.0
MODCARGO_CRATES +=	equivalent	1.0.1	# Apache-2.0 OR MIT
MODCARGO_CRATES +=	errno	0.3.9	# MIT OR Apache-2.0
MODCARGO_CRATES +=	euclid	0.22.11	# MIT OR Apache-2.0
MODCARGO_CRATES +=	event-listener	5.3.1	# Apache-2.0 OR MIT
MODCARGO_CRATES +=	event-listener-strategy	0.5.2	# Apache-2.0 OR MIT
MODCARGO_CRATES +=	exr	1.72.0	# BSD-3-Clause
MODCARGO_CRATES +=	extended	0.1.0	# MIT
MODCARGO_CRATES +=	fallible_collections	0.4.9	# MIT/Apache-2.0
MODCARGO_CRATES +=	fastrand	2.1.1	# Apache-2.0 OR MIT
MODCARGO_CRATES +=	fax	0.2.4	# MIT
MODCARGO_CRATES +=	fax_derive	0.1.0	# MIT
MODCARGO_CRATES +=	fdeflate	0.3.5	# MIT OR Apache-2.0
MODCARGO_CRATES +=	femtovg	0.9.2	# MIT/Apache-2.0
MODCARGO_CRATES +=	ffmpeg_cmdline_utils	0.1.3	# MIT OR Apache-2.0
MODCARGO_CRATES +=	field-offset	0.3.6	# MIT OR Apache-2.0
MODCARGO_CRATES +=	file-id	0.2.1	# MIT OR Apache-2.0
MODCARGO_CRATES +=	filetime	0.2.25	# MIT/Apache-2.0
MODCARGO_CRATES +=	find-crate	0.6.3	# Apache-2.0 OR MIT
MODCARGO_CRATES +=	flate2	1.0.34	# MIT OR Apache-2.0
MODCARGO_CRATES +=	float-cmp	0.9.0	# MIT
MODCARGO_CRATES +=	fluent	0.16.1	# Apache-2.0 OR MIT
MODCARGO_CRATES +=	fluent-bundle	0.15.3	# Apache-2.0 OR MIT
MODCARGO_CRATES +=	fluent-langneg	0.13.0	# Apache-2.0
MODCARGO_CRATES +=	fluent-syntax	0.11.1	# Apache-2.0 OR MIT
MODCARGO_CRATES +=	flume	0.11.0	# Apache-2.0/MIT
MODCARGO_CRATES +=	fnv	1.0.7	# Apache-2.0 / MIT
MODCARGO_CRATES +=	fontconfig-parser	0.5.7	# MIT
MODCARGO_CRATES +=	fontdb	0.18.0	# MIT
MODCARGO_CRATES +=	fontdue	0.9.2	# MIT OR Apache-2.0 OR Zlib
MODCARGO_CRATES +=	foreign-types	0.5.0	# MIT/Apache-2.0
MODCARGO_CRATES +=	foreign-types-macros	0.2.3	# MIT/Apache-2.0
MODCARGO_CRATES +=	foreign-types-shared	0.3.1	# MIT/Apache-2.0
MODCARGO_CRATES +=	form_urlencoded	1.2.1	# MIT OR Apache-2.0
MODCARGO_CRATES +=	four-cc	0.2.0	# MIT/Apache-2.0
MODCARGO_CRATES +=	fs_extra	1.3.0	# MIT
MODCARGO_CRATES +=	fun_time	0.3.4	# MIT
MODCARGO_CRATES +=	fun_time_derive	0.3.4	# MIT
MODCARGO_CRATES +=	futures-channel	0.3.31	# MIT OR Apache-2.0
MODCARGO_CRATES +=	futures-core	0.3.31	# MIT OR Apache-2.0
MODCARGO_CRATES +=	futures-executor	0.3.31	# MIT OR Apache-2.0
MODCARGO_CRATES +=	futures-io	0.3.31	# MIT OR Apache-2.0
MODCARGO_CRATES +=	futures-lite	2.3.0	# Apache-2.0 OR MIT
MODCARGO_CRATES +=	futures-macro	0.3.31	# MIT OR Apache-2.0
MODCARGO_CRATES +=	futures-sink	0.3.31	# MIT OR Apache-2.0
MODCARGO_CRATES +=	futures-task	0.3.31	# MIT OR Apache-2.0
MODCARGO_CRATES +=	futures-util	0.3.31	# MIT OR Apache-2.0
MODCARGO_CRATES +=	gbm	0.15.0	# MIT
MODCARGO_CRATES +=	gbm-sys	0.3.1	# MIT
MODCARGO_CRATES +=	gdk-pixbuf	0.20.4	# MIT
MODCARGO_CRATES +=	gdk-pixbuf-sys	0.20.4	# MIT
MODCARGO_CRATES +=	gdk4	0.9.2	# MIT
MODCARGO_CRATES +=	gdk4-sys	0.9.2	# MIT
MODCARGO_CRATES +=	generator	0.7.5	# MIT/Apache-2.0
MODCARGO_CRATES +=	generic-array	0.14.7	# MIT
MODCARGO_CRATES +=	gethostname	0.4.3	# Apache-2.0
MODCARGO_CRATES +=	getrandom	0.2.15	# MIT OR Apache-2.0
MODCARGO_CRATES +=	gif	0.13.1	# MIT/Apache-2.0
MODCARGO_CRATES +=	gio	0.20.4	# MIT
MODCARGO_CRATES +=	gio-sys	0.20.4	# MIT
MODCARGO_CRATES +=	gl_generator	0.14.0	# Apache-2.0
MODCARGO_CRATES +=	glib	0.20.4	# MIT
MODCARGO_CRATES +=	glib-macros	0.20.4	# MIT
MODCARGO_CRATES +=	glib-sys	0.20.4	# MIT
MODCARGO_CRATES +=	glob	0.3.1	# MIT OR Apache-2.0
MODCARGO_CRATES +=	globalcache	0.2.4	# MIT
MODCARGO_CRATES +=	glow	0.13.1	# MIT OR Apache-2.0 OR Zlib
MODCARGO_CRATES +=	glutin	0.32.1	# Apache-2.0
MODCARGO_CRATES +=	glutin-winit	0.5.0	# MIT
MODCARGO_CRATES +=	glutin_egl_sys	0.7.0	# Apache-2.0
MODCARGO_CRATES +=	glutin_glx_sys	0.6.0	# Apache-2.0
MODCARGO_CRATES +=	glutin_wgl_sys	0.6.0	# Apache-2.0
MODCARGO_CRATES +=	gobject-sys	0.20.4	# MIT
MODCARGO_CRATES +=	graphene-rs	0.20.4	# MIT
MODCARGO_CRATES +=	graphene-sys	0.20.4	# MIT
MODCARGO_CRATES +=	gsk4	0.9.2	# MIT
MODCARGO_CRATES +=	gsk4-sys	0.9.2	# MIT
MODCARGO_CRATES +=	gtk4	0.9.2	# MIT
MODCARGO_CRATES +=	gtk4-macros	0.9.1	# MIT
MODCARGO_CRATES +=	gtk4-sys	0.9.2	# MIT
MODCARGO_CRATES +=	half	2.4.1	# MIT OR Apache-2.0
MODCARGO_CRATES +=	hamming	0.1.3	# MIT/Apache-2.0
MODCARGO_CRATES +=	handsome_logger	0.8.0	# MIT OR Apache-2.0
MODCARGO_CRATES +=	hashbrown	0.12.3	# MIT OR Apache-2.0
MODCARGO_CRATES +=	hashbrown	0.13.2	# MIT OR Apache-2.0
MODCARGO_CRATES +=	hashbrown	0.14.5	# MIT OR Apache-2.0
MODCARGO_CRATES +=	hashbrown	0.15.0	# MIT OR Apache-2.0
MODCARGO_CRATES +=	heck	0.4.1	# MIT OR Apache-2.0
MODCARGO_CRATES +=	heck	0.5.0	# MIT OR Apache-2.0
MODCARGO_CRATES +=	hermit-abi	0.3.9	# MIT OR Apache-2.0
MODCARGO_CRATES +=	hermit-abi	0.4.0	# MIT OR Apache-2.0
MODCARGO_CRATES +=	hex	0.4.3	# MIT OR Apache-2.0
MODCARGO_CRATES +=	hmac	0.12.1	# MIT OR Apache-2.0
MODCARGO_CRATES +=	home	0.5.9	# MIT OR Apache-2.0
MODCARGO_CRATES +=	humansize	2.1.3	# MIT/Apache-2.0
MODCARGO_CRATES +=	i-slint-backend-linuxkms	1.8.0	# GPL-3.0-only OR LicenseRef-Slint-Royalty-free-2.0 OR LicenseRef-Slint-Software-3.0
MODCARGO_CRATES +=	i-slint-backend-selector	1.8.0	# GPL-3.0-only OR LicenseRef-Slint-Royalty-free-2.0 OR LicenseRef-Slint-Software-3.0
MODCARGO_CRATES +=	i-slint-backend-winit	1.8.0	# GPL-3.0-only OR LicenseRef-Slint-Royalty-free-2.0 OR LicenseRef-Slint-Software-3.0
MODCARGO_CRATES +=	i-slint-common	1.8.0	# GPL-3.0-only OR LicenseRef-Slint-Royalty-free-2.0 OR LicenseRef-Slint-Software-3.0
MODCARGO_CRATES +=	i-slint-compiler	1.8.0	# GPL-3.0-only OR LicenseRef-Slint-Royalty-free-2.0 OR LicenseRef-Slint-Software-3.0
MODCARGO_CRATES +=	i-slint-core	1.8.0	# GPL-3.0-only OR LicenseRef-Slint-Royalty-free-2.0 OR LicenseRef-Slint-Software-3.0
MODCARGO_CRATES +=	i-slint-core-macros	1.8.0	# GPL-3.0-only OR LicenseRef-Slint-Royalty-free-2.0 OR LicenseRef-Slint-Software-3.0
MODCARGO_CRATES +=	i-slint-renderer-femtovg	1.8.0	# GPL-3.0-only OR LicenseRef-Slint-Royalty-free-2.0 OR LicenseRef-Slint-Software-3.0
MODCARGO_CRATES +=	i-slint-renderer-skia	1.8.0	# GPL-3.0-only OR LicenseRef-Slint-Royalty-free-2.0 OR LicenseRef-Slint-Software-3.0
MODCARGO_CRATES +=	i18n-config	0.4.7	# MIT
MODCARGO_CRATES +=	i18n-embed	0.15.0	# MIT
MODCARGO_CRATES +=	i18n-embed-fl	0.9.1	# MIT
MODCARGO_CRATES +=	i18n-embed-impl	0.8.3	# MIT
MODCARGO_CRATES +=	iana-time-zone	0.1.61	# MIT OR Apache-2.0
MODCARGO_CRATES +=	iana-time-zone-haiku	0.1.2	# MIT OR Apache-2.0
MODCARGO_CRATES +=	ident_case	1.0.1	# MIT/Apache-2.0
MODCARGO_CRATES +=	idna	0.5.0	# MIT OR Apache-2.0
MODCARGO_CRATES +=	image	0.24.9	# MIT OR Apache-2.0
MODCARGO_CRATES +=	image	0.25.2	# MIT OR Apache-2.0
MODCARGO_CRATES +=	image-webp	0.1.3	# MIT OR Apache-2.0
MODCARGO_CRATES +=	image_hasher	2.0.0	# MIT OR Apache-2.0
MODCARGO_CRATES +=	imagepipe	0.5.0	# LGPL-3.0-only
MODCARGO_CRATES +=	imagesize	0.12.0	# MIT
MODCARGO_CRATES +=	imgref	1.10.1	# CC0-1.0 OR Apache-2.0
MODCARGO_CRATES +=	indexmap	1.9.3	# Apache-2.0 OR MIT
MODCARGO_CRATES +=	indexmap	2.6.0	# Apache-2.0 OR MIT
MODCARGO_CRATES +=	indicatif	0.17.8	# MIT
MODCARGO_CRATES +=	infer	0.16.0	# MIT
MODCARGO_CRATES +=	inout	0.1.3	# MIT OR Apache-2.0
MODCARGO_CRATES +=	input	0.9.1	# MIT
MODCARGO_CRATES +=	input-sys	1.18.0	# MIT
MODCARGO_CRATES +=	instant	0.1.13	# BSD-3-Clause
MODCARGO_CRATES +=	integer-sqrt	0.1.5	# Apache-2.0/MIT
MODCARGO_CRATES +=	interpolate_name	0.2.4	# MIT
MODCARGO_CRATES +=	intl-memoizer	0.5.2	# Apache-2.0 OR MIT
MODCARGO_CRATES +=	intl_pluralrules	7.0.2	# Apache-2.0/MIT
MODCARGO_CRATES +=	io-lifetimes	1.0.11	# Apache-2.0 WITH LLVM-exception OR Apache-2.0 OR MIT
MODCARGO_CRATES +=	is-docker	0.2.0	# MIT
MODCARGO_CRATES +=	is-wsl	0.4.0	# MIT
MODCARGO_CRATES +=	is_terminal_polyfill	1.70.1	# MIT OR Apache-2.0
MODCARGO_CRATES +=	istring	0.3.4	# MIT
MODCARGO_CRATES +=	itertools	0.10.5	# MIT/Apache-2.0
MODCARGO_CRATES +=	itertools	0.12.1	# MIT OR Apache-2.0
MODCARGO_CRATES +=	itertools	0.13.0	# MIT OR Apache-2.0
MODCARGO_CRATES +=	itoa	1.0.11	# MIT OR Apache-2.0
MODCARGO_CRATES +=	jni	0.21.1	# MIT/Apache-2.0
MODCARGO_CRATES +=	jni-sys	0.3.0	# MIT/Apache-2.0
MODCARGO_CRATES +=	jobserver	0.1.32	# MIT OR Apache-2.0
MODCARGO_CRATES +=	jpeg-decoder	0.3.1	# MIT OR Apache-2.0
MODCARGO_CRATES +=	js-sys	0.3.71	# MIT OR Apache-2.0
MODCARGO_CRATES +=	jxl-bitstream	0.4.1	# MIT OR Apache-2.0
MODCARGO_CRATES +=	jxl-coding	0.4.1	# MIT OR Apache-2.0
MODCARGO_CRATES +=	jxl-color	0.8.0	# MIT OR Apache-2.0
MODCARGO_CRATES +=	jxl-frame	0.10.0	# MIT OR Apache-2.0
MODCARGO_CRATES +=	jxl-grid	0.5.0	# MIT OR Apache-2.0
MODCARGO_CRATES +=	jxl-image	0.10.0	# MIT OR Apache-2.0
MODCARGO_CRATES +=	jxl-modular	0.8.0	# MIT OR Apache-2.0
MODCARGO_CRATES +=	jxl-oxide	0.9.0	# MIT OR Apache-2.0
MODCARGO_CRATES +=	jxl-render	0.9.0	# MIT OR Apache-2.0
MODCARGO_CRATES +=	jxl-threadpool	0.1.1	# MIT OR Apache-2.0
MODCARGO_CRATES +=	jxl-vardct	0.8.0	# MIT OR Apache-2.0
MODCARGO_CRATES +=	khronos_api	3.1.0	# Apache-2.0
MODCARGO_CRATES +=	kurbo	0.11.1	# MIT OR Apache-2.0
MODCARGO_CRATES +=	lazy-bytes-cast	5.0.1	# BSL-1.0
MODCARGO_CRATES +=	lazy_static	1.5.0	# MIT OR Apache-2.0
MODCARGO_CRATES +=	lazycell	1.3.0	# MIT/Apache-2.0
MODCARGO_CRATES +=	lebe	0.5.2	# BSD-3-Clause
MODCARGO_CRATES +=	libc	0.2.159	# MIT OR Apache-2.0
MODCARGO_CRATES +=	libflate	2.1.0	# MIT
MODCARGO_CRATES +=	libflate_lz77	2.1.0	# MIT
MODCARGO_CRATES +=	libfuzzer-sys	0.4.7	# MIT/Apache-2.0/NCSA
MODCARGO_CRATES +=	libheif-rs	0.18.0	# MIT
MODCARGO_CRATES +=	libheif-sys	1.14.2	# MIT
MODCARGO_CRATES +=	libloading	0.7.4	# ISC
MODCARGO_CRATES +=	libloading	0.8.5	# ISC
MODCARGO_CRATES +=	libm	0.2.8	# MIT OR Apache-2.0
MODCARGO_CRATES +=	libraw-rs	0.0.4	# MIT/Apache-2.0
MODCARGO_CRATES +=	libraw-rs-sys	0.0.4+libraw-0.20.1	# MIT/Apache-2.0
MODCARGO_CRATES +=	libredox	0.0.2	# MIT
MODCARGO_CRATES +=	libredox	0.1.3	# MIT
MODCARGO_CRATES +=	libudev-sys	0.1.4	# MIT
MODCARGO_CRATES +=	linked-hash-map	0.5.6	# MIT/Apache-2.0
MODCARGO_CRATES +=	linked_hash_set	0.1.4	# Apache-2.0
MODCARGO_CRATES +=	linux-raw-sys	0.4.14	# Apache-2.0 WITH LLVM-exception OR Apache-2.0 OR MIT
MODCARGO_CRATES +=	linux-raw-sys	0.6.5	# Apache-2.0 WITH LLVM-exception OR Apache-2.0 OR MIT
MODCARGO_CRATES +=	locale_config	0.3.0	# MIT
MODCARGO_CRATES +=	lock_api	0.4.12	# MIT OR Apache-2.0
MODCARGO_CRATES +=	lockfree-object-pool	0.1.6	# BSL-1.0
MODCARGO_CRATES +=	lofty	0.21.1	# MIT OR Apache-2.0
MODCARGO_CRATES +=	lofty_attr	0.11.0	# MIT OR Apache-2.0
MODCARGO_CRATES +=	log	0.4.22	# MIT OR Apache-2.0
MODCARGO_CRATES +=	loom	0.5.6	# MIT
MODCARGO_CRATES +=	loop9	0.1.5	# MIT
MODCARGO_CRATES +=	lru	0.12.5	# MIT
MODCARGO_CRATES +=	lyon_algorithms	1.0.4	# MIT OR Apache-2.0
MODCARGO_CRATES +=	lyon_extra	1.0.2	# MIT OR Apache-2.0
MODCARGO_CRATES +=	lyon_geom	1.0.5	# MIT OR Apache-2.0
MODCARGO_CRATES +=	lyon_path	1.0.5	# MIT OR Apache-2.0
MODCARGO_CRATES +=	malloc_buf	0.0.6	# MIT
MODCARGO_CRATES +=	matchers	0.1.0	# MIT
MODCARGO_CRATES +=	maybe-rayon	0.1.1	# MIT
MODCARGO_CRATES +=	md5	0.7.0	# Apache-2.0/MIT
MODCARGO_CRATES +=	memchr	2.7.4	# Unlicense OR MIT
MODCARGO_CRATES +=	memmap2	0.9.5	# MIT OR Apache-2.0
MODCARGO_CRATES +=	memoffset	0.9.1	# MIT
MODCARGO_CRATES +=	metal	0.27.0	# MIT OR Apache-2.0
MODCARGO_CRATES +=	mime	0.3.17	# MIT OR Apache-2.0
MODCARGO_CRATES +=	mime_guess	2.0.5	# MIT
MODCARGO_CRATES +=	minimal-lexical	0.2.1	# MIT/Apache-2.0
MODCARGO_CRATES +=	miniz_oxide	0.7.4	# MIT OR Zlib OR Apache-2.0
MODCARGO_CRATES +=	miniz_oxide	0.8.0	# MIT OR Zlib OR Apache-2.0
MODCARGO_CRATES +=	mp4parse	0.17.0	# MPL-2.0
MODCARGO_CRATES +=	multicache	0.6.1	# LGPL-3.0-only
MODCARGO_CRATES +=	ndk	0.9.0	# MIT OR Apache-2.0
MODCARGO_CRATES +=	ndk-context	0.1.1	# MIT OR Apache-2.0
MODCARGO_CRATES +=	ndk-sys	0.6.0+11769913	# MIT OR Apache-2.0
MODCARGO_CRATES +=	new_debug_unreachable	1.0.6	# MIT
MODCARGO_CRATES +=	nix	0.29.0	# MIT
MODCARGO_CRATES +=	nom	7.1.3	# MIT
MODCARGO_CRATES +=	noop_proc_macro	0.3.0	# MIT
MODCARGO_CRATES +=	nu-ansi-term	0.46.0	# MIT
MODCARGO_CRATES +=	num-bigint	0.4.6	# MIT OR Apache-2.0
MODCARGO_CRATES +=	num-complex	0.3.1	# MIT OR Apache-2.0
MODCARGO_CRATES +=	num-complex	0.4.6	# MIT OR Apache-2.0
MODCARGO_CRATES +=	num-conv	0.1.0	# MIT OR Apache-2.0
MODCARGO_CRATES +=	num-derive	0.4.2	# MIT OR Apache-2.0
MODCARGO_CRATES +=	num-integer	0.1.46	# MIT OR Apache-2.0
MODCARGO_CRATES +=	num-rational	0.4.2	# MIT OR Apache-2.0
MODCARGO_CRATES +=	num-traits	0.2.19	# MIT OR Apache-2.0
MODCARGO_CRATES +=	num_enum	0.7.3	# BSD-3-Clause OR MIT OR Apache-2.0
MODCARGO_CRATES +=	num_enum_derive	0.7.3	# BSD-3-Clause OR MIT OR Apache-2.0
MODCARGO_CRATES +=	num_threads	0.1.7	# MIT OR Apache-2.0
MODCARGO_CRATES +=	number_prefix	0.4.0	# MIT
MODCARGO_CRATES +=	objc	0.2.7	# MIT
MODCARGO_CRATES +=	objc-foundation	0.1.1	# MIT
MODCARGO_CRATES +=	objc-sys	0.3.5	# MIT
MODCARGO_CRATES +=	objc2	0.5.2	# MIT
MODCARGO_CRATES +=	objc2-app-kit	0.2.2	# MIT
MODCARGO_CRATES +=	objc2-cloud-kit	0.2.2	# MIT
MODCARGO_CRATES +=	objc2-contacts	0.2.2	# MIT
MODCARGO_CRATES +=	objc2-core-data	0.2.2	# MIT
MODCARGO_CRATES +=	objc2-core-image	0.2.2	# MIT
MODCARGO_CRATES +=	objc2-core-location	0.2.2	# MIT
MODCARGO_CRATES +=	objc2-encode	4.0.3	# MIT
MODCARGO_CRATES +=	objc2-foundation	0.2.2	# MIT
MODCARGO_CRATES +=	objc2-link-presentation	0.2.2	# MIT
MODCARGO_CRATES +=	objc2-metal	0.2.2	# MIT
MODCARGO_CRATES +=	objc2-quartz-core	0.2.2	# MIT
MODCARGO_CRATES +=	objc2-symbols	0.2.2	# MIT
MODCARGO_CRATES +=	objc2-ui-kit	0.2.2	# MIT
MODCARGO_CRATES +=	objc2-uniform-type-identifiers	0.2.2	# MIT
MODCARGO_CRATES +=	objc2-user-notifications	0.2.2	# MIT
MODCARGO_CRATES +=	objc_exception	0.1.2	# MIT
MODCARGO_CRATES +=	objc_id	0.1.1	# MIT
MODCARGO_CRATES +=	ogg_pager	0.6.1	# MIT OR Apache-2.0
MODCARGO_CRATES +=	once_cell	1.20.2	# MIT OR Apache-2.0
MODCARGO_CRATES +=	open	5.3.0	# MIT
MODCARGO_CRATES +=	orbclient	0.3.47	# MIT
MODCARGO_CRATES +=	ordered-stream	0.2.0	# MIT OR Apache-2.0
MODCARGO_CRATES +=	os_info	3.8.2	# MIT
MODCARGO_CRATES +=	overload	0.1.1	# MIT
MODCARGO_CRATES +=	owned_ttf_parser	0.25.0	# Apache-2.0
MODCARGO_CRATES +=	pango	0.20.4	# MIT
MODCARGO_CRATES +=	pango-sys	0.20.4	# MIT
MODCARGO_CRATES +=	parking	2.2.1	# Apache-2.0 OR MIT
MODCARGO_CRATES +=	parking_lot	0.12.3	# MIT OR Apache-2.0
MODCARGO_CRATES +=	parking_lot_core	0.9.10	# MIT OR Apache-2.0
MODCARGO_CRATES +=	paste	1.0.15	# MIT OR Apache-2.0
MODCARGO_CRATES +=	pathdiff	0.2.1	# MIT/Apache-2.0
MODCARGO_CRATES +=	pbkdf2	0.12.2	# MIT OR Apache-2.0
MODCARGO_CRATES +=	pdf	0.9.0	# MIT
MODCARGO_CRATES +=	pdf_derive	0.2.0	# MIT
MODCARGO_CRATES +=	percent-encoding	2.3.1	# MIT OR Apache-2.0
MODCARGO_CRATES +=	pico-args	0.5.0	# MIT
MODCARGO_CRATES +=	pin-project	1.1.6	# Apache-2.0 OR MIT
MODCARGO_CRATES +=	pin-project-internal	1.1.6	# Apache-2.0 OR MIT
MODCARGO_CRATES +=	pin-project-lite	0.2.14	# Apache-2.0 OR MIT
MODCARGO_CRATES +=	pin-utils	0.1.0	# MIT OR Apache-2.0
MODCARGO_CRATES +=	pin-weak	1.1.0	# MIT
MODCARGO_CRATES +=	piper	0.2.4	# MIT OR Apache-2.0
MODCARGO_CRATES +=	pkg-config	0.3.31	# MIT OR Apache-2.0
MODCARGO_CRATES +=	png	0.17.14	# MIT OR Apache-2.0
MODCARGO_CRATES +=	polling	3.7.3	# Apache-2.0 OR MIT
MODCARGO_CRATES +=	pollster	0.3.0	# Apache-2.0/MIT
MODCARGO_CRATES +=	portable-atomic	1.9.0	# Apache-2.0 OR MIT
MODCARGO_CRATES +=	powerfmt	0.2.0	# MIT OR Apache-2.0
MODCARGO_CRATES +=	ppv-lite86	0.2.20	# MIT/Apache-2.0
MODCARGO_CRATES +=	prettyplease	0.2.22	# MIT OR Apache-2.0
MODCARGO_CRATES +=	primal-check	0.3.4	# MIT OR Apache-2.0
MODCARGO_CRATES +=	proc-macro-crate	3.2.0	# MIT OR Apache-2.0
MODCARGO_CRATES +=	proc-macro-error	1.0.4	# MIT OR Apache-2.0
MODCARGO_CRATES +=	proc-macro-error-attr	1.0.4	# MIT OR Apache-2.0
MODCARGO_CRATES +=	proc-macro2	1.0.87	# MIT OR Apache-2.0
MODCARGO_CRATES +=	profiling	1.0.15	# MIT OR Apache-2.0
MODCARGO_CRATES +=	profiling-procmacros	1.0.15	# MIT OR Apache-2.0
MODCARGO_CRATES +=	qoi	0.4.1	# MIT/Apache-2.0
MODCARGO_CRATES +=	quick-error	2.0.1	# MIT/Apache-2.0
MODCARGO_CRATES +=	quick-xml	0.36.2	# MIT
MODCARGO_CRATES +=	quote	1.0.37	# MIT OR Apache-2.0
MODCARGO_CRATES +=	rand	0.8.5	# MIT OR Apache-2.0
MODCARGO_CRATES +=	rand_chacha	0.3.1	# MIT OR Apache-2.0
MODCARGO_CRATES +=	rand_core	0.6.4	# MIT OR Apache-2.0
MODCARGO_CRATES +=	rav1e	0.7.1	# BSD-2-Clause
MODCARGO_CRATES +=	ravif	0.11.10	# BSD-3-Clause
MODCARGO_CRATES +=	raw-window-handle	0.5.2	# MIT OR Apache-2.0 OR Zlib
MODCARGO_CRATES +=	raw-window-handle	0.6.2	# MIT OR Apache-2.0 OR Zlib
MODCARGO_CRATES +=	raw-window-metal	1.0.0	# MIT OR Apache-2.0
MODCARGO_CRATES +=	rawloader	0.37.1	# LGPL-2.1
MODCARGO_CRATES +=	rayon	1.10.0	# MIT OR Apache-2.0
MODCARGO_CRATES +=	rayon-core	1.12.1	# MIT OR Apache-2.0
MODCARGO_CRATES +=	realfft	3.4.0	# MIT
MODCARGO_CRATES +=	redox_syscall	0.4.1	# MIT
MODCARGO_CRATES +=	redox_syscall	0.5.7	# MIT
MODCARGO_CRATES +=	redox_users	0.4.6	# MIT
MODCARGO_CRATES +=	regex	1.11.0	# MIT OR Apache-2.0
MODCARGO_CRATES +=	regex-automata	0.1.10	# Unlicense/MIT
MODCARGO_CRATES +=	regex-automata	0.4.8	# MIT OR Apache-2.0
MODCARGO_CRATES +=	regex-syntax	0.6.29	# MIT OR Apache-2.0
MODCARGO_CRATES +=	regex-syntax	0.8.5	# MIT OR Apache-2.0
MODCARGO_CRATES +=	resvg	0.42.0	# MPL-2.0
MODCARGO_CRATES +=	rfd	0.15.0	# MIT
MODCARGO_CRATES +=	rgb	0.8.50	# MIT
MODCARGO_CRATES +=	rle-decode-fast	1.0.3	# MIT OR Apache-2.0
MODCARGO_CRATES +=	rowan	0.15.16	# MIT OR Apache-2.0
MODCARGO_CRATES +=	roxmltree	0.20.0	# MIT OR Apache-2.0
MODCARGO_CRATES +=	rubato	0.14.1	# MIT
MODCARGO_CRATES +=	rust-embed	8.5.0	# MIT
MODCARGO_CRATES +=	rust-embed-impl	8.5.0	# MIT
MODCARGO_CRATES +=	rust-embed-utils	8.5.0	# MIT
MODCARGO_CRATES +=	rustc-hash	1.1.0	# Apache-2.0/MIT
MODCARGO_CRATES +=	rustc_version	0.4.1	# MIT OR Apache-2.0
MODCARGO_CRATES +=	rustdct	0.6.0	# MIT OR Apache-2.0
MODCARGO_CRATES +=	rustdct	0.7.1	# MIT OR Apache-2.0
MODCARGO_CRATES +=	rustfft	5.1.1	# MIT OR Apache-2.0
MODCARGO_CRATES +=	rustfft	6.2.0	# MIT OR Apache-2.0
MODCARGO_CRATES +=	rustix	0.38.37	# Apache-2.0 WITH LLVM-exception OR Apache-2.0 OR MIT
MODCARGO_CRATES +=	rustversion	1.0.17	# MIT OR Apache-2.0
MODCARGO_CRATES +=	rusty-chromaprint	0.2.0	# MIT
MODCARGO_CRATES +=	rustybuzz	0.14.1	# MIT
MODCARGO_CRATES +=	ryu	1.0.18	# Apache-2.0 OR BSL-1.0
MODCARGO_CRATES +=	same-file	1.0.6	# Unlicense/MIT
MODCARGO_CRATES +=	scoped-tls	1.0.1	# MIT/Apache-2.0
MODCARGO_CRATES +=	scoped-tls-hkt	0.1.5	# MIT/Apache-2.0
MODCARGO_CRATES +=	scopeguard	1.2.0	# MIT OR Apache-2.0
MODCARGO_CRATES +=	sctk-adwaita	0.10.1	# MIT
MODCARGO_CRATES +=	self_cell	0.10.3	# Apache-2.0
MODCARGO_CRATES +=	self_cell	1.0.4	# Apache-2.0
MODCARGO_CRATES +=	semver	1.0.23	# MIT OR Apache-2.0
MODCARGO_CRATES +=	serde	1.0.210	# MIT OR Apache-2.0
MODCARGO_CRATES +=	serde_derive	1.0.210	# MIT OR Apache-2.0
MODCARGO_CRATES +=	serde_json	1.0.128	# MIT OR Apache-2.0
MODCARGO_CRATES +=	serde_repr	0.1.19	# MIT OR Apache-2.0
MODCARGO_CRATES +=	serde_spanned	0.6.8	# MIT OR Apache-2.0
MODCARGO_CRATES +=	serde_yaml	0.8.26	# MIT OR Apache-2.0
MODCARGO_CRATES +=	sha1	0.10.6	# MIT OR Apache-2.0
MODCARGO_CRATES +=	sha2	0.10.8	# MIT OR Apache-2.0
MODCARGO_CRATES +=	sharded-slab	0.1.7	# MIT
MODCARGO_CRATES +=	shlex	1.3.0	# MIT OR Apache-2.0
MODCARGO_CRATES +=	signal-hook-registry	1.4.2	# Apache-2.0/MIT
MODCARGO_CRATES +=	simd-adler32	0.3.7	# MIT
MODCARGO_CRATES +=	simd_helpers	0.1.0	# MIT
MODCARGO_CRATES +=	simplecss	0.2.1	# MIT/Apache-2.0
MODCARGO_CRATES +=	siphasher	1.0.1	# MIT/Apache-2.0
MODCARGO_CRATES +=	skia-bindings	0.78.2	# MIT
MODCARGO_CRATES +=	skia-safe	0.78.2	# MIT
MODCARGO_CRATES +=	slab	0.4.9	# MIT
MODCARGO_CRATES +=	slint	1.8.0	# GPL-3.0-only OR LicenseRef-Slint-Royalty-free-2.0 OR LicenseRef-Slint-Software-3.0
MODCARGO_CRATES +=	slint-build	1.8.0	# GPL-3.0-only OR LicenseRef-Slint-Royalty-free-2.0 OR LicenseRef-Slint-Software-3.0
MODCARGO_CRATES +=	slint-macros	1.8.0	# GPL-3.0-only OR LicenseRef-Slint-Royalty-free-2.0 OR LicenseRef-Slint-Software-3.0
MODCARGO_CRATES +=	slotmap	1.0.7	# Zlib
MODCARGO_CRATES +=	smallvec	1.13.2	# MIT OR Apache-2.0
MODCARGO_CRATES +=	smithay-client-toolkit	0.19.2	# MIT
MODCARGO_CRATES +=	smithay-clipboard	0.7.2	# MIT
MODCARGO_CRATES +=	smol_str	0.2.2	# MIT OR Apache-2.0
MODCARGO_CRATES +=	smol_str	0.3.1	# MIT OR Apache-2.0
MODCARGO_CRATES +=	snafu	0.7.5	# MIT OR Apache-2.0
MODCARGO_CRATES +=	snafu-derive	0.7.5	# MIT OR Apache-2.0
MODCARGO_CRATES +=	softbuffer	0.4.6	# MIT OR Apache-2.0
MODCARGO_CRATES +=	spin	0.9.8	# MIT
MODCARGO_CRATES +=	spin_on	0.1.1	# Apache-2.0 OR MIT
MODCARGO_CRATES +=	stable_deref_trait	1.2.0	# MIT/Apache-2.0
MODCARGO_CRATES +=	state	0.6.0	# MIT/Apache-2.0
MODCARGO_CRATES +=	static_assertions	1.1.0	# MIT OR Apache-2.0
MODCARGO_CRATES +=	strength_reduce	0.2.4	# MIT OR Apache-2.0
MODCARGO_CRATES +=	strict-num	0.1.1	# MIT
MODCARGO_CRATES +=	stringprep	0.1.5	# MIT/Apache-2.0
MODCARGO_CRATES +=	strsim	0.10.0	# MIT
MODCARGO_CRATES +=	strsim	0.11.1	# MIT
MODCARGO_CRATES +=	strum	0.26.3	# MIT
MODCARGO_CRATES +=	strum_macros	0.26.4	# MIT
MODCARGO_CRATES +=	subtle	2.6.1	# BSD-3-Clause
MODCARGO_CRATES +=	svgtypes	0.15.2	# MIT/Apache-2.0
MODCARGO_CRATES +=	symphonia	0.5.4	# MPL-2.0
MODCARGO_CRATES +=	symphonia-bundle-flac	0.5.4	# MPL-2.0
MODCARGO_CRATES +=	symphonia-bundle-mp3	0.5.4	# MPL-2.0
MODCARGO_CRATES +=	symphonia-codec-aac	0.5.4	# MPL-2.0
MODCARGO_CRATES +=	symphonia-codec-adpcm	0.5.4	# MPL-2.0
MODCARGO_CRATES +=	symphonia-codec-alac	0.5.4	# MPL-2.0
MODCARGO_CRATES +=	symphonia-codec-pcm	0.5.4	# MPL-2.0
MODCARGO_CRATES +=	symphonia-codec-vorbis	0.5.4	# MPL-2.0
MODCARGO_CRATES +=	symphonia-core	0.5.4	# MPL-2.0
MODCARGO_CRATES +=	symphonia-format-caf	0.5.4	# MPL-2.0
MODCARGO_CRATES +=	symphonia-format-isomp4	0.5.4	# MPL-2.0
MODCARGO_CRATES +=	symphonia-format-mkv	0.5.4	# MPL-2.0
MODCARGO_CRATES +=	symphonia-format-ogg	0.5.4	# MPL-2.0
MODCARGO_CRATES +=	symphonia-format-riff	0.5.4	# MPL-2.0
MODCARGO_CRATES +=	symphonia-metadata	0.5.4	# MPL-2.0
MODCARGO_CRATES +=	symphonia-utils-xiph	0.5.4	# MPL-2.0
MODCARGO_CRATES +=	syn	1.0.109	# MIT OR Apache-2.0
MODCARGO_CRATES +=	syn	2.0.79	# MIT OR Apache-2.0
MODCARGO_CRATES +=	system-deps	6.2.2	# MIT OR Apache-2.0
MODCARGO_CRATES +=	system-deps	7.0.3	# MIT OR Apache-2.0
MODCARGO_CRATES +=	tar	0.4.42	# MIT OR Apache-2.0
MODCARGO_CRATES +=	target-lexicon	0.12.16	# Apache-2.0 WITH LLVM-exception
MODCARGO_CRATES +=	tempfile	3.13.0	# MIT OR Apache-2.0
MODCARGO_CRATES +=	termcolor	1.4.1	# Unlicense OR MIT
MODCARGO_CRATES +=	text-size	1.1.1	# MIT OR Apache-2.0
MODCARGO_CRATES +=	thiserror	1.0.64	# MIT OR Apache-2.0
MODCARGO_CRATES +=	thiserror-impl	1.0.64	# MIT OR Apache-2.0
MODCARGO_CRATES +=	thread_local	1.1.8	# MIT OR Apache-2.0
MODCARGO_CRATES +=	tiff	0.9.1	# MIT
MODCARGO_CRATES +=	time	0.3.36	# MIT OR Apache-2.0
MODCARGO_CRATES +=	time-core	0.1.2	# MIT OR Apache-2.0
MODCARGO_CRATES +=	time-macros	0.2.18	# MIT OR Apache-2.0
MODCARGO_CRATES +=	tiny-skia	0.11.4	# BSD-3-Clause
MODCARGO_CRATES +=	tiny-skia-path	0.11.4	# BSD-3-Clause
MODCARGO_CRATES +=	tiny-xlib	0.2.3	# MIT OR Apache-2.0 OR Zlib
MODCARGO_CRATES +=	tinystr	0.7.6	# Unicode-3.0
MODCARGO_CRATES +=	tinyvec	1.8.0	# Zlib OR Apache-2.0 OR MIT
MODCARGO_CRATES +=	tinyvec_macros	0.1.1	# MIT OR Apache-2.0 OR Zlib
MODCARGO_CRATES +=	toml	0.5.11	# MIT/Apache-2.0
MODCARGO_CRATES +=	toml	0.8.19	# MIT OR Apache-2.0
MODCARGO_CRATES +=	toml_datetime	0.6.8	# MIT OR Apache-2.0
MODCARGO_CRATES +=	toml_edit	0.22.22	# MIT OR Apache-2.0
MODCARGO_CRATES +=	tracing	0.1.40	# MIT
MODCARGO_CRATES +=	tracing-attributes	0.1.27	# MIT
MODCARGO_CRATES +=	tracing-core	0.1.32	# MIT
MODCARGO_CRATES +=	tracing-log	0.2.0	# MIT
MODCARGO_CRATES +=	tracing-subscriber	0.3.18	# MIT
MODCARGO_CRATES +=	transpose	0.2.3	# MIT OR Apache-2.0
MODCARGO_CRATES +=	trash	5.1.1	# MIT
MODCARGO_CRATES +=	triple_accel	0.3.4	# MIT
MODCARGO_CRATES +=	ttf-parser	0.21.1	# MIT OR Apache-2.0
MODCARGO_CRATES +=	ttf-parser	0.25.0	# MIT OR Apache-2.0
MODCARGO_CRATES +=	tuple	0.5.2	# MIT
MODCARGO_CRATES +=	type-map	0.5.0	# MIT/Apache-2.0
MODCARGO_CRATES +=	typenum	1.17.0	# MIT OR Apache-2.0
MODCARGO_CRATES +=	tz-rs	0.6.14	# MIT OR Apache-2.0
MODCARGO_CRATES +=	udev	0.9.0	# MIT
MODCARGO_CRATES +=	uds_windows	1.1.0	# MIT
MODCARGO_CRATES +=	unic-langid	0.9.5	# MIT OR Apache-2.0
MODCARGO_CRATES +=	unic-langid-impl	0.9.5	# MIT OR Apache-2.0
MODCARGO_CRATES +=	unicase	2.7.0	# MIT/Apache-2.0
MODCARGO_CRATES +=	unicode-bidi	0.3.17	# MIT OR Apache-2.0
MODCARGO_CRATES +=	unicode-bidi-mirroring	0.2.0	# MIT/Apache-2.0
MODCARGO_CRATES +=	unicode-ccc	0.2.0	# MIT/Apache-2.0
MODCARGO_CRATES +=	unicode-ident	1.0.13	# (MIT OR Apache-2.0) AND Unicode-DFS-2016
MODCARGO_CRATES +=	unicode-linebreak	0.1.5	# Apache-2.0
MODCARGO_CRATES +=	unicode-normalization	0.1.24	# MIT/Apache-2.0
MODCARGO_CRATES +=	unicode-properties	0.1.3	# MIT/Apache-2.0
MODCARGO_CRATES +=	unicode-script	0.5.7	# MIT OR Apache-2.0
MODCARGO_CRATES +=	unicode-segmentation	1.12.0	# MIT OR Apache-2.0
MODCARGO_CRATES +=	unicode-vo	0.1.0	# MIT/Apache-2.0
MODCARGO_CRATES +=	unicode-width	0.1.14	# MIT OR Apache-2.0
MODCARGO_CRATES +=	url	2.5.2	# MIT OR Apache-2.0
MODCARGO_CRATES +=	urlencoding	2.1.3	# MIT
MODCARGO_CRATES +=	usvg	0.42.0	# MPL-2.0
MODCARGO_CRATES +=	utf8parse	0.2.2	# Apache-2.0 OR MIT
MODCARGO_CRATES +=	uuid	1.10.0	# Apache-2.0 OR MIT
MODCARGO_CRATES +=	v_frame	0.3.8	# BSD-2-Clause
MODCARGO_CRATES +=	valuable	0.1.0	# MIT
MODCARGO_CRATES +=	version-compare	0.2.0	# MIT
MODCARGO_CRATES +=	version_check	0.9.5	# MIT/Apache-2.0
MODCARGO_CRATES +=	vid_dup_finder_lib	0.1.1	# MIT OR Apache-2.0
MODCARGO_CRATES +=	vk-parse	0.12.0	# Apache-2.0/MIT
MODCARGO_CRATES +=	vtable	0.2.0	# MIT OR Apache-2.0
MODCARGO_CRATES +=	vtable-macro	0.2.0	# MIT OR Apache-2.0
MODCARGO_CRATES +=	vulkano	0.34.1	# MIT OR Apache-2.0
MODCARGO_CRATES +=	walkdir	2.5.0	# Unlicense/MIT
MODCARGO_CRATES +=	wasi	0.11.0+wasi-snapshot-preview1	# Apache-2.0 WITH LLVM-exception OR Apache-2.0 OR MIT
MODCARGO_CRATES +=	wasm-bindgen	0.2.94	# MIT OR Apache-2.0
MODCARGO_CRATES +=	wasm-bindgen-backend	0.2.94	# MIT OR Apache-2.0
MODCARGO_CRATES +=	wasm-bindgen-futures	0.4.44	# MIT OR Apache-2.0
MODCARGO_CRATES +=	wasm-bindgen-macro	0.2.94	# MIT OR Apache-2.0
MODCARGO_CRATES +=	wasm-bindgen-macro-support	0.2.94	# MIT OR Apache-2.0
MODCARGO_CRATES +=	wasm-bindgen-shared	0.2.94	# MIT OR Apache-2.0
MODCARGO_CRATES +=	wayland-backend	0.3.7	# MIT
MODCARGO_CRATES +=	wayland-client	0.31.6	# MIT
MODCARGO_CRATES +=	wayland-csd-frame	0.3.0	# MIT
MODCARGO_CRATES +=	wayland-cursor	0.31.6	# MIT
MODCARGO_CRATES +=	wayland-protocols	0.32.4	# MIT
MODCARGO_CRATES +=	wayland-protocols-plasma	0.3.4	# MIT
MODCARGO_CRATES +=	wayland-protocols-wlr	0.3.4	# MIT
MODCARGO_CRATES +=	wayland-scanner	0.31.5	# MIT
MODCARGO_CRATES +=	wayland-sys	0.31.5	# MIT
MODCARGO_CRATES +=	web-sys	0.3.71	# MIT OR Apache-2.0
MODCARGO_CRATES +=	web-time	1.1.0	# MIT OR Apache-2.0
MODCARGO_CRATES +=	weezl	0.1.8	# MIT OR Apache-2.0
MODCARGO_CRATES +=	which	4.4.2	# MIT
MODCARGO_CRATES +=	winapi	0.3.9	# MIT/Apache-2.0
MODCARGO_CRATES +=	winapi-i686-pc-windows-gnu	0.4.0	# MIT/Apache-2.0
MODCARGO_CRATES +=	winapi-util	0.1.9	# Unlicense OR MIT
MODCARGO_CRATES +=	winapi-x86_64-pc-windows-gnu	0.4.0	# MIT/Apache-2.0
MODCARGO_CRATES +=	windows	0.48.0	# MIT OR Apache-2.0
MODCARGO_CRATES +=	windows	0.56.0	# MIT OR Apache-2.0
MODCARGO_CRATES +=	windows	0.58.0	# MIT OR Apache-2.0
MODCARGO_CRATES +=	windows-core	0.52.0	# MIT OR Apache-2.0
MODCARGO_CRATES +=	windows-core	0.56.0	# MIT OR Apache-2.0
MODCARGO_CRATES +=	windows-core	0.58.0	# MIT OR Apache-2.0
MODCARGO_CRATES +=	windows-implement	0.56.0	# MIT OR Apache-2.0
MODCARGO_CRATES +=	windows-implement	0.58.0	# MIT OR Apache-2.0
MODCARGO_CRATES +=	windows-interface	0.56.0	# MIT OR Apache-2.0
MODCARGO_CRATES +=	windows-interface	0.58.0	# MIT OR Apache-2.0
MODCARGO_CRATES +=	windows-result	0.1.2	# MIT OR Apache-2.0
MODCARGO_CRATES +=	windows-result	0.2.0	# MIT OR Apache-2.0
MODCARGO_CRATES +=	windows-strings	0.1.0	# MIT OR Apache-2.0
MODCARGO_CRATES +=	windows-sys	0.45.0	# MIT OR Apache-2.0
MODCARGO_CRATES +=	windows-sys	0.48.0	# MIT OR Apache-2.0
MODCARGO_CRATES +=	windows-sys	0.52.0	# MIT OR Apache-2.0
MODCARGO_CRATES +=	windows-sys	0.59.0	# MIT OR Apache-2.0
MODCARGO_CRATES +=	windows-targets	0.42.2	# MIT OR Apache-2.0
MODCARGO_CRATES +=	windows-targets	0.48.5	# MIT OR Apache-2.0
MODCARGO_CRATES +=	windows-targets	0.52.6	# MIT OR Apache-2.0
MODCARGO_CRATES +=	windows_aarch64_gnullvm	0.42.2	# MIT OR Apache-2.0
MODCARGO_CRATES +=	windows_aarch64_gnullvm	0.48.5	# MIT OR Apache-2.0
MODCARGO_CRATES +=	windows_aarch64_gnullvm	0.52.6	# MIT OR Apache-2.0
MODCARGO_CRATES +=	windows_aarch64_msvc	0.42.2	# MIT OR Apache-2.0
MODCARGO_CRATES +=	windows_aarch64_msvc	0.48.5	# MIT OR Apache-2.0
MODCARGO_CRATES +=	windows_aarch64_msvc	0.52.6	# MIT OR Apache-2.0
MODCARGO_CRATES +=	windows_i686_gnu	0.42.2	# MIT OR Apache-2.0
MODCARGO_CRATES +=	windows_i686_gnu	0.48.5	# MIT OR Apache-2.0
MODCARGO_CRATES +=	windows_i686_gnu	0.52.6	# MIT OR Apache-2.0
MODCARGO_CRATES +=	windows_i686_gnullvm	0.52.6	# MIT OR Apache-2.0
MODCARGO_CRATES +=	windows_i686_msvc	0.42.2	# MIT OR Apache-2.0
MODCARGO_CRATES +=	windows_i686_msvc	0.48.5	# MIT OR Apache-2.0
MODCARGO_CRATES +=	windows_i686_msvc	0.52.6	# MIT OR Apache-2.0
MODCARGO_CRATES +=	windows_x86_64_gnu	0.42.2	# MIT OR Apache-2.0
MODCARGO_CRATES +=	windows_x86_64_gnu	0.48.5	# MIT OR Apache-2.0
MODCARGO_CRATES +=	windows_x86_64_gnu	0.52.6	# MIT OR Apache-2.0
MODCARGO_CRATES +=	windows_x86_64_gnullvm	0.42.2	# MIT OR Apache-2.0
MODCARGO_CRATES +=	windows_x86_64_gnullvm	0.48.5	# MIT OR Apache-2.0
MODCARGO_CRATES +=	windows_x86_64_gnullvm	0.52.6	# MIT OR Apache-2.0
MODCARGO_CRATES +=	windows_x86_64_msvc	0.42.2	# MIT OR Apache-2.0
MODCARGO_CRATES +=	windows_x86_64_msvc	0.48.5	# MIT OR Apache-2.0
MODCARGO_CRATES +=	windows_x86_64_msvc	0.52.6	# MIT OR Apache-2.0
MODCARGO_CRATES +=	winit	0.30.5	# Apache-2.0
MODCARGO_CRATES +=	winnow	0.6.20	# MIT
MODCARGO_CRATES +=	wio	0.2.2	# MIT/Apache-2.0
MODCARGO_CRATES +=	x11-clipboard	0.9.2	# MIT
MODCARGO_CRATES +=	x11-dl	2.21.0	# MIT
MODCARGO_CRATES +=	x11rb	0.13.1	# MIT OR Apache-2.0
MODCARGO_CRATES +=	x11rb-protocol	0.13.1	# MIT OR Apache-2.0
MODCARGO_CRATES +=	xattr	1.3.1	# MIT/Apache-2.0
MODCARGO_CRATES +=	xcursor	0.3.8	# MIT
MODCARGO_CRATES +=	xdg-home	1.3.0	# MIT
MODCARGO_CRATES +=	xkbcommon	0.8.0	# MIT
MODCARGO_CRATES +=	xkbcommon-dl	0.4.2	# MIT
MODCARGO_CRATES +=	xkeysym	0.2.1	# MIT OR Apache-2.0 OR Zlib
MODCARGO_CRATES +=	xml-rs	0.8.22	# MIT
MODCARGO_CRATES +=	xmlwriter	0.1.0	# MIT
MODCARGO_CRATES +=	xxhash-rust	0.8.12	# BSL-1.0
MODCARGO_CRATES +=	yaml-rust	0.4.5	# MIT/Apache-2.0
MODCARGO_CRATES +=	zbus	4.4.0	# MIT
MODCARGO_CRATES +=	zbus_macros	4.4.0	# MIT
MODCARGO_CRATES +=	zbus_names	3.0.0	# MIT
MODCARGO_CRATES +=	zerocopy	0.7.35	# BSD-2-Clause OR Apache-2.0 OR MIT
MODCARGO_CRATES +=	zerocopy-derive	0.7.35	# BSD-2-Clause OR Apache-2.0 OR MIT
MODCARGO_CRATES +=	zeroize	1.8.1	# Apache-2.0 OR MIT
MODCARGO_CRATES +=	zeroize_derive	1.4.2	# Apache-2.0 OR MIT
MODCARGO_CRATES +=	zip	2.2.0	# MIT
MODCARGO_CRATES +=	zopfli	0.8.1	# Apache-2.0
MODCARGO_CRATES +=	zune-core	0.4.12	# MIT OR Apache-2.0 OR Zlib
MODCARGO_CRATES +=	zune-inflate	0.2.54	# MIT OR Apache-2.0 OR Zlib
MODCARGO_CRATES +=	zune-jpeg	0.4.13	# MIT OR Apache-2.0 OR Zlib
MODCARGO_CRATES +=	zvariant	4.2.0	# MIT
MODCARGO_CRATES +=	zvariant_derive	4.2.0	# MIT
MODCARGO_CRATES +=	zvariant_utils	2.1.0	# MIT
