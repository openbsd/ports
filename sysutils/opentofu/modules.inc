MODGO_MODULES =	\
	cel.dev/expr											 v0.25.2 \
	cloud.google.com/go										 v0.123.0 \
	cloud.google.com/go/accessapproval								 v1.13.0 \
	cloud.google.com/go/accesscontextmanager							 v1.15.0 \
	cloud.google.com/go/aiplatform									 v1.126.0 \
	cloud.google.com/go/analytics									 v0.35.0 \
	cloud.google.com/go/apigateway									 v1.13.0 \
	cloud.google.com/go/apigeeconnect								 v1.12.0 \
	cloud.google.com/go/apigeeregistry								 v1.1.0 \
	cloud.google.com/go/appengine									 v1.15.0 \
	cloud.google.com/go/area120									 v0.15.0 \
	cloud.google.com/go/artifactregistry								 v1.26.0 \
	cloud.google.com/go/asset									 v1.28.0 \
	cloud.google.com/go/assuredworkloads								 v1.19.0 \
	cloud.google.com/go/auth									 v0.23.0 \
	cloud.google.com/go/auth/oauth2adapt								 v0.2.8 \
	cloud.google.com/go/automl									 v1.21.0 \
	cloud.google.com/go/baremetalsolution								 v1.10.0 \
	cloud.google.com/go/batch									 v1.20.0 \
	cloud.google.com/go/beyondcorp									 v1.8.0 \
	cloud.google.com/go/bigquery									 v1.79.0 \
	cloud.google.com/go/bigtable									 v1.47.0 \
	cloud.google.com/go/billing									 v1.26.0 \
	cloud.google.com/go/binaryauthorization								 v1.16.0 \
	cloud.google.com/go/certificatemanager								 v1.15.0 \
	cloud.google.com/go/channel									 v1.27.0 \
	cloud.google.com/go/cloudbuild									 v1.32.0 \
	cloud.google.com/go/clouddms									 v1.14.0 \
	cloud.google.com/go/cloudtasks									 v1.18.0 \
	cloud.google.com/go/compute									 v1.62.0 \
	cloud.google.com/go/compute/metadata								 v0.9.0 \
	cloud.google.com/go/contactcenterinsights							 v1.23.0 \
	cloud.google.com/go/container									 v1.51.0 \
	cloud.google.com/go/containeranalysis								 v0.19.0 \
	cloud.google.com/go/datacatalog									 v1.33.0 \
	cloud.google.com/go/dataflow									 v0.16.0 \
	cloud.google.com/go/dataform									 v1.2.0 \
	cloud.google.com/go/datafusion									 v1.14.0 \
	cloud.google.com/go/datalabeling								 v0.15.0 \
	cloud.google.com/go/dataplex									 v1.36.0 \
	cloud.google.com/go/dataproc/v2									 v2.25.0 \
	cloud.google.com/go/dataqna									 v0.13.0 \
	cloud.google.com/go/datastore									 v1.25.0 \
	cloud.google.com/go/datastream									 v1.21.0 \
	cloud.google.com/go/deploy									 v1.33.0 \
	cloud.google.com/go/dialogflow									 v1.84.0 \
	cloud.google.com/go/dlp										 v1.34.0 \
	cloud.google.com/go/documentai									 v1.49.0 \
	cloud.google.com/go/domains									 v0.16.0 \
	cloud.google.com/go/edgecontainer								 v1.10.0 \
	cloud.google.com/go/errorreporting								 v0.9.0 \
	cloud.google.com/go/essentialcontacts								 v1.12.0 \
	cloud.google.com/go/eventarc									 v1.25.0 \
	cloud.google.com/go/filestore									 v1.16.0 \
	cloud.google.com/go/firestore									 v1.24.0 \
	cloud.google.com/go/functions									 v1.25.0 \
	cloud.google.com/go/gkebackup									 v1.14.0 \
	cloud.google.com/go/gkeconnect									 v1.0.0 \
	cloud.google.com/go/gkehub									 v0.22.0 \
	cloud.google.com/go/gkemulticloud								 v1.12.0 \
	cloud.google.com/go/gsuiteaddons								 v1.12.0 \
	cloud.google.com/go/iam										 v1.12.0 \
	cloud.google.com/go/iap										 v1.17.0 \
	cloud.google.com/go/ids										 v1.11.0 \
	cloud.google.com/go/iot										 v1.13.0 \
	cloud.google.com/go/kms										 v1.33.0 \
	cloud.google.com/go/language									 v1.18.0 \
	cloud.google.com/go/lifesciences								 v0.16.0 \
	cloud.google.com/go/logging									 v1.19.0 \
	cloud.google.com/go/longrunning									 v1.2.0 \
	cloud.google.com/go/managedidentities								 v1.13.0 \
	cloud.google.com/go/maps									 v1.37.0 \
	cloud.google.com/go/mediatranslation								 v0.13.0 \
	cloud.google.com/go/memcache									 v1.17.0 \
	cloud.google.com/go/metastore									 v1.20.0 \
	cloud.google.com/go/monitoring									 v1.30.0 \
	cloud.google.com/go/networkconnectivity								 v1.27.0 \
	cloud.google.com/go/networkmanagement								 v1.30.0 \
	cloud.google.com/go/networksecurity								 v0.19.0 \
	cloud.google.com/go/notebooks									 v1.18.0 \
	cloud.google.com/go/optimization								 v1.12.0 \
	cloud.google.com/go/orchestration								 v1.17.0 \
	cloud.google.com/go/orgpolicy									 v1.20.0 \
	cloud.google.com/go/osconfig									 v1.22.0 \
	cloud.google.com/go/oslogin									 v1.18.0 \
	cloud.google.com/go/phishingprotection								 v0.13.0 \
	cloud.google.com/go/policytroubleshooter							 v1.16.0 \
	cloud.google.com/go/privatecatalog								 v0.16.0 \
	cloud.google.com/go/pubsub									 v1.51.0 \
	cloud.google.com/go/pubsub/v2									 v2.6.0 \
	cloud.google.com/go/pubsublite									 v1.10.0 \
	cloud.google.com/go/recaptchaenterprise/v2							 v2.26.0 \
	cloud.google.com/go/recommendationengine							 v0.15.0 \
	cloud.google.com/go/recommender									 v1.19.0 \
	cloud.google.com/go/redis									 v1.24.0 \
	cloud.google.com/go/resourcemanager								 v1.16.0 \
	cloud.google.com/go/resourcesettings								 v1.8.3 \
	cloud.google.com/go/retail									 v1.32.0 \
	cloud.google.com/go/run										 v1.22.0 \
	cloud.google.com/go/scheduler									 v1.16.0 \
	cloud.google.com/go/secretmanager								 v1.20.0 \
	cloud.google.com/go/security									 v1.26.0 \
	cloud.google.com/go/securitycenter								 v1.45.0 \
	cloud.google.com/go/servicedirectory								 v1.17.0 \
	cloud.google.com/go/shell									 v1.13.0 \
	cloud.google.com/go/spanner									 v1.91.0 \
	cloud.google.com/go/speech									 v1.36.0 \
	cloud.google.com/go/storage									 v1.65.0 \
	cloud.google.com/go/storagetransfer								 v1.19.0 \
	cloud.google.com/go/talent									 v1.14.0 \
	cloud.google.com/go/texttospeech								 v1.22.0 \
	cloud.google.com/go/tpu										 v1.14.0 \
	cloud.google.com/go/trace									 v1.16.0 \
	cloud.google.com/go/translate									 v1.18.0 \
	cloud.google.com/go/video									 v1.33.0 \
	cloud.google.com/go/videointelligence								 v1.17.0 \
	cloud.google.com/go/vision/v2									 v2.15.0 \
	cloud.google.com/go/vmmigration									 v1.16.0 \
	cloud.google.com/go/vmwareengine								 v1.9.0 \
	cloud.google.com/go/vpcaccess									 v1.14.0 \
	cloud.google.com/go/webrisk									 v1.17.0 \
	cloud.google.com/go/websecurityscanner								 v1.12.0 \
	cloud.google.com/go/workflows									 v1.20.0 \
	dmitri.shuralyov.com/gpu/mtl									 v0.0.0-20190408044501-666a987793e9 \
	github.com/!azure!a!d/microsoft-authentication-extensions-for-go/cache				 v0.1.1 \
	github.com/!azure!a!d/microsoft-authentication-library-for-go					 v1.7.2 \
	github.com/!azure/azure-sdk-for-go/sdk/azcore							 v1.23.0 \
	github.com/!azure/azure-sdk-for-go/sdk/azidentity						 v1.14.0 \
	github.com/!azure/azure-sdk-for-go/sdk/azidentity/cache						 v0.4.0 \
	github.com/!azure/azure-sdk-for-go/sdk/internal							 v1.12.0 \
	github.com/!azure/azure-sdk-for-go/sdk/resourcemanager/internal/v2				 v2.0.0 \
	github.com/!azure/azure-sdk-for-go/sdk/resourcemanager/internal/v3				 v3.1.0 \
	github.com/!azure/azure-sdk-for-go/sdk/resourcemanager/managementgroups/armmanagementgroups	 v1.0.0 \
	github.com/!azure/azure-sdk-for-go/sdk/resourcemanager/resources/armresources			 v1.2.0 \
	github.com/!azure/azure-sdk-for-go/sdk/resourcemanager/storage/armstorage			 v1.8.1 \
	github.com/!azure/azure-sdk-for-go/sdk/security/keyvault/azkeys					 v1.5.0 \
	github.com/!azure/azure-sdk-for-go/sdk/security/keyvault/internal				 v1.2.0 \
	github.com/!azure/azure-sdk-for-go/sdk/storage/azblob						 v1.8.0 \
	github.com/!burnt!sushi/toml									 v1.2.1 \
	github.com/!burnt!sushi/xgb									 v0.0.0-20160522181843-27f122750802 \
	github.com/!data!dog/datadog-go									 v4.8.3+incompatible \
	github.com/!google!cloud!platform/opentelemetry-operations-go/detectors/gcp			 v1.33.0 \
	github.com/!google!cloud!platform/opentelemetry-operations-go/exporter/metric			 v0.57.0 \
	github.com/!google!cloud!platform/opentelemetry-operations-go/internal/cloudmock		 v0.57.0 \
	github.com/!google!cloud!platform/opentelemetry-operations-go/internal/resourcemapping		 v0.57.0 \
	github.com/!hdr!histogram/hdrhistogram-go							 v1.1.2 \
	github.com/!masterminds/goutils									 v1.1.1 \
	github.com/!masterminds/semver/v3								 v3.4.0 \
	github.com/!masterminds/sprig/v3								 v3.2.3 \
	github.com/!microsoft/go-winio									 v0.6.2 \
	github.com/!n!y!times/gziphandler								 v1.1.1 \
	github.com/!netflix/go-expect									 v0.0.0-20220104043353-73e0943537d2 \
	github.com/!proton!mail/go-crypto								 v1.4.1 \
	github.com/agext/levenshtein									 v1.2.3 \
	github.com/ajstarks/svgo									 v0.0.0-20180226025133-644b8db467af \
	github.com/alecthomas/kingpin/v2								 v2.4.0 \
	github.com/alecthomas/template									 v0.0.0-20190718012654-fb15b899a751 \
	github.com/alecthomas/units									 v0.0.0-20240927000941-0f3dac36c52b \
	github.com/aliyun/alibaba-cloud-sdk-go								 v1.63.107 \
	github.com/aliyun/aliyun-oss-go-sdk								 v3.0.2+incompatible \
	github.com/aliyun/aliyun-tablestore-go-sdk							 v4.1.3+incompatible \
	github.com/antihax/optional									 v1.0.0 \
	github.com/apparentlymart/go-cidr								 v1.1.1 \
	github.com/apparentlymart/go-shquot								 v0.0.1 \
	github.com/apparentlymart/go-textseg/v15							 v15.0.0 \
	github.com/apparentlymart/go-textseg/v17							 v17.0.1 \
	github.com/apparentlymart/go-userdirs								 v0.0.0-20200915174352-b0c018a67c13 \
	github.com/apparentlymart/go-versions								 v1.0.3 \
	github.com/apparentlymart/go-workgraph								 v0.0.0-20250609024419-b3453ef8d3e6 \
	github.com/armon/circbuf									 v0.0.0-20190214190532-5111143e8da2 \
	github.com/armon/go-metrics									 v0.4.1 \
	github.com/armon/go-radix									 v1.0.0 \
	github.com/aws/aws-sdk-go-v2									 v1.43.5 \
	github.com/aws/aws-sdk-go-v2/aws/protocol/eventstream						 v1.7.17 \
	github.com/aws/aws-sdk-go-v2/config								 v1.32.35 \
	github.com/aws/aws-sdk-go-v2/credentials							 v1.19.34 \
	github.com/aws/aws-sdk-go-v2/feature/ec2/imds							 v1.18.36 \
	github.com/aws/aws-sdk-go-v2/internal/configsources						 v1.4.36 \
	github.com/aws/aws-sdk-go-v2/internal/endpoints/v2						 v2.7.36 \
	github.com/aws/aws-sdk-go-v2/internal/v4a							 v1.4.37 \
	github.com/aws/aws-sdk-go-v2/service/dynamodb							 v1.63.2 \
	github.com/aws/aws-sdk-go-v2/service/iam							 v1.56.1 \
	github.com/aws/aws-sdk-go-v2/service/internal/accept-encoding					 v1.13.16 \
	github.com/aws/aws-sdk-go-v2/service/internal/checksum						 v1.9.29 \
	github.com/aws/aws-sdk-go-v2/service/internal/endpoint-discovery				 v1.12.13 \
	github.com/aws/aws-sdk-go-v2/service/internal/presigned-url					 v1.13.36 \
	github.com/aws/aws-sdk-go-v2/service/internal/s3shared						 v1.19.37 \
	github.com/aws/aws-sdk-go-v2/service/kms							 v1.55.5 \
	github.com/aws/aws-sdk-go-v2/service/route53							 v1.62.7 \
	github.com/aws/aws-sdk-go-v2/service/s3								 v1.107.1 \
	github.com/aws/aws-sdk-go-v2/service/signin							 v1.5.4 \
	github.com/aws/aws-sdk-go-v2/service/sns							 v1.39.17 \
	github.com/aws/aws-sdk-go-v2/service/sqs							 v1.46.1 \
	github.com/aws/aws-sdk-go-v2/service/sso							 v1.33.4 \
	github.com/aws/aws-sdk-go-v2/service/ssooidc							 v1.38.4 \
	github.com/aws/aws-sdk-go-v2/service/sts							 v1.45.4 \
	github.com/aws/smithy-go									 v1.27.7 \
	github.com/beorn7/perks										 v1.0.1 \
	github.com/bgentry/go-netrc									 v0.0.0-20140422174119-9fd32a8b3d3d \
	github.com/bgentry/speakeasy									 v0.2.0 \
	github.com/bmatcuk/doublestar/v4								 v4.10.0 \
	github.com/bufbuild/protocompile								 v0.14.1 \
	github.com/bwesterb/go-ristretto								 v1.2.3 \
	github.com/cenkalti/backoff/v5									 v5.0.3 \
	github.com/cespare/xxhash/v2									 v2.3.0 \
	github.com/cheggaaa/pb										 v1.0.27 \
	github.com/chzyer/logex										 v1.2.1 \
	github.com/chzyer/readline									 v1.5.1 \
	github.com/chzyer/test										 v1.0.0 \
	github.com/circonus-labs/circonus-gometrics							 v2.3.1+incompatible \
	github.com/circonus-labs/circonusllhist								 v0.1.3 \
	github.com/clbanning/mxj									 v1.8.4 \
	github.com/cli/browser										 v1.3.0 \
	github.com/cloudflare/circl									 v1.6.3 \
	github.com/cncf/xds/go										 v0.0.0-20260202195803-dba9d589def2 \
	github.com/creack/pty										 v1.1.18 \
	github.com/davecgh/go-spew									 v1.1.2-0.20180830191138-d8f796af33cc \
	github.com/dnaeon/go-vcr									 v1.2.0 \
	github.com/emicklei/go-restful/v3								 v3.13.0 \
	github.com/envoyproxy/go-control-plane								 v0.14.0 \
	github.com/envoyproxy/go-control-plane/envoy							 v1.37.0 \
	github.com/envoyproxy/go-control-plane/ratelimit						 v0.1.0 \
	github.com/envoyproxy/protoc-gen-validate							 v1.3.3 \
	github.com/fatih/color										 v1.19.0 \
	github.com/felixge/httpsnoop									 v1.1.0 \
	github.com/fogleman/gg										 v1.2.1-0.20190220221249-0403632d5b90 \
	github.com/frankban/quicktest									 v1.14.3 \
	github.com/fxamacker/cbor/v2									 v2.9.0 \
	github.com/go-gl/glfw										 v0.0.0-20190409004039-e6da0acd62b1 \
	github.com/go-jose/go-jose/v4									 v4.1.4 \
	github.com/go-kit/kit										 v0.9.0 \
	github.com/go-logfmt/logfmt									 v0.4.0 \
	github.com/go-logr/logr										 v1.4.4 \
	github.com/go-logr/stdr										 v1.2.2 \
	github.com/go-openapi/jsonpointer								 v0.21.0 \
	github.com/go-openapi/jsonreference								 v0.20.2 \
	github.com/go-openapi/swag									 v0.23.0 \
	github.com/go-stack/stack									 v1.8.0 \
	github.com/go-test/deep										 v1.1.1 \
	github.com/go-viper/mapstructure/v2								 v2.5.0 \
	github.com/gogo/protobuf									 v1.1.1 \
	github.com/goji/httpauth									 v0.0.0-20160601135302-2da839ab0f4d \
	github.com/golang-jwt/jwt/v5									 v5.3.1 \
	github.com/golang/freetype									 v0.0.0-20170609003504-e2365dfdc4a0 \
	github.com/golang/glog										 v1.2.5 \
	github.com/golang/groupcache									 v0.0.0-20210331224755-41bb18bfe9da \
	github.com/golang/protobuf									 v1.5.4 \
	github.com/golang/snappy									 v0.0.4 \
	github.com/google/btree										 v1.1.3 \
	github.com/google/gnostic-models								 v0.7.0 \
	github.com/google/go-cmp									 v0.7.0 \
	github.com/google/go-pkcs11									 v0.3.0 \
	github.com/google/go-querystring								 v1.2.0 \
	github.com/google/gofuzz									 v1.0.0 \
	github.com/google/martian/v3									 v3.3.3 \
	github.com/google/s2a-go									 v0.1.9 \
	github.com/google/uuid										 v1.6.0 \
	github.com/googleapis/enterprise-certificate-proxy						 v0.3.20 \
	github.com/googleapis/gax-go/v2									 v2.24.0 \
	github.com/gorilla/websocket									 v1.5.4-0.20250319132907-e064f32e3674 \
	github.com/grpc-ecosystem/grpc-gateway/v2							 v2.29.0 \
	github.com/hashicorp/aws-sdk-go-base/v2								 v2.0.0-beta.74 \
	github.com/hashicorp/cli									 v1.1.7 \
	github.com/hashicorp/consul/api									 v1.34.4 \
	github.com/hashicorp/consul/sdk									 v0.18.1 \
	github.com/hashicorp/errwrap									 v1.1.0 \
	github.com/hashicorp/go-cleanhttp								 v0.5.2 \
	github.com/hashicorp/go-getter									 v1.8.8 \
	github.com/hashicorp/go-hclog									 v1.6.3 \
	github.com/hashicorp/go-immutable-radix								 v1.3.1 \
	github.com/hashicorp/go-metrics									 v0.6.0 \
	github.com/hashicorp/go-msgpack/v2								 v2.1.5 \
	github.com/hashicorp/go-multierror								 v1.1.1 \
	github.com/hashicorp/go-plugin									 v1.8.0 \
	github.com/hashicorp/go-retryablehttp								 v0.7.8 \
	github.com/hashicorp/go-rootcerts								 v1.0.2 \
	github.com/hashicorp/go-secure-stdlib/parseutil							 v0.2.0 \
	github.com/hashicorp/go-secure-stdlib/strutil							 v0.1.2 \
	github.com/hashicorp/go-slug									 v0.16.8 \
	github.com/hashicorp/go-sockaddr								 v1.0.7 \
	github.com/hashicorp/go-syslog									 v1.0.0 \
	github.com/hashicorp/go-tfe									 v1.101.0 \
	github.com/hashicorp/go-uuid									 v1.0.3 \
	github.com/hashicorp/go-version									 v1.9.0 \
	github.com/hashicorp/golang-lru									 v1.0.2 \
	github.com/hashicorp/hcl									 v1.0.1-vault-7 \
	github.com/hashicorp/hcl/v2									 v2.20.1 \
	github.com/hashicorp/jsonapi									 v1.5.0 \
	github.com/hashicorp/logutils									 v1.0.0 \
	github.com/hashicorp/mdns									 v1.0.7 \
	github.com/hashicorp/memberlist									 v0.6.0 \
	github.com/hashicorp/serf									 v0.10.4 \
	github.com/hashicorp/terraform-plugin-log							 v0.10.1-0.20260721164921-2f73dc013b2c \
	github.com/hashicorp/terraform-registry-address							 v0.4.0 \
	github.com/hashicorp/terraform-svchost								 v0.1.1 \
	github.com/hashicorp/yamux									 v0.1.2 \
	github.com/huandu/xstrings									 v1.3.3 \
	github.com/iancoleman/strcase									 v0.3.0 \
	github.com/imdario/mergo									 v0.3.13 \
	github.com/jhump/protoreflect									 v1.17.0 \
	github.com/jmespath/go-jmespath									 v0.4.0 \
	github.com/jmespath/go-jmespath/internal/testify						 v1.5.1 \
	github.com/josharian/intern									 v1.0.0 \
	github.com/jpillora/backoff									 v1.0.0 \
	github.com/json-iterator/go									 v1.1.12 \
	github.com/julienschmidt/httprouter								 v1.3.0 \
	github.com/jung-kurt/gofpdf									 v1.0.3-0.20190309125859-24315acbbda5 \
	github.com/kardianos/osext									 v0.0.0-20190222173326-2bc1f35cddc0 \
	github.com/keybase/go-keychain									 v0.0.1 \
	github.com/klauspost/compress									 v1.19.2 \
	github.com/konsorten/go-windows-terminal-sequences						 v1.0.1 \
	github.com/kr/logfmt										 v0.0.0-20140226030751-b84e30acd515 \
	github.com/kr/pretty										 v0.3.1 \
	github.com/kr/pty										 v1.1.1 \
	github.com/kr/text										 v0.2.0 \
	github.com/kylelemons/godebug									 v1.1.0 \
	github.com/lib/pq										 v1.12.3 \
	github.com/lyft/protoc-gen-star/v2								 v2.0.4 \
	github.com/mailru/easyjson									 v0.7.7 \
	github.com/mattn/go-colorable									 v0.1.15 \
	github.com/mattn/go-isatty									 v0.0.24 \
	github.com/mattn/go-runewidth									 v0.0.4 \
	github.com/mattn/go-shellwords									 v1.0.14 \
	github.com/matttproud/golang_protobuf_extensions						 v1.0.1 \
	github.com/miekg/dns										 v1.1.72 \
	github.com/mitchellh/cli									 v1.1.5 \
	github.com/mitchellh/colorstring								 v0.0.0-20190213212951-d06e56a500db \
	github.com/mitchellh/copystructure								 v1.2.0 \
	github.com/mitchellh/go-homedir									 v1.1.0 \
	github.com/mitchellh/go-linereader								 v0.0.0-20190213213312-1b945b3263eb \
	github.com/mitchellh/go-testing-interface							 v1.14.1 \
	github.com/mitchellh/go-wordwrap								 v1.0.1 \
	github.com/mitchellh/gox									 v1.0.1 \
	github.com/mitchellh/iochan									 v1.0.0 \
	github.com/mitchellh/mapstructure								 v1.5.0 \
	github.com/mitchellh/reflectwalk								 v1.0.2 \
	github.com/moby/spdystream									 v0.5.1 \
	github.com/modern-go/concurrent									 v0.0.0-20180306012644-bacd9c7ef1dd \
	github.com/modern-go/reflect2									 v1.0.3-0.20250322232337-35a7c28c31ee \
	github.com/montanaflynn/stats									 v0.7.0 \
	github.com/mozillazg/go-httpheader								 v0.3.0 \
	github.com/munnerz/goautoneg									 v0.0.0-20191010083416-a7dc8b61c822 \
	github.com/mwitkow/go-conntrack									 v0.0.0-20190716064945-2f068394615f \
	github.com/mxk/go-flowrate									 v0.0.0-20140419014527-cca7078d478f \
	github.com/niemeyer/pretty									 v0.0.0-20200227124842-a10e7caefd8e \
	github.com/oklog/run										 v1.1.0 \
	github.com/openbao/openbao/api/v2								 v2.6.0 \
	github.com/opencontainers/go-digest								 v1.0.0 \
	github.com/opencontainers/image-spec								 v1.1.1 \
	github.com/opentofu/hcl/v2									 v2.20.2-0.20260427110253-11bc5ebf0f63 \
	github.com/opentofu/registry-address/v2								 v2.0.0-20260307135325-45f3562374e4 \
	github.com/opentofu/svchost									 v0.0.0-20260410171206-1a42986aa3f4 \
	github.com/opentracing/opentracing-go								 v1.2.1-0.20220228012449-10b1cf09e00b \
	github.com/pascaldekloe/goe									 v0.1.0 \
	github.com/peterbourgon/diskv									 v2.0.1+incompatible \
	github.com/pkg/browser										 v0.0.0-20240102092130-5ac0b6a4141c \
	github.com/pkg/errors										 v0.9.1 \
	github.com/planetscale/vtprotobuf								 v0.6.1-0.20240319094008-0393e58bdf10 \
	github.com/pmezard/go-difflib									 v1.0.1-0.20181226105442-5d4384ee4fb2 \
	github.com/posener/complete									 v1.2.3 \
	github.com/prometheus/client_golang								 v1.24.1 \
	github.com/prometheus/client_model								 v0.6.2 \
	github.com/prometheus/common									 v0.70.1 \
	github.com/prometheus/otlptranslator								 v1.0.0 \
	github.com/prometheus/procfs									 v0.21.1 \
	github.com/rogpeppe/fastuuid									 v1.2.0 \
	github.com/rogpeppe/go-internal									 v1.14.1 \
	github.com/rs/dnscache										 v0.0.0-20230804202142-fc85eb664529 \
	github.com/russross/blackfriday									 v1.6.0 \
	github.com/ryanuber/columnize									 v2.1.2+incompatible \
	github.com/ryanuber/go-glob									 v1.0.0 \
	github.com/santhosh-tekuri/jsonschema/v5							 v5.3.1 \
	github.com/sean-/seed										 v0.0.0-20170313163322-e2103e2c3529 \
	github.com/shopspring/decimal									 v1.3.1 \
	github.com/sirupsen/logrus									 v1.9.3 \
	github.com/spf13/afero										 v1.15.0 \
	github.com/spf13/cast										 v1.5.0 \
	github.com/spf13/pflag										 v1.0.9 \
	github.com/spiffe/go-spiffe/v2									 v2.7.0 \
	github.com/stretchr/objx									 v0.5.2 \
	github.com/stretchr/testify									 v1.11.1 \
	github.com/tencentcloud/tencentcloud-sdk-go/tencentcloud/common					 v1.1.41 \
	github.com/tencentcloud/tencentcloud-sdk-go/tencentcloud/kms					 v1.0.563 \
	github.com/tencentcloud/tencentcloud-sdk-go/tencentcloud/sts					 v1.1.11 \
	github.com/tencentcloud/tencentcloud-sdk-go/tencentcloud/tag					 v1.1.0 \
	github.com/tencentyun/cos-go-sdk-v5								 v0.7.70 \
	github.com/tencentyun/qcloud-cos-sts-sdk							 v0.0.0-20250515025012-e0eec8a5d123 \
	github.com/tv42/httpunix									 v0.0.0-20150427012821-b75d8614f926 \
	github.com/uber/jaeger-client-go								 v2.30.0+incompatible \
	github.com/uber/jaeger-lib									 v2.4.1+incompatible \
	github.com/ulikunitz/xz										 v0.5.16 \
	github.com/urfave/cli/v3									 v3.10.1 \
	github.com/vmihailenco/msgpack/v5								 v5.3.5 \
	github.com/vmihailenco/tagparser/v2								 v2.0.0 \
	github.com/x448/float16										 v0.8.4 \
	github.com/xanzy/ssh-agent									 v0.3.3 \
	github.com/xhit/go-str2duration/v2								 v2.1.0 \
	github.com/xlab/treeprint									 v1.2.0 \
	github.com/yuin/goldmark									 v1.4.13 \
	github.com/zclconf/go-cty									 v1.19.0 \
	github.com/zclconf/go-cty-debug									 v0.0.0-20240509010212-0d6042c53940 \
	github.com/zclconf/go-cty-yaml									 v1.2.0 \
	github.com/zeebo/errs										 v1.4.0 \
	go.opencensus.io										 v0.24.0 \
	go.opentelemetry.io/auto/sdk									 v1.2.1 \
	go.opentelemetry.io/contrib/bridges/prometheus							 v0.70.0 \
	go.opentelemetry.io/contrib/detectors/gcp							 v1.44.0 \
	go.opentelemetry.io/contrib/exporters/autoexport						 v0.70.0 \
	go.opentelemetry.io/contrib/instrumentation/github.com/aws/aws-sdk-go-v2/otelaws		 v0.69.0 \
	go.opentelemetry.io/contrib/instrumentation/google.golang.org/grpc/otelgrpc			 v0.68.0 \
	go.opentelemetry.io/contrib/instrumentation/net/http/otelhttp					 v0.70.0 \
	go.opentelemetry.io/otel									 v1.45.0 \
	go.opentelemetry.io/otel/exporters/otlp/otlplog/otlploggrpc					 v0.21.0 \
	go.opentelemetry.io/otel/exporters/otlp/otlplog/otlploghttp					 v0.21.0 \
	go.opentelemetry.io/otel/exporters/otlp/otlpmetric/otlpmetricgrpc				 v1.45.0 \
	go.opentelemetry.io/otel/exporters/otlp/otlpmetric/otlpmetrichttp				 v1.45.0 \
	go.opentelemetry.io/otel/exporters/otlp/otlptrace						 v1.45.0 \
	go.opentelemetry.io/otel/exporters/otlp/otlptrace/otlptracegrpc					 v1.45.0 \
	go.opentelemetry.io/otel/exporters/otlp/otlptrace/otlptracehttp					 v1.45.0 \
	go.opentelemetry.io/otel/exporters/prometheus							 v0.67.0 \
	go.opentelemetry.io/otel/exporters/stdout/stdoutlog						 v0.21.0 \
	go.opentelemetry.io/otel/exporters/stdout/stdoutmetric						 v1.45.0 \
	go.opentelemetry.io/otel/exporters/stdout/stdouttrace						 v1.45.0 \
	go.opentelemetry.io/otel/log									 v0.21.0 \
	go.opentelemetry.io/otel/metric									 v1.45.0 \
	go.opentelemetry.io/otel/metric/x								 v0.67.0 \
	go.opentelemetry.io/otel/sdk									 v1.45.0 \
	go.opentelemetry.io/otel/sdk/log								 v0.21.0 \
	go.opentelemetry.io/otel/sdk/log/logtest							 v0.21.0 \
	go.opentelemetry.io/otel/sdk/metric								 v1.45.0 \
	go.opentelemetry.io/otel/trace									 v1.45.0 \
	go.opentelemetry.io/proto/otlp									 v1.11.0 \
	go.uber.org/atomic										 v1.9.0 \
	go.uber.org/goleak										 v1.3.0 \
	go.uber.org/mock										 v0.6.0 \
	go.yaml.in/yaml/v2										 v2.4.4 \
	go.yaml.in/yaml/v3										 v3.0.4 \
	golang.org/x/crypto										 v0.56.0 \
	golang.org/x/exp										 v0.0.0-20260218203240-3dfff04db8fa \
	golang.org/x/exp/typeparams									 v0.0.0-20221208152030-732eee02a75a \
	golang.org/x/image										 v0.0.0-20190802002840-cff245a6509b \
	golang.org/x/mobile										 v0.0.0-20190719004257-d2bd2a29d028 \
	golang.org/x/mod										 v0.39.0 \
	golang.org/x/net										 v0.57.0 \
	golang.org/x/oauth2										 v0.36.0 \
	golang.org/x/sync										 v0.22.0 \
	golang.org/x/sys										 v0.47.0 \
	golang.org/x/telemetry										 v0.0.0-20260708182218-49f421fb7959 \
	golang.org/x/term										 v0.45.0 \
	golang.org/x/text										 v0.41.0 \
	golang.org/x/time										 v0.15.0 \
	golang.org/x/tools										 v0.48.0 \
	golang.org/x/tools/go/expect									 v0.1.1-deprecated \
	golang.org/x/tools/go/packages/packagestest							 v0.1.1-deprecated \
	golang.org/x/xerrors										 v0.0.0-20200804184101-5ec99f83aff1 \
	gonum.org/v1/gonum										 v0.17.0 \
	gonum.org/v1/netlib										 v0.0.0-20190313105609-8cb42192e0e0 \
	gonum.org/v1/plot										 v0.0.0-20190515093506-e2840ee46a6b \
	google.golang.org/api										 v0.293.0 \
	google.golang.org/appengine									 v1.6.8 \
	google.golang.org/genproto									 v0.0.0-20260715232425-e75dac1f907d \
	google.golang.org/genproto/googleapis/api							 v0.0.0-20260803160001-6ac0973c030d \
	google.golang.org/genproto/googleapis/bytestream						 v0.0.0-20260807164820-c8921c73eeea \
	google.golang.org/genproto/googleapis/rpc							 v0.0.0-20260807164820-c8921c73eeea \
	google.golang.org/grpc										 v1.83.1 \
	google.golang.org/grpc/cmd/protoc-gen-go-grpc							 v1.3.0 \
	google.golang.org/grpc/examples									 v0.0.0-20250407062114-b368379ef8f6 \
	google.golang.org/protobuf									 v1.36.12 \
	gopkg.in/alecthomas/kingpin.v2									 v2.2.6 \
	gopkg.in/check.v1										 v1.0.0-20201130134442-10cb98267c6c \
	gopkg.in/cheggaaa/pb.v1										 v1.0.27 \
	gopkg.in/evanphx/json-patch.v4									 v4.13.0 \
	gopkg.in/inf.v0											 v0.9.1 \
	gopkg.in/ini.v1											 v1.67.0 \
	gopkg.in/yaml.v2										 v2.4.0 \
	gopkg.in/yaml.v3										 v3.0.1 \
	honnef.co/go/tools										 v0.4.2 \
	k8s.io/api											 v0.36.3 \
	k8s.io/apimachinery										 v0.36.3 \
	k8s.io/client-go										 v0.36.3 \
	k8s.io/gengo/v2											 v2.0.0-20250604051438-85fd79dbfd9f \
	k8s.io/klog/v2											 v2.140.0 \
	k8s.io/kube-openapi										 v0.0.0-20260317180543-43fb72c5454a \
	k8s.io/streaming										 v0.36.3 \
	k8s.io/utils											 v0.0.0-20260707023825-cf1189d6abe3 \
	oras.land/oras-go/v2										 v2.6.2 \
	rsc.io/pdf											 v0.1.1 \
	sigs.k8s.io/json										 v0.0.0-20250730193827-2d320260d730 \
	sigs.k8s.io/randfill										 v1.0.0 \
	sigs.k8s.io/structured-merge-diff/v6								 v6.3.3 \
	sigs.k8s.io/yaml										 v1.6.0

MODGO_MODFILES =	\
	cel.dev/expr										 v0.24.0 \
	cel.dev/expr										 v0.25.1 \
	cloud.google.com/go									 v0.112.2 \
	cloud.google.com/go/auth								 v0.15.0 \
	cloud.google.com/go/auth								 v0.16.4 \
	cloud.google.com/go/auth								 v0.18.2 \
	cloud.google.com/go/auth								 v0.20.0 \
	cloud.google.com/go/auth								 v0.22.0 \
	cloud.google.com/go/auth								 v0.3.0 \
	cloud.google.com/go/auth/oauth2adapt							 v0.2.2 \
	cloud.google.com/go/compute/metadata							 v0.3.0 \
	cloud.google.com/go/compute/metadata							 v0.6.0 \
	cloud.google.com/go/compute/metadata							 v0.8.0 \
	cloud.google.com/go/iam									 v1.11.0 \
	cloud.google.com/go/iam									 v1.5.2 \
	cloud.google.com/go/kms									 v1.32.0 \
	cloud.google.com/go/logging								 v1.18.0 \
	cloud.google.com/go/longrunning								 v0.5.6 \
	cloud.google.com/go/longrunning								 v1.0.0 \
	cloud.google.com/go/monitoring								 v1.24.2 \
	cloud.google.com/go/monitoring								 v1.29.0 \
	cloud.google.com/go/storage								 v1.56.0 \
	cloud.google.com/go/storage								 v1.64.0 \
	cloud.google.com/go/translate								 v1.10.3 \
	github.com/!azure!a!d/microsoft-authentication-library-for-go				 v1.1.1 \
	github.com/!azure!a!d/microsoft-authentication-library-for-go				 v1.4.2 \
	github.com/!azure!a!d/microsoft-authentication-library-for-go				 v1.6.0 \
	github.com/!azure!a!d/microsoft-authentication-library-for-go				 v1.7.0 \
	github.com/!azure/azure-sdk-for-go/sdk/azcore						 v1.18.0 \
	github.com/!azure/azure-sdk-for-go/sdk/azcore						 v1.20.0 \
	github.com/!azure/azure-sdk-for-go/sdk/azcore						 v1.21.0 \
	github.com/!azure/azure-sdk-for-go/sdk/azcore						 v1.22.0 \
	github.com/!azure/azure-sdk-for-go/sdk/azcore						 v1.9.0 \
	github.com/!azure/azure-sdk-for-go/sdk/azidentity					 v1.13.1 \
	github.com/!azure/azure-sdk-for-go/sdk/azidentity					 v1.4.0 \
	github.com/!azure/azure-sdk-for-go/sdk/azidentity					 v1.8.2 \
	github.com/!azure/azure-sdk-for-go/sdk/internal						 v1.11.1 \
	github.com/!azure/azure-sdk-for-go/sdk/internal						 v1.11.2 \
	github.com/!azure/azure-sdk-for-go/sdk/internal						 v1.5.0 \
	github.com/!data!dog/datadog-go								 v3.2.0+incompatible \
	github.com/!google!cloud!platform/opentelemetry-operations-go/detectors/gcp		 v1.27.0 \
	github.com/!google!cloud!platform/opentelemetry-operations-go/detectors/gcp		 v1.32.0 \
	github.com/!google!cloud!platform/opentelemetry-operations-go/exporter/metric		 v0.53.0 \
	github.com/!google!cloud!platform/opentelemetry-operations-go/internal/resourcemapping	 v0.53.0 \
	github.com/!masterminds/semver/v3							 v3.1.1 \
	github.com/!masterminds/semver/v3							 v3.2.0 \
	github.com/!masterminds/sprig/v3							 v3.2.1 \
	github.com/!microsoft/go-winio								 v0.5.2 \
	github.com/agext/levenshtein								 v1.2.1 \
	github.com/alecthomas/template								 v0.0.0-20160405071501-a0175ee3bccc \
	github.com/alecthomas/units								 v0.0.0-20151022065526-2efee857e7cf \
	github.com/alecthomas/units								 v0.0.0-20190717042225-c3de453c63f4 \
	github.com/apparentlymart/go-versions							 v1.0.1 \
	github.com/armon/circbuf								 v0.0.0-20150827004946-bbbad097214e \
	github.com/armon/go-radix								 v0.0.0-20180808171621-7fddfc383310 \
	github.com/aws/aws-sdk-go-v2								 v1.41.7 \
	github.com/aws/aws-sdk-go-v2								 v1.43.1 \
	github.com/aws/aws-sdk-go-v2								 v1.43.4 \
	github.com/aws/aws-sdk-go-v2/aws/protocol/eventstream					 v1.7.15 \
	github.com/aws/aws-sdk-go-v2/aws/protocol/eventstream					 v1.7.16 \
	github.com/aws/aws-sdk-go-v2/config							 v1.32.32 \
	github.com/aws/aws-sdk-go-v2/credentials						 v1.19.31 \
	github.com/aws/aws-sdk-go-v2/feature/ec2/imds						 v1.18.32 \
	github.com/aws/aws-sdk-go-v2/feature/ec2/imds						 v1.18.35 \
	github.com/aws/aws-sdk-go-v2/internal/configsources					 v1.4.23 \
	github.com/aws/aws-sdk-go-v2/internal/configsources					 v1.4.32 \
	github.com/aws/aws-sdk-go-v2/internal/configsources					 v1.4.35 \
	github.com/aws/aws-sdk-go-v2/internal/endpoints/v2					 v2.7.23 \
	github.com/aws/aws-sdk-go-v2/internal/endpoints/v2					 v2.7.32 \
	github.com/aws/aws-sdk-go-v2/internal/endpoints/v2					 v2.7.35 \
	github.com/aws/aws-sdk-go-v2/internal/v4a						 v1.4.33 \
	github.com/aws/aws-sdk-go-v2/internal/v4a						 v1.4.36 \
	github.com/aws/aws-sdk-go-v2/service/dynamodb						 v1.57.4 \
	github.com/aws/aws-sdk-go-v2/service/dynamodb						 v1.62.1 \
	github.com/aws/aws-sdk-go-v2/service/internal/accept-encoding				 v1.13.14 \
	github.com/aws/aws-sdk-go-v2/service/internal/accept-encoding				 v1.13.15 \
	github.com/aws/aws-sdk-go-v2/service/internal/accept-encoding				 v1.13.9 \
	github.com/aws/aws-sdk-go-v2/service/internal/checksum					 v1.9.25 \
	github.com/aws/aws-sdk-go-v2/service/internal/checksum					 v1.9.28 \
	github.com/aws/aws-sdk-go-v2/service/internal/endpoint-discovery			 v1.12.0 \
	github.com/aws/aws-sdk-go-v2/service/internal/endpoint-discovery			 v1.12.9 \
	github.com/aws/aws-sdk-go-v2/service/internal/presigned-url				 v1.13.32 \
	github.com/aws/aws-sdk-go-v2/service/internal/presigned-url				 v1.13.35 \
	github.com/aws/aws-sdk-go-v2/service/internal/s3shared					 v1.19.33 \
	github.com/aws/aws-sdk-go-v2/service/internal/s3shared					 v1.19.36 \
	github.com/aws/aws-sdk-go-v2/service/s3							 v1.106.1 \
	github.com/aws/aws-sdk-go-v2/service/s3							 v1.106.5 \
	github.com/aws/aws-sdk-go-v2/service/signin						 v1.5.1 \
	github.com/aws/aws-sdk-go-v2/service/sqs						 v1.42.27 \
	github.com/aws/aws-sdk-go-v2/service/sso						 v1.33.1 \
	github.com/aws/aws-sdk-go-v2/service/ssooidc						 v1.38.1 \
	github.com/aws/aws-sdk-go-v2/service/sts						 v1.45.1 \
	github.com/aws/smithy-go								 v1.25.1 \
	github.com/aws/smithy-go								 v1.26.0 \
	github.com/aws/smithy-go								 v1.27.5 \
	github.com/aws/smithy-go								 v1.27.6 \
	github.com/beorn7/perks									 v0.0.0-20180321164747-3a771d992973 \
	github.com/beorn7/perks									 v1.0.0 \
	github.com/bgentry/speakeasy								 v0.1.0 \
	github.com/cespare/xxhash/v2								 v2.1.1 \
	github.com/cloudflare/circl								 v1.6.2 \
	github.com/cncf/xds/go									 v0.0.0-20250501225837-2ac532fd4443 \
	github.com/cncf/xds/go									 v0.0.0-20251110193048-8bfbf64dc13e \
	github.com/creack/pty									 v1.1.17 \
	github.com/creack/pty									 v1.1.9 \
	github.com/davecgh/go-spew								 v1.1.0 \
	github.com/davecgh/go-spew								 v1.1.1 \
	github.com/emicklei/go-restful/v3							 v3.11.0 \
	github.com/envoyproxy/go-control-plane/envoy						 v1.32.4 \
	github.com/envoyproxy/protoc-gen-validate						 v1.2.1 \
	github.com/envoyproxy/protoc-gen-validate						 v1.3.0 \
	github.com/fatih/color									 v1.13.0 \
	github.com/fatih/color									 v1.16.0 \
	github.com/fatih/color									 v1.7.0 \
	github.com/felixge/httpsnoop								 v1.0.4 \
	github.com/go-jose/go-jose/v4								 v4.0.5 \
	github.com/go-kit/kit									 v0.8.0 \
	github.com/go-logfmt/logfmt								 v0.3.0 \
	github.com/go-logr/logr									 v1.2.0 \
	github.com/go-logr/logr									 v1.2.2 \
	github.com/go-logr/logr									 v1.4.1 \
	github.com/go-logr/logr									 v1.4.2 \
	github.com/go-logr/logr									 v1.4.3 \
	github.com/go-openapi/jsonpointer							 v0.19.6 \
	github.com/go-openapi/jsonreference							 v0.20.1 \
	github.com/go-openapi/swag								 v0.22.3 \
	github.com/go-test/deep									 v1.0.1 \
	github.com/go-test/deep									 v1.0.3 \
	github.com/golang-jwt/jwt/v5								 v5.0.0 \
	github.com/golang-jwt/jwt/v5								 v5.2.2 \
	github.com/golang-jwt/jwt/v5								 v5.2.3 \
	github.com/golang-jwt/jwt/v5								 v5.3.0 \
	github.com/golang/protobuf								 v1.2.0 \
	github.com/golang/protobuf								 v1.3.1 \
	github.com/golang/protobuf								 v1.3.2 \
	github.com/golang/protobuf								 v1.5.0 \
	github.com/golang/protobuf								 v1.5.3 \
	github.com/google/go-cmp								 v0.3.0 \
	github.com/google/go-cmp								 v0.3.1 \
	github.com/google/go-cmp								 v0.4.0 \
	github.com/google/go-cmp								 v0.5.4 \
	github.com/google/go-cmp								 v0.5.5 \
	github.com/google/go-cmp								 v0.5.7 \
	github.com/google/go-cmp								 v0.5.9 \
	github.com/google/go-cmp								 v0.6.0 \
	github.com/google/go-querystring							 v1.0.0 \
	github.com/google/uuid									 v1.1.1 \
	github.com/google/uuid									 v1.1.2 \
	github.com/google/uuid									 v1.3.0 \
	github.com/google/uuid									 v1.3.1 \
	github.com/googleapis/enterprise-certificate-proxy					 v0.3.11 \
	github.com/googleapis/enterprise-certificate-proxy					 v0.3.15 \
	github.com/googleapis/enterprise-certificate-proxy					 v0.3.17 \
	github.com/googleapis/enterprise-certificate-proxy					 v0.3.19 \
	github.com/googleapis/enterprise-certificate-proxy					 v0.3.2 \
	github.com/googleapis/enterprise-certificate-proxy					 v0.3.5 \
	github.com/googleapis/enterprise-certificate-proxy					 v0.3.6 \
	github.com/googleapis/gax-go/v2								 v2.12.3 \
	github.com/googleapis/gax-go/v2								 v2.14.1 \
	github.com/googleapis/gax-go/v2								 v2.15.0 \
	github.com/googleapis/gax-go/v2								 v2.17.0 \
	github.com/googleapis/gax-go/v2								 v2.22.0 \
	github.com/googleapis/gax-go/v2								 v2.23.0 \
	github.com/hashicorp/errwrap								 v1.0.0 \
	github.com/hashicorp/go-cleanhttp							 v0.5.0 \
	github.com/hashicorp/go-hclog								 v1.5.0 \
	github.com/hashicorp/go-immutable-radix							 v1.0.0 \
	github.com/hashicorp/go-multierror							 v1.0.0 \
	github.com/hashicorp/go-retryablehttp							 v0.5.3 \
	github.com/hashicorp/go-retryablehttp							 v0.7.7 \
	github.com/hashicorp/go-sockaddr							 v1.0.6 \
	github.com/hashicorp/go-uuid								 v1.0.0 \
	github.com/hashicorp/go-uuid								 v1.0.1 \
	github.com/hashicorp/go-version								 v1.0.0 \
	github.com/hashicorp/go-version								 v1.2.1 \
	github.com/hashicorp/go-version								 v1.8.0 \
	github.com/hashicorp/golang-lru								 v0.5.0 \
	github.com/hashicorp/jsonapi								 v1.4.3-0.20250220162346-81a76b606f3e \
	github.com/huandu/xstrings								 v1.3.1 \
	github.com/huandu/xstrings								 v1.3.2 \
	github.com/imdario/mergo								 v0.3.11 \
	github.com/json-iterator/go								 v1.1.6 \
	github.com/json-iterator/go								 v1.1.9 \
	github.com/julienschmidt/httprouter							 v1.2.0 \
	github.com/klauspost/compress								 v1.19.1 \
	github.com/kr/pretty									 v0.1.0 \
	github.com/kr/pretty									 v0.2.1 \
	github.com/kr/pretty									 v0.3.0 \
	github.com/kr/text									 v0.1.0 \
	github.com/kylelemons/godebug								 v0.0.0-20170820004349-d65d576e9348 \
	github.com/mattn/go-colorable								 v0.0.9 \
	github.com/mattn/go-colorable								 v0.1.12 \
	github.com/mattn/go-colorable								 v0.1.13 \
	github.com/mattn/go-colorable								 v0.1.14 \
	github.com/mattn/go-colorable								 v0.1.9 \
	github.com/mattn/go-isatty								 v0.0.12 \
	github.com/mattn/go-isatty								 v0.0.14 \
	github.com/mattn/go-isatty								 v0.0.17 \
	github.com/mattn/go-isatty								 v0.0.20 \
	github.com/mattn/go-isatty								 v0.0.22 \
	github.com/mattn/go-isatty								 v0.0.3 \
	github.com/mitchellh/copystructure							 v1.0.0 \
	github.com/mitchellh/mapstructure							 v1.4.3 \
	github.com/mitchellh/reflectwalk							 v1.0.0 \
	github.com/modern-go/concurrent								 v0.0.0-20180228061459-e0a39a4cb421 \
	github.com/modern-go/reflect2								 v0.0.0-20180701023420-4b7aa43c6742 \
	github.com/modern-go/reflect2								 v1.0.1 \
	github.com/modern-go/reflect2								 v1.0.2 \
	github.com/mozillazg/go-httpheader							 v0.2.1 \
	github.com/mwitkow/go-conntrack								 v0.0.0-20161129095857-cc309e4a2223 \
	github.com/opentofu/svchost								 v0.0.0-20250515000052-8362671ed8ee \
	github.com/pkg/browser									 v0.0.0-20210911075715-681adbf594b8 \
	github.com/pkg/errors									 v0.8.0 \
	github.com/pkg/errors									 v0.8.1 \
	github.com/pmezard/go-difflib								 v1.0.0 \
	github.com/posener/complete								 v1.1.1 \
	github.com/prometheus/client_golang							 v0.9.1 \
	github.com/prometheus/client_golang							 v1.0.0 \
	github.com/prometheus/client_golang							 v1.23.2 \
	github.com/prometheus/client_golang							 v1.4.0 \
	github.com/prometheus/client_model							 v0.0.0-20180712105110-5c3871d89910 \
	github.com/prometheus/client_model							 v0.0.0-20190129233127-fd36f4220a90 \
	github.com/prometheus/client_model							 v0.2.0 \
	github.com/prometheus/common								 v0.4.1 \
	github.com/prometheus/common								 v0.66.1 \
	github.com/prometheus/common								 v0.9.1 \
	github.com/prometheus/procfs								 v0.0.0-20181005140218-185b4288413d \
	github.com/prometheus/procfs								 v0.0.2 \
	github.com/prometheus/procfs								 v0.0.8 \
	github.com/prometheus/procfs								 v0.16.1 \
	github.com/prometheus/procfs								 v0.21.0 \
	github.com/rogpeppe/go-internal								 v1.10.0 \
	github.com/rogpeppe/go-internal								 v1.12.0 \
	github.com/rogpeppe/go-internal								 v1.6.1 \
	github.com/shopspring/decimal								 v1.2.0 \
	github.com/sirupsen/logrus								 v1.2.0 \
	github.com/sirupsen/logrus								 v1.4.2 \
	github.com/sirupsen/logrus								 v1.7.0 \
	github.com/spf13/cast									 v1.3.1 \
	github.com/spf13/pflag									 v1.0.2 \
	github.com/spf13/pflag									 v1.0.5 \
	github.com/spiffe/go-spiffe/v2								 v2.5.0 \
	github.com/spiffe/go-spiffe/v2								 v2.6.0 \
	github.com/stretchr/objx								 v0.1.0 \
	github.com/stretchr/objx								 v0.1.1 \
	github.com/stretchr/objx								 v0.4.0 \
	github.com/stretchr/objx								 v0.5.0 \
	github.com/stretchr/testify								 v1.10.0 \
	github.com/stretchr/testify								 v1.2.2 \
	github.com/stretchr/testify								 v1.3.0 \
	github.com/stretchr/testify								 v1.4.0 \
	github.com/stretchr/testify								 v1.5.1 \
	github.com/stretchr/testify								 v1.6.1 \
	github.com/stretchr/testify								 v1.7.0 \
	github.com/stretchr/testify								 v1.7.1 \
	github.com/stretchr/testify								 v1.7.2 \
	github.com/stretchr/testify								 v1.8.0 \
	github.com/stretchr/testify								 v1.8.1 \
	github.com/stretchr/testify								 v1.8.4 \
	github.com/stretchr/testify								 v1.9.0 \
	github.com/tencentcloud/tencentcloud-sdk-go/tencentcloud/common				 v1.0.563 \
	github.com/tencentcloud/tencentcloud-sdk-go/tencentcloud/common				 v1.1.0 \
	github.com/tencentcloud/tencentcloud-sdk-go/tencentcloud/common				 v1.1.11 \
	github.com/zclconf/go-cty								 v1.0.0 \
	github.com/zclconf/go-cty								 v1.16.2 \
	github.com/zclconf/go-cty								 v1.2.0 \
	go.opentelemetry.io/auto/sdk								 v1.1.0 \
	go.opentelemetry.io/contrib/detectors/gcp						 v1.36.0 \
	go.opentelemetry.io/contrib/detectors/gcp						 v1.43.0 \
	go.opentelemetry.io/contrib/instrumentation/google.golang.org/grpc/otelgrpc		 v0.49.0 \
	go.opentelemetry.io/contrib/instrumentation/google.golang.org/grpc/otelgrpc		 v0.61.0 \
	go.opentelemetry.io/contrib/instrumentation/google.golang.org/grpc/otelgrpc		 v0.67.0 \
	go.opentelemetry.io/contrib/instrumentation/net/http/otelhttp				 v0.49.0 \
	go.opentelemetry.io/contrib/instrumentation/net/http/otelhttp				 v0.61.0 \
	go.opentelemetry.io/contrib/instrumentation/net/http/otelhttp				 v0.67.0 \
	go.opentelemetry.io/otel								 v1.24.0 \
	go.opentelemetry.io/otel								 v1.36.0 \
	go.opentelemetry.io/otel								 v1.38.0 \
	go.opentelemetry.io/otel								 v1.43.0 \
	go.opentelemetry.io/otel								 v1.44.0 \
	go.opentelemetry.io/otel/exporters/stdout/stdoutmetric					 v1.44.0 \
	go.opentelemetry.io/otel/metric								 v1.24.0 \
	go.opentelemetry.io/otel/metric								 v1.36.0 \
	go.opentelemetry.io/otel/metric								 v1.43.0 \
	go.opentelemetry.io/otel/metric								 v1.44.0 \
	go.opentelemetry.io/otel/sdk								 v1.36.0 \
	go.opentelemetry.io/otel/sdk								 v1.43.0 \
	go.opentelemetry.io/otel/sdk								 v1.44.0 \
	go.opentelemetry.io/otel/sdk/metric							 v1.36.0 \
	go.opentelemetry.io/otel/sdk/metric							 v1.43.0 \
	go.opentelemetry.io/otel/sdk/metric							 v1.44.0 \
	go.opentelemetry.io/otel/trace								 v1.24.0 \
	go.opentelemetry.io/otel/trace								 v1.36.0 \
	go.opentelemetry.io/otel/trace								 v1.38.0 \
	go.opentelemetry.io/otel/trace								 v1.43.0 \
	go.opentelemetry.io/otel/trace								 v1.44.0 \
	go.opentelemetry.io/proto/otlp								 v1.9.0 \
	go.uber.org/mock									 v0.4.0 \
	go.yaml.in/yaml/v2									 v2.4.2 \
	go.yaml.in/yaml/v2									 v2.4.3 \
	go.yaml.in/yaml/v3									 v3.0.3 \
	golang.org/x/crypto									 v0.0.0-20180904163835-0709b304e793 \
	golang.org/x/crypto									 v0.0.0-20190308221718-c2843e01d9a2 \
	golang.org/x/crypto									 v0.0.0-20190510104115-cbcb75029529 \
	golang.org/x/crypto									 v0.0.0-20200414173820-0848c9571904 \
	golang.org/x/crypto									 v0.0.0-20200820211705-5c72a883971a \
	golang.org/x/crypto									 v0.0.0-20210921155107-089bfa567519 \
	golang.org/x/crypto									 v0.0.0-20220622213112-05595931fe9d \
	golang.org/x/crypto									 v0.14.0 \
	golang.org/x/crypto									 v0.17.0 \
	golang.org/x/crypto									 v0.3.0 \
	golang.org/x/crypto									 v0.30.0 \
	golang.org/x/crypto									 v0.31.0 \
	golang.org/x/crypto									 v0.39.0 \
	golang.org/x/crypto									 v0.41.0 \
	golang.org/x/crypto									 v0.45.0 \
	golang.org/x/crypto									 v0.49.0 \
	golang.org/x/crypto									 v0.51.0 \
	golang.org/x/crypto									 v0.52.0 \
	golang.org/x/crypto									 v0.53.0 \
	golang.org/x/crypto									 v0.54.0 \
	golang.org/x/exp									 v0.0.0-20180321215751-8460e604b9de \
	golang.org/x/exp									 v0.0.0-20180807140117-3d87b88a115f \
	golang.org/x/exp									 v0.0.0-20190125153040-c74c464bbbf2 \
	golang.org/x/exp									 v0.0.0-20190306152737-a1d7652674e8 \
	golang.org/x/exp									 v0.0.0-20191030013958-a1ab85dbe136 \
	golang.org/x/image									 v0.0.0-20180708004352-c73c2afc3b81 \
	golang.org/x/image									 v0.0.0-20190227222117-0694c2d4d067 \
	golang.org/x/mod									 v0.1.0 \
	golang.org/x/mod									 v0.12.0 \
	golang.org/x/mod									 v0.26.0 \
	golang.org/x/mod									 v0.27.0 \
	golang.org/x/mod									 v0.29.0 \
	golang.org/x/mod									 v0.32.0 \
	golang.org/x/mod									 v0.33.0 \
	golang.org/x/mod									 v0.37.0 \
	golang.org/x/mod									 v0.38.0 \
	golang.org/x/mod									 v0.6.0-dev.0.20220419223038-86c51ed26bb4 \
	golang.org/x/mod									 v0.7.0 \
	golang.org/x/net									 v0.0.0-20181114220301-adae6a3d119a \
	golang.org/x/net									 v0.0.0-20190404232315-eb5bcb51f2a3 \
	golang.org/x/net									 v0.0.0-20190613194153-d28f0bde5980 \
	golang.org/x/net									 v0.0.0-20190620200207-3b0461eec859 \
	golang.org/x/net									 v0.0.0-20210226172049-e18ecbb05110 \
	golang.org/x/net									 v0.0.0-20211112202133-69e39bad7dc2 \
	golang.org/x/net									 v0.0.0-20220722155237-a158d28d115b \
	golang.org/x/net									 v0.14.0 \
	golang.org/x/net									 v0.17.0 \
	golang.org/x/net									 v0.2.0 \
	golang.org/x/net									 v0.33.0 \
	golang.org/x/net									 v0.37.0 \
	golang.org/x/net									 v0.38.0 \
	golang.org/x/net									 v0.40.0 \
	golang.org/x/net									 v0.41.0 \
	golang.org/x/net									 v0.42.0 \
	golang.org/x/net									 v0.43.0 \
	golang.org/x/net									 v0.47.0 \
	golang.org/x/net									 v0.48.0 \
	golang.org/x/net									 v0.49.0 \
	golang.org/x/net									 v0.52.0 \
	golang.org/x/net									 v0.55.0 \
	golang.org/x/net									 v0.56.0 \
	golang.org/x/oauth2									 v0.19.0 \
	golang.org/x/oauth2									 v0.28.0 \
	golang.org/x/oauth2									 v0.30.0 \
	golang.org/x/oauth2									 v0.34.0 \
	golang.org/x/sync									 v0.0.0-20181108010431-42b317875d0f \
	golang.org/x/sync									 v0.0.0-20181221193216-37e7f081c4d4 \
	golang.org/x/sync									 v0.0.0-20190423024810-112230192c58 \
	golang.org/x/sync									 v0.0.0-20190911185100-cd5d95a43a6e \
	golang.org/x/sync									 v0.0.0-20220722155255-886fb9371eb4 \
	golang.org/x/sync									 v0.10.0 \
	golang.org/x/sync									 v0.16.0 \
	golang.org/x/sync									 v0.18.0 \
	golang.org/x/sync									 v0.19.0 \
	golang.org/x/sync									 v0.20.0 \
	golang.org/x/sync									 v0.21.0 \
	golang.org/x/sys									 v0.0.0-20180905080454-ebe1bf3edb33 \
	golang.org/x/sys									 v0.0.0-20181116152217-5ac8a444bdc5 \
	golang.org/x/sys									 v0.0.0-20190215142949-d0b11bdaac8a \
	golang.org/x/sys									 v0.0.0-20190312061237-fead79001313 \
	golang.org/x/sys									 v0.0.0-20190412213103-97732733099d \
	golang.org/x/sys									 v0.0.0-20190422165155-953cdadca894 \
	golang.org/x/sys									 v0.0.0-20190509141414-a5b02f93d862 \
	golang.org/x/sys									 v0.0.0-20191026070338-33540a1f6037 \
	golang.org/x/sys									 v0.0.0-20200116001909-b77594299b42 \
	golang.org/x/sys									 v0.0.0-20200122134326-e047566fdf82 \
	golang.org/x/sys									 v0.0.0-20200223170610-d5e6a3e2c0ae \
	golang.org/x/sys									 v0.0.0-20201119102817-f84b799fce68 \
	golang.org/x/sys									 v0.0.0-20210124154548-22da62e12c0c \
	golang.org/x/sys									 v0.0.0-20210423082822-04245dca01da \
	golang.org/x/sys									 v0.0.0-20210615035016-665e8c7367d1 \
	golang.org/x/sys									 v0.0.0-20210630005230-0f9fa26af87c \
	golang.org/x/sys									 v0.0.0-20210927094055-39ccf1dd6fa6 \
	golang.org/x/sys									 v0.0.0-20220310020820-b874c991c1a5 \
	golang.org/x/sys									 v0.0.0-20220503163025-988cb79eb6c6 \
	golang.org/x/sys									 v0.0.0-20220520151302-bc2c85ada10a \
	golang.org/x/sys									 v0.0.0-20220715151400-c0bba94af5f8 \
	golang.org/x/sys									 v0.0.0-20220722155257-8c9f86f7a55f \
	golang.org/x/sys									 v0.1.0 \
	golang.org/x/sys									 v0.10.0 \
	golang.org/x/sys									 v0.11.0 \
	golang.org/x/sys									 v0.13.0 \
	golang.org/x/sys									 v0.15.0 \
	golang.org/x/sys									 v0.2.0 \
	golang.org/x/sys									 v0.20.0 \
	golang.org/x/sys									 v0.28.0 \
	golang.org/x/sys									 v0.29.0 \
	golang.org/x/sys									 v0.3.0 \
	golang.org/x/sys									 v0.31.0 \
	golang.org/x/sys									 v0.33.0 \
	golang.org/x/sys									 v0.34.0 \
	golang.org/x/sys									 v0.35.0 \
	golang.org/x/sys									 v0.38.0 \
	golang.org/x/sys									 v0.39.0 \
	golang.org/x/sys									 v0.40.0 \
	golang.org/x/sys									 v0.41.0 \
	golang.org/x/sys									 v0.42.0 \
	golang.org/x/sys									 v0.44.0 \
	golang.org/x/sys									 v0.45.0 \
	golang.org/x/sys									 v0.46.0 \
	golang.org/x/sys									 v0.5.0 \
	golang.org/x/term									 v0.0.0-20201126162022-7de9c90e9dd1 \
	golang.org/x/term									 v0.0.0-20210927222741-03fcf44c2211 \
	golang.org/x/term									 v0.2.0 \
	golang.org/x/term									 v0.37.0 \
	golang.org/x/term									 v0.39.0 \
	golang.org/x/text									 v0.11.0 \
	golang.org/x/text									 v0.12.0 \
	golang.org/x/text									 v0.13.0 \
	golang.org/x/text									 v0.21.0 \
	golang.org/x/text									 v0.23.0 \
	golang.org/x/text									 v0.25.0 \
	golang.org/x/text									 v0.26.0 \
	golang.org/x/text									 v0.27.0 \
	golang.org/x/text									 v0.28.0 \
	golang.org/x/text									 v0.3.0 \
	golang.org/x/text									 v0.3.3 \
	golang.org/x/text									 v0.3.6 \
	golang.org/x/text									 v0.3.7 \
	golang.org/x/text									 v0.31.0 \
	golang.org/x/text									 v0.32.0 \
	golang.org/x/text									 v0.33.0 \
	golang.org/x/text									 v0.35.0 \
	golang.org/x/text									 v0.36.0 \
	golang.org/x/text									 v0.37.0 \
	golang.org/x/text									 v0.38.0 \
	golang.org/x/text									 v0.4.0 \
	golang.org/x/text									 v0.40.0 \
	golang.org/x/time									 v0.12.0 \
	golang.org/x/time									 v0.14.0 \
	golang.org/x/time									 v0.5.0 \
	golang.org/x/tools									 v0.0.0-20180525024113-a5b4c53f6e8b \
	golang.org/x/tools									 v0.0.0-20180917221912-90fa682c2a6e \
	golang.org/x/tools									 v0.0.0-20190206041539-40960b6deb8e \
	golang.org/x/tools									 v0.0.0-20191012152004-8de300cfc20a \
	golang.org/x/tools									 v0.0.0-20191119224855-298f0cb1881e \
	golang.org/x/tools									 v0.1.12 \
	golang.org/x/tools									 v0.11.0 \
	golang.org/x/tools									 v0.36.0 \
	golang.org/x/tools									 v0.38.0 \
	golang.org/x/tools									 v0.4.1-0.20221208213631-3f74d914ae6d \
	golang.org/x/tools									 v0.41.0 \
	golang.org/x/tools									 v0.42.0 \
	golang.org/x/tools									 v0.47.0 \
	golang.org/x/tools/go/expect								 v0.1.0-deprecated \
	golang.org/x/xerrors									 v0.0.0-20190717185122-a985d3407aa7 \
	golang.org/x/xerrors									 v0.0.0-20191204190536-9bdfabe68543 \
	gonum.org/v1/gonum									 v0.0.0-20180816165407-929014505bf4 \
	gonum.org/v1/gonum									 v0.8.2 \
	google.golang.org/api									 v0.177.0 \
	google.golang.org/api									 v0.247.0 \
	google.golang.org/api									 v0.280.0 \
	google.golang.org/api									 v0.287.1 \
	google.golang.org/api									 v0.288.0 \
	google.golang.org/api									 v0.292.0 \
	google.golang.org/genproto								 v0.0.0-20250603155806-513f23925822 \
	google.golang.org/genproto								 v0.0.0-20260319201613-d00831a3d3e7 \
	google.golang.org/genproto								 v0.0.0-20260519071638-aa98bba5eb94 \
	google.golang.org/genproto/googleapis/api						 v0.0.0-20240429193739-8cf5692501f6 \
	google.golang.org/genproto/googleapis/api						 v0.0.0-20250721164621-a45f3dfb1074 \
	google.golang.org/genproto/googleapis/api						 v0.0.0-20250804133106-a7a43d27e69b \
	google.golang.org/genproto/googleapis/api						 v0.0.0-20251029180050-ab9386a59fda \
	google.golang.org/genproto/googleapis/api						 v0.0.0-20260414002931-afd174a4e478 \
	google.golang.org/genproto/googleapis/api						 v0.0.0-20260519071638-aa98bba5eb94 \
	google.golang.org/genproto/googleapis/api						 v0.0.0-20260526163538-3dc84a4a5aaa \
	google.golang.org/genproto/googleapis/api						 v0.0.0-20260630182238-925bb5da69e7 \
	google.golang.org/genproto/googleapis/api						 v0.0.0-20260715232425-e75dac1f907d \
	google.golang.org/genproto/googleapis/api						 v0.0.0-20260720211330-0afa2a65878a \
	google.golang.org/genproto/googleapis/rpc						 v0.0.0-20230822172742-b8732ec3820d \
	google.golang.org/genproto/googleapis/rpc						 v0.0.0-20231106174013-bbf56f31fb17 \
	google.golang.org/genproto/googleapis/rpc						 v0.0.0-20240429193739-8cf5692501f6 \
	google.golang.org/genproto/googleapis/rpc						 v0.0.0-20250227231956-55c901821b1e \
	google.golang.org/genproto/googleapis/rpc						 v0.0.0-20250804133106-a7a43d27e69b \
	google.golang.org/genproto/googleapis/rpc						 v0.0.0-20250818200422-3122310a409c \
	google.golang.org/genproto/googleapis/rpc						 v0.0.0-20251029180050-ab9386a59fda \
	google.golang.org/genproto/googleapis/rpc						 v0.0.0-20251202230838-ff82c1b0f217 \
	google.golang.org/genproto/googleapis/rpc						 v0.0.0-20260406210006-6f92a3bedf2d \
	google.golang.org/genproto/googleapis/rpc						 v0.0.0-20260414002931-afd174a4e478 \
	google.golang.org/genproto/googleapis/rpc						 v0.0.0-20260519071638-aa98bba5eb94 \
	google.golang.org/genproto/googleapis/rpc						 v0.0.0-20260526163538-3dc84a4a5aaa \
	google.golang.org/genproto/googleapis/rpc						 v0.0.0-20260630182238-925bb5da69e7 \
	google.golang.org/genproto/googleapis/rpc						 v0.0.0-20260715232425-e75dac1f907d \
	google.golang.org/genproto/googleapis/rpc						 v0.0.0-20260720211330-0afa2a65878a \
	google.golang.org/genproto/googleapis/rpc						 v0.0.0-20260729162451-8efbd57d26e0 \
	google.golang.org/genproto/googleapis/rpc						 v0.0.0-20260803160001-6ac0973c030d \
	google.golang.org/grpc									 v1.58.2 \
	google.golang.org/grpc									 v1.61.0 \
	google.golang.org/grpc									 v1.63.2 \
	google.golang.org/grpc									 v1.71.0 \
	google.golang.org/grpc									 v1.74.2 \
	google.golang.org/grpc									 v1.76.0 \
	google.golang.org/grpc									 v1.78.0 \
	google.golang.org/grpc									 v1.79.3 \
	google.golang.org/grpc									 v1.80.0 \
	google.golang.org/grpc									 v1.81.1 \
	google.golang.org/grpc									 v1.82.0 \
	google.golang.org/grpc									 v1.82.1 \
	google.golang.org/grpc									 v1.83.0 \
	google.golang.org/protobuf								 v1.28.1 \
	google.golang.org/protobuf								 v1.31.0 \
	google.golang.org/protobuf								 v1.33.0 \
	google.golang.org/protobuf								 v1.34.2 \
	google.golang.org/protobuf								 v1.35.1 \
	google.golang.org/protobuf								 v1.36.10 \
	google.golang.org/protobuf								 v1.36.11 \
	google.golang.org/protobuf								 v1.36.12-0.20260120151049-f2248ac996af \
	google.golang.org/protobuf								 v1.36.6 \
	google.golang.org/protobuf								 v1.36.7 \
	google.golang.org/protobuf								 v1.36.8 \
	gopkg.in/check.v1									 v0.0.0-20161208181325-20d25e280405 \
	gopkg.in/check.v1									 v1.0.0-20180628173108-788fd7840127 \
	gopkg.in/check.v1									 v1.0.0-20190902080502-41f04d3bba15 \
	gopkg.in/check.v1									 v1.0.0-20200227125254-8fa46927fb4f \
	gopkg.in/yaml.v2									 v2.2.1 \
	gopkg.in/yaml.v2									 v2.2.2 \
	gopkg.in/yaml.v2									 v2.2.4 \
	gopkg.in/yaml.v2									 v2.2.5 \
	gopkg.in/yaml.v2									 v2.2.8 \
	gopkg.in/yaml.v2									 v2.3.0 \
	gopkg.in/yaml.v3									 v3.0.0 \
	gopkg.in/yaml.v3									 v3.0.0-20200313102051-9f266ea9e77c \
	k8s.io/klog/v2										 v2.130.1 \
	k8s.io/klog/v2										 v2.80.1 \
	k8s.io/utils										 v0.0.0-20240711033017-18e509b52bc8 \
	k8s.io/utils										 v0.0.0-20260210185600-b8788abfbbc2 \
	sigs.k8s.io/json									 v0.0.0-20221116044647-bc3834ca7abd \
	sigs.k8s.io/randfill									 v0.0.0-20250304075658-069ef1bbf016 \
	sigs.k8s.io/structured-merge-diff/v6							 v6.2.0 \
	sigs.k8s.io/yaml									 v1.4.0

