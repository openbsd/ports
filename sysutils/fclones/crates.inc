MODCARGO_CRATES +=	aho-corasick	1.1.2	# Unlicense OR MIT
MODCARGO_CRATES +=	android-tzdata	0.1.1	# MIT OR Apache-2.0
MODCARGO_CRATES +=	android_system_properties	0.1.5	# MIT/Apache-2.0
MODCARGO_CRATES +=	ansi-escapes	0.1.1	# MIT
MODCARGO_CRATES +=	anstream	0.6.4	# MIT OR Apache-2.0
MODCARGO_CRATES +=	anstyle	1.0.4	# MIT OR Apache-2.0
MODCARGO_CRATES +=	anstyle-parse	0.2.2	# MIT OR Apache-2.0
MODCARGO_CRATES +=	anstyle-query	1.0.0	# MIT OR Apache-2.0
MODCARGO_CRATES +=	anstyle-wincon	3.0.1	# MIT OR Apache-2.0
MODCARGO_CRATES +=	arrayref	0.3.7	# BSD-2-Clause
MODCARGO_CRATES +=	arrayvec	0.7.4	# MIT OR Apache-2.0
MODCARGO_CRATES +=	assert_matches	1.5.0	# MIT/Apache-2.0
MODCARGO_CRATES +=	atty	0.2.14	# MIT
MODCARGO_CRATES +=	autocfg	1.1.0	# Apache-2.0 OR MIT
MODCARGO_CRATES +=	bincode	1.3.3	# MIT
MODCARGO_CRATES +=	bitflags	1.3.2	# MIT/Apache-2.0
MODCARGO_CRATES +=	bitflags	2.4.1	# MIT OR Apache-2.0
MODCARGO_CRATES +=	blake3	1.5.0	# CC0-1.0 OR Apache-2.0
MODCARGO_CRATES +=	block-buffer	0.10.4	# MIT OR Apache-2.0
MODCARGO_CRATES +=	bstr	1.7.0	# MIT OR Apache-2.0
MODCARGO_CRATES +=	bumpalo	3.14.0	# MIT OR Apache-2.0
MODCARGO_CRATES +=	byte-unit	4.0.19	# MIT
MODCARGO_CRATES +=	byteorder	1.5.0	# Unlicense OR MIT
MODCARGO_CRATES +=	bytesize	1.3.0	# Apache-2.0
MODCARGO_CRATES +=	cc	1.0.83	# MIT OR Apache-2.0
MODCARGO_CRATES +=	cfg-if	1.0.0	# MIT/Apache-2.0
MODCARGO_CRATES +=	chrono	0.4.31	# MIT OR Apache-2.0
MODCARGO_CRATES +=	clap	4.4.6	# MIT OR Apache-2.0
MODCARGO_CRATES +=	clap_builder	4.4.6	# MIT OR Apache-2.0
MODCARGO_CRATES +=	clap_derive	4.4.2	# MIT OR Apache-2.0
MODCARGO_CRATES +=	clap_lex	0.5.1	# MIT OR Apache-2.0
MODCARGO_CRATES +=	colorchoice	1.0.0	# MIT OR Apache-2.0
MODCARGO_CRATES +=	console	0.15.7	# MIT
MODCARGO_CRATES +=	constant_time_eq	0.3.0	# CC0-1.0 OR MIT-0 OR Apache-2.0
MODCARGO_CRATES +=	core-foundation-sys	0.8.4	# MIT / Apache-2.0
MODCARGO_CRATES +=	cpufeatures	0.2.9	# MIT OR Apache-2.0
MODCARGO_CRATES +=	crc32fast	1.3.2	# MIT OR Apache-2.0
MODCARGO_CRATES +=	crossbeam-channel	0.5.8	# MIT OR Apache-2.0
MODCARGO_CRATES +=	crossbeam-deque	0.8.3	# MIT OR Apache-2.0
MODCARGO_CRATES +=	crossbeam-epoch	0.9.15	# MIT OR Apache-2.0
MODCARGO_CRATES +=	crossbeam-utils	0.8.16	# MIT OR Apache-2.0
MODCARGO_CRATES +=	crypto-common	0.1.6	# MIT OR Apache-2.0
MODCARGO_CRATES +=	csv	1.3.0	# Unlicense/MIT
MODCARGO_CRATES +=	csv-core	0.1.11	# Unlicense/MIT
MODCARGO_CRATES +=	dashmap	5.5.3	# MIT
MODCARGO_CRATES +=	digest	0.10.7	# MIT OR Apache-2.0
MODCARGO_CRATES +=	dirs	5.0.1	# MIT OR Apache-2.0
MODCARGO_CRATES +=	dirs-sys	0.4.1	# MIT OR Apache-2.0
MODCARGO_CRATES +=	dtparse	2.0.0	# Apache-2.0
MODCARGO_CRATES +=	dunce	1.0.4	# CC0-1.0 OR MIT-0 OR Apache-2.0
MODCARGO_CRATES +=	either	1.9.0	# MIT OR Apache-2.0
MODCARGO_CRATES +=	encode_unicode	0.3.6	# MIT/Apache-2.0
MODCARGO_CRATES +=	equivalent	1.0.1	# Apache-2.0 OR MIT
MODCARGO_CRATES +=	errno	0.3.5	# MIT OR Apache-2.0
MODCARGO_CRATES +=	fallible-iterator	0.3.0	# MIT/Apache-2.0
MODCARGO_CRATES +=	fastrand	2.0.1	# Apache-2.0 OR MIT
MODCARGO_CRATES +=	fiemap	0.1.1	# BSD-2-Clause
MODCARGO_CRATES +=	file-owner	0.1.2	# MIT
MODCARGO_CRATES +=	filetime	0.2.22	# MIT/Apache-2.0
MODCARGO_CRATES +=	fnv	1.0.7	# Apache-2.0 / MIT
MODCARGO_CRATES +=	fs2	0.4.3	# MIT/Apache-2.0
MODCARGO_CRATES +=	fxhash	0.2.1	# Apache-2.0/MIT
MODCARGO_CRATES +=	generic-array	0.14.7	# MIT
MODCARGO_CRATES +=	getrandom	0.2.10	# MIT OR Apache-2.0
MODCARGO_CRATES +=	globset	0.4.13	# Unlicense OR MIT
MODCARGO_CRATES +=	hashbrown	0.12.3	# MIT OR Apache-2.0
MODCARGO_CRATES +=	hashbrown	0.14.2	# MIT OR Apache-2.0
MODCARGO_CRATES +=	heck	0.4.1	# MIT OR Apache-2.0
MODCARGO_CRATES +=	hermit-abi	0.1.19	# MIT/Apache-2.0
MODCARGO_CRATES +=	hermit-abi	0.3.3	# MIT OR Apache-2.0
MODCARGO_CRATES +=	hex	0.4.3	# MIT OR Apache-2.0
MODCARGO_CRATES +=	iana-time-zone	0.1.58	# MIT OR Apache-2.0
MODCARGO_CRATES +=	iana-time-zone-haiku	0.1.2	# MIT OR Apache-2.0
MODCARGO_CRATES +=	ignore	0.4.20	# Unlicense OR MIT
MODCARGO_CRATES +=	indexmap	1.9.3	# Apache-2.0 OR MIT
MODCARGO_CRATES +=	indexmap	2.0.2	# Apache-2.0 OR MIT
MODCARGO_CRATES +=	instant	0.1.12	# BSD-3-Clause
MODCARGO_CRATES +=	itertools	0.11.0	# MIT OR Apache-2.0
MODCARGO_CRATES +=	itoa	1.0.9	# MIT OR Apache-2.0
MODCARGO_CRATES +=	js-sys	0.3.64	# MIT/Apache-2.0
MODCARGO_CRATES +=	keccak	0.1.4	# Apache-2.0 OR MIT
MODCARGO_CRATES +=	lazy-init	0.5.1	# Apache-2.0/MIT
MODCARGO_CRATES +=	lazy_static	1.4.0	# MIT/Apache-2.0
MODCARGO_CRATES +=	libc	0.2.149	# MIT OR Apache-2.0
MODCARGO_CRATES +=	linux-raw-sys	0.4.10	# Apache-2.0 WITH LLVM-exception OR Apache-2.0 OR MIT
MODCARGO_CRATES +=	lock_api	0.4.11	# MIT OR Apache-2.0
MODCARGO_CRATES +=	log	0.4.20	# MIT OR Apache-2.0
MODCARGO_CRATES +=	maplit	1.0.2	# MIT/Apache-2.0
MODCARGO_CRATES +=	memchr	2.6.4	# Unlicense OR MIT
MODCARGO_CRATES +=	memoffset	0.9.0	# MIT
MODCARGO_CRATES +=	metrohash	1.0.6	# MIT
MODCARGO_CRATES +=	minimal-lexical	0.2.1	# MIT/Apache-2.0
MODCARGO_CRATES +=	nix	0.27.1	# MIT
MODCARGO_CRATES +=	nom	7.1.3	# MIT
MODCARGO_CRATES +=	nom-regex	0.2.0	# MIT
MODCARGO_CRATES +=	ntapi	0.4.1	# Apache-2.0 OR MIT
MODCARGO_CRATES +=	num-traits	0.2.17	# MIT OR Apache-2.0
MODCARGO_CRATES +=	num_cpus	1.16.0	# MIT OR Apache-2.0
MODCARGO_CRATES +=	once_cell	1.18.0	# MIT OR Apache-2.0
MODCARGO_CRATES +=	option-ext	0.2.0	# MPL-2.0
MODCARGO_CRATES +=	parking_lot	0.11.2	# Apache-2.0/MIT
MODCARGO_CRATES +=	parking_lot_core	0.8.6	# Apache-2.0/MIT
MODCARGO_CRATES +=	parking_lot_core	0.9.9	# MIT OR Apache-2.0
MODCARGO_CRATES +=	pin-project	1.1.3	# Apache-2.0 OR MIT
MODCARGO_CRATES +=	pin-project-internal	1.1.3	# Apache-2.0 OR MIT
MODCARGO_CRATES +=	ppv-lite86	0.2.17	# MIT/Apache-2.0
MODCARGO_CRATES +=	priority-queue	1.3.2	# LGPL-3.0 OR MPL-2.0
MODCARGO_CRATES +=	proc-macro2	1.0.69	# MIT OR Apache-2.0
MODCARGO_CRATES +=	quote	1.0.33	# MIT OR Apache-2.0
MODCARGO_CRATES +=	rand	0.8.5	# MIT OR Apache-2.0
MODCARGO_CRATES +=	rand_chacha	0.3.1	# MIT OR Apache-2.0
MODCARGO_CRATES +=	rand_core	0.6.4	# MIT OR Apache-2.0
MODCARGO_CRATES +=	rayon	1.8.0	# MIT OR Apache-2.0
MODCARGO_CRATES +=	rayon-core	1.12.0	# MIT OR Apache-2.0
MODCARGO_CRATES +=	redox_syscall	0.2.16	# MIT
MODCARGO_CRATES +=	redox_syscall	0.3.5	# MIT
MODCARGO_CRATES +=	redox_syscall	0.4.1	# MIT
MODCARGO_CRATES +=	redox_users	0.4.3	# MIT
MODCARGO_CRATES +=	reflink	0.1.3	# MIT/Apache-2.0
MODCARGO_CRATES +=	regex	1.10.2	# MIT OR Apache-2.0
MODCARGO_CRATES +=	regex-automata	0.4.3	# MIT OR Apache-2.0
MODCARGO_CRATES +=	regex-syntax	0.8.2	# MIT OR Apache-2.0
MODCARGO_CRATES +=	rust_decimal	1.32.0	# MIT
MODCARGO_CRATES +=	rustix	0.38.20	# Apache-2.0 WITH LLVM-exception OR Apache-2.0 OR MIT
MODCARGO_CRATES +=	ryu	1.0.15	# Apache-2.0 OR BSL-1.0
MODCARGO_CRATES +=	same-file	1.0.6	# Unlicense/MIT
MODCARGO_CRATES +=	scopeguard	1.2.0	# MIT OR Apache-2.0
MODCARGO_CRATES +=	serde	1.0.189	# MIT OR Apache-2.0
MODCARGO_CRATES +=	serde_derive	1.0.189	# MIT OR Apache-2.0
MODCARGO_CRATES +=	serde_json	1.0.107	# MIT OR Apache-2.0
MODCARGO_CRATES +=	serde_test	1.0.176	# MIT OR Apache-2.0
MODCARGO_CRATES +=	sha2	0.10.8	# MIT OR Apache-2.0
MODCARGO_CRATES +=	sha3	0.10.8	# MIT OR Apache-2.0
MODCARGO_CRATES +=	sled	0.34.7	# MIT/Apache-2.0
MODCARGO_CRATES +=	smallvec	1.11.1	# MIT OR Apache-2.0
MODCARGO_CRATES +=	status-line	0.2.0	# MIT
MODCARGO_CRATES +=	stfu8	0.2.6	# MIT OR Apache-2.0
MODCARGO_CRATES +=	strsim	0.10.0	# MIT
MODCARGO_CRATES +=	syn	2.0.38	# MIT OR Apache-2.0
MODCARGO_CRATES +=	sysinfo	0.29.10	# MIT
MODCARGO_CRATES +=	tempfile	3.8.0	# MIT OR Apache-2.0
MODCARGO_CRATES +=	terminal_size	0.3.0	# MIT OR Apache-2.0
MODCARGO_CRATES +=	thiserror	1.0.50	# MIT OR Apache-2.0
MODCARGO_CRATES +=	thiserror-impl	1.0.50	# MIT OR Apache-2.0
MODCARGO_CRATES +=	thread_local	1.1.7	# MIT OR Apache-2.0
MODCARGO_CRATES +=	typed-sled	0.2.3	# MIT
MODCARGO_CRATES +=	typenum	1.17.0	# MIT OR Apache-2.0
MODCARGO_CRATES +=	unicode-ident	1.0.12	# (MIT OR Apache-2.0) AND Unicode-DFS-2016
MODCARGO_CRATES +=	unicode-width	0.1.11	# MIT/Apache-2.0
MODCARGO_CRATES +=	utf8-width	0.1.6	# MIT
MODCARGO_CRATES +=	utf8parse	0.2.1	# Apache-2.0 OR MIT
MODCARGO_CRATES +=	uuid	1.5.0	# Apache-2.0 OR MIT
MODCARGO_CRATES +=	version_check	0.9.4	# MIT/Apache-2.0
MODCARGO_CRATES +=	walkdir	2.4.0	# Unlicense/MIT
MODCARGO_CRATES +=	wasi	0.11.0+wasi-snapshot-preview1	# Apache-2.0 WITH LLVM-exception OR Apache-2.0 OR MIT
MODCARGO_CRATES +=	wasm-bindgen	0.2.87	# MIT/Apache-2.0
MODCARGO_CRATES +=	wasm-bindgen-backend	0.2.87	# MIT/Apache-2.0
MODCARGO_CRATES +=	wasm-bindgen-macro	0.2.87	# MIT/Apache-2.0
MODCARGO_CRATES +=	wasm-bindgen-macro-support	0.2.87	# MIT/Apache-2.0
MODCARGO_CRATES +=	wasm-bindgen-shared	0.2.87	# MIT/Apache-2.0
MODCARGO_CRATES +=	winapi	0.3.9	# MIT/Apache-2.0
MODCARGO_CRATES +=	winapi-i686-pc-windows-gnu	0.4.0	# MIT/Apache-2.0
MODCARGO_CRATES +=	winapi-util	0.1.6	# Unlicense/MIT
MODCARGO_CRATES +=	winapi-x86_64-pc-windows-gnu	0.4.0	# MIT/Apache-2.0
MODCARGO_CRATES +=	windows-core	0.51.1	# MIT OR Apache-2.0
MODCARGO_CRATES +=	windows-sys	0.45.0	# MIT OR Apache-2.0
MODCARGO_CRATES +=	windows-sys	0.48.0	# MIT OR Apache-2.0
MODCARGO_CRATES +=	windows-targets	0.42.2	# MIT OR Apache-2.0
MODCARGO_CRATES +=	windows-targets	0.48.5	# MIT OR Apache-2.0
MODCARGO_CRATES +=	windows_aarch64_gnullvm	0.42.2	# MIT OR Apache-2.0
MODCARGO_CRATES +=	windows_aarch64_gnullvm	0.48.5	# MIT OR Apache-2.0
MODCARGO_CRATES +=	windows_aarch64_msvc	0.42.2	# MIT OR Apache-2.0
MODCARGO_CRATES +=	windows_aarch64_msvc	0.48.5	# MIT OR Apache-2.0
MODCARGO_CRATES +=	windows_i686_gnu	0.42.2	# MIT OR Apache-2.0
MODCARGO_CRATES +=	windows_i686_gnu	0.48.5	# MIT OR Apache-2.0
MODCARGO_CRATES +=	windows_i686_msvc	0.42.2	# MIT OR Apache-2.0
MODCARGO_CRATES +=	windows_i686_msvc	0.48.5	# MIT OR Apache-2.0
MODCARGO_CRATES +=	windows_x86_64_gnu	0.42.2	# MIT OR Apache-2.0
MODCARGO_CRATES +=	windows_x86_64_gnu	0.48.5	# MIT OR Apache-2.0
MODCARGO_CRATES +=	windows_x86_64_gnullvm	0.42.2	# MIT OR Apache-2.0
MODCARGO_CRATES +=	windows_x86_64_gnullvm	0.48.5	# MIT OR Apache-2.0
MODCARGO_CRATES +=	windows_x86_64_msvc	0.42.2	# MIT OR Apache-2.0
MODCARGO_CRATES +=	windows_x86_64_msvc	0.48.5	# MIT OR Apache-2.0
MODCARGO_CRATES +=	xattr	1.0.1	# MIT/Apache-2.0
MODCARGO_CRATES +=	xxhash-rust	0.8.7	# BSL-1.0
