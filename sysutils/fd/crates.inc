MODCARGO_CRATES +=	aho-corasick	1.1.4	# Unlicense OR MIT
MODCARGO_CRATES +=	anstream	0.6.21	# MIT OR Apache-2.0
MODCARGO_CRATES +=	anstyle	1.0.13	# MIT OR Apache-2.0
MODCARGO_CRATES +=	anstyle-parse	0.2.7	# MIT OR Apache-2.0
MODCARGO_CRATES +=	anstyle-query	1.1.5	# MIT OR Apache-2.0
MODCARGO_CRATES +=	anstyle-wincon	3.0.11	# MIT OR Apache-2.0
MODCARGO_CRATES +=	anyhow	1.0.102	# MIT OR Apache-2.0
MODCARGO_CRATES +=	argmax	0.4.0	# MIT/Apache-2.0
MODCARGO_CRATES +=	bitflags	1.3.2	# MIT/Apache-2.0
MODCARGO_CRATES +=	bitflags	2.11.0	# MIT OR Apache-2.0
MODCARGO_CRATES +=	block2	0.6.2	# MIT
MODCARGO_CRATES +=	bstr	1.12.1	# MIT OR Apache-2.0
MODCARGO_CRATES +=	cc	1.2.56	# MIT OR Apache-2.0
MODCARGO_CRATES +=	cfg-if	1.0.4	# MIT OR Apache-2.0
MODCARGO_CRATES +=	cfg_aliases	0.2.1	# MIT
MODCARGO_CRATES +=	clap	4.5.60	# MIT OR Apache-2.0
MODCARGO_CRATES +=	clap_builder	4.5.60	# MIT OR Apache-2.0
MODCARGO_CRATES +=	clap_complete	4.5.66	# MIT OR Apache-2.0
MODCARGO_CRATES +=	clap_derive	4.5.55	# MIT OR Apache-2.0
MODCARGO_CRATES +=	clap_lex	1.0.0	# MIT OR Apache-2.0
MODCARGO_CRATES +=	colorchoice	1.0.4	# MIT OR Apache-2.0
MODCARGO_CRATES +=	crossbeam-channel	0.5.15	# MIT OR Apache-2.0
MODCARGO_CRATES +=	crossbeam-deque	0.8.6	# MIT OR Apache-2.0
MODCARGO_CRATES +=	crossbeam-epoch	0.9.18	# MIT OR Apache-2.0
MODCARGO_CRATES +=	crossbeam-utils	0.8.21	# MIT OR Apache-2.0
MODCARGO_CRATES +=	ctrlc	3.5.2	# MIT/Apache-2.0
MODCARGO_CRATES +=	diff	0.1.13	# MIT OR Apache-2.0
MODCARGO_CRATES +=	dispatch2	0.3.1	# Zlib OR Apache-2.0 OR MIT
MODCARGO_CRATES +=	equivalent	1.0.2	# Apache-2.0 OR MIT
MODCARGO_CRATES +=	errno	0.3.14	# MIT OR Apache-2.0
MODCARGO_CRATES +=	etcetera	0.11.0	# MIT OR Apache-2.0
MODCARGO_CRATES +=	faccess	0.2.4	# MIT
MODCARGO_CRATES +=	fastrand	2.3.0	# Apache-2.0 OR MIT
MODCARGO_CRATES +=	filetime	0.2.27	# MIT/Apache-2.0
MODCARGO_CRATES +=	find-msvc-tools	0.1.9	# MIT OR Apache-2.0
MODCARGO_CRATES +=	foldhash	0.1.5	# Zlib
MODCARGO_CRATES +=	getrandom	0.4.2	# MIT OR Apache-2.0
MODCARGO_CRATES +=	globset	0.4.18	# Unlicense OR MIT
MODCARGO_CRATES +=	hashbrown	0.15.5	# MIT OR Apache-2.0
MODCARGO_CRATES +=	hashbrown	0.16.1	# MIT OR Apache-2.0
MODCARGO_CRATES +=	heck	0.5.0	# MIT OR Apache-2.0
MODCARGO_CRATES +=	id-arena	2.3.0	# MIT/Apache-2.0
MODCARGO_CRATES +=	ignore	0.4.25	# Unlicense OR MIT
MODCARGO_CRATES +=	indexmap	2.13.0	# Apache-2.0 OR MIT
MODCARGO_CRATES +=	is_terminal_polyfill	1.70.2	# MIT OR Apache-2.0
MODCARGO_CRATES +=	itoa	1.0.17	# MIT OR Apache-2.0
MODCARGO_CRATES +=	jiff	0.2.23	# Unlicense OR MIT
MODCARGO_CRATES +=	jiff-static	0.2.23	# Unlicense OR MIT
MODCARGO_CRATES +=	jiff-tzdb	0.1.6	# Unlicense OR MIT
MODCARGO_CRATES +=	jiff-tzdb-platform	0.1.3	# Unlicense OR MIT
MODCARGO_CRATES +=	leb128fmt	0.1.0	# MIT OR Apache-2.0
MODCARGO_CRATES +=	libc	0.2.183	# MIT OR Apache-2.0
MODCARGO_CRATES +=	libredox	0.1.14	# MIT
MODCARGO_CRATES +=	linux-raw-sys	0.12.1	# Apache-2.0 WITH LLVM-exception OR Apache-2.0 OR MIT
MODCARGO_CRATES +=	log	0.4.29	# MIT OR Apache-2.0
MODCARGO_CRATES +=	lscolors	0.21.0	# MIT/Apache-2.0
MODCARGO_CRATES +=	memchr	2.8.0	# Unlicense OR MIT
MODCARGO_CRATES +=	nix	0.30.1	# MIT
MODCARGO_CRATES +=	nix	0.31.2	# MIT
MODCARGO_CRATES +=	normpath	1.5.0	# MIT OR Apache-2.0
MODCARGO_CRATES +=	nu-ansi-term	0.50.3	# MIT
MODCARGO_CRATES +=	objc2	0.6.4	# MIT
MODCARGO_CRATES +=	objc2-encode	4.1.0	# MIT
MODCARGO_CRATES +=	once_cell	1.21.3	# MIT OR Apache-2.0
MODCARGO_CRATES +=	once_cell_polyfill	1.70.2	# MIT OR Apache-2.0
MODCARGO_CRATES +=	plain	0.2.3	# MIT/Apache-2.0
MODCARGO_CRATES +=	portable-atomic	1.13.1	# Apache-2.0 OR MIT
MODCARGO_CRATES +=	portable-atomic-util	0.2.5	# Apache-2.0 OR MIT
MODCARGO_CRATES +=	prettyplease	0.2.37	# MIT OR Apache-2.0
MODCARGO_CRATES +=	proc-macro2	1.0.106	# MIT OR Apache-2.0
MODCARGO_CRATES +=	quote	1.0.45	# MIT OR Apache-2.0
MODCARGO_CRATES +=	r-efi	6.0.0	# MIT OR Apache-2.0 OR LGPL-2.1-or-later
MODCARGO_CRATES +=	redox_syscall	0.7.3	# MIT
MODCARGO_CRATES +=	regex	1.12.3	# MIT OR Apache-2.0
MODCARGO_CRATES +=	regex-automata	0.4.14	# MIT OR Apache-2.0
MODCARGO_CRATES +=	regex-syntax	0.8.10	# MIT OR Apache-2.0
MODCARGO_CRATES +=	rustix	1.1.4	# Apache-2.0 WITH LLVM-exception OR Apache-2.0 OR MIT
MODCARGO_CRATES +=	same-file	1.0.6	# Unlicense/MIT
MODCARGO_CRATES +=	semver	1.0.27	# MIT OR Apache-2.0
MODCARGO_CRATES +=	serde	1.0.228	# MIT OR Apache-2.0
MODCARGO_CRATES +=	serde_core	1.0.228	# MIT OR Apache-2.0
MODCARGO_CRATES +=	serde_derive	1.0.228	# MIT OR Apache-2.0
MODCARGO_CRATES +=	serde_json	1.0.149	# MIT OR Apache-2.0
MODCARGO_CRATES +=	shlex	1.3.0	# MIT OR Apache-2.0
MODCARGO_CRATES +=	strsim	0.11.1	# MIT
MODCARGO_CRATES +=	syn	2.0.117	# MIT OR Apache-2.0
MODCARGO_CRATES +=	tempfile	3.26.0	# MIT OR Apache-2.0
MODCARGO_CRATES +=	terminal_size	0.4.3	# MIT OR Apache-2.0
MODCARGO_CRATES +=	test-case	3.3.1	# MIT
MODCARGO_CRATES +=	test-case-core	3.3.1	# MIT
MODCARGO_CRATES +=	test-case-macros	3.3.1	# MIT
MODCARGO_CRATES +=	tikv-jemalloc-sys	0.6.1+5.3.0-1-ge13ca993e8ccb9ba9847cc330696e02839f328f7	# MIT/Apache-2.0
MODCARGO_CRATES +=	tikv-jemallocator	0.6.1	# MIT/Apache-2.0
MODCARGO_CRATES +=	unicode-ident	1.0.24	# (MIT OR Apache-2.0) AND Unicode-3.0
MODCARGO_CRATES +=	unicode-xid	0.2.6	# MIT OR Apache-2.0
MODCARGO_CRATES +=	utf8parse	0.2.2	# Apache-2.0 OR MIT
MODCARGO_CRATES +=	walkdir	2.5.0	# Unlicense/MIT
MODCARGO_CRATES +=	wasip2	1.0.2+wasi-0.2.9	# Apache-2.0 WITH LLVM-exception OR Apache-2.0 OR MIT
MODCARGO_CRATES +=	wasip3	0.4.0+wasi-0.3.0-rc-2026-01-06	# Apache-2.0 WITH LLVM-exception OR Apache-2.0 OR MIT
MODCARGO_CRATES +=	wasm-encoder	0.244.0	# Apache-2.0 WITH LLVM-exception OR Apache-2.0 OR MIT
MODCARGO_CRATES +=	wasm-metadata	0.244.0	# Apache-2.0 WITH LLVM-exception OR Apache-2.0 OR MIT
MODCARGO_CRATES +=	wasmparser	0.244.0	# Apache-2.0 WITH LLVM-exception OR Apache-2.0 OR MIT
MODCARGO_CRATES +=	winapi	0.3.9	# MIT/Apache-2.0
MODCARGO_CRATES +=	winapi-i686-pc-windows-gnu	0.4.0	# MIT/Apache-2.0
MODCARGO_CRATES +=	winapi-util	0.1.11	# Unlicense OR MIT
MODCARGO_CRATES +=	winapi-x86_64-pc-windows-gnu	0.4.0	# MIT/Apache-2.0
MODCARGO_CRATES +=	windows-link	0.2.1	# MIT OR Apache-2.0
MODCARGO_CRATES +=	windows-sys	0.60.2	# MIT OR Apache-2.0
MODCARGO_CRATES +=	windows-sys	0.61.2	# MIT OR Apache-2.0
MODCARGO_CRATES +=	windows-targets	0.53.5	# MIT OR Apache-2.0
MODCARGO_CRATES +=	windows_aarch64_gnullvm	0.53.1	# MIT OR Apache-2.0
MODCARGO_CRATES +=	windows_aarch64_msvc	0.53.1	# MIT OR Apache-2.0
MODCARGO_CRATES +=	windows_i686_gnu	0.53.1	# MIT OR Apache-2.0
MODCARGO_CRATES +=	windows_i686_gnullvm	0.53.1	# MIT OR Apache-2.0
MODCARGO_CRATES +=	windows_i686_msvc	0.53.1	# MIT OR Apache-2.0
MODCARGO_CRATES +=	windows_x86_64_gnu	0.53.1	# MIT OR Apache-2.0
MODCARGO_CRATES +=	windows_x86_64_gnullvm	0.53.1	# MIT OR Apache-2.0
MODCARGO_CRATES +=	windows_x86_64_msvc	0.53.1	# MIT OR Apache-2.0
MODCARGO_CRATES +=	wit-bindgen	0.51.0	# Apache-2.0 WITH LLVM-exception OR Apache-2.0 OR MIT
MODCARGO_CRATES +=	wit-bindgen-core	0.51.0	# Apache-2.0 WITH LLVM-exception OR Apache-2.0 OR MIT
MODCARGO_CRATES +=	wit-bindgen-rust	0.51.0	# Apache-2.0 WITH LLVM-exception OR Apache-2.0 OR MIT
MODCARGO_CRATES +=	wit-bindgen-rust-macro	0.51.0	# Apache-2.0 WITH LLVM-exception OR Apache-2.0 OR MIT
MODCARGO_CRATES +=	wit-component	0.244.0	# Apache-2.0 WITH LLVM-exception OR Apache-2.0 OR MIT
MODCARGO_CRATES +=	wit-parser	0.244.0	# Apache-2.0 WITH LLVM-exception OR Apache-2.0 OR MIT
MODCARGO_CRATES +=	zmij	1.0.21	# MIT
