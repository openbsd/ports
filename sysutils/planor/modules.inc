MODGO_MODULES =	\
	cloud.google.com/go/compute					 v1.7.0 \
	github.com/atotto/clipboard					 v0.1.4 \
	github.com/aws/aws-sdk-go					 v1.43.20 \
	github.com/aws/aws-sdk-go-v2					 v1.16.11 \
	github.com/aws/aws-sdk-go-v2/config				 v1.17.1 \
	github.com/aws/aws-sdk-go-v2/credentials			 v1.12.14 \
	github.com/aws/aws-sdk-go-v2/feature/ec2/imds			 v1.12.12 \
	github.com/aws/aws-sdk-go-v2/internal/configsources		 v1.1.18 \
	github.com/aws/aws-sdk-go-v2/internal/endpoints/v2		 v2.4.12 \
	github.com/aws/aws-sdk-go-v2/internal/ini			 v1.3.19 \
	github.com/aws/aws-sdk-go-v2/service/cloudwatchlogs		 v1.15.14 \
	github.com/aws/aws-sdk-go-v2/service/codepipeline		 v1.13.12 \
	github.com/aws/aws-sdk-go-v2/service/ec2			 v1.52.1 \
	github.com/aws/aws-sdk-go-v2/service/internal/presigned-url	 v1.9.12 \
	github.com/aws/aws-sdk-go-v2/service/sso			 v1.11.17 \
	github.com/aws/aws-sdk-go-v2/service/sts			 v1.16.13 \
	github.com/aws/smithy-go					 v1.12.1 \
	github.com/cenkalti/backoff					 v2.2.1+incompatible \
	github.com/charmbracelet/bubbles				 v0.13.0 \
	github.com/charmbracelet/bubbletea				 v0.22.0 \
	github.com/charmbracelet/harmonica				 v0.2.0 \
	github.com/charmbracelet/lipgloss				 v0.5.0 \
	github.com/containerd/console					 v1.0.3 \
	github.com/davecgh/go-spew					 v1.1.1 \
	github.com/gin-contrib/sse					 v0.1.0 \
	github.com/gin-gonic/gin					 v1.6.3 \
	github.com/go-logr/logr						 v1.2.3 \
	github.com/go-logr/stdr						 v1.2.2 \
	github.com/go-playground/assert/v2				 v2.0.1 \
	github.com/go-playground/locales				 v0.13.0 \
	github.com/go-playground/universal-translator			 v0.17.0 \
	github.com/go-playground/validator/v10				 v10.2.0 \
	github.com/gobwas/httphead					 v0.0.0-20180130184737-2c6c146eadee \
	github.com/gobwas/pool						 v0.2.0 \
	github.com/gobwas/ws						 v1.0.2 \
	github.com/golang/protobuf					 v1.5.2 \
	github.com/google/go-cmp					 v0.5.8 \
	github.com/google/go-querystring				 v1.1.0 \
	github.com/google/gofuzz					 v1.0.0 \
	github.com/google/uuid						 v1.3.0 \
	github.com/gorilla/websocket					 v1.4.1 \
	github.com/graph-gophers/graphql-go				 v1.4.0 \
	github.com/graph-gophers/graphql-transport-ws			 v0.0.2 \
	github.com/hashicorp/go-cleanhttp				 v0.5.2 \
	github.com/hashicorp/go-hclog					 v0.9.2 \
	github.com/hashicorp/go-retryablehttp				 v0.7.1 \
	github.com/hasura/go-graphql-client				 v0.8.0 \
	github.com/heroku/heroku-go/v5					 v5.4.1 \
	github.com/jmespath/go-jmespath					 v0.4.0 \
	github.com/jmespath/go-jmespath/internal/testify		 v1.5.1 \
	github.com/json-iterator/go					 v1.1.9 \
	github.com/klauspost/compress					 v1.15.9 \
	github.com/kylelemons/godebug					 v1.1.0 \
	github.com/leodido/go-urn					 v1.2.0 \
	github.com/lucasb-eyer/go-colorful				 v1.2.0 \
	github.com/mattn/go-isatty					 v0.0.16 \
	github.com/mattn/go-runewidth					 v0.0.13 \
	github.com/modern-go/concurrent					 v0.0.0-20180228061459-e0a39a4cb421 \
	github.com/modern-go/reflect2					 v0.0.0-20180701023420-4b7aa43c6742 \
	github.com/mrusme/go-fleek					 v0.1.0 \
	github.com/mrusme/go-render					 v0.1.0 \
	github.com/muesli/ansi						 v0.0.0-20211031195517-c9f0611b6c70 \
	github.com/muesli/cancelreader					 v0.2.2 \
	github.com/muesli/reflow					 v0.3.0 \
	github.com/muesli/termenv					 v0.12.0 \
	github.com/opentracing/opentracing-go				 v1.2.0 \
	github.com/pborman/uuid						 v1.2.1 \
	github.com/pkg/errors						 v0.9.1 \
	github.com/pmezard/go-difflib					 v1.0.0 \
	github.com/rivo/uniseg						 v0.3.4 \
	github.com/sahilm/fuzzy						 v0.1.0 \
	github.com/stretchr/objx					 v0.1.0 \
	github.com/stretchr/testify					 v1.7.1 \
	github.com/ugorji/go						 v1.1.7 \
	github.com/ugorji/go/codec					 v1.1.7 \
	github.com/vultr/govultr/v2					 v2.17.2 \
	go.opentelemetry.io/otel					 v1.6.3 \
	go.opentelemetry.io/otel/trace					 v1.6.3 \
	golang.org/x/crypto						 v0.0.0-20190308221718-c2843e01d9a2 \
	golang.org/x/net						 v0.0.0-20220812174116-3211cb980234 \
	golang.org/x/oauth2						 v0.0.0-20220808172628-8227340efae7 \
	golang.org/x/sys						 v0.0.0-20220817070843-5a390386f1f2 \
	golang.org/x/term						 v0.0.0-20220722155259-a9ba230a4035 \
	golang.org/x/text						 v0.3.7 \
	golang.org/x/time						 v0.0.0-20191024005414-555d28b269f0 \
	golang.org/x/tools						 v0.0.0-20180917221912-90fa682c2a6e \
	golang.org/x/xerrors						 v0.0.0-20191204190536-9bdfabe68543 \
	google.golang.org/appengine					 v1.6.7 \
	google.golang.org/protobuf					 v1.28.1 \
	gopkg.in/check.v1						 v0.0.0-20161208181325-20d25e280405 \
	gopkg.in/yaml.v2						 v2.2.8 \
	gopkg.in/yaml.v3						 v3.0.0-20200313102051-9f266ea9e77c \
	nhooyr.io/websocket						 v1.8.7
MODGO_MODFILES =	\
	github.com/cenkalti/backoff		 v2.1.1+incompatible \
	github.com/charmbracelet/bubbletea	 v0.21.0 \
	github.com/davecgh/go-spew		 v1.1.0 \
	github.com/go-logr/logr			 v1.2.2 \
	github.com/golang/protobuf		 v1.3.1 \
	github.com/golang/protobuf		 v1.3.3 \
	github.com/golang/protobuf		 v1.3.5 \
	github.com/golang/protobuf		 v1.5.0 \
	github.com/google/go-cmp		 v0.4.0 \
	github.com/google/go-cmp		 v0.5.2 \
	github.com/google/go-cmp		 v0.5.5 \
	github.com/google/go-cmp		 v0.5.7 \
	github.com/google/go-querystring	 v1.0.0 \
	github.com/google/uuid			 v1.0.0 \
	github.com/hashicorp/go-cleanhttp	 v0.5.1 \
	github.com/hasura/go-graphql-client	 v0.7.2 \
	github.com/klauspost/compress		 v1.10.3 \
	github.com/mattn/go-isatty		 v0.0.12 \
	github.com/mattn/go-isatty		 v0.0.14 \
	github.com/mattn/go-runewidth		 v0.0.10 \
	github.com/mattn/go-runewidth		 v0.0.12 \
	github.com/muesli/ansi			 v0.0.0-20211018074035-2e021307bc4b \
	github.com/muesli/cancelreader		 v0.2.0 \
	github.com/muesli/cancelreader		 v0.2.1 \
	github.com/muesli/reflow		 v0.2.1-0.20210115123740-9e1d0d53df68 \
	github.com/muesli/termenv		 v0.11.1-0.20220204035834-5ac8409525e0 \
	github.com/muesli/termenv		 v0.11.1-0.20220212125758-44cd13922739 \
	github.com/pborman/uuid			 v1.2.0 \
	github.com/rivo/uniseg			 v0.1.0 \
	github.com/rivo/uniseg			 v0.2.0 \
	github.com/stretchr/testify		 v1.2.2 \
	github.com/stretchr/testify		 v1.3.0 \
	github.com/stretchr/testify		 v1.4.0 \
	github.com/stretchr/testify		 v1.7.0 \
	golang.org/x/net			 v0.0.0-20190603091049-60506f45cf65 \
	golang.org/x/net			 v0.0.0-20220127200216-cd36cc0744dd \
	golang.org/x/net			 v0.0.0-20220624214902-1bab6f366d9e \
	golang.org/x/net			 v0.0.0-20220728211354-c7608f3a8462 \
	golang.org/x/oauth2			 v0.0.0-20220722155238-128564f6959c \
	golang.org/x/sys			 v0.0.0-20190215142949-d0b11bdaac8a \
	golang.org/x/sys			 v0.0.0-20200116001909-b77594299b42 \
	golang.org/x/sys			 v0.0.0-20210124154548-22da62e12c0c \
	golang.org/x/sys			 v0.0.0-20210615035016-665e8c7367d1 \
	golang.org/x/sys			 v0.0.0-20210630005230-0f9fa26af87c \
	golang.org/x/sys			 v0.0.0-20211216021012-1d35b9e2eb4e \
	golang.org/x/sys			 v0.0.0-20220204135822-1c1b9b1eba6a \
	golang.org/x/sys			 v0.0.0-20220209214540-3681064d5158 \
	golang.org/x/sys			 v0.0.0-20220728004956-3c1f35247d10 \
	golang.org/x/sys			 v0.0.0-20220811171246-fbc7d0a398ab \
	golang.org/x/term			 v0.0.0-20210927222741-03fcf44c2211 \
	golang.org/x/text			 v0.3.0 \
	golang.org/x/text			 v0.3.2 \
	google.golang.org/protobuf		 v1.26.0 \
	google.golang.org/protobuf		 v1.26.0-rc.1 \
	google.golang.org/protobuf		 v1.28.0 \
	gopkg.in/yaml.v2			 v2.2.2
