MODCARGO_CRATES +=	adler	1.0.2	# 0BSD OR MIT OR Apache-2.0
MODCARGO_CRATES +=	aho-corasick	0.7.19	# Unlicense/MIT
MODCARGO_CRATES +=	aho-corasick	1.0.1	# Unlicense OR MIT
MODCARGO_CRATES +=	ansi_colours	1.2.1	# LGPL-3.0-or-later
MODCARGO_CRATES +=	anstream	0.6.4	# MIT OR Apache-2.0
MODCARGO_CRATES +=	anstyle	0.3.5	# MIT OR Apache-2.0
MODCARGO_CRATES +=	anstyle	1.0.0	# MIT OR Apache-2.0
MODCARGO_CRATES +=	anstyle-parse	0.2.0	# MIT OR Apache-2.0
MODCARGO_CRATES +=	anstyle-query	1.0.0	# MIT OR Apache-2.0
MODCARGO_CRATES +=	anstyle-wincon	3.0.1	# MIT OR Apache-2.0
MODCARGO_CRATES +=	assert_cmd	2.0.10	# MIT OR Apache-2.0
MODCARGO_CRATES +=	autocfg	1.1.0	# Apache-2.0 OR MIT
MODCARGO_CRATES +=	base64	0.21.0	# MIT OR Apache-2.0
MODCARGO_CRATES +=	bincode	1.3.3	# MIT
MODCARGO_CRATES +=	bit-set	0.5.3	# MIT/Apache-2.0
MODCARGO_CRATES +=	bit-vec	0.6.3	# MIT/Apache-2.0
MODCARGO_CRATES +=	bitflags	1.3.2	# MIT/Apache-2.0
MODCARGO_CRATES +=	bitflags	2.4.0	# MIT OR Apache-2.0
MODCARGO_CRATES +=	bstr	1.6.0	# MIT OR Apache-2.0
MODCARGO_CRATES +=	bugreport	0.5.0	# MIT/Apache-2.0
MODCARGO_CRATES +=	bytemuck	1.12.1	# Zlib OR Apache-2.0 OR MIT
MODCARGO_CRATES +=	bytesize	1.3.0	# Apache-2.0
MODCARGO_CRATES +=	cc	1.0.73	# MIT/Apache-2.0
MODCARGO_CRATES +=	cfg-if	1.0.0	# MIT/Apache-2.0
MODCARGO_CRATES +=	clap	4.4.6	# MIT OR Apache-2.0
MODCARGO_CRATES +=	clap_builder	4.4.6	# MIT OR Apache-2.0
MODCARGO_CRATES +=	clap_lex	0.5.0	# MIT OR Apache-2.0
MODCARGO_CRATES +=	clircle	0.4.0	# MIT OR Apache-2.0
MODCARGO_CRATES +=	colorchoice	1.0.0	# MIT OR Apache-2.0
MODCARGO_CRATES +=	console	0.15.5	# MIT
MODCARGO_CRATES +=	content_inspector	0.2.4	# MIT/Apache-2.0
MODCARGO_CRATES +=	crc32fast	1.3.2	# MIT OR Apache-2.0
MODCARGO_CRATES +=	dashmap	5.4.0	# MIT
MODCARGO_CRATES +=	difflib	0.4.0	# MIT
MODCARGO_CRATES +=	dissimilar	1.0.5	# Apache-2.0
MODCARGO_CRATES +=	doc-comment	0.3.3	# MIT
MODCARGO_CRATES +=	dunce	1.0.3	# CC0-1.0 OR MIT-0
MODCARGO_CRATES +=	either	1.8.0	# MIT/Apache-2.0
MODCARGO_CRATES +=	encode_unicode	0.3.6	# MIT/Apache-2.0
MODCARGO_CRATES +=	encoding_rs	0.8.33	# (Apache-2.0 OR MIT) AND BSD-3-Clause
MODCARGO_CRATES +=	equivalent	1.0.1	# Apache-2.0 OR MIT
MODCARGO_CRATES +=	errno	0.3.3	# MIT OR Apache-2.0
MODCARGO_CRATES +=	errno-dragonfly	0.1.2	# MIT
MODCARGO_CRATES +=	etcetera	0.8.0	# MIT OR Apache-2.0
MODCARGO_CRATES +=	expect-test	1.4.1	# MIT OR Apache-2.0
MODCARGO_CRATES +=	fancy-regex	0.7.1	# MIT
MODCARGO_CRATES +=	fastrand	2.0.0	# Apache-2.0 OR MIT
MODCARGO_CRATES +=	flate2	1.0.27	# MIT OR Apache-2.0
MODCARGO_CRATES +=	float-cmp	0.9.0	# MIT
MODCARGO_CRATES +=	fnv	1.0.7	# Apache-2.0 / MIT
MODCARGO_CRATES +=	form_urlencoded	1.1.0	# MIT OR Apache-2.0
MODCARGO_CRATES +=	fsio	0.4.0	# Apache-2.0
MODCARGO_CRATES +=	getrandom	0.2.7	# MIT OR Apache-2.0
MODCARGO_CRATES +=	git-version	0.3.5	# BSD-2-Clause
MODCARGO_CRATES +=	git-version-macro	0.3.5	# BSD-2-Clause
MODCARGO_CRATES +=	git2	0.18.0	# MIT OR Apache-2.0
MODCARGO_CRATES +=	glob	0.3.0	# MIT/Apache-2.0
MODCARGO_CRATES +=	globset	0.4.10	# Unlicense OR MIT
MODCARGO_CRATES +=	grep-cli	0.1.9	# Unlicense OR MIT
MODCARGO_CRATES +=	hashbrown	0.12.3	# MIT OR Apache-2.0
MODCARGO_CRATES +=	hashbrown	0.14.1	# MIT OR Apache-2.0
MODCARGO_CRATES +=	home	0.5.5	# MIT OR Apache-2.0
MODCARGO_CRATES +=	idna	0.3.0	# MIT OR Apache-2.0
MODCARGO_CRATES +=	indexmap	1.9.1	# Apache-2.0 OR MIT
MODCARGO_CRATES +=	indexmap	2.0.2	# Apache-2.0 OR MIT
MODCARGO_CRATES +=	itertools	0.10.5	# MIT/Apache-2.0
MODCARGO_CRATES +=	itoa	1.0.3	# MIT OR Apache-2.0
MODCARGO_CRATES +=	jobserver	0.1.25	# MIT/Apache-2.0
MODCARGO_CRATES +=	lazy_static	1.4.0	# MIT/Apache-2.0
MODCARGO_CRATES +=	libc	0.2.147	# MIT OR Apache-2.0
MODCARGO_CRATES +=	libgit2-sys	0.16.1+1.7.1	# MIT OR Apache-2.0
MODCARGO_CRATES +=	libz-sys	1.1.8	# MIT OR Apache-2.0
MODCARGO_CRATES +=	line-wrap	0.1.1	# Apache-2.0
MODCARGO_CRATES +=	linked-hash-map	0.5.6	# MIT/Apache-2.0
MODCARGO_CRATES +=	linux-raw-sys	0.4.5	# Apache-2.0 WITH LLVM-exception OR Apache-2.0 OR MIT
MODCARGO_CRATES +=	lock_api	0.4.9	# MIT OR Apache-2.0
MODCARGO_CRATES +=	log	0.4.17	# MIT OR Apache-2.0
MODCARGO_CRATES +=	memchr	2.5.0	# Unlicense/MIT
MODCARGO_CRATES +=	miniz_oxide	0.7.1	# MIT OR Zlib OR Apache-2.0
MODCARGO_CRATES +=	nix	0.26.2	# MIT
MODCARGO_CRATES +=	normalize-line-endings	0.3.0	# Apache-2.0
MODCARGO_CRATES +=	nu-ansi-term	0.49.0	# MIT
MODCARGO_CRATES +=	num-traits	0.2.15	# MIT OR Apache-2.0
MODCARGO_CRATES +=	num_threads	0.1.6	# MIT OR Apache-2.0
MODCARGO_CRATES +=	once_cell	1.18.0	# MIT OR Apache-2.0
MODCARGO_CRATES +=	onig	6.4.0	# MIT
MODCARGO_CRATES +=	onig_sys	69.8.1	# MIT
MODCARGO_CRATES +=	os_str_bytes	6.4.1	# MIT OR Apache-2.0
MODCARGO_CRATES +=	parking_lot	0.12.1	# MIT OR Apache-2.0
MODCARGO_CRATES +=	parking_lot_core	0.9.7	# MIT OR Apache-2.0
MODCARGO_CRATES +=	path_abs	0.5.1	# MIT OR Apache-2.0
MODCARGO_CRATES +=	percent-encoding	2.2.0	# MIT OR Apache-2.0
MODCARGO_CRATES +=	pkg-config	0.3.25	# MIT OR Apache-2.0
MODCARGO_CRATES +=	plist	1.4.3	# MIT
MODCARGO_CRATES +=	ppv-lite86	0.2.17	# MIT/Apache-2.0
MODCARGO_CRATES +=	predicates	3.0.3	# MIT OR Apache-2.0
MODCARGO_CRATES +=	predicates-core	1.0.6	# MIT OR Apache-2.0
MODCARGO_CRATES +=	predicates-tree	1.0.5	# MIT OR Apache-2.0
MODCARGO_CRATES +=	proc-macro-hack	0.5.19	# MIT OR Apache-2.0
MODCARGO_CRATES +=	proc-macro2	1.0.66	# MIT OR Apache-2.0
MODCARGO_CRATES +=	quick-xml	0.28.1	# MIT
MODCARGO_CRATES +=	quote	1.0.26	# MIT OR Apache-2.0
MODCARGO_CRATES +=	rand	0.8.5	# MIT OR Apache-2.0
MODCARGO_CRATES +=	rand_chacha	0.3.1	# MIT OR Apache-2.0
MODCARGO_CRATES +=	rand_core	0.6.4	# MIT OR Apache-2.0
MODCARGO_CRATES +=	redox_syscall	0.2.16	# MIT
MODCARGO_CRATES +=	redox_syscall	0.3.5	# MIT
MODCARGO_CRATES +=	regex	1.8.3	# MIT OR Apache-2.0
MODCARGO_CRATES +=	regex-automata	0.3.7	# MIT OR Apache-2.0
MODCARGO_CRATES +=	regex-syntax	0.6.27	# MIT OR Apache-2.0
MODCARGO_CRATES +=	regex-syntax	0.7.2	# MIT OR Apache-2.0
MODCARGO_CRATES +=	rgb	0.8.34	# MIT
MODCARGO_CRATES +=	run_script	0.10.0	# Apache-2.0
MODCARGO_CRATES +=	rustix	0.38.11	# Apache-2.0 WITH LLVM-exception OR Apache-2.0 OR MIT
MODCARGO_CRATES +=	ryu	1.0.11	# Apache-2.0 OR BSL-1.0
MODCARGO_CRATES +=	safemem	0.3.3	# MIT/Apache-2.0
MODCARGO_CRATES +=	same-file	1.0.6	# Unlicense/MIT
MODCARGO_CRATES +=	scopeguard	1.1.0	# MIT/Apache-2.0
MODCARGO_CRATES +=	semver	1.0.17	# MIT OR Apache-2.0
MODCARGO_CRATES +=	serde	1.0.163	# MIT OR Apache-2.0
MODCARGO_CRATES +=	serde_derive	1.0.163	# MIT OR Apache-2.0
MODCARGO_CRATES +=	serde_json	1.0.85	# MIT OR Apache-2.0
MODCARGO_CRATES +=	serde_yaml	0.9.25	# MIT OR Apache-2.0
MODCARGO_CRATES +=	serial_test	2.0.0	# MIT
MODCARGO_CRATES +=	serial_test_derive	2.0.0	# MIT
MODCARGO_CRATES +=	shell-escape	0.1.5	# MIT/Apache-2.0
MODCARGO_CRATES +=	shell-words	1.1.0	# MIT/Apache-2.0
MODCARGO_CRATES +=	smallvec	1.10.0	# MIT OR Apache-2.0
MODCARGO_CRATES +=	static_assertions	1.1.0	# MIT OR Apache-2.0
MODCARGO_CRATES +=	std_prelude	0.2.12	# MIT
MODCARGO_CRATES +=	strsim	0.10.0	# MIT
MODCARGO_CRATES +=	syn	1.0.104	# MIT OR Apache-2.0
MODCARGO_CRATES +=	syn	2.0.12	# MIT OR Apache-2.0
MODCARGO_CRATES +=	syntect	5.0.0	# MIT
MODCARGO_CRATES +=	sys-info	0.9.1	# MIT
MODCARGO_CRATES +=	tempfile	3.8.0	# MIT OR Apache-2.0
MODCARGO_CRATES +=	termcolor	1.1.3	# Unlicense OR MIT
MODCARGO_CRATES +=	terminal_size	0.3.0	# MIT OR Apache-2.0
MODCARGO_CRATES +=	termtree	0.2.4	# MIT
MODCARGO_CRATES +=	thiserror	1.0.40	# MIT OR Apache-2.0
MODCARGO_CRATES +=	thiserror-impl	1.0.40	# MIT OR Apache-2.0
MODCARGO_CRATES +=	time	0.3.14	# MIT OR Apache-2.0
MODCARGO_CRATES +=	tinyvec	1.6.0	# Zlib OR Apache-2.0 OR MIT
MODCARGO_CRATES +=	tinyvec_macros	0.1.0	# MIT OR Apache-2.0 OR Zlib
MODCARGO_CRATES +=	unicode-bidi	0.3.8	# MIT OR Apache-2.0
MODCARGO_CRATES +=	unicode-ident	1.0.4	# (MIT OR Apache-2.0) AND Unicode-DFS-2016
MODCARGO_CRATES +=	unicode-normalization	0.1.22	# MIT/Apache-2.0
MODCARGO_CRATES +=	unicode-width	0.1.10	# MIT/Apache-2.0
MODCARGO_CRATES +=	unsafe-libyaml	0.2.9	# MIT
MODCARGO_CRATES +=	url	2.3.1	# MIT OR Apache-2.0
MODCARGO_CRATES +=	utf8parse	0.2.1	# Apache-2.0 OR MIT
MODCARGO_CRATES +=	vcpkg	0.2.15	# MIT/Apache-2.0
MODCARGO_CRATES +=	wait-timeout	0.2.0	# MIT/Apache-2.0
MODCARGO_CRATES +=	walkdir	2.3.3	# Unlicense/MIT
MODCARGO_CRATES +=	wasi	0.11.0+wasi-snapshot-preview1	# Apache-2.0 WITH LLVM-exception OR Apache-2.0 OR MIT
MODCARGO_CRATES +=	wild	2.1.0	# Apache-2.0 OR MIT
MODCARGO_CRATES +=	winapi	0.3.9	# MIT/Apache-2.0
MODCARGO_CRATES +=	winapi-i686-pc-windows-gnu	0.4.0	# MIT/Apache-2.0
MODCARGO_CRATES +=	winapi-util	0.1.5	# Unlicense/MIT
MODCARGO_CRATES +=	winapi-x86_64-pc-windows-gnu	0.4.0	# MIT/Apache-2.0
MODCARGO_CRATES +=	windows-sys	0.42.0	# MIT OR Apache-2.0
MODCARGO_CRATES +=	windows-sys	0.45.0	# MIT OR Apache-2.0
MODCARGO_CRATES +=	windows-sys	0.48.0	# MIT OR Apache-2.0
MODCARGO_CRATES +=	windows-targets	0.42.1	# MIT OR Apache-2.0
MODCARGO_CRATES +=	windows-targets	0.48.0	# MIT OR Apache-2.0
MODCARGO_CRATES +=	windows_aarch64_gnullvm	0.42.1	# MIT OR Apache-2.0
MODCARGO_CRATES +=	windows_aarch64_gnullvm	0.48.0	# MIT OR Apache-2.0
MODCARGO_CRATES +=	windows_aarch64_msvc	0.42.1	# MIT OR Apache-2.0
MODCARGO_CRATES +=	windows_aarch64_msvc	0.48.0	# MIT OR Apache-2.0
MODCARGO_CRATES +=	windows_i686_gnu	0.42.1	# MIT OR Apache-2.0
MODCARGO_CRATES +=	windows_i686_gnu	0.48.0	# MIT OR Apache-2.0
MODCARGO_CRATES +=	windows_i686_msvc	0.42.1	# MIT OR Apache-2.0
MODCARGO_CRATES +=	windows_i686_msvc	0.48.0	# MIT OR Apache-2.0
MODCARGO_CRATES +=	windows_x86_64_gnu	0.42.1	# MIT OR Apache-2.0
MODCARGO_CRATES +=	windows_x86_64_gnu	0.48.0	# MIT OR Apache-2.0
MODCARGO_CRATES +=	windows_x86_64_gnullvm	0.42.1	# MIT OR Apache-2.0
MODCARGO_CRATES +=	windows_x86_64_gnullvm	0.48.0	# MIT OR Apache-2.0
MODCARGO_CRATES +=	windows_x86_64_msvc	0.42.1	# MIT OR Apache-2.0
MODCARGO_CRATES +=	windows_x86_64_msvc	0.48.0	# MIT OR Apache-2.0
MODCARGO_CRATES +=	yaml-rust	0.4.5	# MIT/Apache-2.0
