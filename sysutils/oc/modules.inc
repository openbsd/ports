MODGO_MODULES =	\
	al.essio.dev/pkg/shellescape							 v1.6.0 \
	cel.dev/expr									 v0.24.0 \
	chainguard.dev/go-grpc-kit							 v0.17.7 \
	chainguard.dev/sdk								 v0.1.29 \
	cloud.google.com/go								 v0.116.0 \
	cloud.google.com/go/auth							 v0.14.0 \
	cloud.google.com/go/auth/oauth2adapt						 v0.2.7 \
	cloud.google.com/go/compute/metadata						 v0.6.0 \
	cloud.google.com/go/iam								 v1.2.2 \
	cloud.google.com/go/kms								 v1.20.4 \
	cloud.google.com/go/longrunning							 v0.6.2 \
	cloud.google.com/go/security							 v1.18.3 \
	cyphar.com/go-pathrs								 v0.2.1 \
	dario.cat/mergo									 v1.0.2 \
	filippo.io/edwards25519								 v1.1.0 \
	github.com/!aaron!o/go-git-http							 v0.0.0-20161214145340-1d9485b3a98f \
	github.com/!ada!logics/go-fuzz-headers						 v0.0.0-20240806141605-e8a1dd7889d6 \
	github.com/!adam!korcz/go-118-fuzz-build					 v0.0.0-20221215162035-5330a85ea652 \
	github.com/!azure!a!d/microsoft-authentication-library-for-go			 v1.3.1 \
	github.com/!azure/azure-sdk-for-go/sdk/azcore					 v1.17.0 \
	github.com/!azure/azure-sdk-for-go/sdk/azidentity				 v1.8.0 \
	github.com/!azure/azure-sdk-for-go/sdk/internal					 v1.10.0 \
	github.com/!azure/azure-sdk-for-go/sdk/security/keyvault/azkeys			 v1.3.0 \
	github.com/!azure/azure-sdk-for-go/sdk/security/keyvault/internal		 v1.1.0 \
	github.com/!azure/azure-sdk-for-go/sdk/storage/azblob				 v1.0.0 \
	github.com/!azure/go-ansiterm							 v0.0.0-20250102033503-faa5f7b0171c \
	github.com/!azure/go-ntlmssp							 v0.0.0-20221128193559-754e69321358 \
	github.com/!burnt!sushi/toml							 v1.5.0 \
	github.com/!burnt!sushi/xgb							 v0.0.0-20160522181843-27f122750802 \
	github.com/!make!now!just/heredoc						 v1.0.0 \
	github.com/!masterminds/semver/v3						 v3.4.0 \
	github.com/!microsoft/go-winio							 v0.6.2 \
	github.com/!microsoft/hcsshim							 v0.13.0 \
	github.com/!n!y!times/gziphandler						 v1.1.1 \
	github.com/!paessler!a!g/gval							 v1.0.0 \
	github.com/!paessler!a!g/jsonpath						 v0.1.1 \
	github.com/!proton!mail/go-crypto						 v1.1.3 \
	github.com/!rangel!reale/osincli						 v0.0.0-20160924135400-fababb0555f2 \
	github.com/!shopify/logrus-bugsnag						 v0.0.0-20171204204709-577dee27f20d \
	github.com/!thales!ignite/crypto11						 v1.2.5 \
	github.com/!vivid!cortex/ewma							 v1.2.0 \
	github.com/acarl005/stripansi							 v0.0.0-20180116102854-5a71ef0e047d \
	github.com/agext/levenshtein							 v1.2.3 \
	github.com/alecthomas/kingpin/v2						 v2.4.0 \
	github.com/alecthomas/template							 v0.0.0-20160405071501-a0175ee3bccc \
	github.com/alecthomas/units							 v0.0.0-20211218093645-b94a6e3cc137 \
	github.com/alexbrainman/sspi							 v0.0.0-20250919150558-7d374ff0d59e \
	github.com/alicebob/sqlittle							 v1.4.0 \
	github.com/anchore/go-struct-converter						 v0.0.0-20221118182256-c68fdcfa2092 \
	github.com/andreyvit/diff							 v0.0.0-20170406064948-c7f18ee00883 \
	github.com/anmitsu/go-shlex							 v0.0.0-20200514113438-38f4b401e2be \
	github.com/antlr/antlr4/runtime/!go/antlr/v4					 v4.0.0-20230305170008-8188dc5388df \
	github.com/antlr4-go/antlr/v4							 v4.13.0 \
	github.com/armon/circbuf							 v0.0.0-20190214190532-5111143e8da2 \
	github.com/armon/go-socks5							 v0.0.0-20160902184237-e75332964ef5 \
	github.com/asaskevich/govalidator						 v0.0.0-20210307081110-f21760c49a8d \
	github.com/aws/aws-sdk-go							 v1.55.5 \
	github.com/aws/aws-sdk-go-v2							 v1.41.3 \
	github.com/aws/aws-sdk-go-v2/aws/protocol/eventstream				 v1.7.6 \
	github.com/aws/aws-sdk-go-v2/config						 v1.32.11 \
	github.com/aws/aws-sdk-go-v2/credentials					 v1.19.11 \
	github.com/aws/aws-sdk-go-v2/feature/ec2/imds					 v1.18.19 \
	github.com/aws/aws-sdk-go-v2/feature/s3/manager					 v1.22.6 \
	github.com/aws/aws-sdk-go-v2/internal/configsources				 v1.4.19 \
	github.com/aws/aws-sdk-go-v2/internal/endpoints/v2				 v2.7.19 \
	github.com/aws/aws-sdk-go-v2/internal/ini					 v1.8.5 \
	github.com/aws/aws-sdk-go-v2/internal/v4a					 v1.4.20 \
	github.com/aws/aws-sdk-go-v2/service/internal/accept-encoding			 v1.13.6 \
	github.com/aws/aws-sdk-go-v2/service/internal/checksum				 v1.9.11 \
	github.com/aws/aws-sdk-go-v2/service/internal/presigned-url			 v1.13.19 \
	github.com/aws/aws-sdk-go-v2/service/internal/s3shared				 v1.19.19 \
	github.com/aws/aws-sdk-go-v2/service/kms					 v1.37.8 \
	github.com/aws/aws-sdk-go-v2/service/s3						 v1.96.4 \
	github.com/aws/aws-sdk-go-v2/service/signin					 v1.0.7 \
	github.com/aws/aws-sdk-go-v2/service/sso					 v1.30.12 \
	github.com/aws/aws-sdk-go-v2/service/ssooidc					 v1.35.16 \
	github.com/aws/aws-sdk-go-v2/service/sts					 v1.41.8 \
	github.com/aws/smithy-go							 v1.24.2 \
	github.com/beorn7/perks								 v1.0.1 \
	github.com/bitly/go-simplejson							 v0.5.0 \
	github.com/blang/semver								 v3.5.1+incompatible \
	github.com/blang/semver/v4							 v4.0.0 \
	github.com/bshuster-repo/logrus-logstash-hook					 v1.0.0 \
	github.com/bugsnag/bugsnag-go							 v0.0.0-20141110184014-b1d153021fcd \
	github.com/bugsnag/osext							 v0.0.0-20130617224835-0dd3f918b21b \
	github.com/bugsnag/panicwrap							 v0.0.0-20151223152923-e2c28503fcd0 \
	github.com/cenkalti/backoff/v4							 v4.3.0 \
	github.com/cespare/xxhash/v2							 v2.3.0 \
	github.com/chai2010/gettext-go							 v1.0.2 \
	github.com/chainguard-dev/clog							 v1.5.1 \
	github.com/chromedp/cdproto							 v0.0.0-20230802225258-3cf4e6d46a89 \
	github.com/chromedp/chromedp							 v0.9.2 \
	github.com/chromedp/sysutil							 v1.0.0 \
	github.com/chzyer/logex								 v1.2.1 \
	github.com/chzyer/readline							 v1.5.1 \
	github.com/chzyer/test								 v1.0.0 \
	github.com/cloudflare/circl							 v1.3.7 \
	github.com/codahale/rfc6979							 v0.0.0-20141003034818-6a90f24967eb \
	github.com/coder/websocket							 v1.8.14 \
	github.com/common-nighthawk/go-figure						 v0.0.0-20210622060536-734e95fb86be \
	github.com/containerd/cgroups							 v1.1.0 \
	github.com/containerd/cgroups/v3						 v3.0.5 \
	github.com/containerd/console							 v1.0.3 \
	github.com/containerd/containerd						 v1.7.2 \
	github.com/containerd/continuity						 v0.4.1 \
	github.com/containerd/errdefs							 v1.0.0 \
	github.com/containerd/errdefs/pkg						 v0.3.0 \
	github.com/containerd/fifo							 v1.1.0 \
	github.com/containerd/fuse-overlayfs-snapshotter				 v1.0.2 \
	github.com/containerd/go-cni							 v1.1.9 \
	github.com/containerd/go-runc							 v1.1.0 \
	github.com/containerd/log							 v0.1.0 \
	github.com/containerd/nydus-snapshotter						 v0.8.2 \
	github.com/containerd/stargz-snapshotter					 v0.14.3 \
	github.com/containerd/stargz-snapshotter/estargz				 v0.16.3 \
	github.com/containerd/ttrpc							 v1.2.2 \
	github.com/containerd/typeurl/v2						 v2.2.3 \
	github.com/containernetworking/cni						 v1.1.2 \
	github.com/containers/image/v5							 v5.36.2 \
	github.com/containers/libtrust							 v0.0.0-20230121012942-c1716e8a8d01 \
	github.com/containers/ocicrypt							 v1.2.1 \
	github.com/containers/storage							 v1.59.1 \
	github.com/coreos/go-oidc							 v2.3.0+incompatible \
	github.com/coreos/go-oidc/v3							 v3.17.0 \
	github.com/coreos/go-semver							 v0.3.1 \
	github.com/coreos/go-systemd/v22						 v22.5.0 \
	github.com/cpuguy83/go-md2man/v2						 v2.0.6 \
	github.com/creack/pty								 v1.1.18 \
	github.com/cyberphone/json-canonicalization					 v0.0.0-20241213102144-19d51d7fe467 \
	github.com/cyphar/filepath-securejoin						 v0.6.0 \
	github.com/danieljoos/wincred							 v1.2.2 \
	github.com/davecgh/go-spew							 v1.1.2-0.20180830191138-d8f796af33cc \
	github.com/denverdino/aliyungo							 v0.0.0-20190125010748-a747050bb1ba \
	github.com/dgryski/go-rendezvous						 v0.0.0-20200823014737-9f7001d12a5f \
	github.com/dimchansky/utfbom							 v1.1.1 \
	github.com/distribution/distribution/v3						 v3.0.0-20230519140516-983358f8e250 \
	github.com/distribution/reference						 v0.6.0 \
	github.com/docker/cli								 v28.3.2+incompatible \
	github.com/docker/distribution							 v2.8.3+incompatible \
	github.com/docker/docker							 v28.5.2+incompatible \
	github.com/docker/docker-credential-helpers					 v0.9.3 \
	github.com/docker/go-connections						 v0.5.0 \
	github.com/docker/go-events							 v0.0.0-20190806004212-e31b211e4f1c \
	github.com/docker/go-metrics							 v0.0.1 \
	github.com/docker/go-units							 v0.5.0 \
	github.com/docker/libtrust							 v0.0.0-20160708172513-aabc10ec26b7 \
	github.com/dustin/go-humanize							 v1.0.1 \
	github.com/eggsampler/acme/v3							 v3.6.0 \
	github.com/elazarl/goproxy							 v1.8.2 \
	github.com/emicklei/go-restful/v3						 v3.12.2 \
	github.com/emirpasic/gods							 v1.18.1 \
	github.com/evanphx/json-patch							 v4.12.0+incompatible \
	github.com/exponent-io/jsonpath							 v0.0.0-20210407135951-1de76d718b3f \
	github.com/fatih/camelcase							 v1.0.0 \
	github.com/fatih/color								 v1.7.0 \
	github.com/felixge/fgprof							 v0.9.4 \
	github.com/felixge/httpsnoop							 v1.0.4 \
	github.com/fsnotify/fsnotify							 v1.9.0 \
	github.com/fsouza/go-dockerclient						 v1.10.0 \
	github.com/fvbommel/sortorder							 v1.1.0 \
	github.com/fxamacker/cbor/v2							 v2.9.0 \
	github.com/ghodss/yaml								 v1.0.0 \
	github.com/gliderlabs/ssh							 v0.3.8 \
	github.com/go-asn1-ber/asn1-ber							 v1.5.8-0.20250403174932-29230038a667 \
	github.com/go-errors/errors							 v1.4.2 \
	github.com/go-git/gcfg								 v1.5.1-0.20230307220236-3a3c6141e376 \
	github.com/go-git/go-billy/v5							 v5.6.1 \
	github.com/go-git/go-git-fixtures/v4						 v4.3.2-0.20231010084843-55a94097c399 \
	github.com/go-git/go-git/v5							 v5.13.1 \
	github.com/go-jose/go-jose/v3							 v3.0.3 \
	github.com/go-jose/go-jose/v4							 v4.1.3 \
	github.com/go-kit/kit								 v0.8.0 \
	github.com/go-ldap/ldap/v3							 v3.4.11 \
	github.com/go-logfmt/logfmt							 v0.4.0 \
	github.com/go-logr/logr								 v1.4.3 \
	github.com/go-logr/stdr								 v1.2.2 \
	github.com/go-logr/zapr								 v1.3.0 \
	github.com/go-openapi/jsonpointer						 v0.21.0 \
	github.com/go-openapi/jsonreference						 v0.21.0 \
	github.com/go-openapi/swag							 v0.23.0 \
	github.com/go-playground/locales						 v0.14.1 \
	github.com/go-playground/universal-translator					 v0.18.1 \
	github.com/go-rod/rod								 v0.116.2 \
	github.com/go-sql-driver/mysql							 v1.5.0 \
	github.com/go-stack/stack							 v1.8.0 \
	github.com/go-task/slim-sprig							 v0.0.0-20230315185526-52ccab3ef572 \
	github.com/go-task/slim-sprig/v3						 v3.0.0 \
	github.com/go-test/deep								 v1.1.1 \
	github.com/goadesign/goa							 v2.2.5+incompatible \
	github.com/gobuffalo/flect							 v0.2.0 \
	github.com/gobwas/httphead							 v0.1.0 \
	github.com/gobwas/pool								 v0.2.1 \
	github.com/gobwas/ws								 v1.2.1 \
	github.com/gofrs/flock								 v0.8.1 \
	github.com/gogo/googleapis							 v1.4.1 \
	github.com/gogo/protobuf							 v1.3.2 \
	github.com/golang-jwt/jwt/v4							 v4.4.2 \
	github.com/golang-jwt/jwt/v5							 v5.2.2 \
	github.com/golang/groupcache							 v0.0.0-20241129210726-2c02b8208cf8 \
	github.com/golang/protobuf							 v1.5.4 \
	github.com/golang/snappy							 v0.0.4 \
	github.com/gomodule/redigo							 v1.8.2 \
	github.com/gonum/blas								 v0.0.0-20181208220705-f22b278b28ac \
	github.com/gonum/floats								 v0.0.0-20181209220543-c233463c7e82 \
	github.com/gonum/graph								 v0.0.0-20170401004347-50b27dea7ebb \
	github.com/gonum/internal							 v0.0.0-20181124074243-f884aa714029 \
	github.com/gonum/lapack								 v0.0.0-20181123203213-e4cdc5a0bff9 \
	github.com/gonum/mathext							 v0.0.0-20181121095525-8a4bf007ea55 \
	github.com/gonum/matrix								 v0.0.0-20181209220409-c518dec07be9 \
	github.com/gonum/stat								 v0.0.0-20181125101827-41a0da705a5b \
	github.com/google/btree								 v1.1.3 \
	github.com/google/cel-go							 v0.26.0 \
	github.com/google/certificate-transparency-go					 v1.3.1 \
	github.com/google/gnostic							 v0.5.7-v3refs \
	github.com/google/gnostic-models						 v0.7.0 \
	github.com/google/go-cmp							 v0.7.0 \
	github.com/google/go-containerregistry						 v0.20.3 \
	github.com/google/go-intervals							 v0.0.2 \
	github.com/google/gofuzz							 v1.1.0 \
	github.com/google/pprof								 v0.0.0-20250403155104-27863c87afa6 \
	github.com/google/s2a-go							 v0.1.9 \
	github.com/google/shlex								 v0.0.0-20191202100458-e7afc7fbc510 \
	github.com/google/uuid								 v1.6.0 \
	github.com/googleapis/enterprise-certificate-proxy				 v0.3.4 \
	github.com/googleapis/gax-go/v2							 v2.14.1 \
	github.com/gorilla/handlers							 v1.5.1 \
	github.com/gorilla/mux								 v1.8.1 \
	github.com/gorilla/websocket							 v1.5.4-0.20250319132907-e064f32e3674 \
	github.com/gregjones/httpcache							 v0.0.0-20190611155906-901d90724c79 \
	github.com/grpc-ecosystem/go-grpc-middleware					 v1.4.0 \
	github.com/grpc-ecosystem/go-grpc-middleware/providers/prometheus		 v1.0.1 \
	github.com/grpc-ecosystem/go-grpc-middleware/v2					 v2.3.0 \
	github.com/grpc-ecosystem/go-grpc-prometheus					 v1.2.1-0.20210315223345-82c243799c99 \
	github.com/grpc-ecosystem/grpc-gateway/v2					 v2.26.3 \
	github.com/hanwen/go-fuse/v2							 v2.2.0 \
	github.com/hashicorp/errwrap							 v1.1.0 \
	github.com/hashicorp/go-cleanhttp						 v0.5.2 \
	github.com/hashicorp/go-immutable-radix						 v1.3.1 \
	github.com/hashicorp/go-multierror						 v1.1.1 \
	github.com/hashicorp/go-retryablehttp						 v0.7.8 \
	github.com/hashicorp/go-rootcerts						 v1.0.2 \
	github.com/hashicorp/go-secure-stdlib/parseutil					 v0.1.7 \
	github.com/hashicorp/go-secure-stdlib/strutil					 v0.1.2 \
	github.com/hashicorp/go-sockaddr						 v1.0.2 \
	github.com/hashicorp/go-uuid							 v1.0.3 \
	github.com/hashicorp/golang-lru							 v1.0.2 \
	github.com/hashicorp/hcl							 v1.0.0 \
	github.com/hashicorp/vault/api							 v1.15.0 \
	github.com/ianlancetaylor/demangle						 v0.0.0-20240312041847-bd984b5ce465 \
	github.com/imdario/mergo							 v0.3.7 \
	github.com/in-toto/in-toto-golang						 v0.5.0 \
	github.com/inconshreveable/mousetrap						 v1.1.0 \
	github.com/int128/listener							 v1.3.0 \
	github.com/int128/oauth2cli							 v1.18.0 \
	github.com/jbenet/go-context							 v0.0.0-20150711004518-d14ea06fba99 \
	github.com/jcmturner/aescts/v2							 v2.0.0 \
	github.com/jcmturner/dnsutils/v2						 v2.0.0 \
	github.com/jcmturner/gofork							 v1.7.6 \
	github.com/jcmturner/goidentity/v6						 v6.0.1 \
	github.com/jcmturner/gokrb5/v8							 v8.4.4 \
	github.com/jcmturner/rpc/v2							 v2.0.3 \
	github.com/jellydator/ttlcache/v3						 v3.3.0 \
	github.com/jmespath/go-jmespath							 v0.4.1-0.20220621161143-b0104c826a24 \
	github.com/jmhodges/clock							 v1.2.0 \
	github.com/joelanford/ignore							 v0.1.1 \
	github.com/jonboulle/clockwork							 v0.5.0 \
	github.com/josharian/intern							 v1.0.0 \
	github.com/jpillora/backoff							 v1.0.0 \
	github.com/json-iterator/go							 v1.1.12 \
	github.com/julienschmidt/httprouter						 v1.3.0 \
	github.com/kevinburke/ssh_config						 v1.2.0 \
	github.com/keybase/go-keychain							 v0.0.1 \
	github.com/kisielk/errcheck							 v1.5.0 \
	github.com/kisielk/gotool							 v1.0.0 \
	github.com/klauspost/compress							 v1.18.0 \
	github.com/klauspost/pgzip							 v1.2.6 \
	github.com/konsorten/go-windows-terminal-sequences				 v1.0.1 \
	github.com/kr/logfmt								 v0.0.0-20140226030751-b84e30acd515 \
	github.com/kr/pretty								 v0.3.1 \
	github.com/kr/text								 v0.2.0 \
	github.com/kylelemons/godebug							 v1.1.0 \
	github.com/ledongthuc/pdf							 v0.0.0-20220302134840-0c2507a12d80 \
	github.com/letsencrypt/borp							 v0.0.0-20230707160741-6cc6ce580243 \
	github.com/letsencrypt/boulder							 v0.0.0-20240620165639-de9c06129bec \
	github.com/letsencrypt/challtestsrv						 v1.2.1 \
	github.com/letsencrypt/pkcs11key/v4						 v4.0.0 \
	github.com/letsencrypt/validator/v10						 v10.0.0-20230215210743-a0c7dfc17158 \
	github.com/liggitt/tabwriter							 v0.0.0-20181228230101-89fcab3d43de \
	github.com/lithammer/dedent							 v1.1.0 \
	github.com/magiconair/properties						 v1.8.9 \
	github.com/mailru/easyjson							 v0.7.7 \
	github.com/manifoldco/promptui							 v0.9.0 \
	github.com/mattn/go-colorable							 v0.1.2 \
	github.com/mattn/go-isatty							 v0.0.8 \
	github.com/mattn/go-runewidth							 v0.0.16 \
	github.com/mattn/go-shellwords							 v1.0.12 \
	github.com/mattn/go-sqlite3							 v1.14.28 \
	github.com/matttproud/golang_protobuf_extensions				 v1.0.4 \
	github.com/miekg/dns								 v1.1.58 \
	github.com/miekg/pkcs11								 v1.1.1 \
	github.com/mistifyio/go-zfs/v3							 v3.0.1 \
	github.com/mitchellh/go-homedir							 v1.1.0 \
	github.com/mitchellh/go-wordwrap						 v1.0.1 \
	github.com/mitchellh/hashstructure/v2						 v2.0.2 \
	github.com/mitchellh/mapstructure						 v1.5.0 \
	github.com/mitchellh/osext							 v0.0.0-20151018003038-5e2d6d41470f \
	github.com/moby/buildkit							 v0.12.5 \
	github.com/moby/docker-image-spec						 v1.3.1 \
	github.com/moby/go-archive							 v0.1.0 \
	github.com/moby/locker								 v1.0.1 \
	github.com/moby/patternmatcher							 v0.6.0 \
	github.com/moby/spdystream							 v0.5.0 \
	github.com/moby/sys/atomicwriter						 v0.1.0 \
	github.com/moby/sys/capability							 v0.4.0 \
	github.com/moby/sys/mount							 v0.3.4 \
	github.com/moby/sys/mountinfo							 v0.7.2 \
	github.com/moby/sys/reexec							 v0.1.0 \
	github.com/moby/sys/sequential							 v0.6.0 \
	github.com/moby/sys/signal							 v0.7.0 \
	github.com/moby/sys/user							 v0.4.0 \
	github.com/moby/sys/userns							 v0.1.0 \
	github.com/moby/term								 v0.5.2 \
	github.com/modern-go/concurrent							 v0.0.0-20180306012644-bacd9c7ef1dd \
	github.com/modern-go/reflect2							 v1.0.3-0.20250322232337-35a7c28c31ee \
	github.com/monochromegane/go-gitignore						 v0.0.0-20200626010858-205db1a8cc00 \
	github.com/morikuni/aec								 v1.0.0 \
	github.com/munnerz/goautoneg							 v0.0.0-20191010083416-a7dc8b61c822 \
	github.com/mwitkow/go-conntrack							 v0.0.0-20190716064945-2f068394615f \
	github.com/mxk/go-flowrate							 v0.0.0-20140419014527-cca7078d478f \
	github.com/ncw/swift								 v1.0.47 \
	github.com/nxadm/tail								 v1.4.11 \
	github.com/onsi/ginkgo/v2							 v2.27.2 \
	github.com/onsi/gomega								 v1.38.2 \
	github.com/opencontainers/go-digest						 v1.0.0 \
	github.com/opencontainers/image-spec						 v1.1.1 \
	github.com/opencontainers/runc							 v1.1.7 \
	github.com/opencontainers/runtime-spec						 v1.2.1 \
	github.com/opencontainers/selinux						 v1.13.0 \
	github.com/openshift-eng/openshift-tests-extension				 v0.0.0-20250804142706-7b3ab438a292 \
	github.com/openshift/api							 v0.0.0-20260309185601-71270106f276 \
	github.com/openshift/build-machinery-go						 v0.0.0-20251023084048-5d77c1a5e5af \
	github.com/openshift/client-go							 v0.0.0-20260306160707-3935d929fc7d \
	github.com/openshift/gssapi							 v0.0.0-20161010215902-5fb4217df13b \
	github.com/openshift/library-go							 v0.0.0-20260303171201-5d9eb6295ff6 \
	github.com/openshift/onsi-ginkgo/v2						 v2.6.1-0.20251001123353-fd5b1fb35db1 \
	github.com/orisano/pixelmatch							 v0.0.0-20220722002657-fb0b55479cde \
	github.com/package-url/packageurl-go						 v0.1.1-0.20220428063043-89078438f170 \
	github.com/pelletier/go-toml							 v1.9.5 \
	github.com/pelletier/go-toml/v2							 v2.2.2 \
	github.com/peterbourgon/diskv							 v2.0.1+incompatible \
	github.com/pjbgf/sha1cd								 v0.3.0 \
	github.com/pkg/browser								 v0.0.0-20240102092130-5ac0b6a4141c \
	github.com/pkg/errors								 v0.9.1 \
	github.com/pkg/profile								 v1.7.0 \
	github.com/pmezard/go-difflib							 v1.0.1-0.20181226105442-5d4384ee4fb2 \
	github.com/poy/onpar								 v1.1.2 \
	github.com/pquerna/cachecontrol							 v0.1.0 \
	github.com/proglottis/gpgme							 v0.1.4 \
	github.com/prometheus-operator/prometheus-operator/pkg/apis/monitoring		 v0.74.0 \
	github.com/prometheus/client_golang						 v1.23.2 \
	github.com/prometheus/client_model						 v0.6.2 \
	github.com/prometheus/common							 v0.66.1 \
	github.com/prometheus/procfs							 v0.16.1 \
	github.com/redis/go-redis/v9							 v9.3.0 \
	github.com/rivo/uniseg								 v0.4.7 \
	github.com/robfig/cron								 v1.2.0 \
	github.com/rogpeppe/go-internal							 v1.14.1 \
	github.com/rs/cors								 v1.11.1 \
	github.com/russross/blackfriday							 v1.6.0 \
	github.com/russross/blackfriday/v2						 v2.1.0 \
	github.com/ryanuber/go-glob							 v1.0.0 \
	github.com/sagikazarmark/locafero						 v0.4.0 \
	github.com/sagikazarmark/slog-shim						 v0.1.0 \
	github.com/santhosh-tekuri/jsonschema/v5					 v5.3.1 \
	github.com/santhosh-tekuri/jsonschema/v6					 v6.0.2 \
	github.com/secure-systems-lab/go-securesystemslib				 v0.9.0 \
	github.com/segmentio/ksuid							 v1.0.4 \
	github.com/sergi/go-diff							 v1.3.2-0.20230802210424-5b0b94c5c0d3 \
	github.com/serialx/hashring							 v0.0.0-20190422032157-8b2912629002 \
	github.com/shibumi/go-pathspec							 v1.3.0 \
	github.com/sigstore/fulcio							 v1.6.6 \
	github.com/sigstore/protobuf-specs						 v0.4.1 \
	github.com/sigstore/sigstore							 v1.9.5 \
	github.com/sigstore/sigstore/pkg/signature/kms/aws				 v1.8.12 \
	github.com/sigstore/sigstore/pkg/signature/kms/azure				 v1.8.12 \
	github.com/sigstore/sigstore/pkg/signature/kms/gcp				 v1.8.12 \
	github.com/sigstore/sigstore/pkg/signature/kms/hashivault			 v1.8.12 \
	github.com/sirupsen/logrus							 v1.9.3 \
	github.com/skeema/knownhosts							 v1.3.0 \
	github.com/skratchdot/open-golang						 v0.0.0-20200116055534-eef842397966 \
	github.com/smallstep/pkcs7							 v0.1.1 \
	github.com/soheilhy/cmux							 v0.1.5 \
	github.com/sourcegraph/conc							 v0.3.0 \
	github.com/spdx/tools-golang							 v0.5.1 \
	github.com/spf13/afero								 v1.11.0 \
	github.com/spf13/cast								 v1.7.0 \
	github.com/spf13/cobra								 v1.10.2 \
	github.com/spf13/pflag								 v1.0.10 \
	github.com/spf13/viper								 v1.19.0 \
	github.com/spiffe/go-spiffe/v2							 v2.4.0 \
	github.com/stefanberger/go-pkcs11uri						 v0.0.0-20230803200340-78284954bff6 \
	github.com/stoewer/go-strcase							 v1.3.0 \
	github.com/stretchr/objx							 v0.5.2 \
	github.com/stretchr/testify							 v1.11.1 \
	github.com/subosito/gotenv							 v1.6.0 \
	github.com/sylabs/sif/v2							 v2.21.1 \
	github.com/syndtr/goleveldb							 v1.0.1-0.20220721030215-126854af5e6d \
	github.com/tchap/go-patricia/v2							 v2.3.3 \
	github.com/thales-e-security/pool						 v0.0.2 \
	github.com/theupdateframework/go-tuf						 v0.7.0 \
	github.com/tink-crypto/tink-go-awskms/v2					 v2.1.0 \
	github.com/tink-crypto/tink-go-gcpkms/v2					 v2.2.0 \
	github.com/tink-crypto/tink-go/v2						 v2.4.0 \
	github.com/titanous/rocacheck							 v0.0.0-20171023193734-afe73141d399 \
	github.com/tmc/grpc-websocket-proxy						 v0.0.0-20220101234140-673ab2c3ae75 \
	github.com/tonistiigi/fsutil							 v0.0.0-20230629203738-36ef4d8c0dbb \
	github.com/tonistiigi/go-actions-cache						 v0.0.0-20220404170428-0bdeb6e1eac7 \
	github.com/tonistiigi/go-archvariant						 v1.0.0 \
	github.com/tonistiigi/units							 v0.0.0-20180711220420-6950e57a87ea \
	github.com/tonistiigi/vt100							 v0.0.0-20230623042737-f9a4f7ef6531 \
	github.com/ulikunitz/xz								 v0.5.12 \
	github.com/urfave/cli								 v1.22.12 \
	github.com/vbatts/tar-split							 v0.12.1 \
	github.com/vbauerster/mpb/v8							 v8.10.2 \
	github.com/vincent-petithory/dataurl						 v1.0.0 \
	github.com/weppos/publicsuffix-go						 v0.30.3-0.20240510084413-5f1d03393b3d \
	github.com/x448/float16								 v0.8.4 \
	github.com/xanzy/ssh-agent							 v0.3.3 \
	github.com/xhit/go-str2duration/v2						 v2.1.0 \
	github.com/xiang90/probing							 v0.0.0-20221125231312-a49e3df8f510 \
	github.com/xlab/treeprint							 v1.2.0 \
	github.com/ysmood/fetchup							 v0.2.3 \
	github.com/ysmood/goob								 v0.4.0 \
	github.com/ysmood/got								 v0.40.0 \
	github.com/ysmood/gson								 v0.7.3 \
	github.com/ysmood/leakless							 v0.9.0 \
	github.com/yuin/goldmark							 v1.4.13 \
	github.com/yvasiyarov/go-metrics						 v0.0.0-20140926110328-57bccd1ccd43 \
	github.com/yvasiyarov/gorelic							 v0.0.0-20141212073537-a9bba5b9ab50 \
	github.com/yvasiyarov/newrelic_platform_go					 v0.0.0-20140908184405-b21fdbd4370f \
	github.com/zmap/zcrypto								 v0.0.0-20231219022726-a1f61fb1661c \
	github.com/zmap/zlint/v3							 v3.6.0 \
	go.etcd.io/bbolt								 v1.4.3 \
	go.etcd.io/etcd/api/v3								 v3.6.5 \
	go.etcd.io/etcd/client/pkg/v3							 v3.6.5 \
	go.etcd.io/etcd/client/v3							 v3.6.5 \
	go.etcd.io/etcd/pkg/v3								 v3.6.5 \
	go.etcd.io/etcd/server/v3							 v3.6.5 \
	go.etcd.io/raft/v3								 v3.6.0 \
	go.opencensus.io								 v0.24.0 \
	go.opentelemetry.io/auto/sdk							 v1.1.0 \
	go.opentelemetry.io/contrib/instrumentation/google.golang.org/grpc/otelgrpc	 v0.60.0 \
	go.opentelemetry.io/contrib/instrumentation/net/http/httptrace/otelhttptrace	 v0.40.0 \
	go.opentelemetry.io/contrib/instrumentation/net/http/otelhttp			 v0.61.0 \
	go.opentelemetry.io/otel							 v1.36.0 \
	go.opentelemetry.io/otel/exporters/jaeger					 v1.14.0 \
	go.opentelemetry.io/otel/exporters/otlp/internal/retry				 v1.14.0 \
	go.opentelemetry.io/otel/exporters/otlp/otlptrace				 v1.34.0 \
	go.opentelemetry.io/otel/exporters/otlp/otlptrace/otlptracegrpc			 v1.34.0 \
	go.opentelemetry.io/otel/exporters/otlp/otlptrace/otlptracehttp			 v1.35.0 \
	go.opentelemetry.io/otel/metric							 v1.36.0 \
	go.opentelemetry.io/otel/sdk							 v1.36.0 \
	go.opentelemetry.io/otel/trace							 v1.36.0 \
	go.opentelemetry.io/proto/otlp							 v1.5.0 \
	go.step.sm/crypto								 v0.57.0 \
	go.uber.org/automaxprocs							 v1.6.0 \
	go.uber.org/goleak								 v1.3.0 \
	go.uber.org/multierr								 v1.11.0 \
	go.uber.org/zap									 v1.27.0 \
	go.yaml.in/yaml/v2								 v2.4.3 \
	go.yaml.in/yaml/v3								 v3.0.4 \
	goa.design/goa									 v2.2.5+incompatible \
	golang.org/x/crypto								 v0.49.0 \
	golang.org/x/exp								 v0.0.0-20241108190413-2d47ceb2692f \
	golang.org/x/image								 v0.0.0-20190227222117-0694c2d4d067 \
	golang.org/x/mobile								 v0.0.0-20190312151609-d3739f865fa6 \
	golang.org/x/mod								 v0.33.0 \
	golang.org/x/net								 v0.52.0 \
	golang.org/x/oauth2								 v0.36.0 \
	golang.org/x/sync								 v0.20.0 \
	golang.org/x/sys								 v0.42.0 \
	golang.org/x/telemetry								 v0.0.0-20260209163413-e7419c687ee4 \
	golang.org/x/term								 v0.41.0 \
	golang.org/x/text								 v0.35.0 \
	golang.org/x/time								 v0.11.0 \
	golang.org/x/tools								 v0.42.0 \
	golang.org/x/tools/go/expect							 v0.1.0-deprecated \
	golang.org/x/tools/go/packages/packagestest					 v0.1.1-deprecated \
	golang.org/x/xerrors								 v0.0.0-20200804184101-5ec99f83aff1 \
	google.golang.org/api								 v0.217.0 \
	google.golang.org/appengine							 v1.6.7 \
	google.golang.org/cloud								 v0.0.0-20151119220103-975617b05ea8 \
	google.golang.org/genproto							 v0.0.0-20241118233622-e639e219e697 \
	google.golang.org/genproto/googleapis/api					 v0.0.0-20250303144028-a0af3efb3deb \
	google.golang.org/genproto/googleapis/rpc					 v0.0.0-20250528174236-200df99c418a \
	google.golang.org/grpc								 v1.72.2 \
	google.golang.org/protobuf							 v1.36.8 \
	gopkg.in/alecthomas/kingpin.v2							 v2.2.6 \
	gopkg.in/check.v1								 v1.0.0-20201130134442-10cb98267c6c \
	gopkg.in/evanphx/json-patch.v4							 v4.13.0 \
	gopkg.in/go-jose/go-jose.v2							 v2.6.3 \
	gopkg.in/inf.v0									 v0.9.1 \
	gopkg.in/ini.v1									 v1.67.0 \
	gopkg.in/natefinch/lumberjack.v2						 v2.2.1 \
	gopkg.in/tomb.v1								 v1.0.0-20141024135613-dd632973f1e7 \
	gopkg.in/warnings.v0								 v0.1.2 \
	gopkg.in/yaml.v2								 v2.4.0 \
	gopkg.in/yaml.v3								 v3.0.1 \
	gotest.tools/v3									 v3.5.2 \
	k8s.io/api									 v0.35.2 \
	k8s.io/apiextensions-apiserver							 v0.35.2 \
	k8s.io/apimachinery								 v0.35.2 \
	k8s.io/apiserver								 v0.35.2 \
	k8s.io/cli-runtime								 v0.35.2 \
	k8s.io/client-go								 v0.35.2 \
	k8s.io/code-generator								 v0.35.2 \
	k8s.io/component-base								 v0.35.2 \
	k8s.io/component-helpers							 v0.35.2 \
	k8s.io/gengo									 v0.0.0-20220902162205-c0856e24416d \
	k8s.io/gengo/v2									 v2.0.0-20250922181213-ec3ebc5fd46b \
	k8s.io/klog/v2									 v2.140.0 \
	k8s.io/kms									 v0.35.2 \
	k8s.io/kube-aggregator								 v0.35.1 \
	k8s.io/kube-openapi								 v0.0.0-20250910181357-589584f1c912 \
	k8s.io/kubectl									 v0.35.2 \
	k8s.io/metrics									 v0.35.2 \
	k8s.io/pod-security-admission							 v0.35.2 \
	k8s.io/utils									 v0.0.0-20260210185600-b8788abfbbc2 \
	kernel.org/pub/linux/libs/security/libcap/cap					 v1.2.67 \
	kernel.org/pub/linux/libs/security/libcap/psx					 v1.2.67 \
	sigs.k8s.io/apiserver-network-proxy/konnectivity-client				 v0.31.2 \
	sigs.k8s.io/controller-tools							 v0.4.1 \
	sigs.k8s.io/json								 v0.0.0-20250730193827-2d320260d730 \
	sigs.k8s.io/kube-storage-version-migrator					 v0.0.6-0.20230721195810-5c8923c5ff96 \
	sigs.k8s.io/kustomize/api							 v0.20.1 \
	sigs.k8s.io/kustomize/cmd/config						 v0.20.1 \
	sigs.k8s.io/kustomize/kustomize/v5						 v5.7.1 \
	sigs.k8s.io/kustomize/kyaml							 v0.20.1 \
	sigs.k8s.io/randfill								 v1.0.0 \
	sigs.k8s.io/release-utils							 v0.9.0 \
	sigs.k8s.io/structured-merge-diff/v4						 v4.2.3 \
	sigs.k8s.io/structured-merge-diff/v6						 v6.3.0 \
	sigs.k8s.io/yaml								 v1.6.0
MODGO_MODFILES =	\
	cloud.google.com/go								 v0.65.0 \
	cloud.google.com/go/compute/metadata						 v0.3.0 \
	dario.cat/mergo									 v1.0.0 \
	github.com/!ada!logics/go-fuzz-headers						 v0.0.0-20221103172237-443f56ff4ba8 \
	github.com/!ada!logics/go-fuzz-headers						 v0.0.0-20230106234847-43070de90fa1 \
	github.com/!azure!a!d/microsoft-authentication-library-for-go			 v0.6.0 \
	github.com/!azure!a!d/microsoft-authentication-library-for-go			 v0.8.1 \
	github.com/!azure/azure-sdk-for-go/sdk/azcore					 v1.1.0 \
	github.com/!azure/azure-sdk-for-go/sdk/azcore					 v1.3.0 \
	github.com/!azure/azure-sdk-for-go/sdk/azidentity				 v1.1.0 \
	github.com/!azure/azure-sdk-for-go/sdk/azidentity				 v1.2.1 \
	github.com/!azure/azure-sdk-for-go/sdk/internal					 v1.0.0 \
	github.com/!azure/azure-sdk-for-go/sdk/internal					 v1.1.1 \
	github.com/!azure/azure-sdk-for-go/sdk/storage/azblob				 v0.4.1 \
	github.com/!azure/go-ansiterm							 v0.0.0-20210617225240-d185dfc1b5a1 \
	github.com/!azure/go-ansiterm							 v0.0.0-20230124172434-306776ec8161 \
	github.com/!masterminds/semver/v3						 v3.1.0 \
	github.com/!microsoft/go-winio							 v0.4.14 \
	github.com/!microsoft/go-winio							 v0.6.1 \
	github.com/!microsoft/hcsshim							 v0.10.0-rc.8 \
	github.com/alecthomas/units							 v0.0.0-20151022065526-2efee857e7cf \
	github.com/alexbrainman/sspi							 v0.0.0-20231016080023-1a75b4708caa \
	github.com/aws/aws-sdk-go							 v1.43.16 \
	github.com/aws/aws-sdk-go-v2							 v1.17.6 \
	github.com/aws/aws-sdk-go-v2							 v1.27.2 \
	github.com/aws/aws-sdk-go-v2							 v1.32.8 \
	github.com/aws/aws-sdk-go-v2/aws/protocol/eventstream				 v1.4.10 \
	github.com/aws/aws-sdk-go-v2/aws/protocol/eventstream				 v1.6.2 \
	github.com/aws/aws-sdk-go-v2/config						 v1.18.16 \
	github.com/aws/aws-sdk-go-v2/config						 v1.27.18 \
	github.com/aws/aws-sdk-go-v2/config						 v1.28.10 \
	github.com/aws/aws-sdk-go-v2/credentials					 v1.13.16 \
	github.com/aws/aws-sdk-go-v2/credentials					 v1.17.18 \
	github.com/aws/aws-sdk-go-v2/credentials					 v1.17.51 \
	github.com/aws/aws-sdk-go-v2/feature/ec2/imds					 v1.12.24 \
	github.com/aws/aws-sdk-go-v2/feature/ec2/imds					 v1.16.23 \
	github.com/aws/aws-sdk-go-v2/feature/ec2/imds					 v1.16.5 \
	github.com/aws/aws-sdk-go-v2/feature/s3/manager					 v1.11.56 \
	github.com/aws/aws-sdk-go-v2/internal/configsources				 v1.1.30 \
	github.com/aws/aws-sdk-go-v2/internal/configsources				 v1.3.27 \
	github.com/aws/aws-sdk-go-v2/internal/configsources				 v1.3.9 \
	github.com/aws/aws-sdk-go-v2/internal/endpoints/v2				 v2.4.24 \
	github.com/aws/aws-sdk-go-v2/internal/endpoints/v2				 v2.6.27 \
	github.com/aws/aws-sdk-go-v2/internal/endpoints/v2				 v2.6.9 \
	github.com/aws/aws-sdk-go-v2/internal/ini					 v1.3.31 \
	github.com/aws/aws-sdk-go-v2/internal/ini					 v1.8.0 \
	github.com/aws/aws-sdk-go-v2/internal/ini					 v1.8.1 \
	github.com/aws/aws-sdk-go-v2/internal/v4a					 v1.0.22 \
	github.com/aws/aws-sdk-go-v2/internal/v4a					 v1.3.9 \
	github.com/aws/aws-sdk-go-v2/service/internal/accept-encoding			 v1.11.2 \
	github.com/aws/aws-sdk-go-v2/service/internal/accept-encoding			 v1.12.1 \
	github.com/aws/aws-sdk-go-v2/service/internal/accept-encoding			 v1.9.11 \
	github.com/aws/aws-sdk-go-v2/service/internal/checksum				 v1.1.25 \
	github.com/aws/aws-sdk-go-v2/service/internal/checksum				 v1.3.11 \
	github.com/aws/aws-sdk-go-v2/service/internal/presigned-url			 v1.11.11 \
	github.com/aws/aws-sdk-go-v2/service/internal/presigned-url			 v1.12.8 \
	github.com/aws/aws-sdk-go-v2/service/internal/presigned-url			 v1.9.24 \
	github.com/aws/aws-sdk-go-v2/service/internal/s3shared				 v1.13.24 \
	github.com/aws/aws-sdk-go-v2/service/internal/s3shared				 v1.17.9 \
	github.com/aws/aws-sdk-go-v2/service/s3						 v1.30.6 \
	github.com/aws/aws-sdk-go-v2/service/s3						 v1.55.1 \
	github.com/aws/aws-sdk-go-v2/service/sso					 v1.12.5 \
	github.com/aws/aws-sdk-go-v2/service/sso					 v1.20.11 \
	github.com/aws/aws-sdk-go-v2/service/sso					 v1.24.9 \
	github.com/aws/aws-sdk-go-v2/service/ssooidc					 v1.14.5 \
	github.com/aws/aws-sdk-go-v2/service/ssooidc					 v1.24.5 \
	github.com/aws/aws-sdk-go-v2/service/ssooidc					 v1.28.8 \
	github.com/aws/aws-sdk-go-v2/service/sts					 v1.18.6 \
	github.com/aws/aws-sdk-go-v2/service/sts					 v1.28.12 \
	github.com/aws/aws-sdk-go-v2/service/sts					 v1.33.6 \
	github.com/aws/smithy-go							 v1.13.5 \
	github.com/aws/smithy-go							 v1.20.2 \
	github.com/aws/smithy-go							 v1.22.1 \
	github.com/beorn7/perks								 v0.0.0-20180321164747-3a771d992973 \
	github.com/beorn7/perks								 v1.0.0 \
	github.com/cenkalti/backoff/v4							 v4.2.0 \
	github.com/cespare/xxhash/v2							 v2.1.2 \
	github.com/cespare/xxhash/v2							 v2.2.0 \
	github.com/chzyer/logex								 v1.1.10 \
	github.com/chzyer/readline							 v0.0.0-20180603132655-2972be24d48e \
	github.com/chzyer/test								 v0.0.0-20180213035817-a1ea475d72b1 \
	github.com/containerd/containerd						 v1.6.18 \
	github.com/containerd/errdefs							 v0.3.0 \
	github.com/containerd/stargz-snapshotter/estargz				 v0.14.3 \
	github.com/containerd/typeurl/v2						 v2.1.1 \
	github.com/containerd/typeurl/v2						 v2.2.0 \
	github.com/coreos/go-oidc/v3							 v3.12.0 \
	github.com/coreos/go-oidc/v3							 v3.14.1 \
	github.com/cpuguy83/go-md2man/v2						 v2.0.2 \
	github.com/cyphar/filepath-securejoin						 v0.2.3 \
	github.com/cyphar/filepath-securejoin						 v0.2.4 \
	github.com/cyphar/filepath-securejoin						 v0.3.6 \
	github.com/cyphar/filepath-securejoin						 v0.4.1 \
	github.com/davecgh/go-spew							 v1.1.0 \
	github.com/davecgh/go-spew							 v1.1.1 \
	github.com/distribution/distribution/v3						 v3.0.0-20230511163743-f7717b7855ca \
	github.com/docker/cli								 v24.0.4+incompatible \
	github.com/docker/cli								 v27.5.0+incompatible \
	github.com/docker/distribution							 v2.8.2+incompatible \
	github.com/docker/docker							 v24.0.0-rc.2.0.20230718135204-8e51b8b59cb8+incompatible \
	github.com/docker/docker							 v24.0.6+incompatible \
	github.com/docker/docker							 v27.5.0+incompatible \
	github.com/docker/docker							 v28.3.2+incompatible \
	github.com/docker/docker-credential-helpers					 v0.7.0 \
	github.com/docker/docker-credential-helpers					 v0.8.2 \
	github.com/docker/go-connections						 v0.4.0 \
	github.com/docker/libtrust							 v0.0.0-20150114040149-fa567046d9b1 \
	github.com/elazarl/goproxy							 v1.2.3 \
	github.com/emicklei/go-restful/v3						 v3.11.0 \
	github.com/emicklei/go-restful/v3						 v3.9.0 \
	github.com/felixge/fgprof							 v0.9.3 \
	github.com/felixge/httpsnoop							 v1.0.1 \
	github.com/felixge/httpsnoop							 v1.0.3 \
	github.com/fsnotify/fsnotify							 v1.6.0 \
	github.com/fsnotify/fsnotify							 v1.8.0 \
	github.com/go-jose/go-jose/v4							 v4.0.1 \
	github.com/go-jose/go-jose/v4							 v4.0.4 \
	github.com/go-jose/go-jose/v4							 v4.0.5 \
	github.com/go-logfmt/logfmt							 v0.3.0 \
	github.com/go-logr/logr								 v1.2.0 \
	github.com/go-logr/logr								 v1.2.3 \
	github.com/go-logr/logr								 v1.4.1 \
	github.com/go-logr/logr								 v1.4.2 \
	github.com/go-openapi/jsonpointer						 v0.19.6 \
	github.com/go-openapi/jsonreference						 v0.20.1 \
	github.com/go-openapi/jsonreference						 v0.20.2 \
	github.com/go-openapi/swag							 v0.22.3 \
	github.com/gogo/protobuf							 v1.1.1 \
	github.com/golang-jwt/jwt/v5							 v5.2.1 \
	github.com/golang/groupcache							 v0.0.0-20200121045136-8c9f03a8e57e \
	github.com/golang/groupcache							 v0.0.0-20210331224755-41bb18bfe9da \
	github.com/golang/protobuf							 v1.2.0 \
	github.com/golang/protobuf							 v1.3.1 \
	github.com/golang/protobuf							 v1.3.2 \
	github.com/golang/protobuf							 v1.5.0 \
	github.com/golang/protobuf							 v1.5.2 \
	github.com/golang/protobuf							 v1.5.3 \
	github.com/google/cel-go							 v0.17.8 \
	github.com/google/certificate-transparency-go					 v1.1.6 \
	github.com/google/gnostic-models						 v0.6.9 \
	github.com/google/go-cmp							 v0.3.0 \
	github.com/google/go-cmp							 v0.5.5 \
	github.com/google/go-cmp							 v0.5.8 \
	github.com/google/go-cmp							 v0.5.9 \
	github.com/google/go-cmp							 v0.6.0 \
	github.com/google/go-containerregistry						 v0.20.2 \
	github.com/google/gofuzz							 v1.0.0 \
	github.com/google/pprof								 v0.0.0-20210720184732-4bb14d4b1be1 \
	github.com/google/pprof								 v0.0.0-20211214055906-6f57359322fd \
	github.com/google/pprof								 v0.0.0-20240227163752-401108e1b7e7 \
	github.com/google/pprof								 v0.0.0-20240727154555-813a5fbdbec8 \
	github.com/google/pprof								 v0.0.0-20241029153458-d1b30febd7db \
	github.com/google/uuid								 v1.1.1 \
	github.com/google/uuid								 v1.3.0 \
	github.com/googleapis/gax-go/v2							 v2.0.5 \
	github.com/gorilla/mux								 v1.8.0 \
	github.com/grpc-ecosystem/go-grpc-middleware					 v1.3.0 \
	github.com/grpc-ecosystem/go-grpc-prometheus					 v1.2.0 \
	github.com/grpc-ecosystem/grpc-gateway/v2					 v2.11.3 \
	github.com/grpc-ecosystem/grpc-gateway/v2					 v2.20.0 \
	github.com/grpc-ecosystem/grpc-gateway/v2					 v2.25.1 \
	github.com/hashicorp/go-retryablehttp						 v0.7.2 \
	github.com/hashicorp/go-retryablehttp						 v0.7.7 \
	github.com/hashicorp/golang-lru							 v0.5.4 \
	github.com/ianlancetaylor/demangle						 v0.0.0-20210905161508-09a460cdf81d \
	github.com/ianlancetaylor/demangle						 v0.0.0-20230524184225-eabc099b10ab \
	github.com/inconshreveable/mousetrap						 v1.0.1 \
	github.com/jmespath/go-jmespath							 v0.4.0 \
	github.com/json-iterator/go							 v1.1.6 \
	github.com/json-iterator/go							 v1.1.7 \
	github.com/julienschmidt/httprouter						 v1.2.0 \
	github.com/klauspost/compress							 v1.11.13 \
	github.com/klauspost/compress							 v1.17.11 \
	github.com/klauspost/compress							 v1.17.2 \
	github.com/kr/pretty								 v0.2.1 \
	github.com/matttproud/golang_protobuf_extensions				 v1.0.1 \
	github.com/matttproud/golang_protobuf_extensions				 v1.0.2 \
	github.com/mitchellh/mapstructure						 v1.1.2 \
	github.com/moby/patternmatcher							 v0.5.0 \
	github.com/moby/sys/mount							 v0.3.3 \
	github.com/moby/sys/mountinfo							 v0.6.2 \
	github.com/moby/sys/sequential							 v0.5.0 \
	github.com/moby/term								 v0.0.0-20210619224110-3f7ff695adc6 \
	github.com/moby/term								 v0.0.0-20221205130635-1aeaba878587 \
	github.com/moby/term								 v0.5.0 \
	github.com/modern-go/concurrent							 v0.0.0-20180228061459-e0a39a4cb421 \
	github.com/modern-go/reflect2							 v0.0.0-20180701023420-4b7aa43c6742 \
	github.com/modern-go/reflect2							 v1.0.1 \
	github.com/modern-go/reflect2							 v1.0.2 \
	github.com/mwitkow/go-conntrack							 v0.0.0-20161129095857-cc309e4a2223 \
	github.com/onsi/ginkgo/v2							 v2.19.0 \
	github.com/onsi/ginkgo/v2							 v2.21.0 \
	github.com/onsi/ginkgo/v2							 v2.25.1 \
	github.com/onsi/ginkgo/v2							 v2.9.2 \
	github.com/onsi/gomega								 v1.33.1 \
	github.com/onsi/gomega								 v1.34.1 \
	github.com/onsi/gomega								 v1.34.2 \
	github.com/onsi/gomega								 v1.35.1 \
	github.com/opencontainers/image-spec						 v1.0.2 \
	github.com/opencontainers/image-spec						 v1.0.3-0.20211202183452-c5a74bcca799 \
	github.com/opencontainers/image-spec						 v1.1.0 \
	github.com/opencontainers/image-spec						 v1.1.0-rc3 \
	github.com/opencontainers/runc							 v1.1.5 \
	github.com/opencontainers/runtime-spec						 v1.1.0-rc.2 \
	github.com/opencontainers/selinux						 v1.11.0 \
	github.com/opencontainers/selinux						 v1.12.0 \
	github.com/openshift/api							 v0.0.0-20260302174620-dcac36b908db \
	github.com/openshift/api							 v0.0.0-20260306002634-d3bbdada155c \
	github.com/openshift/build-machinery-go						 v0.0.0-20250530140348-dc5b2804eeee \
	github.com/openshift/client-go							 v0.0.0-20260302182750-20813ce71ca6 \
	github.com/pkg/browser								 v0.0.0-20210115035449-ce105d075bb4 \
	github.com/pkg/browser								 v0.0.0-20210911075715-681adbf594b8 \
	github.com/pkg/errors								 v0.8.0 \
	github.com/pkg/profile								 v1.5.0 \
	github.com/pmezard/go-difflib							 v1.0.0 \
	github.com/prometheus/client_golang						 v0.9.1 \
	github.com/prometheus/client_golang						 v1.0.0 \
	github.com/prometheus/client_golang						 v1.1.0 \
	github.com/prometheus/client_golang						 v1.12.1 \
	github.com/prometheus/client_golang						 v1.14.0 \
	github.com/prometheus/client_golang						 v1.15.1 \
	github.com/prometheus/client_golang						 v1.20.4 \
	github.com/prometheus/client_golang						 v1.20.5 \
	github.com/prometheus/client_golang						 v1.22.0 \
	github.com/prometheus/client_model						 v0.0.0-20180712105110-5c3871d89910 \
	github.com/prometheus/client_model						 v0.0.0-20190129233127-fd36f4220a90 \
	github.com/prometheus/client_model						 v0.2.0 \
	github.com/prometheus/client_model						 v0.3.0 \
	github.com/prometheus/client_model						 v0.4.0 \
	github.com/prometheus/client_model						 v0.6.1 \
	github.com/prometheus/common							 v0.32.1 \
	github.com/prometheus/common							 v0.37.0 \
	github.com/prometheus/common							 v0.4.1 \
	github.com/prometheus/common							 v0.42.0 \
	github.com/prometheus/common							 v0.6.0 \
	github.com/prometheus/common							 v0.62.0 \
	github.com/prometheus/procfs							 v0.0.0-20181005140218-185b4288413d \
	github.com/prometheus/procfs							 v0.0.2 \
	github.com/prometheus/procfs							 v0.0.3 \
	github.com/prometheus/procfs							 v0.15.1 \
	github.com/prometheus/procfs							 v0.7.3 \
	github.com/prometheus/procfs							 v0.8.0 \
	github.com/prometheus/procfs							 v0.9.0 \
	github.com/rogpeppe/go-internal							 v1.10.0 \
	github.com/rogpeppe/go-internal							 v1.11.0 \
	github.com/rogpeppe/go-internal							 v1.12.0 \
	github.com/secure-systems-lab/go-securesystemslib				 v0.4.0 \
	github.com/sergi/go-diff							 v1.0.0 \
	github.com/sergi/go-diff							 v1.2.0 \
	github.com/sergi/go-diff							 v1.3.1 \
	github.com/sigstore/sigstore							 v1.8.12 \
	github.com/sirupsen/logrus							 v1.2.0 \
	github.com/sirupsen/logrus							 v1.8.1 \
	github.com/sirupsen/logrus							 v1.9.0 \
	github.com/spf13/cobra								 v1.10.0 \
	github.com/spf13/cobra								 v1.6.0 \
	github.com/spf13/cobra								 v1.6.1 \
	github.com/spf13/cobra								 v1.8.0 \
	github.com/spf13/cobra								 v1.8.1 \
	github.com/spf13/pflag								 v1.0.5 \
	github.com/spf13/pflag								 v1.0.6 \
	github.com/spf13/pflag								 v1.0.9 \
	github.com/stefanberger/go-pkcs11uri						 v0.0.0-20201008174630-78d3cae3a980 \
	github.com/stoewer/go-strcase							 v1.2.0 \
	github.com/stretchr/objx							 v0.1.0 \
	github.com/stretchr/objx							 v0.1.1 \
	github.com/stretchr/objx							 v0.4.0 \
	github.com/stretchr/objx							 v0.5.0 \
	github.com/stretchr/testify							 v1.10.0 \
	github.com/stretchr/testify							 v1.2.2 \
	github.com/stretchr/testify							 v1.3.0 \
	github.com/stretchr/testify							 v1.6.1 \
	github.com/stretchr/testify							 v1.7.0 \
	github.com/stretchr/testify							 v1.7.1 \
	github.com/stretchr/testify							 v1.8.0 \
	github.com/stretchr/testify							 v1.8.1 \
	github.com/stretchr/testify							 v1.8.2 \
	github.com/stretchr/testify							 v1.8.3 \
	github.com/stretchr/testify							 v1.8.4 \
	github.com/stretchr/testify							 v1.9.0 \
	github.com/tink-crypto/tink-go/v2						 v2.3.0 \
	github.com/vbatts/tar-split							 v0.11.2 \
	github.com/vbatts/tar-split							 v0.11.6 \
	github.com/yuin/goldmark							 v1.1.27 \
	github.com/yuin/goldmark							 v1.2.1 \
	go.etcd.io/bbolt								 v1.3.7 \
	go.etcd.io/bbolt								 v1.4.2 \
	go.opencensus.io								 v0.22.4 \
	go.opentelemetry.io/contrib/instrumentation/google.golang.org/grpc/otelgrpc	 v0.40.0 \
	go.opentelemetry.io/contrib/instrumentation/google.golang.org/grpc/otelgrpc	 v0.52.0 \
	go.opentelemetry.io/contrib/instrumentation/google.golang.org/grpc/otelgrpc	 v0.57.0 \
	go.opentelemetry.io/contrib/instrumentation/net/http/otelhttp			 v0.40.0 \
	go.opentelemetry.io/contrib/instrumentation/net/http/otelhttp			 v0.52.0 \
	go.opentelemetry.io/contrib/instrumentation/net/http/otelhttp			 v0.57.0 \
	go.opentelemetry.io/contrib/instrumentation/net/http/otelhttp			 v0.58.0 \
	go.opentelemetry.io/contrib/instrumentation/net/http/otelhttp			 v0.60.0 \
	go.opentelemetry.io/otel							 v1.14.0 \
	go.opentelemetry.io/otel							 v1.27.0 \
	go.opentelemetry.io/otel							 v1.32.0 \
	go.opentelemetry.io/otel							 v1.33.0 \
	go.opentelemetry.io/otel							 v1.35.0 \
	go.opentelemetry.io/otel/exporters/otlp/otlptrace				 v1.14.0 \
	go.opentelemetry.io/otel/exporters/otlp/otlptrace				 v1.27.0 \
	go.opentelemetry.io/otel/exporters/otlp/otlptrace				 v1.32.0 \
	go.opentelemetry.io/otel/exporters/otlp/otlptrace/otlptracegrpc			 v1.14.0 \
	go.opentelemetry.io/otel/exporters/otlp/otlptrace/otlptracegrpc			 v1.27.0 \
	go.opentelemetry.io/otel/exporters/otlp/otlptrace/otlptracegrpc			 v1.32.0 \
	go.opentelemetry.io/otel/exporters/otlp/otlptrace/otlptracehttp			 v1.14.0 \
	go.opentelemetry.io/otel/exporters/otlp/otlptrace/otlptracehttp			 v1.33.0 \
	go.opentelemetry.io/otel/metric							 v0.37.0 \
	go.opentelemetry.io/otel/metric							 v1.27.0 \
	go.opentelemetry.io/otel/metric							 v1.32.0 \
	go.opentelemetry.io/otel/metric							 v1.33.0 \
	go.opentelemetry.io/otel/metric							 v1.35.0 \
	go.opentelemetry.io/otel/sdk							 v1.14.0 \
	go.opentelemetry.io/otel/sdk							 v1.27.0 \
	go.opentelemetry.io/otel/sdk							 v1.32.0 \
	go.opentelemetry.io/otel/sdk							 v1.33.0 \
	go.opentelemetry.io/otel/trace							 v1.14.0 \
	go.opentelemetry.io/otel/trace							 v1.27.0 \
	go.opentelemetry.io/otel/trace							 v1.32.0 \
	go.opentelemetry.io/otel/trace							 v1.33.0 \
	go.opentelemetry.io/otel/trace							 v1.35.0 \
	go.opentelemetry.io/proto/otlp							 v0.19.0 \
	go.opentelemetry.io/proto/otlp							 v1.2.0 \
	go.opentelemetry.io/proto/otlp							 v1.3.1 \
	go.yaml.in/yaml/v2								 v2.4.2 \
	go.yaml.in/yaml/v3								 v3.0.3 \
	golang.org/x/crypto								 v0.0.0-20180904163835-0709b304e793 \
	golang.org/x/crypto								 v0.0.0-20190308221718-c2843e01d9a2 \
	golang.org/x/crypto								 v0.0.0-20191011191535-87dc89f01550 \
	golang.org/x/crypto								 v0.0.0-20200622213623-75b288015ac9 \
	golang.org/x/crypto								 v0.0.0-20220511200225-c6db032c6c88 \
	golang.org/x/crypto								 v0.2.0 \
	golang.org/x/crypto								 v0.23.0 \
	golang.org/x/crypto								 v0.30.0 \
	golang.org/x/crypto								 v0.31.0 \
	golang.org/x/crypto								 v0.32.0 \
	golang.org/x/crypto								 v0.36.0 \
	golang.org/x/crypto								 v0.40.0 \
	golang.org/x/crypto								 v0.45.0 \
	golang.org/x/exp								 v0.0.0-20190419195159-b8972e603456 \
	golang.org/x/exp								 v0.0.0-20230515195305-f3d0a9c9a5cc \
	golang.org/x/exp								 v0.0.0-20240112132812-db7319d0e0e3 \
	golang.org/x/exp								 v0.0.0-20240719175910-8a7402abbf56 \
	golang.org/x/mod								 v0.12.0 \
	golang.org/x/mod								 v0.14.0 \
	golang.org/x/mod								 v0.17.0 \
	golang.org/x/mod								 v0.2.0 \
	golang.org/x/mod								 v0.22.0 \
	golang.org/x/mod								 v0.27.0 \
	golang.org/x/mod								 v0.29.0 \
	golang.org/x/mod								 v0.3.0 \
	golang.org/x/mod								 v0.8.0 \
	golang.org/x/mod								 v0.9.0 \
	golang.org/x/net								 v0.0.0-20181114220301-adae6a3d119a \
	golang.org/x/net								 v0.0.0-20190311183353-d8887717615a \
	golang.org/x/net								 v0.0.0-20190404232315-eb5bcb51f2a3 \
	golang.org/x/net								 v0.0.0-20190613194153-d28f0bde5980 \
	golang.org/x/net								 v0.0.0-20190620200207-3b0461eec859 \
	golang.org/x/net								 v0.0.0-20200226121028-0de0cce0169b \
	golang.org/x/net								 v0.0.0-20201021035429-f5854403a974 \
	golang.org/x/net								 v0.25.0 \
	golang.org/x/net								 v0.26.0 \
	golang.org/x/net								 v0.29.0 \
	golang.org/x/net								 v0.30.0 \
	golang.org/x/net								 v0.33.0 \
	golang.org/x/net								 v0.34.0 \
	golang.org/x/net								 v0.38.0 \
	golang.org/x/net								 v0.41.0 \
	golang.org/x/net								 v0.43.0 \
	golang.org/x/net								 v0.47.0 \
	golang.org/x/net								 v0.50.0 \
	golang.org/x/net								 v0.51.0 \
	golang.org/x/net								 v0.7.0 \
	golang.org/x/net								 v0.8.0 \
	golang.org/x/oauth2								 v0.0.0-20210514164344-f6687ab2804c \
	golang.org/x/oauth2								 v0.0.0-20220223155221-ee480838109b \
	golang.org/x/oauth2								 v0.25.0 \
	golang.org/x/oauth2								 v0.28.0 \
	golang.org/x/oauth2								 v0.30.0 \
	golang.org/x/oauth2								 v0.33.0 \
	golang.org/x/sync								 v0.0.0-20181108010431-42b317875d0f \
	golang.org/x/sync								 v0.0.0-20181221193216-37e7f081c4d4 \
	golang.org/x/sync								 v0.0.0-20190423024810-112230192c58 \
	golang.org/x/sync								 v0.0.0-20190911185100-cd5d95a43a6e \
	golang.org/x/sync								 v0.0.0-20201020160332-67f06af15bc9 \
	golang.org/x/sync								 v0.1.0 \
	golang.org/x/sync								 v0.10.0 \
	golang.org/x/sync								 v0.13.0 \
	golang.org/x/sync								 v0.16.0 \
	golang.org/x/sync								 v0.18.0 \
	golang.org/x/sync								 v0.19.0 \
	golang.org/x/sync								 v0.7.0 \
	golang.org/x/sync								 v0.9.0 \
	golang.org/x/sys								 v0.0.0-20180905080454-ebe1bf3edb33 \
	golang.org/x/sys								 v0.0.0-20181116152217-5ac8a444bdc5 \
	golang.org/x/sys								 v0.0.0-20190215142949-d0b11bdaac8a \
	golang.org/x/sys								 v0.0.0-20190312061237-fead79001313 \
	golang.org/x/sys								 v0.0.0-20190412213103-97732733099d \
	golang.org/x/sys								 v0.0.0-20190419153524-e8e3143a4f4a \
	golang.org/x/sys								 v0.0.0-20190801041406-cbf593c0f2f3 \
	golang.org/x/sys								 v0.0.0-20200930185726-fdedc70b468f \
	golang.org/x/sys								 v0.0.0-20210616094352-59db8d763f22 \
	golang.org/x/sys								 v0.0.0-20211007075335-d3039528d8ac \
	golang.org/x/sys								 v0.0.0-20220310020820-b874c991c1a5 \
	golang.org/x/sys								 v0.0.0-20220715151400-c0bba94af5f8 \
	golang.org/x/sys								 v0.1.0 \
	golang.org/x/sys								 v0.10.0 \
	golang.org/x/sys								 v0.13.0 \
	golang.org/x/sys								 v0.20.0 \
	golang.org/x/sys								 v0.26.0 \
	golang.org/x/sys								 v0.28.0 \
	golang.org/x/sys								 v0.29.0 \
	golang.org/x/sys								 v0.31.0 \
	golang.org/x/sys								 v0.32.0 \
	golang.org/x/sys								 v0.34.0 \
	golang.org/x/sys								 v0.35.0 \
	golang.org/x/sys								 v0.38.0 \
	golang.org/x/sys								 v0.41.0 \
	golang.org/x/sys								 v0.5.0 \
	golang.org/x/sys								 v0.6.0 \
	golang.org/x/sys								 v0.7.0 \
	golang.org/x/term								 v0.13.0 \
	golang.org/x/term								 v0.20.0 \
	golang.org/x/term								 v0.27.0 \
	golang.org/x/term								 v0.28.0 \
	golang.org/x/term								 v0.30.0 \
	golang.org/x/term								 v0.33.0 \
	golang.org/x/term								 v0.37.0 \
	golang.org/x/term								 v0.6.0 \
	golang.org/x/text								 v0.15.0 \
	golang.org/x/text								 v0.19.0 \
	golang.org/x/text								 v0.21.0 \
	golang.org/x/text								 v0.22.0 \
	golang.org/x/text								 v0.27.0 \
	golang.org/x/text								 v0.28.0 \
	golang.org/x/text								 v0.3.0 \
	golang.org/x/text								 v0.3.3 \
	golang.org/x/text								 v0.31.0 \
	golang.org/x/text								 v0.7.0 \
	golang.org/x/text								 v0.8.0 \
	golang.org/x/time								 v0.0.0-20210723032227-1f47c861a9ac \
	golang.org/x/time								 v0.0.0-20220210224613-90d013bbcef8 \
	golang.org/x/time								 v0.3.0 \
	golang.org/x/time								 v0.9.0 \
	golang.org/x/tools								 v0.0.0-20180917221912-90fa682c2a6e \
	golang.org/x/tools								 v0.0.0-20190312151545-0bb0c0a6e846 \
	golang.org/x/tools								 v0.0.0-20191119224855-298f0cb1881e \
	golang.org/x/tools								 v0.0.0-20200619180055-7c47624df98f \
	golang.org/x/tools								 v0.0.0-20210106214847-113979e3529a \
	golang.org/x/tools								 v0.11.0 \
	golang.org/x/tools								 v0.17.0 \
	golang.org/x/tools								 v0.21.1-0.20240508182429-e35e4ccd0d2d \
	golang.org/x/tools								 v0.26.0 \
	golang.org/x/tools								 v0.27.0 \
	golang.org/x/tools								 v0.29.0 \
	golang.org/x/tools								 v0.36.0 \
	golang.org/x/tools								 v0.38.0 \
	golang.org/x/tools								 v0.6.0 \
	golang.org/x/tools								 v0.7.0 \
	golang.org/x/xerrors								 v0.0.0-20190717185122-a985d3407aa7 \
	golang.org/x/xerrors								 v0.0.0-20191011141410-1b5146add898 \
	golang.org/x/xerrors								 v0.0.0-20191204190536-9bdfabe68543 \
	google.golang.org/api								 v0.30.0 \
	google.golang.org/appengine							 v1.6.6 \
	google.golang.org/genproto							 v0.0.0-20200825200019-8632dd797987 \
	google.golang.org/genproto							 v0.0.0-20230306155012-7f2fa6fef1f4 \
	google.golang.org/genproto							 v0.0.0-20230410155749-daa745c078e1 \
	google.golang.org/genproto							 v0.0.0-20230706204954-ccb25ca9f130 \
	google.golang.org/genproto/googleapis/api					 v0.0.0-20230726155614-23370e0ffb3e \
	google.golang.org/genproto/googleapis/api					 v0.0.0-20240520151616-dc85e6b867a5 \
	google.golang.org/genproto/googleapis/api					 v0.0.0-20240528184218-531527333157 \
	google.golang.org/genproto/googleapis/api					 v0.0.0-20240826202546-f6391c0de4c7 \
	google.golang.org/genproto/googleapis/api					 v0.0.0-20241219192143-6b3ec007d9bb \
	google.golang.org/genproto/googleapis/rpc					 v0.0.0-20240520151616-dc85e6b867a5 \
	google.golang.org/genproto/googleapis/rpc					 v0.0.0-20240826202546-f6391c0de4c7 \
	google.golang.org/genproto/googleapis/rpc					 v0.0.0-20240924160255-9d4c2d233b61 \
	google.golang.org/genproto/googleapis/rpc					 v0.0.0-20241015192408-796eee8c2d53 \
	google.golang.org/genproto/googleapis/rpc					 v0.0.0-20250106144421-5f5ef82da422 \
	google.golang.org/genproto/googleapis/rpc					 v0.0.0-20250227231956-55c901821b1e \
	google.golang.org/genproto/googleapis/rpc					 v0.0.0-20250313205543-e70fdf4c4cb4 \
	google.golang.org/grpc								 v1.31.0 \
	google.golang.org/grpc								 v1.53.0 \
	google.golang.org/grpc								 v1.64.0 \
	google.golang.org/grpc								 v1.67.1 \
	google.golang.org/grpc								 v1.68.1 \
	google.golang.org/grpc								 v1.69.0 \
	google.golang.org/grpc								 v1.69.4 \
	google.golang.org/protobuf							 v1.26.0 \
	google.golang.org/protobuf							 v1.28.1 \
	google.golang.org/protobuf							 v1.30.0 \
	google.golang.org/protobuf							 v1.33.0 \
	google.golang.org/protobuf							 v1.34.1 \
	google.golang.org/protobuf							 v1.34.2 \
	google.golang.org/protobuf							 v1.35.1 \
	google.golang.org/protobuf							 v1.35.2 \
	google.golang.org/protobuf							 v1.36.1 \
	google.golang.org/protobuf							 v1.36.3 \
	google.golang.org/protobuf							 v1.36.5 \
	google.golang.org/protobuf							 v1.36.6 \
	google.golang.org/protobuf							 v1.36.7 \
	gopkg.in/check.v1								 v0.0.0-20161208181325-20d25e280405 \
	gopkg.in/evanphx/json-patch.v4							 v4.12.0 \
	gopkg.in/yaml.v2								 v2.2.1 \
	gopkg.in/yaml.v3								 v3.0.0-20200313102051-9f266ea9e77c \
	gotest.tools/v3									 v3.0.3 \
	k8s.io/api									 v0.27.4 \
	k8s.io/api									 v0.35.1 \
	k8s.io/apiextensions-apiserver							 v0.27.4 \
	k8s.io/apiextensions-apiserver							 v0.35.1 \
	k8s.io/apimachinery								 v0.27.4 \
	k8s.io/apimachinery								 v0.35.1 \
	k8s.io/apiserver								 v0.35.1 \
	k8s.io/client-go								 v0.27.4 \
	k8s.io/client-go								 v0.35.1 \
	k8s.io/code-generator								 v0.27.4 \
	k8s.io/code-generator								 v0.35.1 \
	k8s.io/component-base								 v0.27.4 \
	k8s.io/component-base								 v0.35.1 \
	k8s.io/gengo/v2									 v2.0.0-20250604051438-85fd79dbfd9f \
	k8s.io/klog/v2									 v2.100.1 \
	k8s.io/klog/v2									 v2.130.1 \
	k8s.io/klog/v2									 v2.80.1 \
	k8s.io/klog/v2									 v2.90.1 \
	k8s.io/kms									 v0.35.1 \
	k8s.io/kube-aggregator								 v0.27.4 \
	k8s.io/kube-openapi								 v0.0.0-20230501164219-8b0f38b5fd1f \
	k8s.io/kube-openapi								 v0.0.0-20241212222426-2c72e554b1e7 \
	k8s.io/utils									 v0.0.0-20230209194617-a36077c30491 \
	k8s.io/utils									 v0.0.0-20240711033017-18e509b52bc8 \
	k8s.io/utils									 v0.0.0-20251002143259-bc988d571ff4 \
	sigs.k8s.io/json								 v0.0.0-20221116044647-bc3834ca7abd \
	sigs.k8s.io/randfill								 v0.0.0-20250304075658-069ef1bbf016 \
	sigs.k8s.io/structured-merge-diff/v6						 v6.2.0 \
	sigs.k8s.io/yaml								 v1.3.0 \
	sigs.k8s.io/yaml								 v1.4.0 \
	sigs.k8s.io/yaml								 v1.5.0

