MODGO_MODULES =	\
	github.com/!data!dog/datadog-go				 v4.8.3+incompatible \
	github.com/!data!dog/zstd				 v1.5.2 \
	github.com/!masterminds/goutils				 v1.1.1 \
	github.com/!masterminds/semver/v3			 v3.2.0 \
	github.com/!masterminds/sprig/v3			 v3.2.3 \
	github.com/!microsoft/go-winio				 v0.6.2 \
	github.com/!sereal/!sereal/!go/sereal			 v0.0.0-20231009093132-b9187f1a92c6 \
	github.com/alecthomas/template				 v0.0.0-20190718012654-fb15b899a751 \
	github.com/alecthomas/units				 v0.0.0-20190717042225-c3de453c63f4 \
	github.com/armon/circbuf				 v0.0.0-20150827004946-bbbad097214e \
	github.com/armon/go-metrics				 v0.4.1 \
	github.com/armon/go-radix				 v1.0.0 \
	github.com/beorn7/perks					 v1.0.1 \
	github.com/bgentry/speakeasy				 v0.1.0 \
	github.com/cespare/xxhash/v2				 v2.3.0 \
	github.com/circonus-labs/circonus-gometrics		 v2.3.1+incompatible \
	github.com/circonus-labs/circonusllhist			 v0.1.3 \
	github.com/davecgh/go-spew				 v1.1.1 \
	github.com/davecgh/go-xdr				 v0.0.0-20161123171359-e6a2ba005892 \
	github.com/fatih/color					 v1.16.0 \
	github.com/go-kit/kit					 v0.9.0 \
	github.com/go-logfmt/logfmt				 v0.4.0 \
	github.com/go-stack/stack				 v1.8.0 \
	github.com/go-viper/mapstructure/v2			 v2.5.0 \
	github.com/gogo/protobuf				 v1.1.1 \
	github.com/golang/protobuf				 v1.5.4 \
	github.com/golang/snappy				 v0.0.4 \
	github.com/google/btree					 v1.1.3 \
	github.com/google/go-cmp				 v0.6.0 \
	github.com/google/gofuzz				 v1.0.0 \
	github.com/google/uuid					 v1.1.2 \
	github.com/hashicorp/cli				 v1.1.7 \
	github.com/hashicorp/errwrap				 v1.1.0 \
	github.com/hashicorp/go-cleanhttp			 v0.5.2 \
	github.com/hashicorp/go-immutable-radix			 v1.3.1 \
	github.com/hashicorp/go-metrics				 v0.6.0 \
	github.com/hashicorp/go-msgpack/v2			 v2.1.5 \
	github.com/hashicorp/go-multierror			 v1.1.1 \
	github.com/hashicorp/go-retryablehttp			 v0.7.7 \
	github.com/hashicorp/go-sockaddr			 v1.0.7 \
	github.com/hashicorp/go-syslog				 v1.0.0 \
	github.com/hashicorp/go-uuid				 v1.0.1 \
	github.com/hashicorp/golang-lru				 v1.0.2 \
	github.com/hashicorp/logutils				 v1.0.0 \
	github.com/hashicorp/mdns				 v1.0.7 \
	github.com/hashicorp/memberlist				 v0.6.0 \
	github.com/huandu/xstrings				 v1.3.3 \
	github.com/imdario/mergo				 v0.3.11 \
	github.com/josharian/intern				 v1.0.0 \
	github.com/json-iterator/go				 v1.1.12 \
	github.com/julienschmidt/httprouter			 v1.2.0 \
	github.com/konsorten/go-windows-terminal-sequences	 v1.0.1 \
	github.com/kr/logfmt					 v0.0.0-20140226030751-b84e30acd515 \
	github.com/kr/pretty					 v0.1.0 \
	github.com/kr/pty					 v1.1.1 \
	github.com/kr/text					 v0.1.0 \
	github.com/mailru/easyjson				 v0.7.7 \
	github.com/mattn/go-colorable				 v0.1.13 \
	github.com/mattn/go-isatty				 v0.0.20 \
	github.com/matttproud/golang_protobuf_extensions	 v1.0.1 \
	github.com/miekg/dns					 v1.1.72 \
	github.com/mitchellh/cli				 v1.1.5 \
	github.com/mitchellh/copystructure			 v1.0.0 \
	github.com/mitchellh/go-wordwrap			 v1.0.1 \
	github.com/mitchellh/reflectwalk			 v1.0.0 \
	github.com/modern-go/concurrent				 v0.0.0-20180306012644-bacd9c7ef1dd \
	github.com/modern-go/reflect2				 v1.0.2 \
	github.com/munnerz/goautoneg				 v0.0.0-20191010083416-a7dc8b61c822 \
	github.com/mwitkow/go-conntrack				 v0.0.0-20161129095857-cc309e4a2223 \
	github.com/pascaldekloe/goe				 v0.1.0 \
	github.com/philhofer/fwd				 v1.1.2 \
	github.com/pkg/errors					 v0.9.1 \
	github.com/pmezard/go-difflib				 v1.0.0 \
	github.com/posener/complete				 v1.2.3 \
	github.com/pquerna/ffjson				 v0.0.0-20190930134022-aa0246cd15f7 \
	github.com/prometheus/client_golang			 v1.23.2 \
	github.com/prometheus/client_model			 v0.6.2 \
	github.com/prometheus/common				 v0.66.1 \
	github.com/prometheus/procfs				 v0.16.1 \
	github.com/ryanuber/columnize				 v2.1.2+incompatible \
	github.com/sean-/seed					 v0.0.0-20170313163322-e2103e2c3529 \
	github.com/shopspring/decimal				 v1.2.0 \
	github.com/sirupsen/logrus				 v1.4.2 \
	github.com/spf13/cast					 v1.3.1 \
	github.com/stretchr/objx				 v0.1.1 \
	github.com/stretchr/testify				 v1.11.1 \
	github.com/tinylib/msgp					 v1.1.8 \
	github.com/tv42/httpunix				 v0.0.0-20150427012821-b75d8614f926 \
	github.com/yuin/goldmark				 v1.4.13 \
	go.yaml.in/yaml/v2					 v2.4.2 \
	golang.org/x/crypto					 v0.53.0 \
	golang.org/x/mod					 v0.37.0 \
	golang.org/x/net					 v0.56.0 \
	golang.org/x/sync					 v0.21.0 \
	golang.org/x/sys					 v0.46.0 \
	golang.org/x/telemetry					 v0.0.0-20260625142307-59b4966ccb57 \
	golang.org/x/term					 v0.44.0 \
	golang.org/x/text					 v0.38.0 \
	golang.org/x/tools					 v0.47.0 \
	golang.org/x/xerrors					 v0.0.0-20191204190536-9bdfabe68543 \
	google.golang.org/appengine				 v1.6.7 \
	google.golang.org/protobuf				 v1.36.8 \
	gopkg.in/alecthomas/kingpin.v2				 v2.2.6 \
	gopkg.in/check.v1					 v1.0.0-20201130134442-10cb98267c6c \
	gopkg.in/mgo.v2						 v2.0.0-20190816093944-a6b53ec6cb22 \
	gopkg.in/vmihailenco/msgpack.v2				 v2.9.2 \
	gopkg.in/yaml.v2					 v2.4.0 \
	gopkg.in/yaml.v3					 v3.0.1

MODGO_MODFILES =	\
	github.com/!data!dog/datadog-go		 v3.2.0+incompatible \
	github.com/!masterminds/semver/v3	 v3.1.1 \
	github.com/!masterminds/sprig/v3	 v3.2.1 \
	github.com/alecthomas/template		 v0.0.0-20160405071501-a0175ee3bccc \
	github.com/alecthomas/units		 v0.0.0-20151022065526-2efee857e7cf \
	github.com/armon/go-radix		 v0.0.0-20180808171621-7fddfc383310 \
	github.com/beorn7/perks			 v0.0.0-20180321164747-3a771d992973 \
	github.com/beorn7/perks			 v1.0.0 \
	github.com/cespare/xxhash/v2		 v2.1.1 \
	github.com/davecgh/go-spew		 v1.1.0 \
	github.com/fatih/color			 v1.7.0 \
	github.com/go-kit/kit			 v0.8.0 \
	github.com/go-logfmt/logfmt		 v0.3.0 \
	github.com/golang/protobuf		 v1.2.0 \
	github.com/golang/protobuf		 v1.3.1 \
	github.com/golang/protobuf		 v1.3.2 \
	github.com/golang/protobuf		 v1.5.2 \
	github.com/google/go-cmp		 v0.3.1 \
	github.com/google/go-cmp		 v0.4.0 \
	github.com/google/uuid			 v1.1.1 \
	github.com/hashicorp/errwrap		 v1.0.0 \
	github.com/hashicorp/go-cleanhttp	 v0.5.0 \
	github.com/hashicorp/go-immutable-radix	 v1.0.0 \
	github.com/hashicorp/go-multierror	 v1.0.0 \
	github.com/hashicorp/go-retryablehttp	 v0.5.3 \
	github.com/hashicorp/go-uuid		 v1.0.0 \
	github.com/hashicorp/golang-lru		 v0.5.0 \
	github.com/huandu/xstrings		 v1.3.2 \
	github.com/json-iterator/go		 v1.1.6 \
	github.com/json-iterator/go		 v1.1.9 \
	github.com/mattn/go-colorable		 v0.0.9 \
	github.com/mattn/go-isatty		 v0.0.16 \
	github.com/mattn/go-isatty		 v0.0.3 \
	github.com/modern-go/concurrent		 v0.0.0-20180228061459-e0a39a4cb421 \
	github.com/modern-go/reflect2		 v0.0.0-20180701023420-4b7aa43c6742 \
	github.com/modern-go/reflect2		 v1.0.1 \
	github.com/pkg/errors			 v0.8.0 \
	github.com/pkg/errors			 v0.8.1 \
	github.com/posener/complete		 v1.1.1 \
	github.com/prometheus/client_golang	 v0.9.1 \
	github.com/prometheus/client_golang	 v1.0.0 \
	github.com/prometheus/client_golang	 v1.4.0 \
	github.com/prometheus/client_model	 v0.0.0-20180712105110-5c3871d89910 \
	github.com/prometheus/client_model	 v0.0.0-20190129233127-fd36f4220a90 \
	github.com/prometheus/client_model	 v0.2.0 \
	github.com/prometheus/common		 v0.4.1 \
	github.com/prometheus/common		 v0.9.1 \
	github.com/prometheus/procfs		 v0.0.0-20181005140218-185b4288413d \
	github.com/prometheus/procfs		 v0.0.2 \
	github.com/prometheus/procfs		 v0.0.8 \
	github.com/sirupsen/logrus		 v1.2.0 \
	github.com/stretchr/objx		 v0.1.0 \
	github.com/stretchr/testify		 v1.2.2 \
	github.com/stretchr/testify		 v1.3.0 \
	github.com/stretchr/testify		 v1.4.0 \
	github.com/stretchr/testify		 v1.5.1 \
	github.com/stretchr/testify		 v1.6.1 \
	golang.org/x/crypto			 v0.0.0-20180904163835-0709b304e793 \
	golang.org/x/crypto			 v0.0.0-20190308221718-c2843e01d9a2 \
	golang.org/x/crypto			 v0.0.0-20210921155107-089bfa567519 \
	golang.org/x/crypto			 v0.17.0 \
	golang.org/x/crypto			 v0.3.0 \
	golang.org/x/crypto			 v0.32.0 \
	golang.org/x/mod			 v0.28.0 \
	golang.org/x/mod			 v0.31.0 \
	golang.org/x/mod			 v0.6.0-dev.0.20220419223038-86c51ed26bb4 \
	golang.org/x/net			 v0.0.0-20181114220301-adae6a3d119a \
	golang.org/x/net			 v0.0.0-20190613194153-d28f0bde5980 \
	golang.org/x/net			 v0.0.0-20190620200207-3b0461eec859 \
	golang.org/x/net			 v0.0.0-20210226172049-e18ecbb05110 \
	golang.org/x/net			 v0.0.0-20220722155237-a158d28d115b \
	golang.org/x/net			 v0.2.0 \
	golang.org/x/net			 v0.44.0 \
	golang.org/x/net			 v0.48.0 \
	golang.org/x/net			 v0.55.0 \
	golang.org/x/sync			 v0.0.0-20181108010431-42b317875d0f \
	golang.org/x/sync			 v0.0.0-20181221193216-37e7f081c4d4 \
	golang.org/x/sync			 v0.0.0-20190423024810-112230192c58 \
	golang.org/x/sync			 v0.0.0-20190911185100-cd5d95a43a6e \
	golang.org/x/sync			 v0.0.0-20220722155255-886fb9371eb4 \
	golang.org/x/sync			 v0.17.0 \
	golang.org/x/sync			 v0.19.0 \
	golang.org/x/sys			 v0.0.0-20180905080454-ebe1bf3edb33 \
	golang.org/x/sys			 v0.0.0-20181116152217-5ac8a444bdc5 \
	golang.org/x/sys			 v0.0.0-20190215142949-d0b11bdaac8a \
	golang.org/x/sys			 v0.0.0-20190422165155-953cdadca894 \
	golang.org/x/sys			 v0.0.0-20200122134326-e047566fdf82 \
	golang.org/x/sys			 v0.0.0-20201119102817-f84b799fce68 \
	golang.org/x/sys			 v0.0.0-20210615035016-665e8c7367d1 \
	golang.org/x/sys			 v0.0.0-20220520151302-bc2c85ada10a \
	golang.org/x/sys			 v0.0.0-20220722155257-8c9f86f7a55f \
	golang.org/x/sys			 v0.0.0-20220811171246-fbc7d0a398ab \
	golang.org/x/sys			 v0.14.0 \
	golang.org/x/sys			 v0.15.0 \
	golang.org/x/sys			 v0.2.0 \
	golang.org/x/sys			 v0.29.0 \
	golang.org/x/sys			 v0.35.0 \
	golang.org/x/sys			 v0.39.0 \
	golang.org/x/sys			 v0.45.0 \
	golang.org/x/sys			 v0.6.0 \
	golang.org/x/term			 v0.0.0-20201126162022-7de9c90e9dd1 \
	golang.org/x/term			 v0.0.0-20210927222741-03fcf44c2211 \
	golang.org/x/term			 v0.2.0 \
	golang.org/x/text			 v0.3.0 \
	golang.org/x/text			 v0.3.3 \
	golang.org/x/text			 v0.3.7 \
	golang.org/x/text			 v0.4.0 \
	golang.org/x/tools			 v0.0.0-20180917221912-90fa682c2a6e \
	golang.org/x/tools			 v0.0.0-20191119224855-298f0cb1881e \
	golang.org/x/tools			 v0.1.12 \
	golang.org/x/tools			 v0.37.0 \
	golang.org/x/tools			 v0.40.0 \
	golang.org/x/tools			 v0.45.0 \
	golang.org/x/xerrors			 v0.0.0-20190717185122-a985d3407aa7 \
	google.golang.org/protobuf		 v1.33.0 \
	gopkg.in/check.v1			 v0.0.0-20161208181325-20d25e280405 \
	gopkg.in/check.v1			 v1.0.0-20190902080502-41f04d3bba15 \
	gopkg.in/yaml.v2			 v2.2.1 \
	gopkg.in/yaml.v2			 v2.2.2 \
	gopkg.in/yaml.v2			 v2.2.4 \
	gopkg.in/yaml.v2			 v2.2.5 \
	gopkg.in/yaml.v2			 v2.3.0

