MODCARGO_CRATES +=	aho-corasick	1.1.4	# Unlicense OR MIT
MODCARGO_CRATES +=	allocator-api2	0.2.21	# MIT OR Apache-2.0
MODCARGO_CRATES +=	android_system_properties	0.1.5	# MIT/Apache-2.0
MODCARGO_CRATES +=	anstream	0.6.21	# MIT OR Apache-2.0
MODCARGO_CRATES +=	anstyle	1.0.13	# MIT OR Apache-2.0
MODCARGO_CRATES +=	anstyle-parse	0.2.7	# MIT OR Apache-2.0
MODCARGO_CRATES +=	anstyle-query	1.1.5	# MIT OR Apache-2.0
MODCARGO_CRATES +=	anstyle-wincon	3.0.11	# MIT OR Apache-2.0
MODCARGO_CRATES +=	anyhow	1.0.100	# MIT OR Apache-2.0
MODCARGO_CRATES +=	arc-swap	1.8.0	# MIT OR Apache-2.0
MODCARGO_CRATES +=	arraydeque	0.5.1	# MIT/Apache-2.0
MODCARGO_CRATES +=	arrayvec	0.7.6	# MIT OR Apache-2.0
MODCARGO_CRATES +=	async-broadcast	0.7.2	# MIT OR Apache-2.0
MODCARGO_CRATES +=	async-channel	2.5.0	# Apache-2.0 OR MIT
MODCARGO_CRATES +=	async-executor	1.13.3	# Apache-2.0 OR MIT
MODCARGO_CRATES +=	async-io	2.6.0	# Apache-2.0 OR MIT
MODCARGO_CRATES +=	async-lock	3.4.2	# Apache-2.0 OR MIT
MODCARGO_CRATES +=	async-process	2.5.0	# Apache-2.0 OR MIT
MODCARGO_CRATES +=	async-recursion	1.1.1	# MIT OR Apache-2.0
MODCARGO_CRATES +=	async-signal	0.2.13	# Apache-2.0 OR MIT
MODCARGO_CRATES +=	async-task	4.7.1	# Apache-2.0 OR MIT
MODCARGO_CRATES +=	async-trait	0.1.89	# MIT OR Apache-2.0
MODCARGO_CRATES +=	atomic-waker	1.1.2	# Apache-2.0 OR MIT
MODCARGO_CRATES +=	attr_alias	0.1.4	# MIT OR Apache-2.0
MODCARGO_CRATES +=	autocfg	1.5.0	# Apache-2.0 OR MIT
MODCARGO_CRATES +=	base64	0.13.1	# MIT/Apache-2.0
MODCARGO_CRATES +=	base64	0.22.1	# MIT OR Apache-2.0
MODCARGO_CRATES +=	bitflags	1.3.2	# MIT/Apache-2.0
MODCARGO_CRATES +=	bitflags	2.10.0	# MIT OR Apache-2.0
MODCARGO_CRATES +=	block-buffer	0.9.0	# MIT OR Apache-2.0
MODCARGO_CRATES +=	block-buffer	0.10.4	# MIT OR Apache-2.0
MODCARGO_CRATES +=	block2	0.6.2	# MIT
MODCARGO_CRATES +=	blocking	1.6.2	# Apache-2.0 OR MIT
MODCARGO_CRATES +=	bstr	1.12.1	# MIT OR Apache-2.0
MODCARGO_CRATES +=	bumpalo	3.19.1	# MIT OR Apache-2.0
MODCARGO_CRATES +=	byteorder	1.5.0	# Unlicense OR MIT
MODCARGO_CRATES +=	bytesize	1.3.3	# Apache-2.0
MODCARGO_CRATES +=	cc	1.2.51	# MIT OR Apache-2.0
MODCARGO_CRATES +=	cfg-if	1.0.4	# MIT OR Apache-2.0
MODCARGO_CRATES +=	cfg_aliases	0.2.1	# MIT
MODCARGO_CRATES +=	chrono	0.4.42	# MIT OR Apache-2.0
MODCARGO_CRATES +=	clap	4.5.53	# MIT OR Apache-2.0
MODCARGO_CRATES +=	clap_builder	4.5.53	# MIT OR Apache-2.0
MODCARGO_CRATES +=	clap_complete	4.5.63	# MIT OR Apache-2.0
MODCARGO_CRATES +=	clap_complete_nushell	4.5.10	# MIT OR Apache-2.0
MODCARGO_CRATES +=	clap_derive	4.5.49	# MIT OR Apache-2.0
MODCARGO_CRATES +=	clap_lex	0.7.6	# MIT OR Apache-2.0
MODCARGO_CRATES +=	clru	0.6.2	# MIT
MODCARGO_CRATES +=	colorchoice	1.0.4	# MIT OR Apache-2.0
MODCARGO_CRATES +=	concurrent-queue	2.5.0	# Apache-2.0 OR MIT
MODCARGO_CRATES +=	const-random	0.1.18	# MIT OR Apache-2.0
MODCARGO_CRATES +=	const-random-macro	0.1.16	# MIT OR Apache-2.0
MODCARGO_CRATES +=	const_format	0.2.35	# Zlib
MODCARGO_CRATES +=	const_format_proc_macros	0.2.34	# Zlib
MODCARGO_CRATES +=	core-foundation	0.10.1	# MIT OR Apache-2.0
MODCARGO_CRATES +=	core-foundation-sys	0.8.7	# MIT OR Apache-2.0
MODCARGO_CRATES +=	cpufeatures	0.2.17	# MIT OR Apache-2.0
MODCARGO_CRATES +=	crc32fast	1.5.0	# MIT OR Apache-2.0
MODCARGO_CRATES +=	crossbeam-channel	0.5.15	# MIT OR Apache-2.0
MODCARGO_CRATES +=	crossbeam-deque	0.8.6	# MIT OR Apache-2.0
MODCARGO_CRATES +=	crossbeam-epoch	0.9.18	# MIT OR Apache-2.0
MODCARGO_CRATES +=	crossbeam-utils	0.8.21	# MIT OR Apache-2.0
MODCARGO_CRATES +=	crunchy	0.2.4	# MIT
MODCARGO_CRATES +=	crypto-common	0.1.7	# MIT OR Apache-2.0
MODCARGO_CRATES +=	dashmap	6.1.0	# MIT
MODCARGO_CRATES +=	deelevate	0.2.0	# MIT
MODCARGO_CRATES +=	deranged	0.5.5	# MIT OR Apache-2.0
MODCARGO_CRATES +=	digest	0.9.0	# MIT OR Apache-2.0
MODCARGO_CRATES +=	digest	0.10.7	# MIT OR Apache-2.0
MODCARGO_CRATES +=	dirs	4.0.0	# MIT OR Apache-2.0
MODCARGO_CRATES +=	dirs	6.0.0	# MIT OR Apache-2.0
MODCARGO_CRATES +=	dirs-sys	0.3.7	# MIT OR Apache-2.0
MODCARGO_CRATES +=	dirs-sys	0.5.0	# MIT OR Apache-2.0
MODCARGO_CRATES +=	dispatch2	0.3.0	# Zlib OR Apache-2.0 OR MIT
MODCARGO_CRATES +=	dlv-list	0.5.2	# MIT OR Apache-2.0
MODCARGO_CRATES +=	downcast	0.11.0	# MIT
MODCARGO_CRATES +=	dunce	1.0.5	# CC0-1.0 OR MIT-0 OR Apache-2.0
MODCARGO_CRATES +=	dyn-clone	1.0.20	# MIT OR Apache-2.0
MODCARGO_CRATES +=	either	1.15.0	# MIT OR Apache-2.0
MODCARGO_CRATES +=	encoding_rs	0.8.35	# (Apache-2.0 OR MIT) AND BSD-3-Clause
MODCARGO_CRATES +=	endi	1.1.1	# MIT
MODCARGO_CRATES +=	enumflags2	0.7.12	# MIT OR Apache-2.0
MODCARGO_CRATES +=	enumflags2_derive	0.7.12	# MIT OR Apache-2.0
MODCARGO_CRATES +=	env_home	0.1.0	# MIT OR Apache-2.0
MODCARGO_CRATES +=	equivalent	1.0.2	# Apache-2.0 OR MIT
MODCARGO_CRATES +=	errno	0.2.8	# MIT/Apache-2.0
MODCARGO_CRATES +=	errno	0.3.14	# MIT OR Apache-2.0
MODCARGO_CRATES +=	errno-dragonfly	0.1.2	# MIT
MODCARGO_CRATES +=	event-listener	5.4.1	# Apache-2.0 OR MIT
MODCARGO_CRATES +=	event-listener-strategy	0.5.4	# Apache-2.0 OR MIT
MODCARGO_CRATES +=	faster-hex	0.10.0	# MIT
MODCARGO_CRATES +=	fastrand	2.3.0	# Apache-2.0 OR MIT
MODCARGO_CRATES +=	filedescriptor	0.8.3	# MIT
MODCARGO_CRATES +=	filetime	0.2.26	# MIT/Apache-2.0
MODCARGO_CRATES +=	find-msvc-tools	0.1.6	# MIT OR Apache-2.0
MODCARGO_CRATES +=	fnv	1.0.7	# Apache-2.0 / MIT
MODCARGO_CRATES +=	foldhash	0.1.5	# Zlib
MODCARGO_CRATES +=	foldhash	0.2.0	# Zlib
MODCARGO_CRATES +=	fragile	2.0.1	# Apache-2.0
MODCARGO_CRATES +=	futures-core	0.3.31	# MIT OR Apache-2.0
MODCARGO_CRATES +=	futures-io	0.3.31	# MIT OR Apache-2.0
MODCARGO_CRATES +=	futures-lite	2.6.1	# Apache-2.0 OR MIT
MODCARGO_CRATES +=	generic-array	0.14.7	# MIT
MODCARGO_CRATES +=	getrandom	0.2.16	# MIT OR Apache-2.0
MODCARGO_CRATES +=	getrandom	0.3.4	# MIT OR Apache-2.0
MODCARGO_CRATES +=	gix	0.76.0	# MIT OR Apache-2.0
MODCARGO_CRATES +=	gix-actor	0.36.1	# MIT OR Apache-2.0
MODCARGO_CRATES +=	gix-attributes	0.29.0	# MIT OR Apache-2.0
MODCARGO_CRATES +=	gix-bitmap	0.2.15	# MIT OR Apache-2.0
MODCARGO_CRATES +=	gix-chunk	0.4.12	# MIT OR Apache-2.0
MODCARGO_CRATES +=	gix-command	0.6.3	# MIT OR Apache-2.0
MODCARGO_CRATES +=	gix-commitgraph	0.31.0	# MIT OR Apache-2.0
MODCARGO_CRATES +=	gix-config	0.49.0	# MIT OR Apache-2.0
MODCARGO_CRATES +=	gix-config-value	0.16.0	# MIT OR Apache-2.0
MODCARGO_CRATES +=	gix-date	0.11.1	# MIT OR Apache-2.0
MODCARGO_CRATES +=	gix-diff	0.56.0	# MIT OR Apache-2.0
MODCARGO_CRATES +=	gix-dir	0.18.0	# MIT OR Apache-2.0
MODCARGO_CRATES +=	gix-discover	0.44.0	# MIT OR Apache-2.0
MODCARGO_CRATES +=	gix-features	0.45.0	# MIT OR Apache-2.0
MODCARGO_CRATES +=	gix-filter	0.23.0	# MIT OR Apache-2.0
MODCARGO_CRATES +=	gix-fs	0.18.0	# MIT OR Apache-2.0
MODCARGO_CRATES +=	gix-glob	0.23.0	# MIT OR Apache-2.0
MODCARGO_CRATES +=	gix-hash	0.21.0	# MIT OR Apache-2.0
MODCARGO_CRATES +=	gix-hashtable	0.11.0	# MIT OR Apache-2.0
MODCARGO_CRATES +=	gix-ignore	0.18.0	# MIT OR Apache-2.0
MODCARGO_CRATES +=	gix-index	0.44.0	# MIT OR Apache-2.0
MODCARGO_CRATES +=	gix-lock	20.0.0	# MIT OR Apache-2.0
MODCARGO_CRATES +=	gix-object	0.53.0	# MIT OR Apache-2.0
MODCARGO_CRATES +=	gix-odb	0.73.0	# MIT OR Apache-2.0
MODCARGO_CRATES +=	gix-pack	0.63.0	# MIT OR Apache-2.0
MODCARGO_CRATES +=	gix-packetline	0.20.0	# MIT OR Apache-2.0
MODCARGO_CRATES +=	gix-path	0.10.22	# MIT OR Apache-2.0
MODCARGO_CRATES +=	gix-pathspec	0.14.0	# MIT OR Apache-2.0
MODCARGO_CRATES +=	gix-protocol	0.54.0	# MIT OR Apache-2.0
MODCARGO_CRATES +=	gix-quote	0.6.1	# MIT OR Apache-2.0
MODCARGO_CRATES +=	gix-ref	0.56.0	# MIT OR Apache-2.0
MODCARGO_CRATES +=	gix-refspec	0.34.0	# MIT OR Apache-2.0
MODCARGO_CRATES +=	gix-revision	0.38.0	# MIT OR Apache-2.0
MODCARGO_CRATES +=	gix-revwalk	0.24.0	# MIT OR Apache-2.0
MODCARGO_CRATES +=	gix-sec	0.12.2	# MIT OR Apache-2.0
MODCARGO_CRATES +=	gix-shallow	0.7.0	# MIT OR Apache-2.0
MODCARGO_CRATES +=	gix-status	0.23.0	# MIT OR Apache-2.0
MODCARGO_CRATES +=	gix-submodule	0.23.0	# MIT OR Apache-2.0
MODCARGO_CRATES +=	gix-tempfile	20.0.0	# MIT OR Apache-2.0
MODCARGO_CRATES +=	gix-trace	0.1.16	# MIT OR Apache-2.0
MODCARGO_CRATES +=	gix-transport	0.51.0	# MIT OR Apache-2.0
MODCARGO_CRATES +=	gix-traverse	0.50.0	# MIT OR Apache-2.0
MODCARGO_CRATES +=	gix-url	0.34.0	# MIT OR Apache-2.0
MODCARGO_CRATES +=	gix-utils	0.3.1	# MIT OR Apache-2.0
MODCARGO_CRATES +=	gix-validate	0.10.1	# MIT OR Apache-2.0
MODCARGO_CRATES +=	gix-worktree	0.45.0	# MIT OR Apache-2.0
MODCARGO_CRATES +=	guess_host_triple	0.1.5	# MIT/Apache-2.0
MODCARGO_CRATES +=	hash32	0.3.1	# MIT OR Apache-2.0
MODCARGO_CRATES +=	hashbrown	0.14.5	# MIT OR Apache-2.0
MODCARGO_CRATES +=	hashbrown	0.15.5	# MIT OR Apache-2.0
MODCARGO_CRATES +=	hashbrown	0.16.1	# MIT OR Apache-2.0
MODCARGO_CRATES +=	hashlink	0.11.0	# MIT OR Apache-2.0
MODCARGO_CRATES +=	heapless	0.8.0	# MIT OR Apache-2.0
MODCARGO_CRATES +=	heck	0.5.0	# MIT OR Apache-2.0
MODCARGO_CRATES +=	hermit-abi	0.5.2	# MIT OR Apache-2.0
MODCARGO_CRATES +=	hex	0.4.3	# MIT OR Apache-2.0
MODCARGO_CRATES +=	home	0.5.12	# MIT OR Apache-2.0
MODCARGO_CRATES +=	iana-time-zone	0.1.64	# MIT OR Apache-2.0
MODCARGO_CRATES +=	iana-time-zone-haiku	0.1.2	# MIT OR Apache-2.0
MODCARGO_CRATES +=	imara-diff	0.1.8	# Apache-2.0
MODCARGO_CRATES +=	indexmap	2.12.1	# Apache-2.0 OR MIT
MODCARGO_CRATES +=	is-docker	0.2.0	# MIT
MODCARGO_CRATES +=	is-wsl	0.4.0	# MIT
MODCARGO_CRATES +=	is_debug	1.1.0	# MIT AND Apache-2.0
MODCARGO_CRATES +=	is_terminal_polyfill	1.70.2	# MIT OR Apache-2.0
MODCARGO_CRATES +=	itertools	0.14.0	# MIT OR Apache-2.0
MODCARGO_CRATES +=	itoa	1.0.17	# MIT OR Apache-2.0
MODCARGO_CRATES +=	jiff	0.2.17	# Unlicense OR MIT
MODCARGO_CRATES +=	jiff-static	0.2.17	# Unlicense OR MIT
MODCARGO_CRATES +=	jiff-tzdb	0.1.5	# Unlicense OR MIT
MODCARGO_CRATES +=	jiff-tzdb-platform	0.1.3	# Unlicense OR MIT
MODCARGO_CRATES +=	js-sys	0.3.83	# MIT OR Apache-2.0
MODCARGO_CRATES +=	jsonc-parser	0.28.0	# MIT
MODCARGO_CRATES +=	kstring	2.0.2	# MIT OR Apache-2.0
MODCARGO_CRATES +=	lazy_static	1.5.0	# MIT OR Apache-2.0
MODCARGO_CRATES +=	lazycell	1.3.0	# MIT/Apache-2.0
MODCARGO_CRATES +=	libc	0.2.178	# MIT OR Apache-2.0
MODCARGO_CRATES +=	libredox	0.1.12	# MIT
MODCARGO_CRATES +=	linux-raw-sys	0.11.0	# Apache-2.0 WITH LLVM-exception OR Apache-2.0 OR MIT
MODCARGO_CRATES +=	lock_api	0.4.14	# MIT OR Apache-2.0
MODCARGO_CRATES +=	log	0.4.29	# MIT OR Apache-2.0
MODCARGO_CRATES +=	mac-notification-sys	0.6.9	# MIT/Apache-2.0
MODCARGO_CRATES +=	mach2	0.5.0	# BSD-2-Clause OR MIT OR Apache-2.0
MODCARGO_CRATES +=	maybe-async	0.2.10	# MIT
MODCARGO_CRATES +=	memchr	2.7.6	# Unlicense OR MIT
MODCARGO_CRATES +=	memmap2	0.9.9	# MIT OR Apache-2.0
MODCARGO_CRATES +=	memmem	0.1.1	# MIT/Apache-2.0
MODCARGO_CRATES +=	memoffset	0.9.1	# MIT
MODCARGO_CRATES +=	minimal-lexical	0.2.1	# MIT/Apache-2.0
MODCARGO_CRATES +=	mockall	0.14.0	# MIT OR Apache-2.0
MODCARGO_CRATES +=	mockall_derive	0.14.0	# MIT OR Apache-2.0
MODCARGO_CRATES +=	nix	0.30.1	# MIT
MODCARGO_CRATES +=	nom	5.1.3	# MIT
MODCARGO_CRATES +=	nom	7.1.3	# MIT
MODCARGO_CRATES +=	nom	8.0.0	# MIT
MODCARGO_CRATES +=	notify-rust	4.11.7	# MIT/Apache-2.0
MODCARGO_CRATES +=	nu-ansi-term	0.50.3	# MIT
MODCARGO_CRATES +=	num-conv	0.1.0	# MIT OR Apache-2.0
MODCARGO_CRATES +=	num-derive	0.3.3	# MIT OR Apache-2.0
MODCARGO_CRATES +=	num-traits	0.2.19	# MIT OR Apache-2.0
MODCARGO_CRATES +=	num_threads	0.1.7	# MIT OR Apache-2.0
MODCARGO_CRATES +=	objc2	0.6.3	# MIT
MODCARGO_CRATES +=	objc2-cloud-kit	0.3.2	# Zlib OR Apache-2.0 OR MIT
MODCARGO_CRATES +=	objc2-core-data	0.3.2	# Zlib OR Apache-2.0 OR MIT
MODCARGO_CRATES +=	objc2-core-foundation	0.3.2	# Zlib OR Apache-2.0 OR MIT
MODCARGO_CRATES +=	objc2-core-graphics	0.3.2	# Zlib OR Apache-2.0 OR MIT
MODCARGO_CRATES +=	objc2-core-image	0.3.2	# Zlib OR Apache-2.0 OR MIT
MODCARGO_CRATES +=	objc2-core-location	0.3.2	# Zlib OR Apache-2.0 OR MIT
MODCARGO_CRATES +=	objc2-core-text	0.3.2	# Zlib OR Apache-2.0 OR MIT
MODCARGO_CRATES +=	objc2-encode	4.1.0	# MIT
MODCARGO_CRATES +=	objc2-foundation	0.3.2	# MIT
MODCARGO_CRATES +=	objc2-io-surface	0.3.2	# Zlib OR Apache-2.0 OR MIT
MODCARGO_CRATES +=	objc2-quartz-core	0.3.2	# Zlib OR Apache-2.0 OR MIT
MODCARGO_CRATES +=	objc2-ui-kit	0.3.2	# Zlib OR Apache-2.0 OR MIT
MODCARGO_CRATES +=	objc2-user-notifications	0.3.2	# Zlib OR Apache-2.0 OR MIT
MODCARGO_CRATES +=	once_cell	1.21.3	# MIT OR Apache-2.0
MODCARGO_CRATES +=	once_cell_polyfill	1.70.2	# MIT OR Apache-2.0
MODCARGO_CRATES +=	opaque-debug	0.3.1	# MIT OR Apache-2.0
MODCARGO_CRATES +=	open	5.3.3	# MIT
MODCARGO_CRATES +=	option-ext	0.2.0	# MPL-2.0
MODCARGO_CRATES +=	ordered-float	2.10.1	# MIT
MODCARGO_CRATES +=	ordered-multimap	0.7.3	# MIT
MODCARGO_CRATES +=	ordered-stream	0.2.0	# MIT OR Apache-2.0
MODCARGO_CRATES +=	os_info	3.14.0	# MIT
MODCARGO_CRATES +=	parking	2.2.1	# Apache-2.0 OR MIT
MODCARGO_CRATES +=	parking_lot	0.12.5	# MIT OR Apache-2.0
MODCARGO_CRATES +=	parking_lot_core	0.9.12	# MIT OR Apache-2.0
MODCARGO_CRATES +=	path-slash	0.2.1	# MIT
MODCARGO_CRATES +=	pathdiff	0.2.3	# MIT/Apache-2.0
MODCARGO_CRATES +=	pathsearch	0.2.0	# MIT
MODCARGO_CRATES +=	percent-encoding	2.3.2	# MIT OR Apache-2.0
MODCARGO_CRATES +=	pest	2.8.4	# MIT OR Apache-2.0
MODCARGO_CRATES +=	pest_derive	2.8.4	# MIT OR Apache-2.0
MODCARGO_CRATES +=	pest_generator	2.8.4	# MIT OR Apache-2.0
MODCARGO_CRATES +=	pest_meta	2.8.4	# MIT OR Apache-2.0
MODCARGO_CRATES +=	phf	0.11.3	# MIT
MODCARGO_CRATES +=	phf_codegen	0.11.3	# MIT
MODCARGO_CRATES +=	phf_generator	0.11.3	# MIT
MODCARGO_CRATES +=	phf_shared	0.11.3	# MIT
MODCARGO_CRATES +=	pin-project-lite	0.2.16	# Apache-2.0 OR MIT
MODCARGO_CRATES +=	piper	0.2.4	# MIT OR Apache-2.0
MODCARGO_CRATES +=	plist	1.8.0	# MIT
MODCARGO_CRATES +=	polling	3.11.0	# Apache-2.0 OR MIT
MODCARGO_CRATES +=	portable-atomic	1.13.0	# Apache-2.0 OR MIT
MODCARGO_CRATES +=	portable-atomic-util	0.2.4	# Apache-2.0 OR MIT
MODCARGO_CRATES +=	powerfmt	0.2.0	# MIT OR Apache-2.0
MODCARGO_CRATES +=	ppv-lite86	0.2.21	# MIT OR Apache-2.0
MODCARGO_CRATES +=	predicates	3.1.3	# MIT OR Apache-2.0
MODCARGO_CRATES +=	predicates-core	1.0.9	# MIT OR Apache-2.0
MODCARGO_CRATES +=	predicates-tree	1.0.12	# MIT OR Apache-2.0
MODCARGO_CRATES +=	proc-macro-crate	3.4.0	# MIT OR Apache-2.0
MODCARGO_CRATES +=	proc-macro2	1.0.104	# MIT OR Apache-2.0
MODCARGO_CRATES +=	process_control	5.2.0	# MIT OR Apache-2.0
MODCARGO_CRATES +=	prodash	30.0.1	# MIT
MODCARGO_CRATES +=	quick-xml	0.37.5	# MIT
MODCARGO_CRATES +=	quick-xml	0.38.4	# MIT
MODCARGO_CRATES +=	quote	1.0.42	# MIT OR Apache-2.0
MODCARGO_CRATES +=	r-efi	5.3.0	# MIT OR Apache-2.0 OR LGPL-2.1-or-later
MODCARGO_CRATES +=	rand	0.8.5	# MIT OR Apache-2.0
MODCARGO_CRATES +=	rand	0.9.2	# MIT OR Apache-2.0
MODCARGO_CRATES +=	rand_chacha	0.3.1	# MIT OR Apache-2.0
MODCARGO_CRATES +=	rand_chacha	0.9.0	# MIT OR Apache-2.0
MODCARGO_CRATES +=	rand_core	0.6.4	# MIT OR Apache-2.0
MODCARGO_CRATES +=	rand_core	0.9.3	# MIT OR Apache-2.0
MODCARGO_CRATES +=	rayon	1.11.0	# MIT OR Apache-2.0
MODCARGO_CRATES +=	rayon-core	1.13.0	# MIT OR Apache-2.0
MODCARGO_CRATES +=	redox_syscall	0.5.18	# MIT
MODCARGO_CRATES +=	redox_syscall	0.7.0	# MIT
MODCARGO_CRATES +=	redox_users	0.4.6	# MIT
MODCARGO_CRATES +=	redox_users	0.5.2	# MIT
MODCARGO_CRATES +=	ref-cast	1.0.25	# MIT OR Apache-2.0
MODCARGO_CRATES +=	ref-cast-impl	1.0.25	# MIT OR Apache-2.0
MODCARGO_CRATES +=	regex	1.12.2	# MIT OR Apache-2.0
MODCARGO_CRATES +=	regex-automata	0.4.13	# MIT OR Apache-2.0
MODCARGO_CRATES +=	regex-syntax	0.8.8	# MIT OR Apache-2.0
MODCARGO_CRATES +=	rust-ini	0.21.3	# MIT
MODCARGO_CRATES +=	rustix	1.1.3	# Apache-2.0 WITH LLVM-exception OR Apache-2.0 OR MIT
MODCARGO_CRATES +=	rustversion	1.0.22	# MIT OR Apache-2.0
MODCARGO_CRATES +=	same-file	1.0.6	# Unlicense/MIT
MODCARGO_CRATES +=	schemars	1.2.0	# MIT
MODCARGO_CRATES +=	schemars_derive	1.2.0	# MIT
MODCARGO_CRATES +=	scopeguard	1.2.0	# MIT OR Apache-2.0
MODCARGO_CRATES +=	semver	0.11.0	# MIT/Apache-2.0
MODCARGO_CRATES +=	semver	1.0.27	# MIT OR Apache-2.0
MODCARGO_CRATES +=	semver-parser	0.10.3	# MIT/Apache-2.0
MODCARGO_CRATES +=	serde	1.0.228	# MIT OR Apache-2.0
MODCARGO_CRATES +=	serde_core	1.0.228	# MIT OR Apache-2.0
MODCARGO_CRATES +=	serde_derive	1.0.228	# MIT OR Apache-2.0
MODCARGO_CRATES +=	serde_derive_internals	0.29.1	# MIT OR Apache-2.0
MODCARGO_CRATES +=	serde_json	1.0.148	# MIT OR Apache-2.0
MODCARGO_CRATES +=	serde_repr	0.1.20	# MIT OR Apache-2.0
MODCARGO_CRATES +=	serde_spanned	1.0.4	# MIT OR Apache-2.0
MODCARGO_CRATES +=	sha1	0.10.6	# MIT OR Apache-2.0
MODCARGO_CRATES +=	sha1-checked	0.10.0	# MIT OR Apache-2.0
MODCARGO_CRATES +=	sha2	0.9.9	# MIT OR Apache-2.0
MODCARGO_CRATES +=	sha2	0.10.9	# MIT OR Apache-2.0
MODCARGO_CRATES +=	shadow-rs	1.5.0	# MIT AND Apache-2.0
MODCARGO_CRATES +=	shared_library	0.1.9	# Apache-2.0/MIT
MODCARGO_CRATES +=	shell-words	1.1.1	# MIT/Apache-2.0
MODCARGO_CRATES +=	shlex	1.3.0	# MIT OR Apache-2.0
MODCARGO_CRATES +=	signal-hook	0.1.17	# Apache-2.0/MIT
MODCARGO_CRATES +=	signal-hook	0.3.18	# Apache-2.0/MIT
MODCARGO_CRATES +=	signal-hook-registry	1.4.8	# MIT OR Apache-2.0
MODCARGO_CRATES +=	siphasher	1.0.1	# MIT/Apache-2.0
MODCARGO_CRATES +=	slab	0.4.11	# MIT
MODCARGO_CRATES +=	smallvec	1.15.1	# MIT OR Apache-2.0
MODCARGO_CRATES +=	stable_deref_trait	1.2.1	# MIT OR Apache-2.0
MODCARGO_CRATES +=	starship-battery	0.10.3	# ISC
MODCARGO_CRATES +=	static_assertions	1.1.0	# MIT OR Apache-2.0
MODCARGO_CRATES +=	strsim	0.11.1	# MIT
MODCARGO_CRATES +=	syn	1.0.109	# MIT OR Apache-2.0
MODCARGO_CRATES +=	syn	2.0.111	# MIT OR Apache-2.0
MODCARGO_CRATES +=	systemstat	0.2.5	# Unlicense
MODCARGO_CRATES +=	tauri-winrt-notification	0.7.2	# MIT OR Apache-2.0
MODCARGO_CRATES +=	tempfile	3.24.0	# MIT OR Apache-2.0
MODCARGO_CRATES +=	terminal_size	0.4.3	# MIT OR Apache-2.0
MODCARGO_CRATES +=	terminfo	0.7.5	# WTFPL
MODCARGO_CRATES +=	termios	0.3.3	# MIT
MODCARGO_CRATES +=	termtree	0.5.1	# MIT
MODCARGO_CRATES +=	termwiz	0.15.0	# MIT
MODCARGO_CRATES +=	thiserror	1.0.69	# MIT OR Apache-2.0
MODCARGO_CRATES +=	thiserror	2.0.17	# MIT OR Apache-2.0
MODCARGO_CRATES +=	thiserror-impl	1.0.69	# MIT OR Apache-2.0
MODCARGO_CRATES +=	thiserror-impl	2.0.17	# MIT OR Apache-2.0
MODCARGO_CRATES +=	time	0.3.44	# MIT OR Apache-2.0
MODCARGO_CRATES +=	time-core	0.1.6	# MIT OR Apache-2.0
MODCARGO_CRATES +=	time-macros	0.2.24	# MIT OR Apache-2.0
MODCARGO_CRATES +=	tiny-keccak	2.0.2	# CC0-1.0
MODCARGO_CRATES +=	tinyvec	1.10.0	# Zlib OR Apache-2.0 OR MIT
MODCARGO_CRATES +=	tinyvec_macros	0.1.1	# MIT OR Apache-2.0 OR Zlib
MODCARGO_CRATES +=	toml	0.5.11	# MIT/Apache-2.0
MODCARGO_CRATES +=	toml	0.9.10+spec-1.1.0	# MIT OR Apache-2.0
MODCARGO_CRATES +=	toml_datetime	0.7.5+spec-1.1.0	# MIT OR Apache-2.0
MODCARGO_CRATES +=	toml_edit	0.23.10+spec-1.0.0	# MIT OR Apache-2.0
MODCARGO_CRATES +=	toml_edit	0.24.0+spec-1.1.0	# MIT OR Apache-2.0
MODCARGO_CRATES +=	toml_parser	1.0.6+spec-1.1.0	# MIT OR Apache-2.0
MODCARGO_CRATES +=	toml_writer	1.0.6+spec-1.1.0	# MIT OR Apache-2.0
MODCARGO_CRATES +=	tracing	0.1.44	# MIT
MODCARGO_CRATES +=	tracing-attributes	0.1.31	# MIT
MODCARGO_CRATES +=	tracing-core	0.1.36	# MIT
MODCARGO_CRATES +=	typenum	1.19.0	# MIT OR Apache-2.0
MODCARGO_CRATES +=	tz-rs	0.7.1	# MIT OR Apache-2.0
MODCARGO_CRATES +=	tzdb	0.7.3	# Apache-2.0
MODCARGO_CRATES +=	tzdb_data	0.2.3	# MIT-0 OR MIT OR Apache-2.0
MODCARGO_CRATES +=	ucd-trie	0.1.7	# MIT OR Apache-2.0
MODCARGO_CRATES +=	uds_windows	1.1.0	# MIT
MODCARGO_CRATES +=	uluru	3.1.0	# MPL-2.0
MODCARGO_CRATES +=	unicase	2.8.1	# MIT OR Apache-2.0
MODCARGO_CRATES +=	unicode-bom	2.0.3	# Apache-2.0
MODCARGO_CRATES +=	unicode-ident	1.0.22	# (MIT OR Apache-2.0) AND Unicode-3.0
MODCARGO_CRATES +=	unicode-normalization	0.1.25	# MIT OR Apache-2.0
MODCARGO_CRATES +=	unicode-segmentation	1.12.0	# MIT OR Apache-2.0
MODCARGO_CRATES +=	unicode-width	0.2.2	# MIT OR Apache-2.0
MODCARGO_CRATES +=	unicode-xid	0.2.6	# MIT OR Apache-2.0
MODCARGO_CRATES +=	uom	0.37.0	# Apache-2.0 OR MIT
MODCARGO_CRATES +=	urlencoding	2.1.3	# MIT
MODCARGO_CRATES +=	utf8parse	0.2.2	# Apache-2.0 OR MIT
MODCARGO_CRATES +=	uuid	1.19.0	# Apache-2.0 OR MIT
MODCARGO_CRATES +=	version_check	0.9.5	# MIT/Apache-2.0
MODCARGO_CRATES +=	versions	7.0.0	# MIT
MODCARGO_CRATES +=	vtparse	0.6.2	# MIT
MODCARGO_CRATES +=	walkdir	2.5.0	# Unlicense/MIT
MODCARGO_CRATES +=	wasi	0.11.1+wasi-snapshot-preview1	# Apache-2.0 WITH LLVM-exception OR Apache-2.0 OR MIT
MODCARGO_CRATES +=	wasip2	1.0.1+wasi-0.2.4	# Apache-2.0 WITH LLVM-exception OR Apache-2.0 OR MIT
MODCARGO_CRATES +=	wasite	0.1.0	# Apache-2.0 OR BSL-1.0 OR MIT
MODCARGO_CRATES +=	wasm-bindgen	0.2.106	# MIT OR Apache-2.0
MODCARGO_CRATES +=	wasm-bindgen-macro	0.2.106	# MIT OR Apache-2.0
MODCARGO_CRATES +=	wasm-bindgen-macro-support	0.2.106	# MIT OR Apache-2.0
MODCARGO_CRATES +=	wasm-bindgen-shared	0.2.106	# MIT OR Apache-2.0
MODCARGO_CRATES +=	which	8.0.0	# MIT
MODCARGO_CRATES +=	whoami	1.6.1	# Apache-2.0 OR BSL-1.0 OR MIT
MODCARGO_CRATES +=	winapi	0.3.9	# MIT/Apache-2.0
MODCARGO_CRATES +=	winapi-i686-pc-windows-gnu	0.4.0	# MIT/Apache-2.0
MODCARGO_CRATES +=	winapi-util	0.1.11	# Unlicense OR MIT
MODCARGO_CRATES +=	winapi-x86_64-pc-windows-gnu	0.4.0	# MIT/Apache-2.0
MODCARGO_CRATES +=	windows	0.61.3	# MIT OR Apache-2.0
MODCARGO_CRATES +=	windows	0.62.2	# MIT OR Apache-2.0
MODCARGO_CRATES +=	windows-collections	0.2.0	# MIT OR Apache-2.0
MODCARGO_CRATES +=	windows-collections	0.3.2	# MIT OR Apache-2.0
MODCARGO_CRATES +=	windows-core	0.61.2	# MIT OR Apache-2.0
MODCARGO_CRATES +=	windows-core	0.62.2	# MIT OR Apache-2.0
MODCARGO_CRATES +=	windows-future	0.2.1	# MIT OR Apache-2.0
MODCARGO_CRATES +=	windows-future	0.3.2	# MIT OR Apache-2.0
MODCARGO_CRATES +=	windows-implement	0.60.2	# MIT OR Apache-2.0
MODCARGO_CRATES +=	windows-interface	0.59.3	# MIT OR Apache-2.0
MODCARGO_CRATES +=	windows-link	0.1.3	# MIT OR Apache-2.0
MODCARGO_CRATES +=	windows-link	0.2.1	# MIT OR Apache-2.0
MODCARGO_CRATES +=	windows-numerics	0.2.0	# MIT OR Apache-2.0
MODCARGO_CRATES +=	windows-numerics	0.3.1	# MIT OR Apache-2.0
MODCARGO_CRATES +=	windows-result	0.3.4	# MIT OR Apache-2.0
MODCARGO_CRATES +=	windows-result	0.4.1	# MIT OR Apache-2.0
MODCARGO_CRATES +=	windows-strings	0.4.2	# MIT OR Apache-2.0
MODCARGO_CRATES +=	windows-strings	0.5.1	# MIT OR Apache-2.0
MODCARGO_CRATES +=	windows-sys	0.60.2	# MIT OR Apache-2.0
MODCARGO_CRATES +=	windows-sys	0.61.2	# MIT OR Apache-2.0
MODCARGO_CRATES +=	windows-targets	0.53.5	# MIT OR Apache-2.0
MODCARGO_CRATES +=	windows-threading	0.1.0	# MIT OR Apache-2.0
MODCARGO_CRATES +=	windows-threading	0.2.1	# MIT OR Apache-2.0
MODCARGO_CRATES +=	windows-version	0.1.7	# MIT OR Apache-2.0
MODCARGO_CRATES +=	windows_aarch64_gnullvm	0.53.1	# MIT OR Apache-2.0
MODCARGO_CRATES +=	windows_aarch64_msvc	0.53.1	# MIT OR Apache-2.0
MODCARGO_CRATES +=	windows_i686_gnu	0.53.1	# MIT OR Apache-2.0
MODCARGO_CRATES +=	windows_i686_gnullvm	0.53.1	# MIT OR Apache-2.0
MODCARGO_CRATES +=	windows_i686_msvc	0.53.1	# MIT OR Apache-2.0
MODCARGO_CRATES +=	windows_x86_64_gnu	0.53.1	# MIT OR Apache-2.0
MODCARGO_CRATES +=	windows_x86_64_gnullvm	0.53.1	# MIT OR Apache-2.0
MODCARGO_CRATES +=	windows_x86_64_msvc	0.53.1	# MIT OR Apache-2.0
MODCARGO_CRATES +=	winnow	0.7.14	# MIT
MODCARGO_CRATES +=	winres	0.1.12	# MIT
MODCARGO_CRATES +=	winsafe	0.0.19	# MIT
MODCARGO_CRATES +=	wit-bindgen	0.46.0	# Apache-2.0 WITH LLVM-exception OR Apache-2.0 OR MIT
MODCARGO_CRATES +=	yaml-rust2	0.11.0	# MIT OR Apache-2.0
MODCARGO_CRATES +=	zbus	5.12.0	# MIT
MODCARGO_CRATES +=	zbus_macros	5.12.0	# MIT
MODCARGO_CRATES +=	zbus_names	4.2.0	# MIT
MODCARGO_CRATES +=	zerocopy	0.8.31	# BSD-2-Clause OR Apache-2.0 OR MIT
MODCARGO_CRATES +=	zerocopy-derive	0.8.31	# BSD-2-Clause OR Apache-2.0 OR MIT
MODCARGO_CRATES +=	zlib-rs	0.5.5	# Zlib
MODCARGO_CRATES +=	zmij	1.0.2	# MIT
MODCARGO_CRATES +=	zvariant	5.8.0	# MIT
MODCARGO_CRATES +=	zvariant_derive	5.8.0	# MIT
MODCARGO_CRATES +=	zvariant_utils	3.2.1	# MIT
