MODGO_MODULES =	\
	github.com/davecgh/go-spew	 v1.1.1 \
	github.com/kr/pretty		 v0.3.1 \
	github.com/kr/text		 v0.2.0 \
	github.com/mjwhitta/cli		 v1.12.5 \
	github.com/mjwhitta/errors	 v1.0.3 \
	github.com/mjwhitta/hilighter	 v1.11.10 \
	github.com/mjwhitta/jq		 v1.5.6 \
	github.com/mjwhitta/jsoncfg	 v1.6.13 \
	github.com/mjwhitta/log		 v1.6.10 \
	github.com/mjwhitta/pathname	 v1.2.6 \
	github.com/mjwhitta/safety	 v1.11.4 \
	github.com/mjwhitta/sysinfo	 v1.5.7 \
	github.com/mjwhitta/where	 v1.3.3 \
	github.com/pmezard/go-difflib	 v1.0.0 \
	github.com/rogpeppe/go-internal	 v1.9.0 \
	github.com/stretchr/objx	 v0.5.2 \
	github.com/stretchr/testify	 v1.9.0 \
	golang.org/x/sys		 v0.21.0 \
	gopkg.in/check.v1		 v1.0.0-20201130134442-10cb98267c6c \
	gopkg.in/yaml.v3		 v3.0.1

MODGO_MODFILES =	\
	gopkg.in/check.v1	 v0.0.0-20161208181325-20d25e280405

