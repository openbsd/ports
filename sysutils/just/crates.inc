MODCARGO_CRATES +=	aho-corasick	1.1.4	# Unlicense OR MIT
MODCARGO_CRATES +=	android_system_properties	0.1.5	# MIT/Apache-2.0
MODCARGO_CRATES +=	ansi_term	0.12.1	# MIT
MODCARGO_CRATES +=	anstream	1.0.0	# MIT OR Apache-2.0
MODCARGO_CRATES +=	anstyle	1.0.14	# MIT OR Apache-2.0
MODCARGO_CRATES +=	anstyle-parse	1.0.0	# MIT OR Apache-2.0
MODCARGO_CRATES +=	anstyle-query	1.1.5	# MIT OR Apache-2.0
MODCARGO_CRATES +=	anstyle-wincon	3.0.11	# MIT OR Apache-2.0
MODCARGO_CRATES +=	anyhow	1.0.102	# MIT OR Apache-2.0
MODCARGO_CRATES +=	arrayref	0.3.9	# BSD-2-Clause
MODCARGO_CRATES +=	arrayvec	0.7.6	# MIT OR Apache-2.0
MODCARGO_CRATES +=	autocfg	1.5.0	# Apache-2.0 OR MIT
MODCARGO_CRATES +=	bitflags	2.11.0	# MIT OR Apache-2.0
MODCARGO_CRATES +=	blake3	1.8.3	# CC0-1.0 OR Apache-2.0 OR Apache-2.0 WITH LLVM-exception
MODCARGO_CRATES +=	block-buffer	0.10.4	# MIT OR Apache-2.0
MODCARGO_CRATES +=	block2	0.6.2	# MIT
MODCARGO_CRATES +=	bstr	1.12.1	# MIT OR Apache-2.0
MODCARGO_CRATES +=	bumpalo	3.20.2	# MIT OR Apache-2.0
MODCARGO_CRATES +=	bytecount	0.6.9	# Apache-2.0/MIT
MODCARGO_CRATES +=	camino	1.2.2	# MIT OR Apache-2.0
MODCARGO_CRATES +=	cc	1.2.58	# MIT OR Apache-2.0
MODCARGO_CRATES +=	cfg-if	1.0.4	# MIT OR Apache-2.0
MODCARGO_CRATES +=	cfg_aliases	0.2.1	# MIT
MODCARGO_CRATES +=	chacha20	0.10.0	# MIT OR Apache-2.0
MODCARGO_CRATES +=	chrono	0.4.44	# MIT OR Apache-2.0
MODCARGO_CRATES +=	clap	4.6.0	# MIT OR Apache-2.0
MODCARGO_CRATES +=	clap_builder	4.6.0	# MIT OR Apache-2.0
MODCARGO_CRATES +=	clap_complete	4.6.0	# MIT OR Apache-2.0
MODCARGO_CRATES +=	clap_derive	4.6.0	# MIT OR Apache-2.0
MODCARGO_CRATES +=	clap_lex	1.1.0	# MIT OR Apache-2.0
MODCARGO_CRATES +=	clap_mangen	0.3.0	# MIT OR Apache-2.0
MODCARGO_CRATES +=	colorchoice	1.0.5	# MIT OR Apache-2.0
MODCARGO_CRATES +=	constant_time_eq	0.4.2	# CC0-1.0 OR MIT-0 OR Apache-2.0
MODCARGO_CRATES +=	core-foundation-sys	0.8.7	# MIT OR Apache-2.0
MODCARGO_CRATES +=	cpufeatures	0.2.17	# MIT OR Apache-2.0
MODCARGO_CRATES +=	cpufeatures	0.3.0	# MIT OR Apache-2.0
MODCARGO_CRATES +=	crossbeam-deque	0.8.6	# MIT OR Apache-2.0
MODCARGO_CRATES +=	crossbeam-epoch	0.9.18	# MIT OR Apache-2.0
MODCARGO_CRATES +=	crossbeam-utils	0.8.21	# MIT OR Apache-2.0
MODCARGO_CRATES +=	crypto-common	0.1.7	# MIT OR Apache-2.0
MODCARGO_CRATES +=	ctrlc	3.5.2	# MIT/Apache-2.0
MODCARGO_CRATES +=	derive-where	1.6.1	# MIT OR Apache-2.0
MODCARGO_CRATES +=	diff	0.1.13	# MIT OR Apache-2.0
MODCARGO_CRATES +=	digest	0.10.7	# MIT OR Apache-2.0
MODCARGO_CRATES +=	dirs	6.0.0	# MIT OR Apache-2.0
MODCARGO_CRATES +=	dirs-sys	0.5.0	# MIT OR Apache-2.0
MODCARGO_CRATES +=	dispatch2	0.3.1	# Zlib OR Apache-2.0 OR MIT
MODCARGO_CRATES +=	dotenvy	0.15.7	# MIT
MODCARGO_CRATES +=	edit-distance	2.2.2	# Apache-2.0
MODCARGO_CRATES +=	equivalent	1.0.2	# Apache-2.0 OR MIT
MODCARGO_CRATES +=	errno	0.3.14	# MIT OR Apache-2.0
MODCARGO_CRATES +=	fastrand	2.3.0	# Apache-2.0 OR MIT
MODCARGO_CRATES +=	find-msvc-tools	0.1.9	# MIT OR Apache-2.0
MODCARGO_CRATES +=	fnv	1.0.7	# Apache-2.0 / MIT
MODCARGO_CRATES +=	foldhash	0.1.5	# Zlib
MODCARGO_CRATES +=	generic-array	0.14.7	# MIT
MODCARGO_CRATES +=	getopts	0.2.24	# MIT OR Apache-2.0
MODCARGO_CRATES +=	getrandom	0.2.17	# MIT OR Apache-2.0
MODCARGO_CRATES +=	getrandom	0.4.2	# MIT OR Apache-2.0
MODCARGO_CRATES +=	hashbrown	0.15.5	# MIT OR Apache-2.0
MODCARGO_CRATES +=	hashbrown	0.16.1	# MIT OR Apache-2.0
MODCARGO_CRATES +=	heck	0.5.0	# MIT OR Apache-2.0
MODCARGO_CRATES +=	hermit-abi	0.5.2	# MIT OR Apache-2.0
MODCARGO_CRATES +=	iana-time-zone	0.1.65	# MIT OR Apache-2.0
MODCARGO_CRATES +=	iana-time-zone-haiku	0.1.2	# MIT OR Apache-2.0
MODCARGO_CRATES +=	id-arena	2.3.0	# MIT/Apache-2.0
MODCARGO_CRATES +=	indexmap	2.13.0	# Apache-2.0 OR MIT
MODCARGO_CRATES +=	is_executable	1.0.5	# MIT OR Apache-2.0
MODCARGO_CRATES +=	is_terminal_polyfill	1.70.2	# MIT OR Apache-2.0
MODCARGO_CRATES +=	itoa	1.0.18	# MIT OR Apache-2.0
MODCARGO_CRATES +=	js-sys	0.3.92	# MIT OR Apache-2.0
MODCARGO_CRATES +=	leb128fmt	0.1.0	# MIT OR Apache-2.0
MODCARGO_CRATES +=	lexiclean	0.0.1	# CC0-1.0
MODCARGO_CRATES +=	libc	0.2.183	# MIT OR Apache-2.0
MODCARGO_CRATES +=	libredox	0.1.15	# MIT
MODCARGO_CRATES +=	linux-raw-sys	0.12.1	# Apache-2.0 WITH LLVM-exception OR Apache-2.0 OR MIT
MODCARGO_CRATES +=	log	0.4.29	# MIT OR Apache-2.0
MODCARGO_CRATES +=	memchr	2.8.0	# Unlicense OR MIT
MODCARGO_CRATES +=	memmap2	0.9.10	# MIT OR Apache-2.0
MODCARGO_CRATES +=	nix	0.31.2	# MIT
MODCARGO_CRATES +=	num-traits	0.2.19	# MIT OR Apache-2.0
MODCARGO_CRATES +=	num_cpus	1.17.0	# MIT OR Apache-2.0
MODCARGO_CRATES +=	objc2	0.6.4	# MIT
MODCARGO_CRATES +=	objc2-encode	4.1.0	# MIT
MODCARGO_CRATES +=	once_cell	1.21.4	# MIT OR Apache-2.0
MODCARGO_CRATES +=	once_cell_polyfill	1.70.2	# MIT OR Apache-2.0
MODCARGO_CRATES +=	option-ext	0.2.0	# MPL-2.0
MODCARGO_CRATES +=	papergrid	0.14.0	# MIT
MODCARGO_CRATES +=	percent-encoding	2.3.2	# MIT OR Apache-2.0
MODCARGO_CRATES +=	pretty_assertions	1.4.1	# MIT OR Apache-2.0
MODCARGO_CRATES +=	prettyplease	0.2.37	# MIT OR Apache-2.0
MODCARGO_CRATES +=	proc-macro-error-attr2	2.0.0	# MIT OR Apache-2.0
MODCARGO_CRATES +=	proc-macro-error2	2.0.1	# MIT OR Apache-2.0
MODCARGO_CRATES +=	proc-macro2	1.0.106	# MIT OR Apache-2.0
MODCARGO_CRATES +=	pulldown-cmark	0.9.6	# MIT
MODCARGO_CRATES +=	pulldown-cmark-to-cmark	10.0.4	# Apache-2.0
MODCARGO_CRATES +=	quote	1.0.45	# MIT OR Apache-2.0
MODCARGO_CRATES +=	r-efi	6.0.0	# MIT OR Apache-2.0 OR LGPL-2.1-or-later
MODCARGO_CRATES +=	rand	0.10.0	# MIT OR Apache-2.0
MODCARGO_CRATES +=	rand_core	0.10.0	# MIT OR Apache-2.0
MODCARGO_CRATES +=	rayon-core	1.13.0	# MIT OR Apache-2.0
MODCARGO_CRATES +=	redox_users	0.5.2	# MIT
MODCARGO_CRATES +=	regex	1.12.3	# MIT OR Apache-2.0
MODCARGO_CRATES +=	regex-automata	0.4.14	# MIT OR Apache-2.0
MODCARGO_CRATES +=	regex-syntax	0.8.10	# MIT OR Apache-2.0
MODCARGO_CRATES +=	roff	1.1.0	# MIT OR Apache-2.0
MODCARGO_CRATES +=	rustix	1.1.4	# Apache-2.0 WITH LLVM-exception OR Apache-2.0 OR MIT
MODCARGO_CRATES +=	rustversion	1.0.22	# MIT OR Apache-2.0
MODCARGO_CRATES +=	ryu	1.0.23	# Apache-2.0 OR BSL-1.0
MODCARGO_CRATES +=	semver	1.0.27	# MIT OR Apache-2.0
MODCARGO_CRATES +=	serde	1.0.228	# MIT OR Apache-2.0
MODCARGO_CRATES +=	serde_core	1.0.228	# MIT OR Apache-2.0
MODCARGO_CRATES +=	serde_derive	1.0.228	# MIT OR Apache-2.0
MODCARGO_CRATES +=	serde_json	1.0.149	# MIT OR Apache-2.0
MODCARGO_CRATES +=	serde_yaml	0.9.34+deprecated	# MIT OR Apache-2.0
MODCARGO_CRATES +=	sha2	0.10.9	# MIT OR Apache-2.0
MODCARGO_CRATES +=	shellexpand	3.1.2	# MIT/Apache-2.0
MODCARGO_CRATES +=	shlex	1.3.0	# MIT OR Apache-2.0
MODCARGO_CRATES +=	similar	2.7.0	# Apache-2.0
MODCARGO_CRATES +=	snafu	0.9.0	# MIT OR Apache-2.0
MODCARGO_CRATES +=	snafu-derive	0.9.0	# MIT OR Apache-2.0
MODCARGO_CRATES +=	strsim	0.11.1	# MIT
MODCARGO_CRATES +=	strum	0.28.0	# MIT
MODCARGO_CRATES +=	strum_macros	0.28.0	# MIT
MODCARGO_CRATES +=	syn	2.0.117	# MIT OR Apache-2.0
MODCARGO_CRATES +=	tabled	0.18.0	# MIT
MODCARGO_CRATES +=	tabled_derive	0.10.0	# MIT
MODCARGO_CRATES +=	target	2.1.0	# CC0-1.0
MODCARGO_CRATES +=	tempfile	3.27.0	# MIT OR Apache-2.0
MODCARGO_CRATES +=	temptree	0.2.0	# CC0-1.0
MODCARGO_CRATES +=	terminal_size	0.4.4	# MIT OR Apache-2.0
MODCARGO_CRATES +=	thiserror	2.0.18	# MIT OR Apache-2.0
MODCARGO_CRATES +=	thiserror-impl	2.0.18	# MIT OR Apache-2.0
MODCARGO_CRATES +=	typed-arena	2.0.2	# MIT
MODCARGO_CRATES +=	typenum	1.19.0	# MIT OR Apache-2.0
MODCARGO_CRATES +=	unicase	2.9.0	# MIT OR Apache-2.0
MODCARGO_CRATES +=	unicode-ident	1.0.24	# (MIT OR Apache-2.0) AND Unicode-3.0
MODCARGO_CRATES +=	unicode-segmentation	1.13.2	# MIT OR Apache-2.0
MODCARGO_CRATES +=	unicode-width	0.2.2	# MIT OR Apache-2.0
MODCARGO_CRATES +=	unicode-xid	0.2.6	# MIT OR Apache-2.0
MODCARGO_CRATES +=	unsafe-libyaml	0.2.11	# MIT
MODCARGO_CRATES +=	utf8parse	0.2.2	# Apache-2.0 OR MIT
MODCARGO_CRATES +=	uuid	1.23.0	# Apache-2.0 OR MIT
MODCARGO_CRATES +=	version_check	0.9.5	# MIT/Apache-2.0
MODCARGO_CRATES +=	wasi	0.11.1+wasi-snapshot-preview1	# Apache-2.0 WITH LLVM-exception OR Apache-2.0 OR MIT
MODCARGO_CRATES +=	wasip2	1.0.1+wasi-0.2.4	# Apache-2.0 WITH LLVM-exception OR Apache-2.0 OR MIT
MODCARGO_CRATES +=	wasip3	0.4.0+wasi-0.3.0-rc-2026-01-06	# Apache-2.0 WITH LLVM-exception OR Apache-2.0 OR MIT
MODCARGO_CRATES +=	wasm-bindgen	0.2.115	# MIT OR Apache-2.0
MODCARGO_CRATES +=	wasm-bindgen-macro	0.2.115	# MIT OR Apache-2.0
MODCARGO_CRATES +=	wasm-bindgen-macro-support	0.2.115	# MIT OR Apache-2.0
MODCARGO_CRATES +=	wasm-bindgen-shared	0.2.115	# MIT OR Apache-2.0
MODCARGO_CRATES +=	wasm-encoder	0.244.0	# Apache-2.0 WITH LLVM-exception OR Apache-2.0 OR MIT
MODCARGO_CRATES +=	wasm-metadata	0.244.0	# Apache-2.0 WITH LLVM-exception OR Apache-2.0 OR MIT
MODCARGO_CRATES +=	wasmparser	0.244.0	# Apache-2.0 WITH LLVM-exception OR Apache-2.0 OR MIT
MODCARGO_CRATES +=	which	8.0.2	# MIT
MODCARGO_CRATES +=	winapi	0.3.9	# MIT/Apache-2.0
MODCARGO_CRATES +=	winapi-i686-pc-windows-gnu	0.4.0	# MIT/Apache-2.0
MODCARGO_CRATES +=	winapi-x86_64-pc-windows-gnu	0.4.0	# MIT/Apache-2.0
MODCARGO_CRATES +=	windows-core	0.62.2	# MIT OR Apache-2.0
MODCARGO_CRATES +=	windows-implement	0.60.2	# MIT OR Apache-2.0
MODCARGO_CRATES +=	windows-interface	0.59.3	# MIT OR Apache-2.0
MODCARGO_CRATES +=	windows-link	0.2.1	# MIT OR Apache-2.0
MODCARGO_CRATES +=	windows-result	0.4.1	# MIT OR Apache-2.0
MODCARGO_CRATES +=	windows-strings	0.5.1	# MIT OR Apache-2.0
MODCARGO_CRATES +=	windows-sys	0.60.2	# MIT OR Apache-2.0
MODCARGO_CRATES +=	windows-sys	0.61.2	# MIT OR Apache-2.0
MODCARGO_CRATES +=	windows-targets	0.53.5	# MIT OR Apache-2.0
MODCARGO_CRATES +=	windows_aarch64_gnullvm	0.53.1	# MIT OR Apache-2.0
MODCARGO_CRATES +=	windows_aarch64_msvc	0.53.1	# MIT OR Apache-2.0
MODCARGO_CRATES +=	windows_i686_gnu	0.53.1	# MIT OR Apache-2.0
MODCARGO_CRATES +=	windows_i686_gnullvm	0.53.1	# MIT OR Apache-2.0
MODCARGO_CRATES +=	windows_i686_msvc	0.53.1	# MIT OR Apache-2.0
MODCARGO_CRATES +=	windows_x86_64_gnu	0.53.1	# MIT OR Apache-2.0
MODCARGO_CRATES +=	windows_x86_64_gnullvm	0.53.1	# MIT OR Apache-2.0
MODCARGO_CRATES +=	windows_x86_64_msvc	0.53.1	# MIT OR Apache-2.0
MODCARGO_CRATES +=	wit-bindgen	0.46.0	# Apache-2.0 WITH LLVM-exception OR Apache-2.0 OR MIT
MODCARGO_CRATES +=	wit-bindgen	0.51.0	# Apache-2.0 WITH LLVM-exception OR Apache-2.0 OR MIT
MODCARGO_CRATES +=	wit-bindgen-core	0.51.0	# Apache-2.0 WITH LLVM-exception OR Apache-2.0 OR MIT
MODCARGO_CRATES +=	wit-bindgen-rust	0.51.0	# Apache-2.0 WITH LLVM-exception OR Apache-2.0 OR MIT
MODCARGO_CRATES +=	wit-bindgen-rust-macro	0.51.0	# Apache-2.0 WITH LLVM-exception OR Apache-2.0 OR MIT
MODCARGO_CRATES +=	wit-component	0.244.0	# Apache-2.0 WITH LLVM-exception OR Apache-2.0 OR MIT
MODCARGO_CRATES +=	wit-parser	0.244.0	# Apache-2.0 WITH LLVM-exception OR Apache-2.0 OR MIT
MODCARGO_CRATES +=	yansi	1.0.1	# MIT OR Apache-2.0
MODCARGO_CRATES +=	zmij	1.0.21	# MIT
