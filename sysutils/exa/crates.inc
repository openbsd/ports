# $OpenBSD: crates.inc,v 1.2 2021/09/02 17:39:09 fcambus Exp $

MODCARGO_CRATES +=	ansi_term	0.12.1	# MIT
MODCARGO_CRATES +=	autocfg	1.0.1	# Apache-2.0 OR MIT
MODCARGO_CRATES +=	bitflags	1.2.1	# MIT/Apache-2.0
MODCARGO_CRATES +=	byteorder	1.4.3	# Unlicense OR MIT
MODCARGO_CRATES +=	cc	1.0.67	# MIT/Apache-2.0
MODCARGO_CRATES +=	cfg-if	1.0.0	# MIT/Apache-2.0
MODCARGO_CRATES +=	datetime	0.5.2	# MIT
MODCARGO_CRATES +=	form_urlencoded	1.0.1	# MIT/Apache-2.0
MODCARGO_CRATES +=	git2	0.13.17	# MIT/Apache-2.0
MODCARGO_CRATES +=	glob	0.3.0	# MIT/Apache-2.0
MODCARGO_CRATES +=	hermit-abi	0.1.18	# MIT/Apache-2.0
MODCARGO_CRATES +=	idna	0.2.2	# MIT/Apache-2.0
MODCARGO_CRATES +=	jobserver	0.1.21	# MIT/Apache-2.0
MODCARGO_CRATES +=	lazy_static	1.4.0	# MIT/Apache-2.0
MODCARGO_CRATES +=	libc	0.2.93	# MIT OR Apache-2.0
MODCARGO_CRATES +=	libgit2-sys	0.12.18+1.1.0	# MIT/Apache-2.0
MODCARGO_CRATES +=	libz-sys	1.1.2	# MIT OR Apache-2.0
MODCARGO_CRATES +=	locale	0.2.2	# MIT
MODCARGO_CRATES +=	log	0.4.14	# MIT OR Apache-2.0
MODCARGO_CRATES +=	matches	0.1.8	# MIT
MODCARGO_CRATES +=	natord	1.0.9	# MIT
MODCARGO_CRATES +=	num_cpus	1.13.0	# MIT/Apache-2.0
MODCARGO_CRATES +=	number_prefix	0.4.0	# MIT
MODCARGO_CRATES +=	openssl-src	111.15.0+1.1.1k	# MIT/Apache-2.0
MODCARGO_CRATES +=	openssl-sys	0.9.61	# MIT
MODCARGO_CRATES +=	pad	0.1.6	# MIT
MODCARGO_CRATES +=	percent-encoding	2.1.0	# MIT/Apache-2.0
MODCARGO_CRATES +=	pkg-config	0.3.19	# MIT/Apache-2.0
MODCARGO_CRATES +=	redox_syscall	0.1.57	# MIT
MODCARGO_CRATES +=	scoped_threadpool	0.1.9	# MIT
MODCARGO_CRATES +=	term_grid	0.1.7	# MIT
MODCARGO_CRATES +=	term_size	0.3.2	# MIT/Apache-2.0
MODCARGO_CRATES +=	tinyvec	1.2.0	# Zlib OR Apache-2.0 OR MIT
MODCARGO_CRATES +=	tinyvec_macros	0.1.0	# MIT OR Apache-2.0 OR Zlib
MODCARGO_CRATES +=	unicode-bidi	0.3.5	# MIT / Apache-2.0
MODCARGO_CRATES +=	unicode-normalization	0.1.17	# MIT/Apache-2.0
MODCARGO_CRATES +=	unicode-width	0.1.8	# MIT/Apache-2.0
MODCARGO_CRATES +=	url	2.2.1	# MIT/Apache-2.0
MODCARGO_CRATES +=	users	0.11.0	# MIT
MODCARGO_CRATES +=	vcpkg	0.2.11	# MIT/Apache-2.0
MODCARGO_CRATES +=	winapi	0.3.9	# MIT/Apache-2.0
MODCARGO_CRATES +=	winapi-i686-pc-windows-gnu	0.4.0	# MIT/Apache-2.0
MODCARGO_CRATES +=	winapi-x86_64-pc-windows-gnu	0.4.0	# MIT/Apache-2.0
MODCARGO_CRATES +=	zoneinfo_compiled	0.5.1	# MIT
