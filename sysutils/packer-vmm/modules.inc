MODGO_MODULES =	\
	cel.dev/expr										 v0.23.1 \
	cloud.google.com/go									 v0.121.0 \
	cloud.google.com/go/accessapproval							 v1.8.6 \
	cloud.google.com/go/accesscontextmanager						 v1.9.6 \
	cloud.google.com/go/aiplatform								 v1.84.0 \
	cloud.google.com/go/analytics								 v0.28.0 \
	cloud.google.com/go/apigateway								 v1.7.6 \
	cloud.google.com/go/apigeeconnect							 v1.7.6 \
	cloud.google.com/go/apigeeregistry							 v0.9.6 \
	cloud.google.com/go/appengine								 v1.9.6 \
	cloud.google.com/go/area120								 v0.9.6 \
	cloud.google.com/go/artifactregistry							 v1.17.1 \
	cloud.google.com/go/asset								 v1.20.6 \
	cloud.google.com/go/assuredworkloads							 v1.12.6 \
	cloud.google.com/go/auth								 v0.16.1 \
	cloud.google.com/go/auth/oauth2adapt							 v0.2.8 \
	cloud.google.com/go/automl								 v1.14.7 \
	cloud.google.com/go/baremetalsolution							 v1.3.6 \
	cloud.google.com/go/batch								 v1.12.2 \
	cloud.google.com/go/beyondcorp								 v1.1.6 \
	cloud.google.com/go/bigquery								 v1.67.0 \
	cloud.google.com/go/bigtable								 v1.37.0 \
	cloud.google.com/go/billing								 v1.20.4 \
	cloud.google.com/go/binaryauthorization							 v1.9.5 \
	cloud.google.com/go/certificatemanager							 v1.9.5 \
	cloud.google.com/go/channel								 v1.19.5 \
	cloud.google.com/go/cloudbuild								 v1.22.2 \
	cloud.google.com/go/clouddms								 v1.8.7 \
	cloud.google.com/go/cloudtasks								 v1.13.6 \
	cloud.google.com/go/compute								 v1.37.0 \
	cloud.google.com/go/compute/metadata							 v0.6.0 \
	cloud.google.com/go/contactcenterinsights						 v1.17.3 \
	cloud.google.com/go/container								 v1.42.4 \
	cloud.google.com/go/containeranalysis							 v0.14.1 \
	cloud.google.com/go/datacatalog								 v1.25.2 \
	cloud.google.com/go/dataflow								 v0.10.6 \
	cloud.google.com/go/dataform								 v0.11.2 \
	cloud.google.com/go/datafusion								 v1.8.6 \
	cloud.google.com/go/datalabeling							 v0.9.6 \
	cloud.google.com/go/dataplex								 v1.25.2 \
	cloud.google.com/go/dataproc/v2								 v2.11.2 \
	cloud.google.com/go/dataqna								 v0.9.6 \
	cloud.google.com/go/datastore								 v1.20.0 \
	cloud.google.com/go/datastream								 v1.14.1 \
	cloud.google.com/go/deploy								 v1.27.1 \
	cloud.google.com/go/dialogflow								 v1.68.2 \
	cloud.google.com/go/dlp									 v1.22.1 \
	cloud.google.com/go/documentai								 v1.36.1 \
	cloud.google.com/go/domains								 v0.10.6 \
	cloud.google.com/go/edgecontainer							 v1.4.3 \
	cloud.google.com/go/errorreporting							 v0.3.2 \
	cloud.google.com/go/essentialcontacts							 v1.7.6 \
	cloud.google.com/go/eventarc								 v1.15.5 \
	cloud.google.com/go/filestore								 v1.10.2 \
	cloud.google.com/go/firestore								 v1.18.0 \
	cloud.google.com/go/functions								 v1.19.6 \
	cloud.google.com/go/gkebackup								 v1.6.5 \
	cloud.google.com/go/gkeconnect								 v0.12.4 \
	cloud.google.com/go/gkehub								 v0.15.6 \
	cloud.google.com/go/gkemulticloud							 v1.5.3 \
	cloud.google.com/go/gsuiteaddons							 v1.7.7 \
	cloud.google.com/go/iam									 v1.5.2 \
	cloud.google.com/go/iap									 v1.11.1 \
	cloud.google.com/go/ids									 v1.5.6 \
	cloud.google.com/go/iot									 v1.8.6 \
	cloud.google.com/go/kms									 v1.21.2 \
	cloud.google.com/go/language								 v1.14.5 \
	cloud.google.com/go/lifesciences							 v0.10.6 \
	cloud.google.com/go/logging								 v1.13.0 \
	cloud.google.com/go/longrunning								 v0.6.7 \
	cloud.google.com/go/managedidentities							 v1.7.6 \
	cloud.google.com/go/maps								 v1.20.3 \
	cloud.google.com/go/mediatranslation							 v0.9.6 \
	cloud.google.com/go/memcache								 v1.11.6 \
	cloud.google.com/go/metastore								 v1.14.6 \
	cloud.google.com/go/monitoring								 v1.24.2 \
	cloud.google.com/go/networkconnectivity							 v1.17.1 \
	cloud.google.com/go/networkmanagement							 v1.19.1 \
	cloud.google.com/go/networksecurity							 v0.10.6 \
	cloud.google.com/go/notebooks								 v1.12.6 \
	cloud.google.com/go/optimization							 v1.7.6 \
	cloud.google.com/go/orchestration							 v1.11.9 \
	cloud.google.com/go/orgpolicy								 v1.15.0 \
	cloud.google.com/go/osconfig								 v1.14.5 \
	cloud.google.com/go/oslogin								 v1.14.6 \
	cloud.google.com/go/phishingprotection							 v0.9.6 \
	cloud.google.com/go/policytroubleshooter						 v1.11.6 \
	cloud.google.com/go/privatecatalog							 v0.10.7 \
	cloud.google.com/go/pubsub								 v1.49.0 \
	cloud.google.com/go/pubsublite								 v1.8.2 \
	cloud.google.com/go/recaptchaenterprise/v2						 v2.20.4 \
	cloud.google.com/go/recommendationengine						 v0.9.6 \
	cloud.google.com/go/recommender								 v1.13.5 \
	cloud.google.com/go/redis								 v1.18.2 \
	cloud.google.com/go/resourcemanager							 v1.10.6 \
	cloud.google.com/go/resourcesettings							 v1.8.3 \
	cloud.google.com/go/retail								 v1.19.4 \
	cloud.google.com/go/run									 v1.9.3 \
	cloud.google.com/go/scheduler								 v1.11.7 \
	cloud.google.com/go/secretmanager							 v1.14.7 \
	cloud.google.com/go/security								 v1.18.5 \
	cloud.google.com/go/securitycenter							 v1.36.2 \
	cloud.google.com/go/servicedirectory							 v1.12.6 \
	cloud.google.com/go/shell								 v1.8.6 \
	cloud.google.com/go/spanner								 v1.80.0 \
	cloud.google.com/go/speech								 v1.27.1 \
	cloud.google.com/go/storage								 v1.53.0 \
	cloud.google.com/go/storagetransfer							 v1.12.4 \
	cloud.google.com/go/talent								 v1.8.3 \
	cloud.google.com/go/texttospeech							 v1.12.1 \
	cloud.google.com/go/tpu									 v1.8.3 \
	cloud.google.com/go/trace								 v1.11.6 \
	cloud.google.com/go/translate								 v1.12.5 \
	cloud.google.com/go/video								 v1.23.5 \
	cloud.google.com/go/videointelligence							 v1.12.6 \
	cloud.google.com/go/vision/v2								 v2.9.5 \
	cloud.google.com/go/vmmigration								 v1.8.6 \
	cloud.google.com/go/vmwareengine							 v1.3.5 \
	cloud.google.com/go/vpcaccess								 v1.8.6 \
	cloud.google.com/go/webrisk								 v1.11.1 \
	cloud.google.com/go/websecurityscanner							 v1.7.6 \
	cloud.google.com/go/workflows								 v1.14.2 \
	github.com/!azure/go-ntlmssp								 v0.0.0-20221128193559-754e69321358 \
	github.com/!chris!trenkamp/goxpath							 v0.0.0-20210404020558-97928f7e12b6 \
	github.com/!data!dog/datadog-go								 v3.2.0+incompatible \
	github.com/!google!cloud!platform/opentelemetry-operations-go/detectors/gcp		 v1.27.0 \
	github.com/!google!cloud!platform/opentelemetry-operations-go/exporter/metric		 v0.51.0 \
	github.com/!google!cloud!platform/opentelemetry-operations-go/internal/cloudmock	 v0.51.0 \
	github.com/!google!cloud!platform/opentelemetry-operations-go/internal/resourcemapping	 v0.51.0 \
	github.com/!masterminds/goutils								 v1.1.1 \
	github.com/!masterminds/semver/v3							 v3.1.1 \
	github.com/!masterminds/sprig/v3							 v3.2.1 \
	github.com/!microsoft/go-winio								 v0.6.2 \
	github.com/agext/levenshtein								 v1.2.3 \
	github.com/alecthomas/template								 v0.0.0-20190718012654-fb15b899a751 \
	github.com/alecthomas/units								 v0.0.0-20190924025748-f65c72e2690d \
	github.com/antchfx/xmlquery								 v1.3.5 \
	github.com/antchfx/xpath								 v1.1.11 \
	github.com/apparentlymart/go-textseg/v13						 v13.0.0 \
	github.com/apparentlymart/go-textseg/v15						 v15.0.0 \
	github.com/armon/circbuf								 v0.0.0-20150827004946-bbbad097214e \
	github.com/armon/go-metrics								 v0.4.1 \
	github.com/armon/go-radix								 v1.0.0 \
	github.com/aws/aws-sdk-go								 v1.55.7 \
	github.com/beorn7/perks									 v1.0.1 \
	github.com/bgentry/go-netrc								 v0.0.0-20140422174119-9fd32a8b3d3d \
	github.com/bgentry/speakeasy								 v0.2.0 \
	github.com/bodgit/ntlmssp								 v0.0.0-20240506230425-31973bb52d9b \
	github.com/bodgit/windows								 v1.0.1 \
	github.com/cenkalti/backoff/v3								 v3.2.2 \
	github.com/cenkalti/backoff/v4								 v4.3.0 \
	github.com/cespare/xxhash/v2								 v2.3.0 \
	github.com/circonus-labs/circonus-gometrics						 v2.3.1+incompatible \
	github.com/circonus-labs/circonusllhist							 v0.1.3 \
	github.com/cncf/xds/go									 v0.0.0-20250501225837-2ac532fd4443 \
	github.com/davecgh/go-spew								 v1.1.2-0.20180830191138-d8f796af33cc \
	github.com/dylanmei/iso8601								 v0.1.0 \
	github.com/dylanmei/winrmtest								 v0.0.0-20210303004826-fbc9ae56efb6 \
	github.com/envoyproxy/go-control-plane							 v0.13.4 \
	github.com/envoyproxy/go-control-plane/envoy						 v1.32.4 \
	github.com/envoyproxy/go-control-plane/ratelimit					 v0.1.0 \
	github.com/envoyproxy/protoc-gen-validate						 v1.2.1 \
	github.com/fatih/camelcase								 v1.0.0 \
	github.com/fatih/color									 v1.18.0 \
	github.com/fatih/structtag								 v1.2.0 \
	github.com/felixge/httpsnoop								 v1.0.4 \
	github.com/go-jose/go-jose/v4								 v4.1.0 \
	github.com/go-kit/kit									 v0.9.0 \
	github.com/go-kit/log									 v0.1.0 \
	github.com/go-logfmt/logfmt								 v0.5.0 \
	github.com/go-logr/logr									 v1.4.2 \
	github.com/go-logr/stdr									 v1.2.2 \
	github.com/go-stack/stack								 v1.8.0 \
	github.com/go-test/deep									 v1.0.3 \
	github.com/gofrs/flock									 v0.12.1 \
	github.com/gofrs/uuid									 v4.4.0+incompatible \
	github.com/gogo/protobuf								 v1.1.1 \
	github.com/golang/glog									 v1.2.4 \
	github.com/golang/groupcache								 v0.0.0-20241129210726-2c02b8208cf8 \
	github.com/golang/protobuf								 v1.5.4 \
	github.com/golang/snappy								 v0.0.4 \
	github.com/google/btree									 v1.1.2 \
	github.com/google/go-cmp								 v0.7.0 \
	github.com/google/go-pkcs11								 v0.3.0 \
	github.com/google/gofuzz								 v1.0.0 \
	github.com/google/martian/v3								 v3.3.3 \
	github.com/google/s2a-go								 v0.1.9 \
	github.com/google/shlex									 v0.0.0-20191202100458-e7afc7fbc510 \
	github.com/google/uuid									 v1.6.0 \
	github.com/googleapis/enterprise-certificate-proxy					 v0.3.6 \
	github.com/googleapis/gax-go/v2								 v2.14.1 \
	github.com/gorilla/securecookie								 v1.1.1 \
	github.com/gorilla/sessions								 v1.2.1 \
	github.com/hashicorp/consul/api								 v1.32.0 \
	github.com/hashicorp/consul/sdk								 v0.16.1 \
	github.com/hashicorp/errwrap								 v1.1.0 \
	github.com/hashicorp/go-cleanhttp							 v0.5.2 \
	github.com/hashicorp/go-getter/gcs/v2							 v2.2.3 \
	github.com/hashicorp/go-getter/s3/v2							 v2.2.3 \
	github.com/hashicorp/go-getter/v2							 v2.2.3 \
	github.com/hashicorp/go-hclog								 v1.6.3 \
	github.com/hashicorp/go-immutable-radix							 v1.3.1 \
	github.com/hashicorp/go-metrics								 v0.5.4 \
	github.com/hashicorp/go-msgpack								 v0.5.5 \
	github.com/hashicorp/go-msgpack/v2							 v2.1.2 \
	github.com/hashicorp/go-multierror							 v1.1.1 \
	github.com/hashicorp/go-retryablehttp							 v0.7.7 \
	github.com/hashicorp/go-rootcerts							 v1.0.2 \
	github.com/hashicorp/go-safetemp							 v1.0.0 \
	github.com/hashicorp/go-secure-stdlib/parseutil						 v0.2.0 \
	github.com/hashicorp/go-secure-stdlib/strutil						 v0.1.2 \
	github.com/hashicorp/go-sockaddr							 v1.0.7 \
	github.com/hashicorp/go-syslog								 v1.0.0 \
	github.com/hashicorp/go-uuid								 v1.0.3 \
	github.com/hashicorp/go-version								 v1.7.0 \
	github.com/hashicorp/golang-lru								 v1.0.2 \
	github.com/hashicorp/hcl								 v1.0.0 \
	github.com/hashicorp/hcl/v2								 v2.23.0 \
	github.com/hashicorp/logutils								 v1.0.0 \
	github.com/hashicorp/mdns								 v1.0.5 \
	github.com/hashicorp/memberlist								 v0.5.2 \
	github.com/hashicorp/packer-plugin-sdk							 v0.6.1 \
	github.com/hashicorp/serf								 v0.10.2 \
	github.com/hashicorp/vault/api								 v1.16.0 \
	github.com/hashicorp/yamux								 v0.1.2 \
	github.com/huandu/xstrings								 v1.3.2 \
	github.com/iancoleman/strcase								 v0.3.0 \
	github.com/imdario/mergo								 v0.3.12 \
	github.com/jcmturner/aescts/v2								 v2.0.0 \
	github.com/jcmturner/dnsutils/v2							 v2.0.0 \
	github.com/jcmturner/gofork								 v1.7.6 \
	github.com/jcmturner/goidentity/v6							 v6.0.1 \
	github.com/jcmturner/gokrb5/v8								 v8.4.4 \
	github.com/jcmturner/rpc/v2								 v2.0.3 \
	github.com/jehiah/go-strftime								 v0.0.0-20171201141054-1d33003b3869 \
	github.com/jmespath/go-jmespath								 v0.4.0 \
	github.com/jmespath/go-jmespath/internal/testify					 v1.5.1 \
	github.com/jpillora/backoff								 v1.0.0 \
	github.com/json-iterator/go								 v1.1.11 \
	github.com/julienschmidt/httprouter							 v1.3.0 \
	github.com/klauspost/compress								 v1.18.0 \
	github.com/konsorten/go-windows-terminal-sequences					 v1.0.3 \
	github.com/kr/fs									 v0.1.0 \
	github.com/kr/logfmt									 v0.0.0-20140226030751-b84e30acd515 \
	github.com/kr/pretty									 v0.3.1 \
	github.com/kr/pty									 v1.1.1 \
	github.com/kr/text									 v0.2.0 \
	github.com/lyft/protoc-gen-star/v2							 v2.0.4-0.20230330145011-496ad1ac90a4 \
	github.com/masterzen/simplexml								 v0.0.0-20190410153822-31eea3082786 \
	github.com/masterzen/winrm								 v0.0.0-20240702205601-3fad6e106085 \
	github.com/mattn/go-colorable								 v0.1.14 \
	github.com/mattn/go-isatty								 v0.0.20 \
	github.com/matttproud/golang_protobuf_extensions					 v1.0.1 \
	github.com/miekg/dns									 v1.1.56 \
	github.com/mitchellh/cli								 v1.1.5 \
	github.com/mitchellh/copystructure							 v1.0.0 \
	github.com/mitchellh/go-fs								 v0.0.0-20180402235330-b7b9ca407fff \
	github.com/mitchellh/go-homedir								 v1.1.0 \
	github.com/mitchellh/go-testing-interface						 v1.14.1 \
	github.com/mitchellh/go-wordwrap							 v1.0.1 \
	github.com/mitchellh/iochan								 v1.0.0 \
	github.com/mitchellh/mapstructure							 v1.5.0 \
	github.com/mitchellh/reflectwalk							 v1.0.2 \
	github.com/modern-go/concurrent								 v0.0.0-20180306012644-bacd9c7ef1dd \
	github.com/modern-go/reflect2								 v1.0.1 \
	github.com/mwitkow/go-conntrack								 v0.0.0-20190716064945-2f068394615f \
	github.com/natefinch/atomic								 v1.0.1 \
	github.com/nu7hatch/gouuid								 v0.0.0-20131221200532-179d4d0c4d8d \
	github.com/nywilken/go-cty								 v1.13.3 \
	github.com/packer-community/winrmcp							 v0.0.0-20221126162354-6e900dd2c68f \
	github.com/pascaldekloe/goe								 v0.1.0 \
	github.com/pkg/diff									 v0.0.0-20210226163009-20ebb0f2a09e \
	github.com/pkg/errors									 v0.9.1 \
	github.com/pkg/sftp									 v1.13.9 \
	github.com/planetscale/vtprotobuf							 v0.6.1-0.20240319094008-0393e58bdf10 \
	github.com/pmezard/go-difflib								 v1.0.1-0.20181226105442-5d4384ee4fb2 \
	github.com/posener/complete								 v1.2.3 \
	github.com/prometheus/client_golang							 v1.11.1 \
	github.com/prometheus/client_model							 v0.6.1 \
	github.com/prometheus/common								 v0.26.0 \
	github.com/prometheus/procfs								 v0.6.0 \
	github.com/rogpeppe/go-internal								 v1.13.1 \
	github.com/ryanuber/columnize								 v2.1.2+incompatible \
	github.com/ryanuber/go-glob								 v1.0.0 \
	github.com/sean-/seed									 v0.0.0-20170313163322-e2103e2c3529 \
	github.com/shopspring/decimal								 v1.2.0 \
	github.com/sirupsen/logrus								 v1.6.0 \
	github.com/spf13/afero									 v1.10.0 \
	github.com/spf13/cast									 v1.3.1 \
	github.com/spf13/pflag									 v1.0.2 \
	github.com/spiffe/go-spiffe/v2								 v2.5.0 \
	github.com/stretchr/objx								 v0.5.0 \
	github.com/stretchr/testify								 v1.10.0 \
	github.com/tidwall/transform								 v0.0.0-20201103190739-32f242e2dbde \
	github.com/tv42/httpunix								 v0.0.0-20150427012821-b75d8614f926 \
	github.com/ugorji/go/codec								 v1.2.12 \
	github.com/ulikunitz/xz									 v0.5.12 \
	github.com/vmihailenco/msgpack/v5							 v5.4.1 \
	github.com/vmihailenco/tagparser/v2							 v2.0.0 \
	github.com/yuin/goldmark								 v1.4.13 \
	github.com/zclconf/go-cty								 v1.16.2 \
	github.com/zclconf/go-cty-debug								 v0.0.0-20240509010212-0d6042c53940 \
	github.com/zeebo/errs									 v1.4.0 \
	go.opencensus.io									 v0.24.0 \
	go.opentelemetry.io/auto/sdk								 v1.1.0 \
	go.opentelemetry.io/contrib/detectors/gcp						 v1.35.0 \
	go.opentelemetry.io/contrib/instrumentation/google.golang.org/grpc/otelgrpc		 v0.60.0 \
	go.opentelemetry.io/contrib/instrumentation/net/http/otelhttp				 v0.60.0 \
	go.opentelemetry.io/otel								 v1.35.0 \
	go.opentelemetry.io/otel/exporters/stdout/stdoutmetric					 v1.35.0 \
	go.opentelemetry.io/otel/metric								 v1.35.0 \
	go.opentelemetry.io/otel/sdk								 v1.35.0 \
	go.opentelemetry.io/otel/sdk/metric							 v1.35.0 \
	go.opentelemetry.io/otel/trace								 v1.35.0 \
	go.opentelemetry.io/proto/otlp								 v1.0.0 \
	go.uber.org/goleak									 v1.3.0 \
	golang.org/x/crypto									 v0.37.0 \
	golang.org/x/exp									 v0.0.0-20250408133849-7e4ce0ab07d0 \
	golang.org/x/exp/shiny									 v0.0.0-20230817173708-d852ddb80c63 \
	golang.org/x/image									 v0.26.0 \
	golang.org/x/mobile									 v0.0.0-20250408133729-978277e7eaf7 \
	golang.org/x/mod									 v0.24.0 \
	golang.org/x/net									 v0.39.0 \
	golang.org/x/oauth2									 v0.29.0 \
	golang.org/x/sync									 v0.13.0 \
	golang.org/x/sys									 v0.32.0 \
	golang.org/x/telemetry									 v0.0.0-20240521205824-bda55230c457 \
	golang.org/x/term									 v0.31.0 \
	golang.org/x/text									 v0.24.0 \
	golang.org/x/time									 v0.11.0 \
	golang.org/x/tools									 v0.32.0 \
	golang.org/x/xerrors									 v0.0.0-20220907171357-04be3eba64a2 \
	google.golang.org/api									 v0.231.0 \
	google.golang.org/appengine								 v1.6.8 \
	google.golang.org/genproto								 v0.0.0-20250428153025-10db94c68c34 \
	google.golang.org/genproto/googleapis/api						 v0.0.0-20250428153025-10db94c68c34 \
	google.golang.org/genproto/googleapis/bytestream					 v0.0.0-20250425173222-7b384671a197 \
	google.golang.org/genproto/googleapis/rpc						 v0.0.0-20250428153025-10db94c68c34 \
	google.golang.org/grpc									 v1.72.0 \
	google.golang.org/grpc/examples								 v0.0.0-20230224211313-3775f633ce20 \
	google.golang.org/protobuf								 v1.36.6 \
	gopkg.in/alecthomas/kingpin.v2								 v2.2.6 \
	gopkg.in/check.v1									 v1.0.0-20201130134442-10cb98267c6c \
	gopkg.in/yaml.v2									 v2.3.0 \
	gopkg.in/yaml.v3									 v3.0.1

MODGO_MODFILES =	\
	cel.dev/expr									 v0.15.0 \
	cel.dev/expr									 v0.19.0 \
	cel.dev/expr									 v0.20.0 \
	cloud.google.com/go								 v0.110.8 \
	cloud.google.com/go								 v0.112.2 \
	cloud.google.com/go								 v0.118.3 \
	cloud.google.com/go								 v0.120.0 \
	cloud.google.com/go								 v0.120.1 \
	cloud.google.com/go								 v0.34.0 \
	cloud.google.com/go/auth							 v0.14.0 \
	cloud.google.com/go/auth							 v0.15.0 \
	cloud.google.com/go/auth							 v0.16.0 \
	cloud.google.com/go/auth							 v0.3.0 \
	cloud.google.com/go/auth/oauth2adapt						 v0.2.2 \
	cloud.google.com/go/auth/oauth2adapt						 v0.2.7 \
	cloud.google.com/go/compute							 v1.23.1 \
	cloud.google.com/go/compute/metadata						 v0.2.3 \
	cloud.google.com/go/compute/metadata						 v0.3.0 \
	cloud.google.com/go/iam								 v1.1.3 \
	cloud.google.com/go/iam								 v1.5.0 \
	cloud.google.com/go/longrunning							 v0.5.6 \
	cloud.google.com/go/longrunning							 v0.6.4 \
	cloud.google.com/go/longrunning							 v0.6.6 \
	cloud.google.com/go/monitoring							 v1.22.1 \
	cloud.google.com/go/monitoring							 v1.24.0 \
	cloud.google.com/go/storage							 v1.35.1 \
	cloud.google.com/go/storage							 v1.52.0 \
	cloud.google.com/go/trace							 v1.11.3 \
	cloud.google.com/go/translate							 v1.10.3 \
	github.com/!azure/go-ntlmssp							 v0.0.0-20200615164410-66371956d46c \
	github.com/!google!cloud!platform/opentelemetry-operations-go/detectors/gcp	 v1.26.0 \
	github.com/agext/levenshtein							 v1.2.1 \
	github.com/alecthomas/template							 v0.0.0-20160405071501-a0175ee3bccc \
	github.com/alecthomas/units							 v0.0.0-20151022065526-2efee857e7cf \
	github.com/alecthomas/units							 v0.0.0-20190717042225-c3de453c63f4 \
	github.com/armon/go-radix							 v0.0.0-20180808171621-7fddfc383310 \
	github.com/aws/aws-sdk-go							 v1.44.114 \
	github.com/beorn7/perks								 v0.0.0-20180321164747-3a771d992973 \
	github.com/beorn7/perks								 v1.0.0 \
	github.com/bgentry/speakeasy							 v0.1.0 \
	github.com/cespare/xxhash/v2							 v2.1.1 \
	github.com/cncf/xds/go								 v0.0.0-20240905190251-b4127c9b8d78 \
	github.com/cncf/xds/go								 v0.0.0-20250121191232-2f005788dc42 \
	github.com/davecgh/go-spew							 v1.1.0 \
	github.com/davecgh/go-spew							 v1.1.1 \
	github.com/envoyproxy/protoc-gen-validate					 v1.0.4 \
	github.com/fatih/color								 v1.13.0 \
	github.com/fatih/color								 v1.16.0 \
	github.com/fatih/color								 v1.7.0 \
	github.com/fatih/color								 v1.9.0 \
	github.com/go-jose/go-jose/v4							 v4.0.1 \
	github.com/go-jose/go-jose/v4							 v4.0.4 \
	github.com/go-jose/go-jose/v4							 v4.0.5 \
	github.com/go-kit/kit								 v0.8.0 \
	github.com/go-logfmt/logfmt							 v0.3.0 \
	github.com/go-logfmt/logfmt							 v0.4.0 \
	github.com/go-logr/logr								 v1.2.2 \
	github.com/go-logr/logr								 v1.4.1 \
	github.com/go-test/deep								 v1.0.2 \
	github.com/gofrs/flock								 v0.8.1 \
	github.com/gofrs/uuid								 v4.0.0+incompatible \
	github.com/golang/groupcache							 v0.0.0-20210331224755-41bb18bfe9da \
	github.com/golang/protobuf							 v1.2.0 \
	github.com/golang/protobuf							 v1.3.1 \
	github.com/golang/protobuf							 v1.3.2 \
	github.com/golang/protobuf							 v1.4.0 \
	github.com/golang/protobuf							 v1.4.0-rc.1 \
	github.com/golang/protobuf							 v1.4.0-rc.1.0.20200221234624-67d41d38c208 \
	github.com/golang/protobuf							 v1.4.0-rc.2 \
	github.com/golang/protobuf							 v1.4.0-rc.4.0.20200313231945-b860323f09d0 \
	github.com/golang/protobuf							 v1.4.2 \
	github.com/golang/protobuf							 v1.4.3 \
	github.com/golang/protobuf							 v1.5.0 \
	github.com/golang/protobuf							 v1.5.3 \
	github.com/google/btree								 v1.0.1 \
	github.com/google/go-cmp							 v0.3.0 \
	github.com/google/go-cmp							 v0.3.1 \
	github.com/google/go-cmp							 v0.4.0 \
	github.com/google/go-cmp							 v0.5.4 \
	github.com/google/go-cmp							 v0.5.5 \
	github.com/google/go-cmp							 v0.5.9 \
	github.com/google/go-cmp							 v0.6.0 \
	github.com/google/s2a-go							 v0.1.7 \
	github.com/google/uuid								 v1.1.2 \
	github.com/google/uuid								 v1.4.0 \
	github.com/googleapis/enterprise-certificate-proxy				 v0.3.2 \
	github.com/googleapis/enterprise-certificate-proxy				 v0.3.4 \
	github.com/googleapis/enterprise-certificate-proxy				 v0.3.5 \
	github.com/googleapis/gax-go/v2							 v2.12.0 \
	github.com/googleapis/gax-go/v2							 v2.12.3 \
	github.com/hashicorp/consul/api							 v1.25.1 \
	github.com/hashicorp/errwrap							 v1.0.0 \
	github.com/hashicorp/go-cleanhttp						 v0.5.0 \
	github.com/hashicorp/go-getter/gcs/v2						 v2.2.2 \
	github.com/hashicorp/go-getter/s3/v2						 v2.2.2 \
	github.com/hashicorp/go-getter/v2						 v2.2.2 \
	github.com/hashicorp/go-hclog							 v1.5.0 \
	github.com/hashicorp/go-immutable-radix						 v1.0.0 \
	github.com/hashicorp/go-multierror						 v1.0.0 \
	github.com/hashicorp/go-multierror						 v1.1.0 \
	github.com/hashicorp/go-retryablehttp						 v0.5.3 \
	github.com/hashicorp/go-secure-stdlib/parseutil					 v0.1.6 \
	github.com/hashicorp/go-sockaddr						 v1.0.2 \
	github.com/hashicorp/go-sockaddr						 v1.0.5 \
	github.com/hashicorp/go-sockaddr						 v1.0.6 \
	github.com/hashicorp/go-uuid							 v1.0.0 \
	github.com/hashicorp/go-uuid							 v1.0.1 \
	github.com/hashicorp/go-uuid							 v1.0.2 \
	github.com/hashicorp/go-version							 v1.1.0 \
	github.com/hashicorp/go-version							 v1.2.1 \
	github.com/hashicorp/go-version							 v1.6.0 \
	github.com/hashicorp/golang-lru							 v0.5.0 \
	github.com/hashicorp/golang-lru							 v0.5.4 \
	github.com/hashicorp/hcl/v2							 v2.19.1 \
	github.com/hashicorp/memberlist							 v0.5.0 \
	github.com/hashicorp/serf							 v0.10.1 \
	github.com/hashicorp/vault/api							 v1.14.0 \
	github.com/hashicorp/yamux							 v0.1.1 \
	github.com/imdario/mergo							 v0.3.11 \
	github.com/json-iterator/go							 v1.1.10 \
	github.com/json-iterator/go							 v1.1.6 \
	github.com/json-iterator/go							 v1.1.9 \
	github.com/julienschmidt/httprouter						 v1.2.0 \
	github.com/klauspost/compress							 v1.11.2 \
	github.com/konsorten/go-windows-terminal-sequences				 v1.0.1 \
	github.com/kr/pretty								 v0.1.0 \
	github.com/kr/pretty								 v0.2.0 \
	github.com/kr/text								 v0.1.0 \
	github.com/masterzen/winrm							 v0.0.0-20210623064412-3b76017826b0 \
	github.com/mattn/go-colorable							 v0.0.9 \
	github.com/mattn/go-colorable							 v0.1.12 \
	github.com/mattn/go-colorable							 v0.1.13 \
	github.com/mattn/go-colorable							 v0.1.6 \
	github.com/mattn/go-colorable							 v0.1.9 \
	github.com/mattn/go-isatty							 v0.0.12 \
	github.com/mattn/go-isatty							 v0.0.14 \
	github.com/mattn/go-isatty							 v0.0.3 \
	github.com/miekg/dns								 v1.1.41 \
	github.com/mitchellh/go-homedir							 v1.0.0 \
	github.com/mitchellh/go-testing-interface					 v1.0.0 \
	github.com/mitchellh/go-wordwrap						 v0.0.0-20150314170334-ad45545899c7 \
	github.com/mitchellh/reflectwalk						 v1.0.0 \
	github.com/modern-go/concurrent							 v0.0.0-20180228061459-e0a39a4cb421 \
	github.com/modern-go/reflect2							 v0.0.0-20180701023420-4b7aa43c6742 \
	github.com/mwitkow/go-conntrack							 v0.0.0-20161129095857-cc309e4a2223 \
	github.com/packer-community/winrmcp						 v0.0.0-20180921211025-c76d91c1e7db \
	github.com/pkg/errors								 v0.8.0 \
	github.com/pkg/errors								 v0.8.1 \
	github.com/pkg/sftp								 v1.13.2 \
	github.com/pmezard/go-difflib							 v1.0.0 \
	github.com/posener/complete							 v1.1.1 \
	github.com/prometheus/client_golang						 v0.9.1 \
	github.com/prometheus/client_golang						 v1.0.0 \
	github.com/prometheus/client_golang						 v1.4.0 \
	github.com/prometheus/client_golang						 v1.7.1 \
	github.com/prometheus/client_model						 v0.0.0-20180712105110-5c3871d89910 \
	github.com/prometheus/client_model						 v0.0.0-20190129233127-fd36f4220a90 \
	github.com/prometheus/client_model						 v0.2.0 \
	github.com/prometheus/common							 v0.10.0 \
	github.com/prometheus/common							 v0.4.1 \
	github.com/prometheus/common							 v0.9.1 \
	github.com/prometheus/procfs							 v0.0.0-20181005140218-185b4288413d \
	github.com/prometheus/procfs							 v0.0.2 \
	github.com/prometheus/procfs							 v0.0.8 \
	github.com/prometheus/procfs							 v0.1.3 \
	github.com/sirupsen/logrus							 v1.2.0 \
	github.com/sirupsen/logrus							 v1.4.2 \
	github.com/stretchr/objx							 v0.1.0 \
	github.com/stretchr/objx							 v0.1.1 \
	github.com/stretchr/objx							 v0.4.0 \
	github.com/stretchr/testify							 v1.2.2 \
	github.com/stretchr/testify							 v1.3.0 \
	github.com/stretchr/testify							 v1.4.0 \
	github.com/stretchr/testify							 v1.6.1 \
	github.com/stretchr/testify							 v1.7.1 \
	github.com/stretchr/testify							 v1.7.2 \
	github.com/stretchr/testify							 v1.8.0 \
	github.com/stretchr/testify							 v1.8.1 \
	github.com/stretchr/testify							 v1.8.4 \
	github.com/stretchr/testify							 v1.9.0 \
	github.com/ugorji/go/codec							 v1.2.6 \
	github.com/ulikunitz/xz								 v0.5.10 \
	github.com/ulikunitz/xz								 v0.5.8 \
	github.com/vmihailenco/msgpack/v5						 v5.3.5 \
	github.com/zclconf/go-cty							 v1.13.0 \
	github.com/zclconf/go-cty							 v1.13.3 \
	go.opentelemetry.io/contrib/detectors/gcp					 v1.34.0 \
	go.opentelemetry.io/contrib/instrumentation/google.golang.org/grpc/otelgrpc	 v0.49.0 \
	go.opentelemetry.io/contrib/instrumentation/google.golang.org/grpc/otelgrpc	 v0.54.0 \
	go.opentelemetry.io/contrib/instrumentation/net/http/otelhttp			 v0.49.0 \
	go.opentelemetry.io/otel							 v1.24.0 \
	go.opentelemetry.io/otel							 v1.30.0 \
	go.opentelemetry.io/otel							 v1.31.0 \
	go.opentelemetry.io/otel							 v1.32.0 \
	go.opentelemetry.io/otel							 v1.34.0 \
	go.opentelemetry.io/otel/metric							 v1.24.0 \
	go.opentelemetry.io/otel/metric							 v1.31.0 \
	go.opentelemetry.io/otel/metric							 v1.34.0 \
	go.opentelemetry.io/otel/sdk							 v1.31.0 \
	go.opentelemetry.io/otel/sdk							 v1.34.0 \
	go.opentelemetry.io/otel/sdk/metric						 v1.31.0 \
	go.opentelemetry.io/otel/sdk/metric						 v1.34.0 \
	go.opentelemetry.io/otel/trace							 v1.24.0 \
	go.opentelemetry.io/otel/trace							 v1.31.0 \
	go.opentelemetry.io/otel/trace							 v1.32.0 \
	go.opentelemetry.io/otel/trace							 v1.34.0 \
	golang.org/x/crypto								 v0.0.0-20180904163835-0709b304e793 \
	golang.org/x/crypto								 v0.0.0-20190308221718-c2843e01d9a2 \
	golang.org/x/crypto								 v0.0.0-20200622213623-75b288015ac9 \
	golang.org/x/crypto								 v0.0.0-20210921155107-089bfa567519 \
	golang.org/x/crypto								 v0.0.0-20220517005047-85d78b3ac167 \
	golang.org/x/crypto								 v0.13.0 \
	golang.org/x/crypto								 v0.14.0 \
	golang.org/x/crypto								 v0.17.0 \
	golang.org/x/crypto								 v0.19.0 \
	golang.org/x/crypto								 v0.22.0 \
	golang.org/x/crypto								 v0.23.0 \
	golang.org/x/crypto								 v0.24.0 \
	golang.org/x/crypto								 v0.31.0 \
	golang.org/x/crypto								 v0.32.0 \
	golang.org/x/crypto								 v0.33.0 \
	golang.org/x/crypto								 v0.35.0 \
	golang.org/x/crypto								 v0.36.0 \
	golang.org/x/crypto								 v0.6.0 \
	golang.org/x/exp								 v0.0.0-20230321023759-10a507213a29 \
	golang.org/x/exp								 v0.0.0-20250106191152-7588d65b2ba8 \
	golang.org/x/mobile								 v0.0.0-20210901025245-1fde1d6c3ca1 \
	golang.org/x/mod								 v0.12.0 \
	golang.org/x/mod								 v0.13.0 \
	golang.org/x/mod								 v0.15.0 \
	golang.org/x/mod								 v0.17.0 \
	golang.org/x/mod								 v0.6.0-dev.0.20220419223038-86c51ed26bb4 \
	golang.org/x/mod								 v0.8.0 \
	golang.org/x/net								 v0.0.0-20180724234803-3673e40ba225 \
	golang.org/x/net								 v0.0.0-20181114220301-adae6a3d119a \
	golang.org/x/net								 v0.0.0-20190108225652-1e06a53dbb7e \
	golang.org/x/net								 v0.0.0-20190404232315-eb5bcb51f2a3 \
	golang.org/x/net								 v0.0.0-20190613194153-d28f0bde5980 \
	golang.org/x/net								 v0.0.0-20190620200207-3b0461eec859 \
	golang.org/x/net								 v0.0.0-20200114155413-6afb5195e5aa \
	golang.org/x/net								 v0.0.0-20200625001655-4c5254603344 \
	golang.org/x/net								 v0.0.0-20210226172049-e18ecbb05110 \
	golang.org/x/net								 v0.0.0-20220722155237-a158d28d115b \
	golang.org/x/net								 v0.10.0 \
	golang.org/x/net								 v0.14.0 \
	golang.org/x/net								 v0.15.0 \
	golang.org/x/net								 v0.17.0 \
	golang.org/x/net								 v0.20.0 \
	golang.org/x/net								 v0.21.0 \
	golang.org/x/net								 v0.25.0 \
	golang.org/x/net								 v0.33.0 \
	golang.org/x/net								 v0.34.0 \
	golang.org/x/net								 v0.35.0 \
	golang.org/x/net								 v0.37.0 \
	golang.org/x/net								 v0.6.0 \
	golang.org/x/net								 v0.7.0 \
	golang.org/x/oauth2								 v0.0.0-20190226205417-e64efc72b421 \
	golang.org/x/oauth2								 v0.13.0 \
	golang.org/x/oauth2								 v0.19.0 \
	golang.org/x/oauth2								 v0.25.0 \
	golang.org/x/oauth2								 v0.26.0 \
	golang.org/x/oauth2								 v0.27.0 \
	golang.org/x/oauth2								 v0.28.0 \
	golang.org/x/sync								 v0.0.0-20181108010431-42b317875d0f \
	golang.org/x/sync								 v0.0.0-20181221193216-37e7f081c4d4 \
	golang.org/x/sync								 v0.0.0-20190423024810-112230192c58 \
	golang.org/x/sync								 v0.0.0-20190911185100-cd5d95a43a6e \
	golang.org/x/sync								 v0.0.0-20201207232520-09787c993a3a \
	golang.org/x/sync								 v0.0.0-20220722155255-886fb9371eb4 \
	golang.org/x/sync								 v0.1.0 \
	golang.org/x/sync								 v0.10.0 \
	golang.org/x/sync								 v0.11.0 \
	golang.org/x/sync								 v0.12.0 \
	golang.org/x/sync								 v0.3.0 \
	golang.org/x/sync								 v0.5.0 \
	golang.org/x/sync								 v0.6.0 \
	golang.org/x/sync								 v0.7.0 \
	golang.org/x/sys								 v0.0.0-20180905080454-ebe1bf3edb33 \
	golang.org/x/sys								 v0.0.0-20181116152217-5ac8a444bdc5 \
	golang.org/x/sys								 v0.0.0-20190215142949-d0b11bdaac8a \
	golang.org/x/sys								 v0.0.0-20190412213103-97732733099d \
	golang.org/x/sys								 v0.0.0-20190422165155-953cdadca894 \
	golang.org/x/sys								 v0.0.0-20200106162015-b016eb3dc98e \
	golang.org/x/sys								 v0.0.0-20200116001909-b77594299b42 \
	golang.org/x/sys								 v0.0.0-20200122134326-e047566fdf82 \
	golang.org/x/sys								 v0.0.0-20200223170610-d5e6a3e2c0ae \
	golang.org/x/sys								 v0.0.0-20200323222414-85ca7c5b95cd \
	golang.org/x/sys								 v0.0.0-20200615200032-f1bc736245b1 \
	golang.org/x/sys								 v0.0.0-20200625212154-ddb9806d33ae \
	golang.org/x/sys								 v0.0.0-20201119102817-f84b799fce68 \
	golang.org/x/sys								 v0.0.0-20210124154548-22da62e12c0c \
	golang.org/x/sys								 v0.0.0-20210603081109-ebe580a85c40 \
	golang.org/x/sys								 v0.0.0-20210615035016-665e8c7367d1 \
	golang.org/x/sys								 v0.0.0-20210630005230-0f9fa26af87c \
	golang.org/x/sys								 v0.0.0-20210927094055-39ccf1dd6fa6 \
	golang.org/x/sys								 v0.0.0-20220503163025-988cb79eb6c6 \
	golang.org/x/sys								 v0.0.0-20220520151302-bc2c85ada10a \
	golang.org/x/sys								 v0.0.0-20220722155257-8c9f86f7a55f \
	golang.org/x/sys								 v0.11.0 \
	golang.org/x/sys								 v0.12.0 \
	golang.org/x/sys								 v0.13.0 \
	golang.org/x/sys								 v0.15.0 \
	golang.org/x/sys								 v0.16.0 \
	golang.org/x/sys								 v0.17.0 \
	golang.org/x/sys								 v0.20.0 \
	golang.org/x/sys								 v0.22.0 \
	golang.org/x/sys								 v0.25.0 \
	golang.org/x/sys								 v0.28.0 \
	golang.org/x/sys								 v0.29.0 \
	golang.org/x/sys								 v0.30.0 \
	golang.org/x/sys								 v0.31.0 \
	golang.org/x/sys								 v0.5.0 \
	golang.org/x/sys								 v0.6.0 \
	golang.org/x/sys								 v0.8.0 \
	golang.org/x/telemetry								 v0.0.0-20240228155512-f48c80bd79b2 \
	golang.org/x/term								 v0.0.0-20201126162022-7de9c90e9dd1 \
	golang.org/x/term								 v0.0.0-20210927222741-03fcf44c2211 \
	golang.org/x/term								 v0.12.0 \
	golang.org/x/term								 v0.17.0 \
	golang.org/x/term								 v0.20.0 \
	golang.org/x/term								 v0.27.0 \
	golang.org/x/term								 v0.30.0 \
	golang.org/x/term								 v0.5.0 \
	golang.org/x/term								 v0.8.0 \
	golang.org/x/text								 v0.11.0 \
	golang.org/x/text								 v0.12.0 \
	golang.org/x/text								 v0.13.0 \
	golang.org/x/text								 v0.14.0 \
	golang.org/x/text								 v0.15.0 \
	golang.org/x/text								 v0.16.0 \
	golang.org/x/text								 v0.21.0 \
	golang.org/x/text								 v0.22.0 \
	golang.org/x/text								 v0.23.0 \
	golang.org/x/text								 v0.3.0 \
	golang.org/x/text								 v0.3.2 \
	golang.org/x/text								 v0.3.3 \
	golang.org/x/text								 v0.3.7 \
	golang.org/x/text								 v0.3.8 \
	golang.org/x/text								 v0.7.0 \
	golang.org/x/text								 v0.9.0 \
	golang.org/x/time								 v0.0.0-20200416051211-89c76fbcd5d1 \
	golang.org/x/time								 v0.3.0 \
	golang.org/x/time								 v0.5.0 \
	golang.org/x/time								 v0.9.0 \
	golang.org/x/tools								 v0.0.0-20180917221912-90fa682c2a6e \
	golang.org/x/tools								 v0.0.0-20191119224855-298f0cb1881e \
	golang.org/x/tools								 v0.1.12 \
	golang.org/x/tools								 v0.13.0 \
	golang.org/x/tools								 v0.14.0 \
	golang.org/x/tools								 v0.21.1-0.20240508182429-e35e4ccd0d2d \
	golang.org/x/tools								 v0.31.0 \
	golang.org/x/tools								 v0.6.0 \
	golang.org/x/xerrors								 v0.0.0-20190717185122-a985d3407aa7 \
	golang.org/x/xerrors								 v0.0.0-20191204190536-9bdfabe68543 \
	google.golang.org/api								 v0.150.0 \
	google.golang.org/api								 v0.177.0 \
	google.golang.org/api								 v0.211.0 \
	google.golang.org/api								 v0.216.0 \
	google.golang.org/api								 v0.229.0 \
	google.golang.org/api								 v0.230.0 \
	google.golang.org/appengine							 v1.4.0 \
	google.golang.org/appengine							 v1.6.7 \
	google.golang.org/genproto							 v0.0.0-20231016165738-49dd2c1f3d0b \
	google.golang.org/genproto							 v0.0.0-20250106144421-5f5ef82da422 \
	google.golang.org/genproto							 v0.0.0-20250303144028-a0af3efb3deb \
	google.golang.org/genproto/googleapis/api					 v0.0.0-20230822172742-b8732ec3820d \
	google.golang.org/genproto/googleapis/api					 v0.0.0-20231016165738-49dd2c1f3d0b \
	google.golang.org/genproto/googleapis/api					 v0.0.0-20240429193739-8cf5692501f6 \
	google.golang.org/genproto/googleapis/api					 v0.0.0-20241202173237-19429a94021a \
	google.golang.org/genproto/googleapis/api					 v0.0.0-20241209162323-e6fa225c2576 \
	google.golang.org/genproto/googleapis/api					 v0.0.0-20250106144421-5f5ef82da422 \
	google.golang.org/genproto/googleapis/api					 v0.0.0-20250218202821-56aae31c358a \
	google.golang.org/genproto/googleapis/api					 v0.0.0-20250414145226-207652e42e2e \
	google.golang.org/genproto/googleapis/api					 v0.0.0-20250425173222-7b384671a197 \
	google.golang.org/genproto/googleapis/rpc					 v0.0.0-20230822172742-b8732ec3820d \
	google.golang.org/genproto/googleapis/rpc					 v0.0.0-20231030173426-d783a09b4405 \
	google.golang.org/genproto/googleapis/rpc					 v0.0.0-20240318140521-94a12d6c2237 \
	google.golang.org/genproto/googleapis/rpc					 v0.0.0-20240429193739-8cf5692501f6 \
	google.golang.org/genproto/googleapis/rpc					 v0.0.0-20240826202546-f6391c0de4c7 \
	google.golang.org/genproto/googleapis/rpc					 v0.0.0-20241202173237-19429a94021a \
	google.golang.org/genproto/googleapis/rpc					 v0.0.0-20241209162323-e6fa225c2576 \
	google.golang.org/genproto/googleapis/rpc					 v0.0.0-20250106144421-5f5ef82da422 \
	google.golang.org/genproto/googleapis/rpc					 v0.0.0-20250218202821-56aae31c358a \
	google.golang.org/genproto/googleapis/rpc					 v0.0.0-20250227231956-55c901821b1e \
	google.golang.org/genproto/googleapis/rpc					 v0.0.0-20250414145226-207652e42e2e \
	google.golang.org/genproto/googleapis/rpc					 v0.0.0-20250425173222-7b384671a197 \
	google.golang.org/grpc								 v1.58.2 \
	google.golang.org/grpc								 v1.59.0 \
	google.golang.org/grpc								 v1.63.2 \
	google.golang.org/grpc								 v1.67.1 \
	google.golang.org/grpc								 v1.69.4 \
	google.golang.org/grpc								 v1.70.0 \
	google.golang.org/grpc								 v1.71.0 \
	google.golang.org/grpc								 v1.71.1 \
	google.golang.org/protobuf							 v0.0.0-20200109180630-ec00e32a8dfd \
	google.golang.org/protobuf							 v0.0.0-20200221191635-4d8936d0db64 \
	google.golang.org/protobuf							 v0.0.0-20200228230310-ab0ca4ff8a60 \
	google.golang.org/protobuf							 v1.20.1-0.20200309200217-e05f789c0967 \
	google.golang.org/protobuf							 v1.21.0 \
	google.golang.org/protobuf							 v1.23.0 \
	google.golang.org/protobuf							 v1.26.0-rc.1 \
	google.golang.org/protobuf							 v1.31.0 \
	google.golang.org/protobuf							 v1.33.0 \
	google.golang.org/protobuf							 v1.34.2 \
	google.golang.org/protobuf							 v1.35.2 \
	google.golang.org/protobuf							 v1.36.1 \
	google.golang.org/protobuf							 v1.36.2 \
	google.golang.org/protobuf							 v1.36.3 \
	google.golang.org/protobuf							 v1.36.4 \
	google.golang.org/protobuf							 v1.36.5 \
	gopkg.in/check.v1								 v0.0.0-20161208181325-20d25e280405 \
	gopkg.in/check.v1								 v1.0.0-20180628173108-788fd7840127 \
	gopkg.in/check.v1								 v1.0.0-20190902080502-41f04d3bba15 \
	gopkg.in/yaml.v2								 v2.2.1 \
	gopkg.in/yaml.v2								 v2.2.2 \
	gopkg.in/yaml.v2								 v2.2.4 \
	gopkg.in/yaml.v2								 v2.2.5 \
	gopkg.in/yaml.v2								 v2.2.8 \
	gopkg.in/yaml.v3								 v3.0.0-20200313102051-9f266ea9e77c

