MODGO_MODULES =	\
	cel.dev/expr										 v0.25.2 \
	cloud.google.com/go									 v0.123.0 \
	cloud.google.com/go/aiplatform								 v1.127.0 \
	cloud.google.com/go/appengine								 v1.16.0 \
	cloud.google.com/go/auth								 v0.24.1 \
	cloud.google.com/go/auth/oauth2adapt							 v0.3.0 \
	cloud.google.com/go/bigquery								 v1.85.0 \
	cloud.google.com/go/cloudsqlconn							 v1.26.0 \
	cloud.google.com/go/cloudtasks								 v1.20.0 \
	cloud.google.com/go/compute								 v1.14.0 \
	cloud.google.com/go/compute/metadata							 v0.10.0 \
	cloud.google.com/go/container								 v1.55.0 \
	cloud.google.com/go/containeranalysis							 v0.20.0 \
	cloud.google.com/go/dataflow								 v0.17.0 \
	cloud.google.com/go/dataproc/v2								 v2.27.0 \
	cloud.google.com/go/datastore								 v1.1.0 \
	cloud.google.com/go/documentai								 v1.50.0 \
	cloud.google.com/go/domains								 v0.17.0 \
	cloud.google.com/go/iam									 v1.14.0 \
	cloud.google.com/go/language								 v1.19.0 \
	cloud.google.com/go/logging								 v1.20.0 \
	cloud.google.com/go/longrunning								 v1.3.0 \
	cloud.google.com/go/monitoring								 v1.31.0 \
	cloud.google.com/go/pubsub								 v1.3.1 \
	cloud.google.com/go/recommender								 v1.20.0 \
	cloud.google.com/go/securitycenter							 v1.48.0 \
	cloud.google.com/go/servicedirectory							 v1.18.0 \
	cloud.google.com/go/spanner								 v1.96.1 \
	cloud.google.com/go/sql									 v0.3.0 \
	cloud.google.com/go/storage								 v1.10.0 \
	cloud.google.com/go/trace								 v1.17.0 \
	cloud.google.com/go/translate								 v1.10.3 \
	cloud.google.com/go/video								 v1.34.0 \
	cloud.google.com/go/videointelligence							 v1.18.0 \
	contrib.go.opencensus.io/exporter/prometheus						 v0.4.2 \
	contrib.go.opencensus.io/exporter/stackdriver						 v0.13.15-0.20230702191903-2de6d2748484 \
	dmitri.shuralyov.com/gpu/mtl								 v0.0.0-20190408044501-666a987793e9 \
	filippo.io/edwards25519									 v1.2.0 \
	github.com/!azure!a!d/microsoft-authentication-library-for-go				 v1.8.0 \
	github.com/!azure/azure-sdk-for-go/sdk/azcore						 v1.23.1 \
	github.com/!azure/azure-sdk-for-go/sdk/azidentity					 v1.14.1 \
	github.com/!azure/azure-sdk-for-go/sdk/internal						 v1.12.0 \
	github.com/!azure/azure-sdk-for-go/sdk/security/keyvault/azkeys				 v1.5.0 \
	github.com/!azure/azure-sdk-for-go/sdk/security/keyvault/internal			 v1.2.0 \
	github.com/!burnt!sushi/toml								 v0.3.1 \
	github.com/!burnt!sushi/xgb								 v0.0.0-20160522181843-27f122750802 \
	github.com/!google!cloud!platform/opentelemetry-operations-go/detectors/gcp		 v1.34.0 \
	github.com/!google!cloud!platform/opentelemetry-operations-go/exporter/metric		 v0.60.0 \
	github.com/!google!cloud!platform/opentelemetry-operations-go/internal/cloudmock	 v0.60.0 \
	github.com/!google!cloud!platform/opentelemetry-operations-go/internal/resourcemapping	 v0.62.0 \
	github.com/alecthomas/kingpin/v2							 v2.4.0 \
	github.com/alecthomas/template								 v0.0.0-20190718012654-fb15b899a751 \
	github.com/alecthomas/units								 v0.0.0-20240927000941-0f3dac36c52b \
	github.com/aws/aws-sdk-go-v2								 v1.47.4 \
	github.com/aws/aws-sdk-go-v2/config							 v1.33.10 \
	github.com/aws/aws-sdk-go-v2/credentials						 v1.20.10 \
	github.com/aws/aws-sdk-go-v2/feature/ec2/imds						 v1.20.4 \
	github.com/aws/aws-sdk-go-v2/internal/configsources					 v1.5.7 \
	github.com/aws/aws-sdk-go-v2/internal/endpoints/v2					 v2.8.7 \
	github.com/aws/aws-sdk-go-v2/internal/ini						 v1.3.30 \
	github.com/aws/aws-sdk-go-v2/internal/v4a						 v1.5.7 \
	github.com/aws/aws-sdk-go-v2/service/internal/accept-encoding				 v1.13.22 \
	github.com/aws/aws-sdk-go-v2/service/internal/presigned-url				 v1.14.7 \
	github.com/aws/aws-sdk-go-v2/service/signin						 v1.10.5 \
	github.com/aws/aws-sdk-go-v2/service/sso						 v1.38.5 \
	github.com/aws/aws-sdk-go-v2/service/ssooidc						 v1.43.5 \
	github.com/aws/aws-sdk-go-v2/service/sts						 v1.51.5 \
	github.com/aws/smithy-go								 v1.28.6 \
	github.com/beorn7/perks									 v1.0.1 \
	github.com/census-instrumentation/opencensus-proto					 v0.4.1 \
	github.com/cespare/xxhash/v2								 v2.3.0 \
	github.com/chzyer/logex									 v1.1.10 \
	github.com/chzyer/readline								 v0.0.0-20180603132655-2972be24d48e \
	github.com/chzyer/test									 v0.0.0-20180213035817-a1ea475d72b1 \
	github.com/client9/misspell								 v0.3.4 \
	github.com/cncf/udpa/go									 v0.0.0-20191209042840-269d4d468f6f \
	github.com/cncf/xds/go									 v0.0.0-20260202195803-dba9d589def2 \
	github.com/coreos/go-systemd/v22							 v22.7.0 \
	github.com/cpuguy83/go-md2man/v2							 v2.0.7 \
	github.com/davecgh/go-spew								 v1.1.1 \
	github.com/envoyproxy/go-control-plane							 v0.14.0 \
	github.com/envoyproxy/go-control-plane/envoy						 v1.37.0 \
	github.com/envoyproxy/go-control-plane/ratelimit					 v0.1.0 \
	github.com/envoyproxy/protoc-gen-validate						 v1.3.3 \
	github.com/felixge/httpsnoop								 v1.1.0 \
	github.com/frankban/quicktest								 v1.14.6 \
	github.com/fsnotify/fsnotify								 v1.10.1 \
	github.com/go-gl/glfw									 v0.0.0-20190409004039-e6da0acd62b1 \
	github.com/go-gl/glfw/v3.3/glfw								 v0.0.0-20200222043503-6f7a984d4dc4 \
	github.com/go-jose/go-jose/v4								 v4.1.4 \
	github.com/go-kit/kit									 v0.9.0 \
	github.com/go-kit/log									 v0.2.1 \
	github.com/go-logfmt/logfmt								 v0.5.1 \
	github.com/go-logr/logr									 v1.4.4 \
	github.com/go-logr/stdr									 v1.2.2 \
	github.com/go-sql-driver/mysql								 v1.10.1 \
	github.com/go-stack/stack								 v1.8.0 \
	github.com/go-viper/mapstructure/v2							 v2.5.0 \
	github.com/godbus/dbus/v5								 v5.1.0 \
	github.com/gogo/protobuf								 v1.1.1 \
	github.com/golang-jwt/jwt/v5								 v5.3.1 \
	github.com/golang-sql/civil								 v0.0.0-20220223132316-b832511892a9 \
	github.com/golang-sql/sqlexp								 v0.1.0 \
	github.com/golang/glog									 v1.2.5 \
	github.com/golang/groupcache								 v0.0.0-20241129210726-2c02b8208cf8 \
	github.com/golang/mock									 v1.4.4 \
	github.com/golang/protobuf								 v1.5.4 \
	github.com/google/btree									 v1.0.0 \
	github.com/google/go-cmp								 v0.7.0 \
	github.com/google/go-pkcs11								 v0.3.0 \
	github.com/google/gofuzz								 v1.0.0 \
	github.com/google/martian								 v2.1.0+incompatible \
	github.com/google/martian/v3								 v3.0.0 \
	github.com/google/pprof									 v0.0.0-20200708004538-1a94d8640e99 \
	github.com/google/renameio								 v0.1.0 \
	github.com/google/s2a-go								 v0.1.11 \
	github.com/google/uuid									 v1.6.0 \
	github.com/googleapis/enterprise-certificate-proxy					 v0.3.24 \
	github.com/googleapis/gax-go/v2								 v2.27.0 \
	github.com/grpc-ecosystem/grpc-gateway/v2						 v2.11.3 \
	github.com/hanwen/go-fuse/v2								 v2.11.0 \
	github.com/hashicorp/go-uuid								 v1.0.3 \
	github.com/hashicorp/golang-lru								 v0.5.1 \
	github.com/ianlancetaylor/demangle							 v0.0.0-20181102032728-5e5cf60278f6 \
	github.com/inconshreveable/mousetrap							 v1.1.0 \
	github.com/jackc/pgpassfile								 v1.0.0 \
	github.com/jackc/pgservicefile								 v0.0.0-20240606120523-5a60cdf6a761 \
	github.com/jackc/pgx/v5									 v5.11.0 \
	github.com/jackc/puddle/v2								 v2.2.3 \
	github.com/jcmturner/aescts/v2								 v2.0.0 \
	github.com/jcmturner/dnsutils/v2							 v2.0.0 \
	github.com/jcmturner/gofork								 v1.7.6 \
	github.com/jcmturner/goidentity/v6							 v6.0.1 \
	github.com/jcmturner/gokrb5/v8								 v8.4.4 \
	github.com/jcmturner/rpc/v2								 v2.0.3 \
	github.com/jpillora/backoff								 v1.0.0 \
	github.com/json-iterator/go								 v1.1.12 \
	github.com/jstemmer/go-junit-report							 v0.9.1 \
	github.com/julienschmidt/httprouter							 v1.3.0 \
	github.com/kisielk/gotool								 v1.0.0 \
	github.com/klauspost/compress								 v1.20.1 \
	github.com/konsorten/go-windows-terminal-sequences					 v1.0.3 \
	github.com/kr/logfmt									 v0.0.0-20140226030751-b84e30acd515 \
	github.com/kr/pretty									 v0.3.1 \
	github.com/kr/pty									 v1.1.1 \
	github.com/kr/text									 v0.2.0 \
	github.com/kylelemons/godebug								 v1.1.0 \
	github.com/matttproud/golang_protobuf_extensions					 v1.0.1 \
	github.com/mdlayher/socket								 v0.6.0 \
	github.com/mdlayher/vsock								 v1.3.0 \
	github.com/microsoft/go-mssqldb								 v1.11.2 \
	github.com/moby/sys/mountinfo								 v0.7.2 \
	github.com/modern-go/concurrent								 v0.0.0-20180306012644-bacd9c7ef1dd \
	github.com/modern-go/reflect2								 v1.0.2 \
	github.com/munnerz/goautoneg								 v0.0.0-20191010083416-a7dc8b61c822 \
	github.com/mwitkow/go-conntrack								 v0.0.0-20190716064945-2f068394615f \
	github.com/pelletier/go-toml/v2								 v2.4.3 \
	github.com/pkg/browser									 v0.0.0-20240102092130-5ac0b6a4141c \
	github.com/pkg/errors									 v0.9.1 \
	github.com/planetscale/vtprotobuf							 v0.6.1-0.20240319094008-0393e58bdf10 \
	github.com/pmezard/go-difflib								 v1.0.0 \
	github.com/prometheus/client_golang							 v1.25.0 \
	github.com/prometheus/client_model							 v0.6.3 \
	github.com/prometheus/common								 v0.72.1 \
	github.com/prometheus/exporter-toolkit							 v0.17.1 \
	github.com/prometheus/procfs								 v0.22.0 \
	github.com/prometheus/statsd_exporter							 v0.31.0 \
	github.com/rogpeppe/go-internal								 v1.14.1 \
	github.com/russross/blackfriday/v2							 v2.1.0 \
	github.com/sagikazarmark/locafero							 v0.12.0 \
	github.com/shopspring/decimal								 v1.6.0 \
	github.com/sirupsen/logrus								 v1.6.0 \
	github.com/sourcegraph/conc								 v0.3.1-0.20240121214520-5f936abd7ae8 \
	github.com/spf13/afero									 v1.15.0 \
	github.com/spf13/cast									 v1.10.0 \
	github.com/spf13/cobra									 v1.10.2 \
	github.com/spf13/pflag									 v1.0.10 \
	github.com/spf13/viper									 v1.21.0 \
	github.com/spiffe/go-spiffe/v2								 v2.8.1 \
	github.com/stretchr/objx								 v0.5.0 \
	github.com/stretchr/testify								 v1.12.1 \
	github.com/stvp/go-udp-testing								 v0.0.0-20201019212854-469649b16807 \
	github.com/subosito/gotenv								 v1.6.0 \
	github.com/xhit/go-str2duration/v2							 v2.1.0 \
	github.com/yuin/goldmark								 v1.1.32 \
	go.opencensus.io									 v0.24.0 \
	go.opentelemetry.io/auto/sdk								 v1.2.1 \
	go.opentelemetry.io/contrib/detectors/gcp						 v1.44.0 \
	go.opentelemetry.io/contrib/instrumentation/google.golang.org/grpc/otelgrpc		 v0.72.0 \
	go.opentelemetry.io/contrib/instrumentation/net/http/otelhttp				 v0.72.0 \
	go.opentelemetry.io/otel								 v1.47.0 \
	go.opentelemetry.io/otel/log								 v1.47.0 \
	go.opentelemetry.io/otel/metric								 v1.47.0 \
	go.opentelemetry.io/otel/metric/x							 v0.69.0 \
	go.opentelemetry.io/otel/sdk								 v1.47.0 \
	go.opentelemetry.io/otel/sdk/metric							 v1.47.0 \
	go.opentelemetry.io/otel/trace								 v1.47.0 \
	go.uber.org/goleak									 v1.3.0 \
	go.yaml.in/yaml/v2									 v2.4.4 \
	go.yaml.in/yaml/v3									 v3.0.5 \
	golang.org/x/crypto									 v0.58.0 \
	golang.org/x/exp									 v0.0.0-20200224162631-6cc2880d07d6 \
	golang.org/x/image									 v0.0.0-20190802002840-cff245a6509b \
	golang.org/x/lint									 v0.0.0-20200302205851-738671d3881b \
	golang.org/x/mobile									 v0.0.0-20190719004257-d2bd2a29d028 \
	golang.org/x/mod									 v0.42.0 \
	golang.org/x/net									 v0.61.0 \
	golang.org/x/oauth2									 v0.37.0 \
	golang.org/x/sync									 v0.24.0 \
	golang.org/x/sys									 v0.49.0 \
	golang.org/x/term									 v0.47.0 \
	golang.org/x/text									 v0.43.0 \
	golang.org/x/time									 v0.16.0 \
	golang.org/x/tools									 v0.51.0 \
	golang.org/x/xerrors									 v0.0.0-20200804184101-5ec99f83aff1 \
	gonum.org/v1/gonum									 v0.17.0 \
	google.golang.org/api									 v0.308.0 \
	google.golang.org/appengine								 v1.6.8 \
	google.golang.org/genproto								 v0.0.0-20261019180522-ce908d29299b \
	google.golang.org/genproto/googleapis/api						 v0.0.0-20261019180522-ce908d29299b \
	google.golang.org/genproto/googleapis/bytestream					 v0.0.0-20261019180522-ce908d29299b \
	google.golang.org/genproto/googleapis/rpc						 v0.0.0-20261019180522-ce908d29299b \
	google.golang.org/grpc									 v1.84.0 \
	google.golang.org/protobuf								 v1.36.12 \
	gopkg.in/alecthomas/kingpin.v2								 v2.2.6 \
	gopkg.in/check.v1									 v1.0.0-20201130134442-10cb98267c6c \
	gopkg.in/errgo.v2									 v2.1.0 \
	gopkg.in/natefinch/lumberjack.v2							 v2.2.1 \
	gopkg.in/yaml.v2									 v2.4.0 \
	gopkg.in/yaml.v3									 v3.0.1 \
	honnef.co/go/tools									 v0.0.1-2020.1.4 \
	rsc.io/binaryregexp									 v0.2.0 \
	rsc.io/quote/v3										 v3.1.0 \
	rsc.io/sampler										 v1.3.0

MODGO_MODFILES =	\
	cloud.google.com/go									 v0.112.2 \
	cloud.google.com/go									 v0.26.0 \
	cloud.google.com/go									 v0.34.0 \
	cloud.google.com/go									 v0.38.0 \
	cloud.google.com/go									 v0.44.1 \
	cloud.google.com/go									 v0.44.2 \
	cloud.google.com/go									 v0.45.1 \
	cloud.google.com/go									 v0.46.3 \
	cloud.google.com/go									 v0.50.0 \
	cloud.google.com/go									 v0.52.0 \
	cloud.google.com/go									 v0.53.0 \
	cloud.google.com/go									 v0.54.0 \
	cloud.google.com/go									 v0.56.0 \
	cloud.google.com/go									 v0.57.0 \
	cloud.google.com/go									 v0.62.0 \
	cloud.google.com/go									 v0.65.0 \
	cloud.google.com/go/auth								 v0.20.0 \
	cloud.google.com/go/auth								 v0.24.1-0.20261001053825-dbc26066f70a \
	cloud.google.com/go/auth								 v0.3.0 \
	cloud.google.com/go/auth/oauth2adapt							 v0.2.2 \
	cloud.google.com/go/auth/oauth2adapt							 v0.2.8 \
	cloud.google.com/go/bigquery								 v1.0.1 \
	cloud.google.com/go/bigquery								 v1.3.0 \
	cloud.google.com/go/bigquery								 v1.4.0 \
	cloud.google.com/go/bigquery								 v1.5.0 \
	cloud.google.com/go/bigquery								 v1.7.0 \
	cloud.google.com/go/bigquery								 v1.8.0 \
	cloud.google.com/go/compute/metadata							 v0.2.3 \
	cloud.google.com/go/compute/metadata							 v0.3.0 \
	cloud.google.com/go/compute/metadata							 v0.9.0 \
	cloud.google.com/go/datastore								 v1.0.0 \
	cloud.google.com/go/logging								 v1.18.0 \
	cloud.google.com/go/longrunning								 v0.5.6 \
	cloud.google.com/go/longrunning								 v1.0.0 \
	cloud.google.com/go/longrunning								 v1.2.0 \
	cloud.google.com/go/monitoring								 v1.10.0 \
	cloud.google.com/go/monitoring								 v1.29.0 \
	cloud.google.com/go/pubsub								 v1.0.1 \
	cloud.google.com/go/pubsub								 v1.1.0 \
	cloud.google.com/go/pubsub								 v1.2.0 \
	cloud.google.com/go/storage								 v1.0.0 \
	cloud.google.com/go/storage								 v1.5.0 \
	cloud.google.com/go/storage								 v1.6.0 \
	cloud.google.com/go/storage								 v1.8.0 \
	cloud.google.com/go/trace								 v1.16.0 \
	cloud.google.com/go/trace								 v1.5.0 \
	github.com/!google!cloud!platform/opentelemetry-operations-go/internal/resourcemapping	 v0.60.0 \
	github.com/alecthomas/template								 v0.0.0-20160405071501-a0175ee3bccc \
	github.com/alecthomas/units								 v0.0.0-20151022065526-2efee857e7cf \
	github.com/alecthomas/units								 v0.0.0-20190717042225-c3de453c63f4 \
	github.com/alecthomas/units								 v0.0.0-20190924025748-f65c72e2690d \
	github.com/alecthomas/units								 v0.0.0-20211218093645-b94a6e3cc137 \
	github.com/aws/aws-sdk-go-v2								 v1.17.5 \
	github.com/aws/aws-sdk-go-v2/config							 v1.18.14 \
	github.com/aws/aws-sdk-go-v2/credentials						 v1.13.14 \
	github.com/aws/aws-sdk-go-v2/feature/ec2/imds						 v1.12.23 \
	github.com/aws/aws-sdk-go-v2/internal/configsources					 v1.1.29 \
	github.com/aws/aws-sdk-go-v2/internal/endpoints/v2					 v2.4.23 \
	github.com/aws/aws-sdk-go-v2/service/internal/presigned-url				 v1.9.23 \
	github.com/aws/aws-sdk-go-v2/service/sso						 v1.12.3 \
	github.com/aws/aws-sdk-go-v2/service/ssooidc						 v1.14.3 \
	github.com/aws/aws-sdk-go-v2/service/sts						 v1.18.4 \
	github.com/aws/smithy-go								 v1.13.5 \
	github.com/beorn7/perks									 v0.0.0-20180321164747-3a771d992973 \
	github.com/beorn7/perks									 v1.0.0 \
	github.com/census-instrumentation/opencensus-proto					 v0.2.1 \
	github.com/census-instrumentation/opencensus-proto					 v0.3.0 \
	github.com/cespare/xxhash/v2								 v2.1.1 \
	github.com/cespare/xxhash/v2								 v2.1.2 \
	github.com/cpuguy83/go-md2man/v2							 v2.0.6 \
	github.com/davecgh/go-spew								 v1.1.0 \
	github.com/envoyproxy/go-control-plane							 v0.9.0 \
	github.com/envoyproxy/go-control-plane							 v0.9.1-0.20191026205805-5f8ba28d4473 \
	github.com/envoyproxy/go-control-plane							 v0.9.4 \
	github.com/envoyproxy/protoc-gen-validate						 v0.1.0 \
	github.com/felixge/httpsnoop								 v1.0.4 \
	github.com/fsnotify/fsnotify								 v1.9.0 \
	github.com/go-gl/glfw/v3.3/glfw								 v0.0.0-20191125211704-12ad95a8df72 \
	github.com/go-kit/kit									 v0.8.0 \
	github.com/go-kit/log									 v0.1.0 \
	github.com/go-kit/log									 v0.2.0 \
	github.com/go-logfmt/logfmt								 v0.3.0 \
	github.com/go-logfmt/logfmt								 v0.4.0 \
	github.com/go-logfmt/logfmt								 v0.5.0 \
	github.com/go-logr/logr									 v1.2.2 \
	github.com/go-logr/logr									 v1.4.1 \
	github.com/go-logr/logr									 v1.4.3 \
	github.com/go-viper/mapstructure/v2							 v2.4.0 \
	github.com/golang/glog									 v0.0.0-20160126235308-23def4e6c14b \
	github.com/golang/groupcache								 v0.0.0-20190702054246-869f871628b6 \
	github.com/golang/groupcache								 v0.0.0-20191227052852-215e87163ea7 \
	github.com/golang/groupcache								 v0.0.0-20200121045136-8c9f03a8e57e \
	github.com/golang/groupcache								 v0.0.0-20210331224755-41bb18bfe9da \
	github.com/golang/mock									 v1.1.1 \
	github.com/golang/mock									 v1.2.0 \
	github.com/golang/mock									 v1.3.1 \
	github.com/golang/mock									 v1.4.0 \
	github.com/golang/mock									 v1.4.1 \
	github.com/golang/mock									 v1.4.3 \
	github.com/golang/protobuf								 v1.2.0 \
	github.com/golang/protobuf								 v1.3.1 \
	github.com/golang/protobuf								 v1.3.2 \
	github.com/golang/protobuf								 v1.3.3 \
	github.com/golang/protobuf								 v1.3.4 \
	github.com/golang/protobuf								 v1.3.5 \
	github.com/golang/protobuf								 v1.4.0 \
	github.com/golang/protobuf								 v1.4.0-rc.1 \
	github.com/golang/protobuf								 v1.4.0-rc.1.0.20200221234624-67d41d38c208 \
	github.com/golang/protobuf								 v1.4.0-rc.2 \
	github.com/golang/protobuf								 v1.4.0-rc.4.0.20200313231945-b860323f09d0 \
	github.com/golang/protobuf								 v1.4.1 \
	github.com/golang/protobuf								 v1.4.2 \
	github.com/golang/protobuf								 v1.4.3 \
	github.com/golang/protobuf								 v1.5.0 \
	github.com/golang/protobuf								 v1.5.2 \
	github.com/google/btree									 v0.0.0-20180813153112-4030bb1f1f0c \
	github.com/google/go-cmp								 v0.2.0 \
	github.com/google/go-cmp								 v0.3.0 \
	github.com/google/go-cmp								 v0.3.1 \
	github.com/google/go-cmp								 v0.4.0 \
	github.com/google/go-cmp								 v0.4.1 \
	github.com/google/go-cmp								 v0.5.0 \
	github.com/google/go-cmp								 v0.5.1 \
	github.com/google/go-cmp								 v0.5.3 \
	github.com/google/go-cmp								 v0.5.4 \
	github.com/google/go-cmp								 v0.5.5 \
	github.com/google/go-cmp								 v0.5.8 \
	github.com/google/go-cmp								 v0.5.9 \
	github.com/google/go-cmp								 v0.6.0 \
	github.com/google/pprof									 v0.0.0-20181206194817-3ea8567a2e57 \
	github.com/google/pprof									 v0.0.0-20190515194954-54271f7e092f \
	github.com/google/pprof									 v0.0.0-20191218002539-d4f498aebedc \
	github.com/google/pprof									 v0.0.0-20200212024743-f11f1df84d12 \
	github.com/google/pprof									 v0.0.0-20200229191704-1ebb73c60ed3 \
	github.com/google/pprof									 v0.0.0-20200430221834-fc25d7d30c6d \
	github.com/google/s2a-go								 v0.1.9 \
	github.com/google/uuid									 v1.1.2 \
	github.com/googleapis/enterprise-certificate-proxy					 v0.2.1 \
	github.com/googleapis/enterprise-certificate-proxy					 v0.3.15 \
	github.com/googleapis/enterprise-certificate-proxy					 v0.3.17 \
	github.com/googleapis/enterprise-certificate-proxy					 v0.3.18 \
	github.com/googleapis/enterprise-certificate-proxy					 v0.3.2 \
	github.com/googleapis/enterprise-certificate-proxy					 v0.3.23 \
	github.com/googleapis/gax-go/v2								 v2.0.4 \
	github.com/googleapis/gax-go/v2								 v2.0.5 \
	github.com/googleapis/gax-go/v2								 v2.12.3 \
	github.com/googleapis/gax-go/v2								 v2.21.0 \
	github.com/googleapis/gax-go/v2								 v2.22.0 \
	github.com/googleapis/gax-go/v2								 v2.23.0 \
	github.com/googleapis/gax-go/v2								 v2.26.2 \
	github.com/googleapis/gax-go/v2								 v2.7.0 \
	github.com/hashicorp/golang-lru								 v0.5.0 \
	github.com/jackc/puddle/v2								 v2.2.2 \
	github.com/json-iterator/go								 v1.1.10 \
	github.com/json-iterator/go								 v1.1.11 \
	github.com/json-iterator/go								 v1.1.6 \
	github.com/jstemmer/go-junit-report							 v0.0.0-20190106144839-af01ea7f8024 \
	github.com/julienschmidt/httprouter							 v1.2.0 \
	github.com/konsorten/go-windows-terminal-sequences					 v1.0.1 \
	github.com/kr/pretty									 v0.1.0 \
	github.com/kr/pretty									 v0.3.0 \
	github.com/kr/text									 v0.1.0 \
	github.com/modern-go/concurrent								 v0.0.0-20180228061459-e0a39a4cb421 \
	github.com/modern-go/reflect2								 v0.0.0-20180701023420-4b7aa43c6742 \
	github.com/modern-go/reflect2								 v1.0.1 \
	github.com/mwitkow/go-conntrack								 v0.0.0-20161129095857-cc309e4a2223 \
	github.com/pelletier/go-toml/v2								 v2.2.4 \
	github.com/pkg/errors									 v0.8.0 \
	github.com/pkg/errors									 v0.8.1 \
	github.com/prometheus/client_golang							 v0.9.1 \
	github.com/prometheus/client_golang							 v1.0.0 \
	github.com/prometheus/client_golang							 v1.11.0 \
	github.com/prometheus/client_golang							 v1.12.1 \
	github.com/prometheus/client_golang							 v1.12.2 \
	github.com/prometheus/client_golang							 v1.13.0 \
	github.com/prometheus/client_golang							 v1.23.2 \
	github.com/prometheus/client_golang							 v1.24.1 \
	github.com/prometheus/client_golang							 v1.7.1 \
	github.com/prometheus/client_model							 v0.0.0-20180712105110-5c3871d89910 \
	github.com/prometheus/client_model							 v0.0.0-20190129233127-fd36f4220a90 \
	github.com/prometheus/client_model							 v0.0.0-20190812154241-14fe0d1b01d4 \
	github.com/prometheus/client_model							 v0.2.0 \
	github.com/prometheus/client_model							 v0.6.2 \
	github.com/prometheus/common								 v0.10.0 \
	github.com/prometheus/common								 v0.26.0 \
	github.com/prometheus/common								 v0.32.1 \
	github.com/prometheus/common								 v0.35.0 \
	github.com/prometheus/common								 v0.37.0 \
	github.com/prometheus/common								 v0.4.1 \
	github.com/prometheus/common								 v0.70.1 \
	github.com/prometheus/common								 v0.72.0 \
	github.com/prometheus/procfs								 v0.0.0-20181005140218-185b4288413d \
	github.com/prometheus/procfs								 v0.0.2 \
	github.com/prometheus/procfs								 v0.1.3 \
	github.com/prometheus/procfs								 v0.21.0 \
	github.com/prometheus/procfs								 v0.21.1 \
	github.com/prometheus/procfs								 v0.6.0 \
	github.com/prometheus/procfs								 v0.7.3 \
	github.com/prometheus/procfs								 v0.8.0 \
	github.com/prometheus/statsd_exporter							 v0.22.7 \
	github.com/rogpeppe/go-internal								 v1.3.0 \
	github.com/rogpeppe/go-internal								 v1.9.0 \
	github.com/sagikazarmark/locafero							 v0.11.0 \
	github.com/shopspring/decimal								 v1.4.0 \
	github.com/sirupsen/logrus								 v1.2.0 \
	github.com/sirupsen/logrus								 v1.4.2 \
	github.com/spf13/pflag									 v1.0.9 \
	github.com/stretchr/objx								 v0.1.0 \
	github.com/stretchr/objx								 v0.1.1 \
	github.com/stretchr/objx								 v0.4.0 \
	github.com/stretchr/testify								 v1.11.1 \
	github.com/stretchr/testify								 v1.2.2 \
	github.com/stretchr/testify								 v1.3.0 \
	github.com/stretchr/testify								 v1.4.0 \
	github.com/stretchr/testify								 v1.6.1 \
	github.com/stretchr/testify								 v1.7.0 \
	github.com/stretchr/testify								 v1.7.1 \
	github.com/stretchr/testify								 v1.7.5 \
	github.com/stretchr/testify								 v1.8.0 \
	github.com/stretchr/testify								 v1.8.1 \
	github.com/yuin/goldmark								 v1.1.25 \
	github.com/yuin/goldmark								 v1.1.27 \
	go.opencensus.io									 v0.21.0 \
	go.opencensus.io									 v0.22.0 \
	go.opencensus.io									 v0.22.2 \
	go.opencensus.io									 v0.22.3 \
	go.opencensus.io									 v0.22.4 \
	go.opencensus.io									 v0.23.0 \
	go.opentelemetry.io/contrib/instrumentation/google.golang.org/grpc/otelgrpc		 v0.49.0 \
	go.opentelemetry.io/contrib/instrumentation/google.golang.org/grpc/otelgrpc		 v0.67.0 \
	go.opentelemetry.io/contrib/instrumentation/google.golang.org/grpc/otelgrpc		 v0.69.0 \
	go.opentelemetry.io/contrib/instrumentation/net/http/otelhttp				 v0.49.0 \
	go.opentelemetry.io/contrib/instrumentation/net/http/otelhttp				 v0.67.0 \
	go.opentelemetry.io/contrib/instrumentation/net/http/otelhttp				 v0.69.0 \
	go.opentelemetry.io/otel								 v1.24.0 \
	go.opentelemetry.io/otel								 v1.38.0 \
	go.opentelemetry.io/otel								 v1.44.0 \
	go.opentelemetry.io/otel								 v1.45.0 \
	go.opentelemetry.io/otel/metric								 v1.24.0 \
	go.opentelemetry.io/otel/metric								 v1.44.0 \
	go.opentelemetry.io/otel/metric								 v1.45.0 \
	go.opentelemetry.io/otel/sdk								 v1.44.0 \
	go.opentelemetry.io/otel/sdk								 v1.45.0 \
	go.opentelemetry.io/otel/sdk/metric							 v1.44.0 \
	go.opentelemetry.io/otel/trace								 v1.24.0 \
	go.opentelemetry.io/otel/trace								 v1.38.0 \
	go.opentelemetry.io/otel/trace								 v1.44.0 \
	go.opentelemetry.io/otel/trace								 v1.45.0 \
	go.yaml.in/yaml/v3									 v3.0.4 \
	golang.org/x/crypto									 v0.0.0-20180904163835-0709b304e793 \
	golang.org/x/crypto									 v0.0.0-20190308221718-c2843e01d9a2 \
	golang.org/x/crypto									 v0.0.0-20190510104115-cbcb75029529 \
	golang.org/x/crypto									 v0.0.0-20190605123033-f99c8df09eb5 \
	golang.org/x/crypto									 v0.0.0-20191011191535-87dc89f01550 \
	golang.org/x/crypto									 v0.0.0-20200622213623-75b288015ac9 \
	golang.org/x/crypto									 v0.31.0 \
	golang.org/x/crypto									 v0.52.0 \
	golang.org/x/crypto									 v0.54.0 \
	golang.org/x/crypto									 v0.55.0 \
	golang.org/x/exp									 v0.0.0-20190121172915-509febef88a4 \
	golang.org/x/exp									 v0.0.0-20190306152737-a1d7652674e8 \
	golang.org/x/exp									 v0.0.0-20190510132918-efd6b22b2522 \
	golang.org/x/exp									 v0.0.0-20190829153037-c13cbed26979 \
	golang.org/x/exp									 v0.0.0-20191030013958-a1ab85dbe136 \
	golang.org/x/exp									 v0.0.0-20191129062945-2f5052295587 \
	golang.org/x/exp									 v0.0.0-20191227195350-da58074b4299 \
	golang.org/x/exp									 v0.0.0-20200119233911-0405dc783f0a \
	golang.org/x/exp									 v0.0.0-20200207192155-f17229e696bd \
	golang.org/x/image									 v0.0.0-20190227222117-0694c2d4d067 \
	golang.org/x/lint									 v0.0.0-20181026193005-c67002cb31c3 \
	golang.org/x/lint									 v0.0.0-20190227174305-5b3e6a55c961 \
	golang.org/x/lint									 v0.0.0-20190301231843-5614ed5bae6f \
	golang.org/x/lint									 v0.0.0-20190313153728-d0100b6bd8b3 \
	golang.org/x/lint									 v0.0.0-20190409202823-959b441ac422 \
	golang.org/x/lint									 v0.0.0-20190909230951-414d861bb4ac \
	golang.org/x/lint									 v0.0.0-20190930215403-16217165b5de \
	golang.org/x/lint									 v0.0.0-20191125180803-fdd1cda4f05f \
	golang.org/x/lint									 v0.0.0-20200130185559-910be7a94367 \
	golang.org/x/mobile									 v0.0.0-20190312151609-d3739f865fa6 \
	golang.org/x/mod									 v0.0.0-20190513183733-4bf6d317e70e \
	golang.org/x/mod									 v0.1.0 \
	golang.org/x/mod									 v0.1.1-0.20191105210325-c90efee705ee \
	golang.org/x/mod									 v0.1.1-0.20191107180719-034126e5016b \
	golang.org/x/mod									 v0.2.0 \
	golang.org/x/mod									 v0.3.0 \
	golang.org/x/mod									 v0.41.0 \
	golang.org/x/net									 v0.0.0-20180724234803-3673e40ba225 \
	golang.org/x/net									 v0.0.0-20180826012351-8a410e7b638d \
	golang.org/x/net									 v0.0.0-20181114220301-adae6a3d119a \
	golang.org/x/net									 v0.0.0-20190108225652-1e06a53dbb7e \
	golang.org/x/net									 v0.0.0-20190213061140-3a22650c66bd \
	golang.org/x/net									 v0.0.0-20190311183353-d8887717615a \
	golang.org/x/net									 v0.0.0-20190404232315-eb5bcb51f2a3 \
	golang.org/x/net									 v0.0.0-20190501004415-9ce7a6920f09 \
	golang.org/x/net									 v0.0.0-20190503192946-f4e77d36d62c \
	golang.org/x/net									 v0.0.0-20190603091049-60506f45cf65 \
	golang.org/x/net									 v0.0.0-20190613194153-d28f0bde5980 \
	golang.org/x/net									 v0.0.0-20190620200207-3b0461eec859 \
	golang.org/x/net									 v0.0.0-20190628185345-da137c7871d7 \
	golang.org/x/net									 v0.0.0-20190724013045-ca1201d0de80 \
	golang.org/x/net									 v0.0.0-20191209160850-c0dbc17a3553 \
	golang.org/x/net									 v0.0.0-20200114155413-6afb5195e5aa \
	golang.org/x/net									 v0.0.0-20200202094626-16171245cfb2 \
	golang.org/x/net									 v0.0.0-20200222125558-5a598a2470a0 \
	golang.org/x/net									 v0.0.0-20200226121028-0de0cce0169b \
	golang.org/x/net									 v0.0.0-20200301022130-244492dfa37a \
	golang.org/x/net									 v0.0.0-20200324143707-d3edc9973b7e \
	golang.org/x/net									 v0.0.0-20200501053045-e0ff5e5a1de5 \
	golang.org/x/net									 v0.0.0-20200506145744-7e3656a0809f \
	golang.org/x/net									 v0.0.0-20200513185701-a91f0712d120 \
	golang.org/x/net									 v0.0.0-20200520182314-0ba52f642ac2 \
	golang.org/x/net									 v0.0.0-20200625001655-4c5254603344 \
	golang.org/x/net									 v0.0.0-20200707034311-ab3426394381 \
	golang.org/x/net									 v0.0.0-20200822124328-c89045814202 \
	golang.org/x/net									 v0.0.0-20201110031124-69a78807bb2b \
	golang.org/x/net									 v0.0.0-20210525063256-abc453219eb5 \
	golang.org/x/net									 v0.0.0-20220127200216-cd36cc0744dd \
	golang.org/x/net									 v0.0.0-20220225172249-27dd8689420f \
	golang.org/x/net									 v0.0.0-20220624214902-1bab6f366d9e \
	golang.org/x/net									 v0.33.0 \
	golang.org/x/net									 v0.56.0 \
	golang.org/x/net									 v0.57.0 \
	golang.org/x/net									 v0.58.0 \
	golang.org/x/net									 v0.59.0 \
	golang.org/x/net									 v0.60.0 \
	golang.org/x/net									 v0.7.0 \
	golang.org/x/oauth2									 v0.0.0-20180821212333-d2e6202438be \
	golang.org/x/oauth2									 v0.0.0-20190226205417-e64efc72b421 \
	golang.org/x/oauth2									 v0.0.0-20190604053449-0f29369cfe45 \
	golang.org/x/oauth2									 v0.0.0-20191202225959-858c2ad4c8b6 \
	golang.org/x/oauth2									 v0.0.0-20200107190931-bf48bf16ab8d \
	golang.org/x/oauth2									 v0.0.0-20210514164344-f6687ab2804c \
	golang.org/x/oauth2									 v0.0.0-20220223155221-ee480838109b \
	golang.org/x/oauth2									 v0.19.0 \
	golang.org/x/oauth2									 v0.36.0 \
	golang.org/x/oauth2									 v0.4.0 \
	golang.org/x/sync									 v0.0.0-20180314180146-1d60e4601c6f \
	golang.org/x/sync									 v0.0.0-20181108010431-42b317875d0f \
	golang.org/x/sync									 v0.0.0-20181221193216-37e7f081c4d4 \
	golang.org/x/sync									 v0.0.0-20190227155943-e225da77a7e6 \
	golang.org/x/sync									 v0.0.0-20190423024810-112230192c58 \
	golang.org/x/sync									 v0.0.0-20190911185100-cd5d95a43a6e \
	golang.org/x/sync									 v0.0.0-20200317015054-43a5402ce75a \
	golang.org/x/sync									 v0.0.0-20200625203802-6e8e738ad208 \
	golang.org/x/sync									 v0.0.0-20201207232520-09787c993a3a \
	golang.org/x/sync									 v0.0.0-20220601150217-0de741cfad7f \
	golang.org/x/sync									 v0.1.0 \
	golang.org/x/sync									 v0.10.0 \
	golang.org/x/sync									 v0.17.0 \
	golang.org/x/sync									 v0.22.0 \
	golang.org/x/sys									 v0.0.0-20180830151530-49385e6e1522 \
	golang.org/x/sys									 v0.0.0-20180905080454-ebe1bf3edb33 \
	golang.org/x/sys									 v0.0.0-20181116152217-5ac8a444bdc5 \
	golang.org/x/sys									 v0.0.0-20190215142949-d0b11bdaac8a \
	golang.org/x/sys									 v0.0.0-20190312061237-fead79001313 \
	golang.org/x/sys									 v0.0.0-20190412213103-97732733099d \
	golang.org/x/sys									 v0.0.0-20190422165155-953cdadca894 \
	golang.org/x/sys									 v0.0.0-20190502145724-3ef323f4f1fd \
	golang.org/x/sys									 v0.0.0-20190507160741-ecd444e8653b \
	golang.org/x/sys									 v0.0.0-20190606165138-5da285871e9c \
	golang.org/x/sys									 v0.0.0-20190624142023-c5567b49c5d0 \
	golang.org/x/sys									 v0.0.0-20190726091711-fc99dfbffb4e \
	golang.org/x/sys									 v0.0.0-20191001151750-bb3f8db39f24 \
	golang.org/x/sys									 v0.0.0-20191204072324-ce4227a45e2e \
	golang.org/x/sys									 v0.0.0-20191228213918-04cbcbbfeed8 \
	golang.org/x/sys									 v0.0.0-20200106162015-b016eb3dc98e \
	golang.org/x/sys									 v0.0.0-20200113162924-86b910548bc1 \
	golang.org/x/sys									 v0.0.0-20200122134326-e047566fdf82 \
	golang.org/x/sys									 v0.0.0-20200202164722-d101bd2416d5 \
	golang.org/x/sys									 v0.0.0-20200212091648-12a6c2dcc1e4 \
	golang.org/x/sys									 v0.0.0-20200223170610-d5e6a3e2c0ae \
	golang.org/x/sys									 v0.0.0-20200302150141-5c8b2ff67527 \
	golang.org/x/sys									 v0.0.0-20200323222414-85ca7c5b95cd \
	golang.org/x/sys									 v0.0.0-20200331124033-c3d80250170d \
	golang.org/x/sys									 v0.0.0-20200501052902-10377860bb8e \
	golang.org/x/sys									 v0.0.0-20200511232937-7e40ca221e25 \
	golang.org/x/sys									 v0.0.0-20200515095857-1151b9dac4a9 \
	golang.org/x/sys									 v0.0.0-20200523222454-059865788121 \
	golang.org/x/sys									 v0.0.0-20200615200032-f1bc736245b1 \
	golang.org/x/sys									 v0.0.0-20200625212154-ddb9806d33ae \
	golang.org/x/sys									 v0.0.0-20200803210538-64077c9b5642 \
	golang.org/x/sys									 v0.0.0-20200930185726-fdedc70b468f \
	golang.org/x/sys									 v0.0.0-20201119102817-f84b799fce68 \
	golang.org/x/sys									 v0.0.0-20210124154548-22da62e12c0c \
	golang.org/x/sys									 v0.0.0-20210423082822-04245dca01da \
	golang.org/x/sys									 v0.0.0-20210603081109-ebe580a85c40 \
	golang.org/x/sys									 v0.0.0-20210615035016-665e8c7367d1 \
	golang.org/x/sys									 v0.0.0-20211216021012-1d35b9e2eb4e \
	golang.org/x/sys									 v0.0.0-20220114195835-da31bd327af9 \
	golang.org/x/sys									 v0.0.0-20220520151302-bc2c85ada10a \
	golang.org/x/sys									 v0.0.0-20220610221304-9f5ed59c137d \
	golang.org/x/sys									 v0.0.0-20220708085239-5a0f0661e09d \
	golang.org/x/sys									 v0.1.0 \
	golang.org/x/sys									 v0.13.0 \
	golang.org/x/sys									 v0.28.0 \
	golang.org/x/sys									 v0.29.0 \
	golang.org/x/sys									 v0.42.0 \
	golang.org/x/sys									 v0.45.0 \
	golang.org/x/sys									 v0.46.0 \
	golang.org/x/sys									 v0.47.0 \
	golang.org/x/sys									 v0.48.0 \
	golang.org/x/sys									 v0.5.0 \
	golang.org/x/term									 v0.0.0-20201126162022-7de9c90e9dd1 \
	golang.org/x/term									 v0.0.0-20210927222741-03fcf44c2211 \
	golang.org/x/text									 v0.0.0-20170915032832-14c0d48ead0c \
	golang.org/x/text									 v0.12.0 \
	golang.org/x/text									 v0.21.0 \
	golang.org/x/text									 v0.28.0 \
	golang.org/x/text									 v0.29.0 \
	golang.org/x/text									 v0.3.0 \
	golang.org/x/text									 v0.3.1-0.20180807135948-17ff2d5776d2 \
	golang.org/x/text									 v0.3.2 \
	golang.org/x/text									 v0.3.3 \
	golang.org/x/text									 v0.3.6 \
	golang.org/x/text									 v0.3.7 \
	golang.org/x/text									 v0.40.0 \
	golang.org/x/text									 v0.41.0 \
	golang.org/x/text									 v0.42.0 \
	golang.org/x/text									 v0.7.0 \
	golang.org/x/time									 v0.0.0-20181108054448-85acf8d2951c \
	golang.org/x/time									 v0.0.0-20190308202827-9d24e82272b4 \
	golang.org/x/time									 v0.0.0-20191024005414-555d28b269f0 \
	golang.org/x/time									 v0.15.0 \
	golang.org/x/time									 v0.5.0 \
	golang.org/x/tools									 v0.0.0-20180917221912-90fa682c2a6e \
	golang.org/x/tools									 v0.0.0-20190114222345-bf090417da8b \
	golang.org/x/tools									 v0.0.0-20190226205152-f727befe758c \
	golang.org/x/tools									 v0.0.0-20190311212946-11955173bddd \
	golang.org/x/tools									 v0.0.0-20190312151545-0bb0c0a6e846 \
	golang.org/x/tools									 v0.0.0-20190312170243-e65039ee4138 \
	golang.org/x/tools									 v0.0.0-20190425150028-36563e24a262 \
	golang.org/x/tools									 v0.0.0-20190506145303-2d16b83fe98c \
	golang.org/x/tools									 v0.0.0-20190524140312-2c0ae7006135 \
	golang.org/x/tools									 v0.0.0-20190606124116-d0a3d012864b \
	golang.org/x/tools									 v0.0.0-20190621195816-6e04913cbbac \
	golang.org/x/tools									 v0.0.0-20190628153133-6cdbf07be9d0 \
	golang.org/x/tools									 v0.0.0-20190816200558-6889da9d5479 \
	golang.org/x/tools									 v0.0.0-20190911174233-4f2ddba30aff \
	golang.org/x/tools									 v0.0.0-20191012152004-8de300cfc20a \
	golang.org/x/tools									 v0.0.0-20191113191852-77e3bb0ad9e7 \
	golang.org/x/tools									 v0.0.0-20191115202509-3a792d9c32b2 \
	golang.org/x/tools									 v0.0.0-20191119224855-298f0cb1881e \
	golang.org/x/tools									 v0.0.0-20191125144606-a911d9008d1f \
	golang.org/x/tools									 v0.0.0-20191130070609-6e064ea0cf2d \
	golang.org/x/tools									 v0.0.0-20191216173652-a0e659d51361 \
	golang.org/x/tools									 v0.0.0-20191227053925-7b8e75db28f4 \
	golang.org/x/tools									 v0.0.0-20200117161641-43d50277825c \
	golang.org/x/tools									 v0.0.0-20200122220014-bf1340f18c4a \
	golang.org/x/tools									 v0.0.0-20200130002326-2f3ba24bd6e7 \
	golang.org/x/tools									 v0.0.0-20200204074204-1cc6d1ef6c74 \
	golang.org/x/tools									 v0.0.0-20200207183749-b753a1ba74fa \
	golang.org/x/tools									 v0.0.0-20200212150539-ea181f53ac56 \
	golang.org/x/tools									 v0.0.0-20200224181240-023911ca70b2 \
	golang.org/x/tools									 v0.0.0-20200227222343-706bc42d1f0d \
	golang.org/x/tools									 v0.0.0-20200304193943-95d2e580d8eb \
	golang.org/x/tools									 v0.0.0-20200312045724-11d5b4c81c7d \
	golang.org/x/tools									 v0.0.0-20200331025713-a30bf2db82d4 \
	golang.org/x/tools									 v0.0.0-20200501065659-ab2804fb9c9d \
	golang.org/x/tools									 v0.0.0-20200512131952-2bc93b1c0c88 \
	golang.org/x/tools									 v0.0.0-20200515010526-7d3b6ebf133d \
	golang.org/x/tools									 v0.0.0-20200618134242-20370b0cb4b2 \
	golang.org/x/tools									 v0.0.0-20200729194436-6467de6f59a7 \
	golang.org/x/tools									 v0.0.0-20200804011535-6c149bb5ef0d \
	golang.org/x/tools									 v0.0.0-20200825202427-b303f430e36d \
	golang.org/x/xerrors									 v0.0.0-20190717185122-a985d3407aa7 \
	golang.org/x/xerrors									 v0.0.0-20191011141410-1b5146add898 \
	golang.org/x/xerrors									 v0.0.0-20191204190536-9bdfabe68543 \
	google.golang.org/api									 v0.106.0 \
	google.golang.org/api									 v0.13.0 \
	google.golang.org/api									 v0.14.0 \
	google.golang.org/api									 v0.15.0 \
	google.golang.org/api									 v0.17.0 \
	google.golang.org/api									 v0.177.0 \
	google.golang.org/api									 v0.18.0 \
	google.golang.org/api									 v0.19.0 \
	google.golang.org/api									 v0.20.0 \
	google.golang.org/api									 v0.22.0 \
	google.golang.org/api									 v0.24.0 \
	google.golang.org/api									 v0.278.0 \
	google.golang.org/api									 v0.28.0 \
	google.golang.org/api									 v0.280.0 \
	google.golang.org/api									 v0.287.1 \
	google.golang.org/api									 v0.288.0 \
	google.golang.org/api									 v0.29.0 \
	google.golang.org/api									 v0.290.0 \
	google.golang.org/api									 v0.30.0 \
	google.golang.org/api									 v0.304.0 \
	google.golang.org/api									 v0.4.0 \
	google.golang.org/api									 v0.7.0 \
	google.golang.org/api									 v0.8.0 \
	google.golang.org/api									 v0.9.0 \
	google.golang.org/appengine								 v1.1.0 \
	google.golang.org/appengine								 v1.4.0 \
	google.golang.org/appengine								 v1.5.0 \
	google.golang.org/appengine								 v1.6.1 \
	google.golang.org/appengine								 v1.6.5 \
	google.golang.org/appengine								 v1.6.6 \
	google.golang.org/appengine								 v1.6.7 \
	google.golang.org/genproto								 v0.0.0-20180817151627-c66870c02cf8 \
	google.golang.org/genproto								 v0.0.0-20190307195333-5fe7a883aa19 \
	google.golang.org/genproto								 v0.0.0-20190418145605-e7d98fc518a7 \
	google.golang.org/genproto								 v0.0.0-20190425155659-357c62f0e4bb \
	google.golang.org/genproto								 v0.0.0-20190502173448-54afdca5d873 \
	google.golang.org/genproto								 v0.0.0-20190801165951-fa694d86fc64 \
	google.golang.org/genproto								 v0.0.0-20190819201941-24fa4b261c55 \
	google.golang.org/genproto								 v0.0.0-20190911173649-1774047e7e51 \
	google.golang.org/genproto								 v0.0.0-20191108220845-16a3f7862a1a \
	google.golang.org/genproto								 v0.0.0-20191115194625-c23dd37a84c9 \
	google.golang.org/genproto								 v0.0.0-20191216164720-4f79533eabd1 \
	google.golang.org/genproto								 v0.0.0-20191230161307-f3c370f40bfb \
	google.golang.org/genproto								 v0.0.0-20200115191322-ca5a22157cba \
	google.golang.org/genproto								 v0.0.0-20200122232147-0452cf42e150 \
	google.golang.org/genproto								 v0.0.0-20200204135345-fa8e72b47b90 \
	google.golang.org/genproto								 v0.0.0-20200212174721-66ed5ce911ce \
	google.golang.org/genproto								 v0.0.0-20200224152610-e50cd9704f63 \
	google.golang.org/genproto								 v0.0.0-20200228133532-8c2c7df3a383 \
	google.golang.org/genproto								 v0.0.0-20200305110556-506484158171 \
	google.golang.org/genproto								 v0.0.0-20200312145019-da6875a35672 \
	google.golang.org/genproto								 v0.0.0-20200331122359-1ee6d9798940 \
	google.golang.org/genproto								 v0.0.0-20200430143042-b979b6f78d84 \
	google.golang.org/genproto								 v0.0.0-20200511104702-f5ebc3bea380 \
	google.golang.org/genproto								 v0.0.0-20200515170657-fc4c6c6a6587 \
	google.golang.org/genproto								 v0.0.0-20200526211855-cb27e3aa2013 \
	google.golang.org/genproto								 v0.0.0-20200618031413-b414f8b61790 \
	google.golang.org/genproto								 v0.0.0-20200729003335-053ba62fc06f \
	google.golang.org/genproto								 v0.0.0-20200804131852-c06518451d9c \
	google.golang.org/genproto								 v0.0.0-20200825200019-8632dd797987 \
	google.golang.org/genproto								 v0.0.0-20220822174746-9e6da59bd2fc \
	google.golang.org/genproto								 v0.0.0-20230104163317-caabf589fcbf \
	google.golang.org/genproto								 v0.0.0-20260319201613-d00831a3d3e7 \
	google.golang.org/genproto								 v0.0.0-20260519071638-aa98bba5eb94 \
	google.golang.org/genproto								 v0.0.0-20260723164925-7274b71286bd \
	google.golang.org/genproto								 v0.0.0-20261012220534-4341edf3f941 \
	google.golang.org/genproto/googleapis/api						 v0.0.0-20240429193739-8cf5692501f6 \
	google.golang.org/genproto/googleapis/api						 v0.0.0-20260519071638-aa98bba5eb94 \
	google.golang.org/genproto/googleapis/api						 v0.0.0-20260630182238-925bb5da69e7 \
	google.golang.org/genproto/googleapis/api						 v0.0.0-20260706201446-f0a921348800 \
	google.golang.org/genproto/googleapis/api						 v0.0.0-20260723164925-7274b71286bd \
	google.golang.org/genproto/googleapis/api						 v0.0.0-20261012220534-4341edf3f941 \
	google.golang.org/genproto/googleapis/rpc						 v0.0.0-20240429193739-8cf5692501f6 \
	google.golang.org/genproto/googleapis/rpc						 v0.0.0-20260526163538-3dc84a4a5aaa \
	google.golang.org/genproto/googleapis/rpc						 v0.0.0-20260630182238-925bb5da69e7 \
	google.golang.org/genproto/googleapis/rpc						 v0.0.0-20260706201446-f0a921348800 \
	google.golang.org/genproto/googleapis/rpc						 v0.0.0-20260715232425-e75dac1f907d \
	google.golang.org/genproto/googleapis/rpc						 v0.0.0-20260723164925-7274b71286bd \
	google.golang.org/genproto/googleapis/rpc						 v0.0.0-20260928230214-8a89bd6388cc \
	google.golang.org/genproto/googleapis/rpc						 v0.0.0-20261012220534-4341edf3f941 \
	google.golang.org/grpc									 v1.19.0 \
	google.golang.org/grpc									 v1.20.1 \
	google.golang.org/grpc									 v1.21.1 \
	google.golang.org/grpc									 v1.23.0 \
	google.golang.org/grpc									 v1.25.1 \
	google.golang.org/grpc									 v1.26.0 \
	google.golang.org/grpc									 v1.27.0 \
	google.golang.org/grpc									 v1.27.1 \
	google.golang.org/grpc									 v1.28.0 \
	google.golang.org/grpc									 v1.29.1 \
	google.golang.org/grpc									 v1.30.0 \
	google.golang.org/grpc									 v1.31.0 \
	google.golang.org/grpc									 v1.33.2 \
	google.golang.org/grpc									 v1.49.0 \
	google.golang.org/grpc									 v1.51.0 \
	google.golang.org/grpc									 v1.64.1 \
	google.golang.org/grpc									 v1.82.1 \
	google.golang.org/grpc									 v1.83.1 \
	google.golang.org/grpc									 v1.83.2 \
	google.golang.org/protobuf								 v0.0.0-20200109180630-ec00e32a8dfd \
	google.golang.org/protobuf								 v0.0.0-20200221191635-4d8936d0db64 \
	google.golang.org/protobuf								 v0.0.0-20200228230310-ab0ca4ff8a60 \
	google.golang.org/protobuf								 v1.20.1-0.20200309200217-e05f789c0967 \
	google.golang.org/protobuf								 v1.21.0 \
	google.golang.org/protobuf								 v1.22.0 \
	google.golang.org/protobuf								 v1.23.0 \
	google.golang.org/protobuf								 v1.23.1-0.20200526195155-81db48ad09cc \
	google.golang.org/protobuf								 v1.24.0 \
	google.golang.org/protobuf								 v1.25.0 \
	google.golang.org/protobuf								 v1.26.0 \
	google.golang.org/protobuf								 v1.26.0-rc.1 \
	google.golang.org/protobuf								 v1.28.0 \
	google.golang.org/protobuf								 v1.28.1 \
	google.golang.org/protobuf								 v1.33.0 \
	google.golang.org/protobuf								 v1.34.2 \
	google.golang.org/protobuf								 v1.36.11 \
	gopkg.in/check.v1									 v0.0.0-20161208181325-20d25e280405 \
	gopkg.in/check.v1									 v1.0.0-20180628173108-788fd7840127 \
	gopkg.in/check.v1									 v1.0.0-20190902080502-41f04d3bba15 \
	gopkg.in/yaml.v2									 v2.2.1 \
	gopkg.in/yaml.v2									 v2.2.2 \
	gopkg.in/yaml.v2									 v2.2.4 \
	gopkg.in/yaml.v2									 v2.2.5 \
	gopkg.in/yaml.v2									 v2.3.0 \
	gopkg.in/yaml.v3									 v3.0.0-20200313102051-9f266ea9e77c \
	honnef.co/go/tools									 v0.0.0-20190102054323-c2f93a96b099 \
	honnef.co/go/tools									 v0.0.0-20190106161140-3f1c8253044a \
	honnef.co/go/tools									 v0.0.0-20190418001031-e561f6794a2a \
	honnef.co/go/tools									 v0.0.0-20190523083050-ea95bdfd59fc \
	honnef.co/go/tools									 v0.0.1-2019.2.3 \
	honnef.co/go/tools									 v0.0.1-2020.1.3

