MODGO_MODULES =	\
	cloud.google.com/go/compute/metadata	 v0.3.0 \
	github.com/alecthomas/kingpin/v2	 v2.4.0 \
	github.com/alecthomas/units		 v0.0.0-20240927000941-0f3dac36c52b \
	github.com/beorn7/perks			 v1.0.1 \
	github.com/cespare/xxhash/v2		 v2.3.0 \
	github.com/coreos/go-systemd/v22	 v22.6.0 \
	github.com/davecgh/go-spew		 v1.1.1 \
	github.com/godbus/dbus/v5		 v5.1.0 \
	github.com/golang-jwt/jwt/v5		 v5.3.0 \
	github.com/golang/mock			 v1.6.0 \
	github.com/golang/protobuf		 v1.5.0 \
	github.com/google/go-cmp		 v0.7.0 \
	github.com/google/gopacket		 v1.1.19 \
	github.com/google/uuid			 v1.6.0 \
	github.com/gosnmp/gosnmp		 v1.43.1 \
	github.com/itchyny/timefmt-go		 v0.1.7 \
	github.com/jpillora/backoff		 v1.0.0 \
	github.com/json-iterator/go		 v1.1.12 \
	github.com/julienschmidt/httprouter	 v1.3.0 \
	github.com/klauspost/compress		 v1.18.0 \
	github.com/kr/pretty			 v0.3.1 \
	github.com/kr/text			 v0.2.0 \
	github.com/kylelemons/godebug		 v1.1.0 \
	github.com/mdlayher/socket		 v0.4.1 \
	github.com/mdlayher/vsock		 v1.2.1 \
	github.com/modern-go/concurrent		 v0.0.0-20180306012644-bacd9c7ef1dd \
	github.com/modern-go/reflect2		 v1.0.2 \
	github.com/munnerz/goautoneg		 v0.0.0-20191010083416-a7dc8b61c822 \
	github.com/mwitkow/go-conntrack		 v0.0.0-20190716064945-2f068394615f \
	github.com/pmezard/go-difflib		 v1.0.0 \
	github.com/prometheus/client_golang	 v1.23.2 \
	github.com/prometheus/client_model	 v0.6.2 \
	github.com/prometheus/common		 v0.67.4 \
	github.com/prometheus/exporter-toolkit	 v0.15.1 \
	github.com/prometheus/procfs		 v0.16.1 \
	github.com/rogpeppe/go-internal		 v1.10.0 \
	github.com/stretchr/objx		 v0.5.2 \
	github.com/stretchr/testify		 v1.11.1 \
	github.com/xhit/go-str2duration/v2	 v2.1.0 \
	go.uber.org/goleak			 v1.3.0 \
	go.yaml.in/yaml/v2			 v2.4.3 \
	golang.org/x/crypto			 v0.46.0 \
	golang.org/x/mod			 v0.30.0 \
	golang.org/x/net			 v0.48.0 \
	golang.org/x/oauth2			 v0.34.0 \
	golang.org/x/sync			 v0.19.0 \
	golang.org/x/sys			 v0.39.0 \
	golang.org/x/term			 v0.38.0 \
	golang.org/x/text			 v0.32.0 \
	golang.org/x/time			 v0.14.0 \
	golang.org/x/tools			 v0.39.0 \
	google.golang.org/protobuf		 v1.36.10 \
	gopkg.in/check.v1			 v1.0.0-20201130134442-10cb98267c6c \
	gopkg.in/yaml.v3			 v3.0.1

MODGO_MODFILES =	\
	github.com/alecthomas/units		 v0.0.0-20211218093645-b94a6e3cc137 \
	github.com/davecgh/go-spew		 v1.1.0 \
	github.com/google/go-cmp		 v0.5.9 \
	github.com/prometheus/client_golang	 v1.20.4 \
	github.com/prometheus/common		 v0.66.1 \
	github.com/prometheus/procfs		 v0.15.1 \
	github.com/stretchr/objx		 v0.1.0 \
	github.com/stretchr/objx		 v0.4.0 \
	github.com/stretchr/objx		 v0.5.0 \
	github.com/stretchr/testify		 v1.7.1 \
	github.com/stretchr/testify		 v1.8.0 \
	github.com/stretchr/testify		 v1.8.2 \
	github.com/stretchr/testify		 v1.8.4 \
	github.com/stretchr/testify		 v1.9.0 \
	go.yaml.in/yaml/v2			 v2.4.2 \
	golang.org/x/net			 v0.15.0 \
	golang.org/x/net			 v0.43.0 \
	golang.org/x/net			 v0.46.0 \
	golang.org/x/net			 v0.47.0 \
	golang.org/x/net			 v0.9.0 \
	golang.org/x/oauth2			 v0.30.0 \
	golang.org/x/oauth2			 v0.32.0 \
	golang.org/x/sync			 v0.1.0 \
	golang.org/x/sync			 v0.13.0 \
	golang.org/x/sys			 v0.13.0 \
	golang.org/x/sys			 v0.32.0 \
	golang.org/x/sys			 v0.35.0 \
	golang.org/x/sys			 v0.37.0 \
	golang.org/x/sys			 v0.7.0 \
	golang.org/x/text			 v0.28.0 \
	golang.org/x/text			 v0.30.0 \
	google.golang.org/protobuf		 v1.36.6 \
	google.golang.org/protobuf		 v1.36.8 \
	gopkg.in/check.v1			 v0.0.0-20161208181325-20d25e280405 \
	gopkg.in/yaml.v3			 v3.0.0-20200313102051-9f266ea9e77c

