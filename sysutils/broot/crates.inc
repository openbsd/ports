MODCARGO_CRATES +=	adler2	2.0.1	# 0BSD OR MIT OR Apache-2.0
MODCARGO_CRATES +=	ahash	0.8.12	# MIT OR Apache-2.0
MODCARGO_CRATES +=	aho-corasick	1.1.3	# Unlicense OR MIT
MODCARGO_CRATES +=	aligned-vec	0.6.4	# MIT
MODCARGO_CRATES +=	allocator-api2	0.2.21	# MIT OR Apache-2.0
MODCARGO_CRATES +=	android_system_properties	0.1.5	# MIT/Apache-2.0
MODCARGO_CRATES +=	ansi_colours	1.2.3	# LGPL-3.0-or-later
MODCARGO_CRATES +=	anstream	0.6.20	# MIT OR Apache-2.0
MODCARGO_CRATES +=	anstyle	1.0.13	# MIT OR Apache-2.0
MODCARGO_CRATES +=	anstyle-parse	0.2.7	# MIT OR Apache-2.0
MODCARGO_CRATES +=	anstyle-query	1.1.4	# MIT OR Apache-2.0
MODCARGO_CRATES +=	anstyle-wincon	3.0.10	# MIT OR Apache-2.0
MODCARGO_CRATES +=	anyhow	1.0.100	# MIT OR Apache-2.0
MODCARGO_CRATES +=	arbitrary	1.4.2	# MIT OR Apache-2.0
MODCARGO_CRATES +=	arg_enum_proc_macro	0.3.4	# MIT
MODCARGO_CRATES +=	argh	0.1.13	# BSD-3-Clause
MODCARGO_CRATES +=	argh_derive	0.1.13	# BSD-3-Clause
MODCARGO_CRATES +=	argh_shared	0.1.13	# BSD-3-Clause
MODCARGO_CRATES +=	arrayref	0.3.9	# BSD-2-Clause
MODCARGO_CRATES +=	arrayvec	0.7.6	# MIT OR Apache-2.0
MODCARGO_CRATES +=	autocfg	1.5.0	# Apache-2.0 OR MIT
MODCARGO_CRATES +=	av1-grain	0.2.4	# BSD-2-Clause
MODCARGO_CRATES +=	avif-serialize	0.8.6	# BSD-3-Clause
MODCARGO_CRATES +=	base64	0.13.1	# MIT/Apache-2.0
MODCARGO_CRATES +=	base64	0.22.1	# MIT OR Apache-2.0
MODCARGO_CRATES +=	bet	1.0.4	# MIT
MODCARGO_CRATES +=	bincode	1.3.3	# MIT
MODCARGO_CRATES +=	bit-set	0.5.3	# MIT/Apache-2.0
MODCARGO_CRATES +=	bit-vec	0.6.3	# MIT/Apache-2.0
MODCARGO_CRATES +=	bit_field	0.10.3	# Apache-2.0/MIT
MODCARGO_CRATES +=	bitflags	1.3.2	# MIT/Apache-2.0
MODCARGO_CRATES +=	bitflags	2.9.4	# MIT OR Apache-2.0
MODCARGO_CRATES +=	bitstream-io	2.6.0	# MIT/Apache-2.0
MODCARGO_CRATES +=	block2	0.5.1	# MIT
MODCARGO_CRATES +=	bstr	1.12.0	# MIT OR Apache-2.0
MODCARGO_CRATES +=	built	0.7.7	# MIT
MODCARGO_CRATES +=	bumpalo	3.19.0	# MIT OR Apache-2.0
MODCARGO_CRATES +=	bytemuck	1.23.2	# Zlib OR Apache-2.0 OR MIT
MODCARGO_CRATES +=	byteorder-lite	0.1.0	# Unlicense OR MIT
MODCARGO_CRATES +=	cc	1.2.39	# MIT OR Apache-2.0
MODCARGO_CRATES +=	cfg-expr	0.15.8	# MIT OR Apache-2.0
MODCARGO_CRATES +=	cfg-if	1.0.3	# MIT OR Apache-2.0
MODCARGO_CRATES +=	cfg_aliases	0.2.1	# MIT
MODCARGO_CRATES +=	char_reader	0.1.1	# MIT
MODCARGO_CRATES +=	chrono	0.4.42	# MIT OR Apache-2.0
MODCARGO_CRATES +=	clap	4.5.48	# MIT OR Apache-2.0
MODCARGO_CRATES +=	clap-help	1.5.0	# MIT
MODCARGO_CRATES +=	clap_builder	4.5.48	# MIT OR Apache-2.0
MODCARGO_CRATES +=	clap_complete	4.5.58	# MIT OR Apache-2.0
MODCARGO_CRATES +=	clap_derive	4.5.47	# MIT OR Apache-2.0
MODCARGO_CRATES +=	clap_lex	0.7.5	# MIT OR Apache-2.0
MODCARGO_CRATES +=	clap_mangen	0.2.29	# MIT OR Apache-2.0
MODCARGO_CRATES +=	cli-log	2.1.0	# MIT
MODCARGO_CRATES +=	clipboard-win	4.5.0	# BSL-1.0
MODCARGO_CRATES +=	clipboard_macos	0.1.1	# Apache-2.0
MODCARGO_CRATES +=	color_quant	1.1.0	# MIT
MODCARGO_CRATES +=	colorchoice	1.0.4	# MIT OR Apache-2.0
MODCARGO_CRATES +=	convert_case	0.7.1	# MIT
MODCARGO_CRATES +=	coolor	1.1.0	# MIT
MODCARGO_CRATES +=	core-foundation	0.9.4	# MIT OR Apache-2.0
MODCARGO_CRATES +=	core-foundation-sys	0.8.7	# MIT OR Apache-2.0
MODCARGO_CRATES +=	core_maths	0.1.1	# MIT
MODCARGO_CRATES +=	crc32fast	1.5.0	# MIT OR Apache-2.0
MODCARGO_CRATES +=	crokey	1.3.0	# MIT
MODCARGO_CRATES +=	crokey-proc_macros	1.3.0	# MIT
MODCARGO_CRATES +=	crossbeam	0.8.4	# MIT OR Apache-2.0
MODCARGO_CRATES +=	crossbeam-channel	0.5.15	# MIT OR Apache-2.0
MODCARGO_CRATES +=	crossbeam-deque	0.8.6	# MIT OR Apache-2.0
MODCARGO_CRATES +=	crossbeam-epoch	0.9.18	# MIT OR Apache-2.0
MODCARGO_CRATES +=	crossbeam-queue	0.3.12	# MIT OR Apache-2.0
MODCARGO_CRATES +=	crossbeam-utils	0.8.21	# MIT OR Apache-2.0
MODCARGO_CRATES +=	crossterm	0.28.1	# MIT
MODCARGO_CRATES +=	crossterm	0.29.0	# MIT
MODCARGO_CRATES +=	crossterm_winapi	0.9.1	# MIT
MODCARGO_CRATES +=	crunchy	0.2.4	# MIT
MODCARGO_CRATES +=	csv	1.3.1	# Unlicense/MIT
MODCARGO_CRATES +=	csv-core	0.1.12	# Unlicense/MIT
MODCARGO_CRATES +=	csv2svg	0.2.3	# MIT
MODCARGO_CRATES +=	custom_error	1.9.2	# BSD-2-Clause
MODCARGO_CRATES +=	data-url	0.3.2	# MIT OR Apache-2.0
MODCARGO_CRATES +=	deranged	0.5.4	# MIT OR Apache-2.0
MODCARGO_CRATES +=	derive_more	2.0.1	# MIT
MODCARGO_CRATES +=	derive_more-impl	2.0.1	# MIT
MODCARGO_CRATES +=	deser-hjson	2.2.4	# MIT
MODCARGO_CRATES +=	directories	4.0.1	# MIT OR Apache-2.0
MODCARGO_CRATES +=	directories	5.0.1	# MIT OR Apache-2.0
MODCARGO_CRATES +=	dirs-sys	0.3.7	# MIT OR Apache-2.0
MODCARGO_CRATES +=	dirs-sys	0.4.1	# MIT OR Apache-2.0
MODCARGO_CRATES +=	displaydoc	0.2.5	# MIT OR Apache-2.0
MODCARGO_CRATES +=	doc-comment	0.3.3	# MIT
MODCARGO_CRATES +=	document-features	0.2.11	# MIT OR Apache-2.0
MODCARGO_CRATES +=	either	1.15.0	# MIT OR Apache-2.0
MODCARGO_CRATES +=	equator	0.4.2	# MIT
MODCARGO_CRATES +=	equator-macro	0.4.2	# MIT
MODCARGO_CRATES +=	equivalent	1.0.2	# Apache-2.0 OR MIT
MODCARGO_CRATES +=	errno	0.3.14	# MIT OR Apache-2.0
MODCARGO_CRATES +=	error-code	2.3.1	# BSL-1.0
MODCARGO_CRATES +=	euclid	0.22.11	# MIT OR Apache-2.0
MODCARGO_CRATES +=	exr	1.73.0	# BSD-3-Clause
MODCARGO_CRATES +=	fallible-iterator	0.3.0	# MIT/Apache-2.0
MODCARGO_CRATES +=	fallible-streaming-iterator	0.1.9	# MIT/Apache-2.0
MODCARGO_CRATES +=	fancy-regex	0.11.0	# MIT
MODCARGO_CRATES +=	fastrand	2.3.0	# Apache-2.0 OR MIT
MODCARGO_CRATES +=	fax	0.2.6	# MIT
MODCARGO_CRATES +=	fax_derive	0.2.0	# MIT
MODCARGO_CRATES +=	fdeflate	0.3.7	# MIT OR Apache-2.0
MODCARGO_CRATES +=	file-size	1.0.3	# MIT
MODCARGO_CRATES +=	find-msvc-tools	0.1.2	# MIT OR Apache-2.0
MODCARGO_CRATES +=	flate2	1.1.2	# MIT OR Apache-2.0
MODCARGO_CRATES +=	flex-grow	0.1.0	# MIT
MODCARGO_CRATES +=	float-cmp	0.9.0	# MIT
MODCARGO_CRATES +=	fnv	1.0.7	# Apache-2.0 / MIT
MODCARGO_CRATES +=	foldhash	0.1.5	# Zlib
MODCARGO_CRATES +=	fontconfig-parser	0.5.8	# MIT
MODCARGO_CRATES +=	fontdb	0.23.0	# MIT
MODCARGO_CRATES +=	form_urlencoded	1.2.2	# MIT OR Apache-2.0
MODCARGO_CRATES +=	fsevent-sys	4.1.0	# MIT
MODCARGO_CRATES +=	gethostname	0.3.0	# Apache-2.0
MODCARGO_CRATES +=	getrandom	0.2.16	# MIT OR Apache-2.0
MODCARGO_CRATES +=	getrandom	0.3.3	# MIT OR Apache-2.0
MODCARGO_CRATES +=	gif	0.13.3	# MIT OR Apache-2.0
MODCARGO_CRATES +=	git2	0.20.2	# MIT OR Apache-2.0
MODCARGO_CRATES +=	glassbench	0.4.4	# MIT
MODCARGO_CRATES +=	glob	0.3.3	# MIT OR Apache-2.0
MODCARGO_CRATES +=	half	2.6.0	# MIT OR Apache-2.0
MODCARGO_CRATES +=	hashbrown	0.14.5	# MIT OR Apache-2.0
MODCARGO_CRATES +=	hashbrown	0.15.5	# MIT OR Apache-2.0
MODCARGO_CRATES +=	hashbrown	0.16.0	# MIT OR Apache-2.0
MODCARGO_CRATES +=	hashlink	0.9.1	# MIT OR Apache-2.0
MODCARGO_CRATES +=	heck	0.4.1	# MIT OR Apache-2.0
MODCARGO_CRATES +=	heck	0.5.0	# MIT OR Apache-2.0
MODCARGO_CRATES +=	home	0.5.11	# MIT OR Apache-2.0
MODCARGO_CRATES +=	iana-time-zone	0.1.64	# MIT OR Apache-2.0
MODCARGO_CRATES +=	iana-time-zone-haiku	0.1.2	# MIT OR Apache-2.0
MODCARGO_CRATES +=	icu_collections	2.0.0	# Unicode-3.0
MODCARGO_CRATES +=	icu_locale_core	2.0.0	# Unicode-3.0
MODCARGO_CRATES +=	icu_normalizer	2.0.0	# Unicode-3.0
MODCARGO_CRATES +=	icu_normalizer_data	2.0.0	# Unicode-3.0
MODCARGO_CRATES +=	icu_properties	2.0.1	# Unicode-3.0
MODCARGO_CRATES +=	icu_properties_data	2.0.1	# Unicode-3.0
MODCARGO_CRATES +=	icu_provider	2.0.0	# Unicode-3.0
MODCARGO_CRATES +=	id-arena	2.2.1	# MIT/Apache-2.0
MODCARGO_CRATES +=	idna	1.1.0	# MIT OR Apache-2.0
MODCARGO_CRATES +=	idna_adapter	1.2.1	# Apache-2.0 OR MIT
MODCARGO_CRATES +=	image	0.25.8	# MIT OR Apache-2.0
MODCARGO_CRATES +=	image-webp	0.2.4	# MIT OR Apache-2.0
MODCARGO_CRATES +=	imagesize	0.13.0	# MIT
MODCARGO_CRATES +=	imgref	1.12.0	# CC0-1.0 OR Apache-2.0
MODCARGO_CRATES +=	include_dir	0.7.4	# MIT
MODCARGO_CRATES +=	include_dir_macros	0.7.4	# MIT
MODCARGO_CRATES +=	indexmap	2.11.4	# Apache-2.0 OR MIT
MODCARGO_CRATES +=	inotify	0.11.0	# ISC
MODCARGO_CRATES +=	inotify-sys	0.1.5	# ISC
MODCARGO_CRATES +=	interpolate_name	0.2.4	# MIT
MODCARGO_CRATES +=	io-kit-sys	0.4.1	# MIT / Apache-2.0
MODCARGO_CRATES +=	is_executable	1.0.5	# MIT OR Apache-2.0
MODCARGO_CRATES +=	is_terminal_polyfill	1.70.1	# MIT OR Apache-2.0
MODCARGO_CRATES +=	itertools	0.12.1	# MIT OR Apache-2.0
MODCARGO_CRATES +=	itoa	1.0.15	# MIT OR Apache-2.0
MODCARGO_CRATES +=	jobserver	0.1.34	# MIT OR Apache-2.0
MODCARGO_CRATES +=	jpeg-encoder	0.5.1	# MIT OR Apache-2.0
MODCARGO_CRATES +=	js-sys	0.3.81	# MIT OR Apache-2.0
MODCARGO_CRATES +=	jxl-bitstream	0.2.3	# MIT OR Apache-2.0
MODCARGO_CRATES +=	jxl-coding	0.2.3	# MIT OR Apache-2.0
MODCARGO_CRATES +=	jxl-color	0.3.2	# MIT OR Apache-2.0
MODCARGO_CRATES +=	jxl-frame	0.5.0	# MIT OR Apache-2.0
MODCARGO_CRATES +=	jxl-grid	0.1.1	# MIT OR Apache-2.0
MODCARGO_CRATES +=	jxl-image	0.5.0	# MIT OR Apache-2.0
MODCARGO_CRATES +=	jxl-modular	0.3.0	# MIT OR Apache-2.0
MODCARGO_CRATES +=	jxl-oxide	0.4.0	# MIT OR Apache-2.0
MODCARGO_CRATES +=	jxl-render	0.4.0	# MIT OR Apache-2.0
MODCARGO_CRATES +=	jxl-vardct	0.3.0	# MIT OR Apache-2.0
MODCARGO_CRATES +=	kamadak-exif	0.5.5	# BSD-2-Clause
MODCARGO_CRATES +=	kqueue	1.1.1	# MIT
MODCARGO_CRATES +=	kqueue-sys	1.0.4	# MIT
MODCARGO_CRATES +=	kurbo	0.11.3	# Apache-2.0 OR MIT
MODCARGO_CRATES +=	lazy-regex	3.4.1	# MIT
MODCARGO_CRATES +=	lazy-regex-proc_macros	3.4.1	# MIT
MODCARGO_CRATES +=	lazy_static	1.5.0	# MIT OR Apache-2.0
MODCARGO_CRATES +=	lebe	0.5.3	# BSD-3-Clause
MODCARGO_CRATES +=	lfs-core	0.14.1	# MIT
MODCARGO_CRATES +=	libc	0.2.176	# MIT OR Apache-2.0
MODCARGO_CRATES +=	libfuzzer-sys	0.4.10	# (MIT OR Apache-2.0) AND NCSA
MODCARGO_CRATES +=	libgit2-sys	0.18.2+1.9.1	# MIT OR Apache-2.0
MODCARGO_CRATES +=	libm	0.2.15	# MIT
MODCARGO_CRATES +=	libredox	0.1.10	# MIT
MODCARGO_CRATES +=	libsqlite3-sys	0.30.1	# MIT
MODCARGO_CRATES +=	libz-sys	1.1.22	# MIT OR Apache-2.0
MODCARGO_CRATES +=	linked-hash-map	0.5.6	# MIT/Apache-2.0
MODCARGO_CRATES +=	linux-raw-sys	0.4.15	# Apache-2.0 WITH LLVM-exception OR Apache-2.0 OR MIT
MODCARGO_CRATES +=	linux-raw-sys	0.11.0	# Apache-2.0 WITH LLVM-exception OR Apache-2.0 OR MIT
MODCARGO_CRATES +=	litemap	0.8.0	# Unicode-3.0
MODCARGO_CRATES +=	litrs	0.4.2	# MIT/Apache-2.0
MODCARGO_CRATES +=	lock_api	0.4.13	# MIT OR Apache-2.0
MODCARGO_CRATES +=	log	0.4.28	# MIT OR Apache-2.0
MODCARGO_CRATES +=	loop9	0.1.5	# MIT
MODCARGO_CRATES +=	lru	0.16.1	# MIT
MODCARGO_CRATES +=	mach2	0.4.3	# BSD-2-Clause OR MIT OR Apache-2.0
MODCARGO_CRATES +=	maybe-rayon	0.1.1	# MIT
MODCARGO_CRATES +=	memchr	2.7.6	# Unlicense OR MIT
MODCARGO_CRATES +=	memmap2	0.9.8	# MIT OR Apache-2.0
MODCARGO_CRATES +=	memoffset	0.7.1	# MIT
MODCARGO_CRATES +=	minimad	0.13.1	# MIT
MODCARGO_CRATES +=	minimal-lexical	0.2.1	# MIT/Apache-2.0
MODCARGO_CRATES +=	miniz_oxide	0.8.9	# MIT OR Zlib OR Apache-2.0
MODCARGO_CRATES +=	mio	1.0.4	# MIT
MODCARGO_CRATES +=	moxcms	0.7.5	# BSD-3-Clause OR Apache-2.0
MODCARGO_CRATES +=	mutate_once	0.1.2	# BSD-2-Clause
MODCARGO_CRATES +=	new_debug_unreachable	1.0.6	# MIT
MODCARGO_CRATES +=	nix	0.26.4	# MIT
MODCARGO_CRATES +=	nix	0.29.0	# MIT
MODCARGO_CRATES +=	nom	7.1.3	# MIT
MODCARGO_CRATES +=	noop_proc_macro	0.3.0	# MIT
MODCARGO_CRATES +=	normpath	1.5.0	# MIT OR Apache-2.0
MODCARGO_CRATES +=	notify	8.2.0	# CC0-1.0
MODCARGO_CRATES +=	notify-types	2.0.0	# MIT OR Apache-2.0
MODCARGO_CRATES +=	num-bigint	0.4.6	# MIT OR Apache-2.0
MODCARGO_CRATES +=	num-conv	0.1.0	# MIT OR Apache-2.0
MODCARGO_CRATES +=	num-derive	0.4.2	# MIT OR Apache-2.0
MODCARGO_CRATES +=	num-integer	0.1.46	# MIT OR Apache-2.0
MODCARGO_CRATES +=	num-rational	0.4.2	# MIT OR Apache-2.0
MODCARGO_CRATES +=	num-traits	0.2.19	# MIT OR Apache-2.0
MODCARGO_CRATES +=	objc-sys	0.3.5	# MIT
MODCARGO_CRATES +=	objc2	0.5.2	# MIT
MODCARGO_CRATES +=	objc2	0.6.2	# MIT
MODCARGO_CRATES +=	objc2-app-kit	0.2.2	# MIT
MODCARGO_CRATES +=	objc2-core-data	0.2.2	# MIT
MODCARGO_CRATES +=	objc2-core-image	0.2.2	# MIT
MODCARGO_CRATES +=	objc2-encode	4.1.0	# MIT
MODCARGO_CRATES +=	objc2-foundation	0.2.2	# MIT
MODCARGO_CRATES +=	objc2-foundation	0.3.1	# MIT
MODCARGO_CRATES +=	objc2-metal	0.2.2	# MIT
MODCARGO_CRATES +=	objc2-quartz-core	0.2.2	# MIT
MODCARGO_CRATES +=	once_cell	1.21.3	# MIT OR Apache-2.0
MODCARGO_CRATES +=	once_cell_polyfill	1.70.1	# MIT OR Apache-2.0
MODCARGO_CRATES +=	open	1.7.1	# MIT
MODCARGO_CRATES +=	opener	0.8.3	# MIT OR Apache-2.0
MODCARGO_CRATES +=	option-ext	0.2.0	# MPL-2.0
MODCARGO_CRATES +=	parking_lot	0.12.4	# MIT OR Apache-2.0
MODCARGO_CRATES +=	parking_lot_core	0.9.11	# MIT OR Apache-2.0
MODCARGO_CRATES +=	paste	1.0.15	# MIT OR Apache-2.0
MODCARGO_CRATES +=	pathdiff	0.2.3	# MIT/Apache-2.0
MODCARGO_CRATES +=	percent-encoding	2.3.2	# MIT OR Apache-2.0
MODCARGO_CRATES +=	phf	0.13.1	# MIT
MODCARGO_CRATES +=	phf_generator	0.13.1	# MIT
MODCARGO_CRATES +=	phf_macros	0.13.1	# MIT
MODCARGO_CRATES +=	phf_shared	0.13.1	# MIT
MODCARGO_CRATES +=	pico-args	0.5.0	# MIT
MODCARGO_CRATES +=	pin-project-lite	0.2.16	# Apache-2.0 OR MIT
MODCARGO_CRATES +=	pkg-config	0.3.32	# MIT OR Apache-2.0
MODCARGO_CRATES +=	plist	1.8.0	# MIT
MODCARGO_CRATES +=	png	0.17.16	# MIT OR Apache-2.0
MODCARGO_CRATES +=	png	0.18.0	# MIT OR Apache-2.0
MODCARGO_CRATES +=	potential_utf	0.1.3	# Unicode-3.0
MODCARGO_CRATES +=	powerfmt	0.2.0	# MIT OR Apache-2.0
MODCARGO_CRATES +=	ppv-lite86	0.2.21	# MIT OR Apache-2.0
MODCARGO_CRATES +=	proc-macro2	1.0.101	# MIT OR Apache-2.0
MODCARGO_CRATES +=	proc-status	0.1.1	# MIT
MODCARGO_CRATES +=	profiling	1.0.17	# MIT OR Apache-2.0
MODCARGO_CRATES +=	profiling-procmacros	1.0.17	# MIT OR Apache-2.0
MODCARGO_CRATES +=	pxfm	0.1.24	# BSD-3-Clause OR Apache-2.0
MODCARGO_CRATES +=	qoi	0.4.1	# MIT/Apache-2.0
MODCARGO_CRATES +=	quick-error	2.0.1	# MIT/Apache-2.0
MODCARGO_CRATES +=	quick-xml	0.38.3	# MIT
MODCARGO_CRATES +=	quote	1.0.41	# MIT OR Apache-2.0
MODCARGO_CRATES +=	r-efi	5.3.0	# MIT OR Apache-2.0 OR LGPL-2.1-or-later
MODCARGO_CRATES +=	rand	0.8.5	# MIT OR Apache-2.0
MODCARGO_CRATES +=	rand_chacha	0.3.1	# MIT OR Apache-2.0
MODCARGO_CRATES +=	rand_core	0.6.4	# MIT OR Apache-2.0
MODCARGO_CRATES +=	rav1e	0.7.1	# BSD-2-Clause
MODCARGO_CRATES +=	ravif	0.11.20	# BSD-3-Clause
MODCARGO_CRATES +=	rayon	1.11.0	# MIT OR Apache-2.0
MODCARGO_CRATES +=	rayon-core	1.13.0	# MIT OR Apache-2.0
MODCARGO_CRATES +=	redox_syscall	0.5.17	# MIT
MODCARGO_CRATES +=	redox_users	0.4.6	# MIT
MODCARGO_CRATES +=	regex	1.11.3	# MIT OR Apache-2.0
MODCARGO_CRATES +=	regex-automata	0.4.11	# MIT OR Apache-2.0
MODCARGO_CRATES +=	regex-syntax	0.8.6	# MIT OR Apache-2.0
MODCARGO_CRATES +=	resvg	0.45.1	# Apache-2.0 OR MIT
MODCARGO_CRATES +=	rgb	0.8.52	# MIT
MODCARGO_CRATES +=	roff	0.2.2	# MIT OR Apache-2.0
MODCARGO_CRATES +=	roxmltree	0.20.0	# MIT OR Apache-2.0
MODCARGO_CRATES +=	rusqlite	0.32.1	# MIT
MODCARGO_CRATES +=	rust-fuzzy-search	0.1.1	# MIT OR Apache-2.0
MODCARGO_CRATES +=	rustc-hash	2.1.1	# Apache-2.0 OR MIT
MODCARGO_CRATES +=	rustix	0.38.44	# Apache-2.0 WITH LLVM-exception OR Apache-2.0 OR MIT
MODCARGO_CRATES +=	rustix	1.1.2	# Apache-2.0 WITH LLVM-exception OR Apache-2.0 OR MIT
MODCARGO_CRATES +=	rustversion	1.0.22	# MIT OR Apache-2.0
MODCARGO_CRATES +=	rustybuzz	0.20.1	# MIT
MODCARGO_CRATES +=	ryu	1.0.20	# Apache-2.0 OR BSL-1.0
MODCARGO_CRATES +=	same-file	1.0.6	# Unlicense/MIT
MODCARGO_CRATES +=	scopeguard	1.2.0	# MIT OR Apache-2.0
MODCARGO_CRATES +=	secular	1.0.1	# MIT
MODCARGO_CRATES +=	serde	1.0.228	# MIT OR Apache-2.0
MODCARGO_CRATES +=	serde_core	1.0.228	# MIT OR Apache-2.0
MODCARGO_CRATES +=	serde_derive	1.0.228	# MIT OR Apache-2.0
MODCARGO_CRATES +=	serde_json	1.0.145	# MIT OR Apache-2.0
MODCARGO_CRATES +=	serde_spanned	0.6.9	# MIT OR Apache-2.0
MODCARGO_CRATES +=	serde_spanned	1.0.2	# MIT OR Apache-2.0
MODCARGO_CRATES +=	shlex	1.3.0	# MIT OR Apache-2.0
MODCARGO_CRATES +=	signal-hook	0.3.18	# Apache-2.0/MIT
MODCARGO_CRATES +=	signal-hook-mio	0.2.4	# Apache-2.0/MIT
MODCARGO_CRATES +=	signal-hook-registry	1.4.6	# Apache-2.0/MIT
MODCARGO_CRATES +=	simd-adler32	0.3.7	# MIT
MODCARGO_CRATES +=	simd_helpers	0.1.0	# MIT
MODCARGO_CRATES +=	simplecss	0.2.2	# Apache-2.0 OR MIT
MODCARGO_CRATES +=	siphasher	1.0.1	# MIT/Apache-2.0
MODCARGO_CRATES +=	slotmap	1.0.7	# Zlib
MODCARGO_CRATES +=	smallvec	1.15.1	# MIT OR Apache-2.0
MODCARGO_CRATES +=	snafu	0.7.5	# MIT OR Apache-2.0
MODCARGO_CRATES +=	snafu-derive	0.7.5	# MIT OR Apache-2.0
MODCARGO_CRATES +=	splitty	1.0.2	# MIT
MODCARGO_CRATES +=	stable_deref_trait	1.2.0	# MIT/Apache-2.0
MODCARGO_CRATES +=	str-buf	1.0.6	# BSL-1.0
MODCARGO_CRATES +=	strict	0.2.0	# MIT
MODCARGO_CRATES +=	strict-num	0.1.1	# MIT
MODCARGO_CRATES +=	strsim	0.11.1	# MIT
MODCARGO_CRATES +=	svg	0.16.0	# Apache-2.0/MIT
MODCARGO_CRATES +=	svgtypes	0.15.3	# Apache-2.0 OR MIT
MODCARGO_CRATES +=	syn	1.0.109	# MIT OR Apache-2.0
MODCARGO_CRATES +=	syn	2.0.106	# MIT OR Apache-2.0
MODCARGO_CRATES +=	synstructure	0.13.2	# MIT
MODCARGO_CRATES +=	syntect-no-panic	6.0.0	# MIT
MODCARGO_CRATES +=	system-deps	6.2.2	# MIT OR Apache-2.0
MODCARGO_CRATES +=	target-lexicon	0.12.16	# Apache-2.0 WITH LLVM-exception
MODCARGO_CRATES +=	tempfile	3.23.0	# MIT OR Apache-2.0
MODCARGO_CRATES +=	termimad	0.31.3	# MIT
MODCARGO_CRATES +=	termimad	0.34.0	# MIT
MODCARGO_CRATES +=	terminal-clipboard	0.4.1	# MIT
MODCARGO_CRATES +=	terminal-light	1.8.0	# MIT
MODCARGO_CRATES +=	termux-clipboard	0.1.0	# MIT
MODCARGO_CRATES +=	thiserror	1.0.69	# MIT OR Apache-2.0
MODCARGO_CRATES +=	thiserror	2.0.17	# MIT OR Apache-2.0
MODCARGO_CRATES +=	thiserror-impl	1.0.69	# MIT OR Apache-2.0
MODCARGO_CRATES +=	thiserror-impl	2.0.17	# MIT OR Apache-2.0
MODCARGO_CRATES +=	tiff	0.10.3	# MIT
MODCARGO_CRATES +=	time	0.3.44	# MIT OR Apache-2.0
MODCARGO_CRATES +=	time-core	0.1.6	# MIT OR Apache-2.0
MODCARGO_CRATES +=	time-macros	0.2.24	# MIT OR Apache-2.0
MODCARGO_CRATES +=	tiny-skia	0.11.4	# BSD-3-Clause
MODCARGO_CRATES +=	tiny-skia-path	0.11.4	# BSD-3-Clause
MODCARGO_CRATES +=	tinystr	0.8.1	# Unicode-3.0
MODCARGO_CRATES +=	tinyvec	1.10.0	# Zlib OR Apache-2.0 OR MIT
MODCARGO_CRATES +=	tinyvec_macros	0.1.1	# MIT OR Apache-2.0 OR Zlib
MODCARGO_CRATES +=	toml	0.8.23	# MIT OR Apache-2.0
MODCARGO_CRATES +=	toml	0.9.7	# MIT OR Apache-2.0
MODCARGO_CRATES +=	toml_datetime	0.6.11	# MIT OR Apache-2.0
MODCARGO_CRATES +=	toml_datetime	0.7.2	# MIT OR Apache-2.0
MODCARGO_CRATES +=	toml_edit	0.22.27	# MIT OR Apache-2.0
MODCARGO_CRATES +=	toml_parser	1.0.3	# MIT OR Apache-2.0
MODCARGO_CRATES +=	toml_writer	1.0.3	# MIT OR Apache-2.0
MODCARGO_CRATES +=	tracing	0.1.41	# MIT
MODCARGO_CRATES +=	tracing-core	0.1.34	# MIT
MODCARGO_CRATES +=	trash	5.2.3	# MIT
MODCARGO_CRATES +=	ttf-parser	0.25.1	# MIT OR Apache-2.0
MODCARGO_CRATES +=	umask	2.1.0	# MIT
MODCARGO_CRATES +=	unicode-bidi	0.3.18	# MIT OR Apache-2.0
MODCARGO_CRATES +=	unicode-bidi-mirroring	0.4.0	# MIT/Apache-2.0
MODCARGO_CRATES +=	unicode-ccc	0.4.0	# MIT/Apache-2.0
MODCARGO_CRATES +=	unicode-ident	1.0.19	# (MIT OR Apache-2.0) AND Unicode-3.0
MODCARGO_CRATES +=	unicode-normalization	0.1.24	# MIT/Apache-2.0
MODCARGO_CRATES +=	unicode-properties	0.1.3	# MIT/Apache-2.0
MODCARGO_CRATES +=	unicode-script	0.5.7	# MIT OR Apache-2.0
MODCARGO_CRATES +=	unicode-segmentation	1.12.0	# MIT OR Apache-2.0
MODCARGO_CRATES +=	unicode-vo	0.1.0	# MIT/Apache-2.0
MODCARGO_CRATES +=	unicode-width	0.1.14	# MIT OR Apache-2.0
MODCARGO_CRATES +=	unicode-width	0.2.1	# MIT OR Apache-2.0
MODCARGO_CRATES +=	url	2.5.7	# MIT OR Apache-2.0
MODCARGO_CRATES +=	urlencoding	2.1.3	# MIT
MODCARGO_CRATES +=	usvg	0.45.1	# Apache-2.0 OR MIT
MODCARGO_CRATES +=	utf8_iter	1.0.4	# Apache-2.0 OR MIT
MODCARGO_CRATES +=	utf8parse	0.2.2	# Apache-2.0 OR MIT
MODCARGO_CRATES +=	uzers	0.12.1	# MIT
MODCARGO_CRATES +=	v_frame	0.3.9	# BSD-2-Clause
MODCARGO_CRATES +=	vcpkg	0.2.15	# MIT/Apache-2.0
MODCARGO_CRATES +=	version-compare	0.2.0	# MIT
MODCARGO_CRATES +=	version_check	0.9.5	# MIT/Apache-2.0
MODCARGO_CRATES +=	vte	0.15.0	# Apache-2.0 OR MIT
MODCARGO_CRATES +=	walkdir	2.5.0	# Unlicense/MIT
MODCARGO_CRATES +=	wasi	0.11.1+wasi-snapshot-preview1	# Apache-2.0 WITH LLVM-exception OR Apache-2.0 OR MIT
MODCARGO_CRATES +=	wasi	0.14.7+wasi-0.2.4	# Apache-2.0 WITH LLVM-exception OR Apache-2.0 OR MIT
MODCARGO_CRATES +=	wasip2	1.0.1+wasi-0.2.4	# Apache-2.0 WITH LLVM-exception OR Apache-2.0 OR MIT
MODCARGO_CRATES +=	wasm-bindgen	0.2.104	# MIT OR Apache-2.0
MODCARGO_CRATES +=	wasm-bindgen-backend	0.2.104	# MIT OR Apache-2.0
MODCARGO_CRATES +=	wasm-bindgen-macro	0.2.104	# MIT OR Apache-2.0
MODCARGO_CRATES +=	wasm-bindgen-macro-support	0.2.104	# MIT OR Apache-2.0
MODCARGO_CRATES +=	wasm-bindgen-shared	0.2.104	# MIT OR Apache-2.0
MODCARGO_CRATES +=	weezl	0.1.10	# MIT OR Apache-2.0
MODCARGO_CRATES +=	which	4.4.2	# MIT
MODCARGO_CRATES +=	winapi	0.3.9	# MIT/Apache-2.0
MODCARGO_CRATES +=	winapi-i686-pc-windows-gnu	0.4.0	# MIT/Apache-2.0
MODCARGO_CRATES +=	winapi-util	0.1.11	# Unlicense OR MIT
MODCARGO_CRATES +=	winapi-wsapoll	0.1.2	# MIT OR Apache-2.0
MODCARGO_CRATES +=	winapi-x86_64-pc-windows-gnu	0.4.0	# MIT/Apache-2.0
MODCARGO_CRATES +=	windows	0.56.0	# MIT OR Apache-2.0
MODCARGO_CRATES +=	windows-core	0.56.0	# MIT OR Apache-2.0
MODCARGO_CRATES +=	windows-core	0.62.1	# MIT OR Apache-2.0
MODCARGO_CRATES +=	windows-implement	0.56.0	# MIT OR Apache-2.0
MODCARGO_CRATES +=	windows-implement	0.60.1	# MIT OR Apache-2.0
MODCARGO_CRATES +=	windows-interface	0.56.0	# MIT OR Apache-2.0
MODCARGO_CRATES +=	windows-interface	0.59.2	# MIT OR Apache-2.0
MODCARGO_CRATES +=	windows-link	0.2.0	# MIT OR Apache-2.0
MODCARGO_CRATES +=	windows-result	0.1.2	# MIT OR Apache-2.0
MODCARGO_CRATES +=	windows-result	0.4.0	# MIT OR Apache-2.0
MODCARGO_CRATES +=	windows-strings	0.5.0	# MIT OR Apache-2.0
MODCARGO_CRATES +=	windows-sys	0.48.0	# MIT OR Apache-2.0
MODCARGO_CRATES +=	windows-sys	0.59.0	# MIT OR Apache-2.0
MODCARGO_CRATES +=	windows-sys	0.60.2	# MIT OR Apache-2.0
MODCARGO_CRATES +=	windows-sys	0.61.1	# MIT OR Apache-2.0
MODCARGO_CRATES +=	windows-targets	0.48.5	# MIT OR Apache-2.0
MODCARGO_CRATES +=	windows-targets	0.52.6	# MIT OR Apache-2.0
MODCARGO_CRATES +=	windows-targets	0.53.4	# MIT OR Apache-2.0
MODCARGO_CRATES +=	windows_aarch64_gnullvm	0.48.5	# MIT OR Apache-2.0
MODCARGO_CRATES +=	windows_aarch64_gnullvm	0.52.6	# MIT OR Apache-2.0
MODCARGO_CRATES +=	windows_aarch64_gnullvm	0.53.0	# MIT OR Apache-2.0
MODCARGO_CRATES +=	windows_aarch64_msvc	0.48.5	# MIT OR Apache-2.0
MODCARGO_CRATES +=	windows_aarch64_msvc	0.52.6	# MIT OR Apache-2.0
MODCARGO_CRATES +=	windows_aarch64_msvc	0.53.0	# MIT OR Apache-2.0
MODCARGO_CRATES +=	windows_i686_gnu	0.48.5	# MIT OR Apache-2.0
MODCARGO_CRATES +=	windows_i686_gnu	0.52.6	# MIT OR Apache-2.0
MODCARGO_CRATES +=	windows_i686_gnu	0.53.0	# MIT OR Apache-2.0
MODCARGO_CRATES +=	windows_i686_gnullvm	0.52.6	# MIT OR Apache-2.0
MODCARGO_CRATES +=	windows_i686_gnullvm	0.53.0	# MIT OR Apache-2.0
MODCARGO_CRATES +=	windows_i686_msvc	0.48.5	# MIT OR Apache-2.0
MODCARGO_CRATES +=	windows_i686_msvc	0.52.6	# MIT OR Apache-2.0
MODCARGO_CRATES +=	windows_i686_msvc	0.53.0	# MIT OR Apache-2.0
MODCARGO_CRATES +=	windows_x86_64_gnu	0.48.5	# MIT OR Apache-2.0
MODCARGO_CRATES +=	windows_x86_64_gnu	0.52.6	# MIT OR Apache-2.0
MODCARGO_CRATES +=	windows_x86_64_gnu	0.53.0	# MIT OR Apache-2.0
MODCARGO_CRATES +=	windows_x86_64_gnullvm	0.48.5	# MIT OR Apache-2.0
MODCARGO_CRATES +=	windows_x86_64_gnullvm	0.52.6	# MIT OR Apache-2.0
MODCARGO_CRATES +=	windows_x86_64_gnullvm	0.53.0	# MIT OR Apache-2.0
MODCARGO_CRATES +=	windows_x86_64_msvc	0.48.5	# MIT OR Apache-2.0
MODCARGO_CRATES +=	windows_x86_64_msvc	0.52.6	# MIT OR Apache-2.0
MODCARGO_CRATES +=	windows_x86_64_msvc	0.53.0	# MIT OR Apache-2.0
MODCARGO_CRATES +=	winnow	0.7.13	# MIT
MODCARGO_CRATES +=	wit-bindgen	0.46.0	# Apache-2.0 WITH LLVM-exception OR Apache-2.0 OR MIT
MODCARGO_CRATES +=	writeable	0.6.1	# Unicode-3.0
MODCARGO_CRATES +=	x11-clipboard	0.8.1	# MIT
MODCARGO_CRATES +=	x11rb	0.12.0	# MIT OR Apache-2.0
MODCARGO_CRATES +=	x11rb-protocol	0.12.0	# MIT OR Apache-2.0
MODCARGO_CRATES +=	xmlwriter	0.1.0	# MIT
MODCARGO_CRATES +=	xterm-query	0.5.2	# MIT
MODCARGO_CRATES +=	yaml-rust	0.4.5	# MIT/Apache-2.0
MODCARGO_CRATES +=	yoke	0.8.0	# Unicode-3.0
MODCARGO_CRATES +=	yoke-derive	0.8.0	# Unicode-3.0
MODCARGO_CRATES +=	zerocopy	0.8.27	# BSD-2-Clause OR Apache-2.0 OR MIT
MODCARGO_CRATES +=	zerocopy-derive	0.8.27	# BSD-2-Clause OR Apache-2.0 OR MIT
MODCARGO_CRATES +=	zerofrom	0.1.6	# Unicode-3.0
MODCARGO_CRATES +=	zerofrom-derive	0.1.6	# Unicode-3.0
MODCARGO_CRATES +=	zerotrie	0.2.2	# Unicode-3.0
MODCARGO_CRATES +=	zerovec	0.11.4	# Unicode-3.0
MODCARGO_CRATES +=	zerovec-derive	0.11.1	# Unicode-3.0
MODCARGO_CRATES +=	zune-bmp	0.4.0	# MIT OR Apache-2.0 OR Zlib
MODCARGO_CRATES +=	zune-core	0.4.12	# MIT OR Apache-2.0 OR Zlib
MODCARGO_CRATES +=	zune-farbfeld	0.4.0	# MIT OR Apache-2.0 OR Zlib
MODCARGO_CRATES +=	zune-hdr	0.4.0	# MIT OR Apache-2.0 OR Zlib
MODCARGO_CRATES +=	zune-image	0.4.15	# MIT OR Apache-2.0 OR Zlib
MODCARGO_CRATES +=	zune-inflate	0.2.54	# MIT OR Apache-2.0 OR Zlib
MODCARGO_CRATES +=	zune-jpeg	0.4.21	# MIT OR Apache-2.0 OR Zlib
MODCARGO_CRATES +=	zune-jpegxl	0.4.0	# MIT OR Apache-2.0 OR Zlib
MODCARGO_CRATES +=	zune-png	0.4.10	# MIT OR Apache-2.0 OR Zlib
MODCARGO_CRATES +=	zune-ppm	0.4.0	# MIT OR Apache-2.0 OR Zlib
MODCARGO_CRATES +=	zune-psd	0.4.0	# MIT OR Apache-2.0 OR Zlib
MODCARGO_CRATES +=	zune-qoi	0.4.10	# MIT OR Apache-2.0 OR Zlib
