MODGO_MODULES =	\
	github.com/atotto/clipboard		 v0.1.4 \
	github.com/aymanbagabas/go-osc52	 v1.0.3 \
	github.com/charmbracelet/bubbles	 v0.14.0 \
	github.com/charmbracelet/bubbletea	 v0.23.0 \
	github.com/charmbracelet/harmonica	 v0.2.0 \
	github.com/charmbracelet/lipgloss	 v0.6.0 \
	github.com/containerd/console		 v1.0.3 \
	github.com/kylelemons/godebug		 v1.1.0 \
	github.com/lucasb-eyer/go-colorful	 v1.2.0 \
	github.com/mattn/go-isatty		 v0.0.16 \
	github.com/mattn/go-localereader	 v0.0.1 \
	github.com/mattn/go-runewidth		 v0.0.14 \
	github.com/muesli/ansi			 v0.0.0-20211018074035-2e021307bc4b \
	github.com/muesli/cancelreader		 v0.2.2 \
	github.com/muesli/reflow		 v0.3.0 \
	github.com/muesli/termenv		 v0.13.0 \
	github.com/rivo/uniseg			 v0.2.0 \
	github.com/sahilm/fuzzy			 v0.1.0 \
	golang.org/x/sys			 v0.0.0-20220811171246-fbc7d0a398ab \
	golang.org/x/term			 v0.0.0-20210927222741-03fcf44c2211 \
	golang.org/x/text			 v0.3.7 \
	golang.org/x/tools			 v0.0.0-20180917221912-90fa682c2a6e

MODGO_MODFILES =	\
	github.com/charmbracelet/bubbletea	 v0.21.0 \
	github.com/charmbracelet/lipgloss	 v0.5.0 \
	github.com/mattn/go-isatty		 v0.0.14 \
	github.com/mattn/go-runewidth		 v0.0.10 \
	github.com/mattn/go-runewidth		 v0.0.12 \
	github.com/mattn/go-runewidth		 v0.0.13 \
	github.com/muesli/cancelreader		 v0.2.0 \
	github.com/muesli/reflow		 v0.2.1-0.20210115123740-9e1d0d53df68 \
	github.com/muesli/termenv		 v0.11.1-0.20220204035834-5ac8409525e0 \
	github.com/muesli/termenv		 v0.11.1-0.20220212125758-44cd13922739 \
	github.com/rivo/uniseg			 v0.1.0 \
	golang.org/x/sys			 v0.0.0-20210124154548-22da62e12c0c \
	golang.org/x/sys			 v0.0.0-20210615035016-665e8c7367d1 \
	golang.org/x/sys			 v0.0.0-20210630005230-0f9fa26af87c \
	golang.org/x/sys			 v0.0.0-20220204135822-1c1b9b1eba6a \
	golang.org/x/sys			 v0.0.0-20220209214540-3681064d5158

