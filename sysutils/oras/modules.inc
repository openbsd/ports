MODGO_MODULES =	\
	dario.cat/mergo					 v1.0.2 \
	github.com/!masterminds/goutils			 v1.1.1 \
	github.com/!masterminds/semver/v3		 v3.4.0 \
	github.com/!masterminds/sprig/v3		 v3.3.0 \
	github.com/containerd/console			 v1.0.5 \
	github.com/cpuguy83/go-md2man/v2		 v2.0.6 \
	github.com/davecgh/go-spew			 v1.1.1 \
	github.com/frankban/quicktest			 v1.14.6 \
	github.com/google/go-cmp			 v0.6.0 \
	github.com/google/uuid				 v1.6.0 \
	github.com/huandu/xstrings			 v1.5.0 \
	github.com/inconshreveable/mousetrap		 v1.1.0 \
	github.com/kr/pretty				 v0.3.1 \
	github.com/kr/text				 v0.2.0 \
	github.com/mitchellh/copystructure		 v1.2.0 \
	github.com/mitchellh/reflectwalk		 v1.0.2 \
	github.com/morikuni/aec				 v1.0.0 \
	github.com/opencontainers/go-digest		 v1.0.0 \
	github.com/opencontainers/image-spec		 v1.1.1 \
	github.com/pmezard/go-difflib			 v1.0.0 \
	github.com/rogpeppe/go-internal			 v1.9.0 \
	github.com/russross/blackfriday			 v1.6.0 \
	github.com/russross/blackfriday/v2		 v2.1.0 \
	github.com/santhosh-tekuri/jsonschema/v5	 v5.3.1 \
	github.com/shopspring/decimal			 v1.4.0 \
	github.com/sirupsen/logrus			 v1.9.3 \
	github.com/spf13/cast				 v1.9.2 \
	github.com/spf13/cobra				 v1.10.1 \
	github.com/spf13/pflag				 v1.0.9 \
	github.com/stretchr/objx			 v0.1.0 \
	github.com/stretchr/testify			 v1.7.0 \
	golang.org/x/crypto				 v0.45.0 \
	golang.org/x/net				 v0.47.0 \
	golang.org/x/sync				 v0.16.0 \
	golang.org/x/sys				 v0.38.0 \
	golang.org/x/term				 v0.37.0 \
	golang.org/x/text				 v0.31.0 \
	gopkg.in/check.v1				 v0.0.0-20161208181325-20d25e280405 \
	gopkg.in/yaml.v2				 v2.3.0 \
	gopkg.in/yaml.v3				 v3.0.1 \
	oras.land/oras-go/v2				 v2.6.0

MODGO_MODFILES =	\
	dario.cat/mergo				 v1.0.1 \
	github.com/!masterminds/semver/v3	 v3.3.0 \
	github.com/davecgh/go-spew		 v1.1.0 \
	github.com/google/go-cmp		 v0.5.9 \
	github.com/spf13/cast			 v1.7.0 \
	github.com/stretchr/testify		 v1.5.1 \
	golang.org/x/crypto			 v0.26.0 \
	golang.org/x/sync			 v0.14.0 \
	golang.org/x/sys			 v0.0.0-20220715151400-c0bba94af5f8 \
	golang.org/x/sys			 v0.1.0 \
	gopkg.in/yaml.v3			 v3.0.0-20200313102051-9f266ea9e77c

