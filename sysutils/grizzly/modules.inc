MODGO_MODULES =	\
	aead.dev/minisign					 v0.2.0 \
	cloud.google.com/go					 v0.110.10 \
	cloud.google.com/go/compute				 v1.23.3 \
	cloud.google.com/go/compute/metadata			 v0.2.3 \
	cloud.google.com/go/firestore				 v1.13.0 \
	cloud.google.com/go/iam					 v1.1.5 \
	cloud.google.com/go/longrunning				 v0.5.1 \
	cloud.google.com/go/storage				 v1.35.1 \
	github.com/!d!a!t!a-!d!o!g/go-sqlmock			 v1.3.3 \
	github.com/alecthomas/units				 v0.0.0-20231202071711-9a357b53e9c9 \
	github.com/andybalholm/brotli				 v1.0.6 \
	github.com/armon/go-metrics				 v0.4.1 \
	github.com/asaskevich/govalidator			 v0.0.0-20230301143203-a9d515a09cc2 \
	github.com/bahlo/generic-list-go			 v0.2.0 \
	github.com/beorn7/perks					 v1.0.1 \
	github.com/buger/goterm					 v1.0.4 \
	github.com/buger/jsonparser				 v1.1.1 \
	github.com/census-instrumentation/opencensus-proto	 v0.4.1 \
	github.com/cespare/xxhash/v2				 v2.2.0 \
	github.com/cncf/udpa/go					 v0.0.0-20220112060539-c52dc94e7fbe \
	github.com/cncf/xds/go					 v0.0.0-20231128003011-0fa0005c9caa \
	github.com/coreos/go-semver				 v0.3.0 \
	github.com/coreos/go-systemd/v22			 v22.3.2 \
	github.com/cpuguy83/go-md2man/v2			 v2.0.3 \
	github.com/davecgh/go-spew				 v1.1.2-0.20180830191138-d8f796af33cc \
	github.com/dennwc/varint				 v1.0.0 \
	github.com/docker/go-units				 v0.5.0 \
	github.com/envoyproxy/go-control-plane			 v0.12.0 \
	github.com/envoyproxy/protoc-gen-validate		 v1.0.4 \
	github.com/fatih/color					 v1.15.0 \
	github.com/felixge/httpsnoop				 v1.0.4 \
	github.com/frankban/quicktest				 v1.14.4 \
	github.com/fsnotify/fsnotify				 v1.6.0 \
	github.com/gdamore/encoding				 v1.0.0 \
	github.com/gdamore/tcell				 v1.4.0 \
	github.com/go-chi/chi					 v1.5.5 \
	github.com/go-clix/cli					 v0.2.0 \
	github.com/go-kit/kit					 v0.13.0 \
	github.com/go-kit/log					 v0.2.1 \
	github.com/go-logfmt/logfmt				 v0.6.0 \
	github.com/go-logr/logr					 v1.4.1 \
	github.com/go-logr/stdr					 v1.2.2 \
	github.com/go-openapi/analysis				 v0.23.0 \
	github.com/go-openapi/errors				 v0.22.0 \
	github.com/go-openapi/jsonpointer			 v0.21.0 \
	github.com/go-openapi/jsonreference			 v0.21.0 \
	github.com/go-openapi/loads				 v0.22.0 \
	github.com/go-openapi/runtime				 v0.28.0 \
	github.com/go-openapi/spec				 v0.21.0 \
	github.com/go-openapi/strfmt				 v0.23.0 \
	github.com/go-openapi/swag				 v0.23.0 \
	github.com/go-openapi/validate				 v0.24.0 \
	github.com/go-ping/ping					 v1.1.0 \
	github.com/gobwas/glob					 v0.2.3 \
	github.com/gogo/googleapis				 v1.4.1 \
	github.com/gogo/protobuf				 v1.3.2 \
	github.com/gogo/status					 v1.1.1 \
	github.com/golang/glog					 v1.2.0 \
	github.com/golang/groupcache				 v0.0.0-20210331224755-41bb18bfe9da \
	github.com/golang/protobuf				 v1.5.3 \
	github.com/golang/snappy				 v0.0.4 \
	github.com/google/go-cmp				 v0.6.0 \
	github.com/google/go-jsonnet				 v0.20.0 \
	github.com/google/s2a-go				 v0.1.7 \
	github.com/google/uuid					 v1.6.0 \
	github.com/googleapis/enterprise-certificate-proxy	 v0.3.2 \
	github.com/googleapis/gax-go/v2				 v2.12.0 \
	github.com/googleapis/google-cloud-go-testing		 v0.0.0-20210719221736-1c9a4c676720 \
	github.com/gorilla/websocket				 v1.5.1 \
	github.com/grafana/grafana-openapi-client-go		 v0.0.0-20250108132429-8d7e1f158f65 \
	github.com/grafana/loki/pkg/push			 v0.0.0-20240305220717-0ddf6fc49d58 \
	github.com/grafana/regexp				 v0.0.0-20221122212121-6b5c0a4cb7fd \
	github.com/grafana/synthetic-monitoring-agent		 v0.23.1 \
	github.com/grafana/synthetic-monitoring-api-go-client	 v0.8.0 \
	github.com/hashicorp/consul/api				 v1.25.1 \
	github.com/hashicorp/errwrap				 v1.1.0 \
	github.com/hashicorp/go-cleanhttp			 v0.5.2 \
	github.com/hashicorp/go-hclog				 v1.5.0 \
	github.com/hashicorp/go-immutable-radix			 v1.3.1 \
	github.com/hashicorp/go-multierror			 v1.1.1 \
	github.com/hashicorp/go-rootcerts			 v1.0.2 \
	github.com/hashicorp/golang-lru				 v0.5.4 \
	github.com/hashicorp/hcl				 v1.0.0 \
	github.com/hashicorp/serf				 v0.10.1 \
	github.com/josharian/intern				 v1.0.0 \
	github.com/jpillora/backoff				 v1.0.0 \
	github.com/json-iterator/go				 v1.1.12 \
	github.com/kirsle/configdir				 v0.0.0-20170128060238-e45d2f54772f \
	github.com/kisielk/errcheck				 v1.5.0 \
	github.com/kisielk/gotool				 v1.0.0 \
	github.com/klauspost/compress				 v1.17.0 \
	github.com/kr/fs					 v0.1.0 \
	github.com/kr/pretty					 v0.3.1 \
	github.com/kr/text					 v0.2.0 \
	github.com/lucasb-eyer/go-colorful			 v1.0.3 \
	github.com/magiconair/properties			 v1.8.7 \
	github.com/mailru/easyjson				 v0.7.7 \
	github.com/mattn/go-colorable				 v0.1.13 \
	github.com/mattn/go-isatty				 v0.0.20 \
	github.com/mattn/go-runewidth				 v0.0.9 \
	github.com/mccutchen/go-httpbin/v2			 v2.13.4 \
	github.com/miekg/dns					 v1.1.58 \
	github.com/minio/highwayhash				 v1.0.2 \
	github.com/minio/selfupdate				 v0.6.0 \
	github.com/mitchellh/go-homedir				 v1.1.0 \
	github.com/mitchellh/mapstructure			 v1.5.0 \
	github.com/mmcloughlin/geohash				 v0.10.0 \
	github.com/modern-go/concurrent				 v0.0.0-20180306012644-bacd9c7ef1dd \
	github.com/modern-go/reflect2				 v1.0.2 \
	github.com/montanaflynn/stats				 v0.0.0-20171201202039-1bf9dbcd8cbe \
	github.com/mwitkow/go-conntrack				 v0.0.0-20190716064945-2f068394615f \
	github.com/nats-io/jwt/v2				 v2.4.1 \
	github.com/nats-io/nats.go				 v1.30.2 \
	github.com/nats-io/nkeys				 v0.4.5 \
	github.com/nats-io/nuid					 v1.0.1 \
	github.com/niemeyer/pretty				 v0.0.0-20200227124842-a10e7caefd8e \
	github.com/oklog/ulid					 v1.3.1 \
	github.com/opentracing/opentracing-go			 v1.2.0 \
	github.com/pelletier/go-toml/v2				 v2.1.0 \
	github.com/pkg/errors					 v0.9.1 \
	github.com/pkg/sftp					 v1.13.6 \
	github.com/pmezard/go-difflib				 v1.0.1-0.20181226105442-5d4384ee4fb2 \
	github.com/posener/complete				 v1.2.3 \
	github.com/prometheus/blackbox_exporter			 v0.24.0 \
	github.com/prometheus/client_golang			 v1.19.0 \
	github.com/prometheus/client_model			 v0.6.0 \
	github.com/prometheus/common				 v0.50.0 \
	github.com/prometheus/procfs				 v0.12.0 \
	github.com/prometheus/prometheus			 v0.50.1 \
	github.com/quasilyte/go-ruleguard/dsl			 v0.3.22 \
	github.com/rivo/tview					 v0.0.0-20200818120338-53d50e499bf9 \
	github.com/rivo/uniseg					 v0.1.0 \
	github.com/rogpeppe/go-internal				 v1.11.0 \
	github.com/rs/zerolog					 v1.32.0 \
	github.com/russross/blackfriday/v2			 v2.1.0 \
	github.com/sagikazarmark/crypt				 v0.15.0 \
	github.com/sagikazarmark/locafero			 v0.3.0 \
	github.com/sagikazarmark/slog-shim			 v0.1.0 \
	github.com/sergi/go-diff				 v1.1.0 \
	github.com/sirupsen/logrus				 v1.9.3 \
	github.com/sourcegraph/conc				 v0.3.0 \
	github.com/spf13/afero					 v1.11.0 \
	github.com/spf13/cast					 v1.5.1 \
	github.com/spf13/pflag					 v1.0.5 \
	github.com/spf13/viper					 v1.17.0 \
	github.com/stretchr/objx				 v0.5.2 \
	github.com/stretchr/testify				 v1.9.0 \
	github.com/subosito/gotenv				 v1.6.0 \
	github.com/tonobo/mtr					 v0.1.1-0.20210422192847-1c17592ae70b \
	github.com/urfave/cli/v2				 v2.27.1 \
	github.com/wk8/go-ordered-map/v2			 v2.1.8 \
	github.com/xdg-go/pbkdf2				 v1.0.0 \
	github.com/xdg-go/scram					 v1.1.2 \
	github.com/xdg-go/stringprep				 v1.0.4 \
	github.com/xrash/smetrics				 v0.0.0-20231213231151-1d8dd44e695e \
	github.com/youmark/pkcs8				 v0.0.0-20181117223130-1be2e3e5546d \
	github.com/yuin/goldmark				 v1.2.1 \
	go.etcd.io/etcd/api/v3					 v3.5.9 \
	go.etcd.io/etcd/client/pkg/v3				 v3.5.9 \
	go.etcd.io/etcd/client/v2				 v2.305.9 \
	go.etcd.io/etcd/client/v3				 v3.5.9 \
	go.mongodb.org/mongo-driver				 v1.14.0 \
	go.opencensus.io					 v0.24.0 \
	go.opentelemetry.io/otel				 v1.24.0 \
	go.opentelemetry.io/otel/metric				 v1.24.0 \
	go.opentelemetry.io/otel/sdk				 v1.24.0 \
	go.opentelemetry.io/otel/trace				 v1.24.0 \
	go.uber.org/atomic					 v1.11.0 \
	go.uber.org/multierr					 v1.9.0 \
	go.uber.org/zap						 v1.21.0 \
	golang.org/x/crypto					 v0.31.0 \
	golang.org/x/exp					 v0.0.0-20240119083558-1b970713d09a \
	golang.org/x/mod					 v0.17.0 \
	golang.org/x/net					 v0.33.0 \
	golang.org/x/oauth2					 v0.18.0 \
	golang.org/x/sync					 v0.10.0 \
	golang.org/x/sys					 v0.28.0 \
	golang.org/x/term					 v0.27.0 \
	golang.org/x/text					 v0.21.0 \
	golang.org/x/time					 v0.5.0 \
	golang.org/x/tools					 v0.21.1-0.20240508182429-e35e4ccd0d2d \
	golang.org/x/xerrors					 v0.0.0-20220907171357-04be3eba64a2 \
	google.golang.org/api					 v0.152.0 \
	google.golang.org/appengine				 v1.6.8 \
	google.golang.org/genproto				 v0.0.0-20240123012728-ef4313101c80 \
	google.golang.org/genproto/googleapis/api		 v0.0.0-20240123012728-ef4313101c80 \
	google.golang.org/genproto/googleapis/rpc		 v0.0.0-20240123012728-ef4313101c80 \
	google.golang.org/grpc					 v1.62.1 \
	google.golang.org/protobuf				 v1.33.0 \
	gopkg.in/check.v1					 v1.0.0-20201130134442-10cb98267c6c \
	gopkg.in/fsnotify.v1					 v1.4.7 \
	gopkg.in/ini.v1						 v1.67.0 \
	gopkg.in/yaml.v2					 v2.4.0 \
	gopkg.in/yaml.v3					 v3.0.1 \
	kernel.org/pub/linux/libs/security/libcap/cap		 v1.2.69 \
	kernel.org/pub/linux/libs/security/libcap/psx		 v1.2.69 \
	sigs.k8s.io/yaml					 v1.3.0

MODGO_MODFILES =	\
	cloud.google.com/go					 v0.110.7 \
	cloud.google.com/go/compute				 v1.23.0 \
	github.com/davecgh/go-spew				 v1.1.0 \
	github.com/davecgh/go-spew				 v1.1.1 \
	github.com/fatih/color					 v1.12.0 \
	github.com/fatih/color					 v1.14.1 \
	github.com/gdamore/tcell				 v1.3.0 \
	github.com/go-logr/logr					 v1.2.2 \
	github.com/golang/protobuf				 v1.5.0 \
	github.com/golang/snappy				 v0.0.1 \
	github.com/google/go-cmp				 v0.5.2 \
	github.com/google/go-cmp				 v0.5.5 \
	github.com/google/go-cmp				 v0.5.8 \
	github.com/google/go-cmp				 v0.5.9 \
	github.com/google/uuid					 v1.4.0 \
	github.com/googleapis/enterprise-certificate-proxy	 v0.3.1 \
	github.com/grafana/synthetic-monitoring-agent		 v0.19.4 \
	github.com/hashicorp/errwrap				 v1.0.0 \
	github.com/hashicorp/go-multierror			 v1.0.0 \
	github.com/klauspost/compress				 v1.13.6 \
	github.com/kr/pretty					 v0.3.0 \
	github.com/lucasb-eyer/go-colorful			 v1.0.2 \
	github.com/mattn/go-colorable				 v0.1.8 \
	github.com/mattn/go-isatty				 v0.0.12 \
	github.com/mattn/go-isatty				 v0.0.16 \
	github.com/mattn/go-isatty				 v0.0.17 \
	github.com/mattn/go-runewidth				 v0.0.4 \
	github.com/mattn/go-runewidth				 v0.0.7 \
	github.com/pmezard/go-difflib				 v1.0.0 \
	github.com/rogpeppe/go-internal				 v1.9.0 \
	github.com/rs/zerolog					 v1.31.0 \
	github.com/spf13/afero					 v1.10.0 \
	github.com/spf13/afero					 v1.9.5 \
	github.com/stretchr/objx				 v0.1.0 \
	github.com/stretchr/objx				 v0.4.0 \
	github.com/stretchr/objx				 v0.5.0 \
	github.com/stretchr/testify				 v1.3.0 \
	github.com/stretchr/testify				 v1.4.0 \
	github.com/stretchr/testify				 v1.7.0 \
	github.com/stretchr/testify				 v1.7.1 \
	github.com/stretchr/testify				 v1.7.5 \
	github.com/stretchr/testify				 v1.8.0 \
	github.com/stretchr/testify				 v1.8.1 \
	github.com/stretchr/testify				 v1.8.4 \
	github.com/yuin/goldmark				 v1.1.27 \
	go.uber.org/atomic					 v1.7.0 \
	go.uber.org/atomic					 v1.9.0 \
	golang.org/x/crypto					 v0.0.0-20190308221718-c2843e01d9a2 \
	golang.org/x/crypto					 v0.0.0-20191011191535-87dc89f01550 \
	golang.org/x/crypto					 v0.0.0-20200622213623-75b288015ac9 \
	golang.org/x/crypto					 v0.0.0-20210220033148-5ea612d1eb83 \
	golang.org/x/crypto					 v0.0.0-20211209193657-4570a0811e8b \
	golang.org/x/crypto					 v0.13.0 \
	golang.org/x/crypto					 v0.16.0 \
	golang.org/x/crypto					 v0.17.0 \
	golang.org/x/exp					 v0.0.0-20230905200255-921286631fa9 \
	golang.org/x/mod					 v0.14.0 \
	golang.org/x/mod					 v0.2.0 \
	golang.org/x/mod					 v0.3.0 \
	golang.org/x/net					 v0.0.0-20190404232315-eb5bcb51f2a3 \
	golang.org/x/net					 v0.0.0-20190620200207-3b0461eec859 \
	golang.org/x/net					 v0.0.0-20200226121028-0de0cce0169b \
	golang.org/x/net					 v0.0.0-20201021035429-f5854403a974 \
	golang.org/x/net					 v0.0.0-20211112202133-69e39bad7dc2 \
	golang.org/x/net					 v0.15.0 \
	golang.org/x/net					 v0.17.0 \
	golang.org/x/net					 v0.19.0 \
	golang.org/x/net					 v0.20.0 \
	golang.org/x/net					 v0.21.0 \
	golang.org/x/net					 v0.22.0 \
	golang.org/x/oauth2					 v0.12.0 \
	golang.org/x/oauth2					 v0.15.0 \
	golang.org/x/oauth2					 v0.16.0 \
	golang.org/x/sync					 v0.0.0-20190423024810-112230192c58 \
	golang.org/x/sync					 v0.0.0-20190911185100-cd5d95a43a6e \
	golang.org/x/sync					 v0.0.0-20201020160332-67f06af15bc9 \
	golang.org/x/sync					 v0.1.0 \
	golang.org/x/sync					 v0.3.0 \
	golang.org/x/sync					 v0.5.0 \
	golang.org/x/sync					 v0.6.0 \
	golang.org/x/sys					 v0.0.0-20190215142949-d0b11bdaac8a \
	golang.org/x/sys					 v0.0.0-20190412213103-97732733099d \
	golang.org/x/sys					 v0.0.0-20190626150813-e07cf5db2756 \
	golang.org/x/sys					 v0.0.0-20191026070338-33540a1f6037 \
	golang.org/x/sys					 v0.0.0-20200817155316-9781c653f443 \
	golang.org/x/sys					 v0.0.0-20200930185726-fdedc70b468f \
	golang.org/x/sys					 v0.0.0-20201119102817-f84b799fce68 \
	golang.org/x/sys					 v0.0.0-20210228012217-479acdf4ea46 \
	golang.org/x/sys					 v0.0.0-20210423082822-04245dca01da \
	golang.org/x/sys					 v0.0.0-20210615035016-665e8c7367d1 \
	golang.org/x/sys					 v0.0.0-20220715151400-c0bba94af5f8 \
	golang.org/x/sys					 v0.0.0-20220811171246-fbc7d0a398ab \
	golang.org/x/sys					 v0.0.0-20220908164124-27713097b956 \
	golang.org/x/sys					 v0.1.0 \
	golang.org/x/sys					 v0.12.0 \
	golang.org/x/sys					 v0.15.0 \
	golang.org/x/sys					 v0.16.0 \
	golang.org/x/sys					 v0.17.0 \
	golang.org/x/sys					 v0.18.0 \
	golang.org/x/sys					 v0.6.0 \
	golang.org/x/term					 v0.0.0-20201117132131-f5c789dd3221 \
	golang.org/x/term					 v0.0.0-20201126162022-7de9c90e9dd1 \
	golang.org/x/text					 v0.12.0 \
	golang.org/x/text					 v0.13.0 \
	golang.org/x/text					 v0.14.0 \
	golang.org/x/text					 v0.3.0 \
	golang.org/x/text					 v0.3.2 \
	golang.org/x/text					 v0.3.3 \
	golang.org/x/text					 v0.3.6 \
	golang.org/x/text					 v0.3.7 \
	golang.org/x/time					 v0.3.0 \
	golang.org/x/tools					 v0.0.0-20180917221912-90fa682c2a6e \
	golang.org/x/tools					 v0.0.0-20191119224855-298f0cb1881e \
	golang.org/x/tools					 v0.0.0-20200619180055-7c47624df98f \
	golang.org/x/tools					 v0.0.0-20210106214847-113979e3529a \
	golang.org/x/tools					 v0.13.0 \
	golang.org/x/tools					 v0.17.0 \
	golang.org/x/xerrors					 v0.0.0-20190717185122-a985d3407aa7 \
	golang.org/x/xerrors					 v0.0.0-20191011141410-1b5146add898 \
	golang.org/x/xerrors					 v0.0.0-20191204190536-9bdfabe68543 \
	golang.org/x/xerrors					 v0.0.0-20200804184101-5ec99f83aff1 \
	google.golang.org/api					 v0.143.0 \
	google.golang.org/appengine				 v1.6.7 \
	google.golang.org/genproto				 v0.0.0-20230913181813-007df8e322eb \
	google.golang.org/genproto				 v0.0.0-20231106174013-bbf56f31fb17 \
	google.golang.org/genproto				 v0.0.0-20240116215550-a9fa1716bcac \
	google.golang.org/genproto/googleapis/api		 v0.0.0-20230913181813-007df8e322eb \
	google.golang.org/genproto/googleapis/api		 v0.0.0-20231106174013-bbf56f31fb17 \
	google.golang.org/genproto/googleapis/rpc		 v0.0.0-20230920204549-e6e6cdab5c13 \
	google.golang.org/genproto/googleapis/rpc		 v0.0.0-20231120223509-83a465c0220f \
	google.golang.org/genproto/googleapis/rpc		 v0.0.0-20231212172506-995d672761c0 \
	google.golang.org/grpc					 v1.58.2 \
	google.golang.org/grpc					 v1.59.0 \
	google.golang.org/grpc					 v1.61.0 \
	google.golang.org/protobuf				 v1.26.0 \
	google.golang.org/protobuf				 v1.26.0-rc.1 \
	google.golang.org/protobuf				 v1.31.0 \
	google.golang.org/protobuf				 v1.32.0 \
	gopkg.in/check.v1					 v0.0.0-20161208181325-20d25e280405 \
	gopkg.in/check.v1					 v1.0.0-20190902080502-41f04d3bba15 \
	gopkg.in/check.v1					 v1.0.0-20200227125254-8fa46927fb4f \
	gopkg.in/yaml.v2					 v2.2.2 \
	gopkg.in/yaml.v2					 v2.2.7 \
	gopkg.in/yaml.v3					 v3.0.0-20200313102051-9f266ea9e77c \
	sigs.k8s.io/yaml					 v1.1.0

