MODCARGO_CRATES +=	addr2line	0.25.1	# Apache-2.0 OR MIT
MODCARGO_CRATES +=	adler2	2.0.1	# 0BSD OR MIT OR Apache-2.0
MODCARGO_CRATES +=	aead	0.5.2	# MIT OR Apache-2.0
MODCARGO_CRATES +=	aes	0.8.4	# MIT OR Apache-2.0
MODCARGO_CRATES +=	aes-gcm	0.10.3	# Apache-2.0 OR MIT
MODCARGO_CRATES +=	ahash	0.8.12	# MIT OR Apache-2.0
MODCARGO_CRATES +=	aho-corasick	1.1.5	# Unlicense OR MIT
MODCARGO_CRATES +=	aliasable	0.1.3	# MIT
MODCARGO_CRATES +=	alloc-no-stdlib	2.0.4	# BSD-3-Clause
MODCARGO_CRATES +=	alloc-stdlib	0.2.4	# BSD-3-Clause
MODCARGO_CRATES +=	allocator-api2	0.2.21	# MIT OR Apache-2.0
MODCARGO_CRATES +=	android_system_properties	0.1.6	# MIT OR Apache-2.0
MODCARGO_CRATES +=	annotate-snippets	0.12.16	# MIT OR Apache-2.0
MODCARGO_CRATES +=	annotated-string	0.3.1	# MIT
MODCARGO_CRATES +=	anstream	1.0.0	# MIT OR Apache-2.0
MODCARGO_CRATES +=	anstyle	1.0.14	# MIT OR Apache-2.0
MODCARGO_CRATES +=	anstyle-parse	1.0.0	# MIT OR Apache-2.0
MODCARGO_CRATES +=	anstyle-query	1.1.5	# MIT OR Apache-2.0
MODCARGO_CRATES +=	anstyle-wincon	3.0.11	# MIT OR Apache-2.0
MODCARGO_CRATES +=	ar_archive_writer	0.5.3	# Apache-2.0 WITH LLVM-exception
MODCARGO_CRATES +=	arc-swap	1.9.2	# MIT OR Apache-2.0
MODCARGO_CRATES +=	array-const-fn-init	0.1.1	# MIT/Apache-2.0
MODCARGO_CRATES +=	arraydeque	0.5.1	# MIT/Apache-2.0
MODCARGO_CRATES +=	arrayref	0.3.9	# BSD-2-Clause
MODCARGO_CRATES +=	arrayvec	0.7.8	# MIT OR Apache-2.0
MODCARGO_CRATES +=	assert_cmd	2.2.2	# MIT OR Apache-2.0
MODCARGO_CRATES +=	assert_fs	1.1.4	# MIT OR Apache-2.0
MODCARGO_CRATES +=	async-trait	0.1.92	# MIT OR Apache-2.0
MODCARGO_CRATES +=	async_io_stream	0.3.3	# Unlicense
MODCARGO_CRATES +=	atomic-waker	1.1.2	# Apache-2.0 OR MIT
MODCARGO_CRATES +=	autocfg	1.5.1	# Apache-2.0 OR MIT
MODCARGO_CRATES +=	backon	1.6.0	# Apache-2.0
MODCARGO_CRATES +=	backtrace	0.3.76	# MIT OR Apache-2.0
MODCARGO_CRATES +=	base16ct	1.0.0	# Apache-2.0 OR MIT
MODCARGO_CRATES +=	base64	0.22.1	# MIT OR Apache-2.0
MODCARGO_CRATES +=	base64	0.23.1	# MIT OR Apache-2.0
MODCARGO_CRATES +=	base64ct	1.8.3	# Apache-2.0 OR MIT
MODCARGO_CRATES +=	bindgen	0.70.1	# BSD-3-Clause
MODCARGO_CRATES +=	bitflags	1.3.2	# MIT/Apache-2.0
MODCARGO_CRATES +=	bitflags	2.13.1	# MIT OR Apache-2.0
MODCARGO_CRATES +=	blake2	0.10.6	# MIT OR Apache-2.0
MODCARGO_CRATES +=	blake3	1.8.6	# CC0-1.0 OR Apache-2.0 OR Apache-2.0 WITH LLVM-exception
MODCARGO_CRATES +=	block-buffer	0.10.4	# MIT OR Apache-2.0
MODCARGO_CRATES +=	block-buffer	0.12.1	# MIT OR Apache-2.0
MODCARGO_CRATES +=	block2	0.6.2	# MIT
MODCARGO_CRATES +=	brotli	3.5.0	# BSD-3-Clause OR MIT
MODCARGO_CRATES +=	brotli-decompressor	2.5.1	# BSD-3-Clause/MIT
MODCARGO_CRATES +=	bstr	1.13.1	# MIT OR Apache-2.0
MODCARGO_CRATES +=	bumpalo	3.20.3	# MIT OR Apache-2.0
MODCARGO_CRATES +=	byteorder	1.5.0	# Unlicense OR MIT
MODCARGO_CRATES +=	bytes	1.12.1	# MIT
MODCARGO_CRATES +=	cc	1.4.2	# MIT OR Apache-2.0
MODCARGO_CRATES +=	cesu8	1.1.0	# Apache-2.0/MIT
MODCARGO_CRATES +=	cexpr	0.6.0	# Apache-2.0/MIT
MODCARGO_CRATES +=	cf-rustracing	1.2.1	# MIT
MODCARGO_CRATES +=	cf-rustracing-jaeger	1.2.2	# MIT
MODCARGO_CRATES +=	cfg-if	1.0.4	# MIT OR Apache-2.0
MODCARGO_CRATES +=	cfg_aliases	0.2.2	# MIT
MODCARGO_CRATES +=	chacha20	0.10.1	# MIT OR Apache-2.0
MODCARGO_CRATES +=	chrono	0.4.45	# MIT OR Apache-2.0
MODCARGO_CRATES +=	cipher	0.4.4	# MIT OR Apache-2.0
MODCARGO_CRATES +=	clang-sys	1.9.1	# Apache-2.0
MODCARGO_CRATES +=	clap	4.6.6	# MIT OR Apache-2.0
MODCARGO_CRATES +=	clap_builder	4.6.6	# MIT OR Apache-2.0
MODCARGO_CRATES +=	clap_complete	4.6.9	# MIT OR Apache-2.0
MODCARGO_CRATES +=	clap_derive	4.6.4	# MIT OR Apache-2.0
MODCARGO_CRATES +=	clap_lex	1.1.0	# MIT OR Apache-2.0
MODCARGO_CRATES +=	clap_mangen	0.2.33	# MIT OR Apache-2.0
MODCARGO_CRATES +=	cmake	0.1.58	# MIT OR Apache-2.0
MODCARGO_CRATES +=	cmov	0.5.4	# Apache-2.0 OR MIT
MODCARGO_CRATES +=	cobs	0.3.0	# MIT OR Apache-2.0
MODCARGO_CRATES +=	colorchoice	1.0.5	# MIT OR Apache-2.0
MODCARGO_CRATES +=	combine	4.6.7	# MIT
MODCARGO_CRATES +=	console	0.16.4	# MIT
MODCARGO_CRATES +=	const-oid	0.10.2	# Apache-2.0 OR MIT
MODCARGO_CRATES +=	constant_time_eq	0.4.2	# CC0-1.0 OR MIT-0 OR Apache-2.0
MODCARGO_CRATES +=	convert_case	0.10.0	# MIT
MODCARGO_CRATES +=	cordyceps	0.3.5	# MIT
MODCARGO_CRATES +=	core-foundation	0.9.4	# MIT OR Apache-2.0
MODCARGO_CRATES +=	core-foundation	0.10.1	# MIT OR Apache-2.0
MODCARGO_CRATES +=	core-foundation-sys	0.8.7	# MIT OR Apache-2.0
MODCARGO_CRATES +=	cpufeatures	0.2.17	# MIT OR Apache-2.0
MODCARGO_CRATES +=	cpufeatures	0.3.0	# MIT OR Apache-2.0
MODCARGO_CRATES +=	crc32fast	1.5.1	# MIT OR Apache-2.0
MODCARGO_CRATES +=	critical-section	1.2.0	# MIT OR Apache-2.0
MODCARGO_CRATES +=	crossbeam-channel	0.5.16	# MIT OR Apache-2.0
MODCARGO_CRATES +=	crossbeam-deque	0.8.7	# MIT OR Apache-2.0
MODCARGO_CRATES +=	crossbeam-epoch	0.9.20	# MIT OR Apache-2.0
MODCARGO_CRATES +=	crossbeam-queue	0.3.13	# MIT OR Apache-2.0
MODCARGO_CRATES +=	crossbeam-utils	0.8.22	# MIT OR Apache-2.0
MODCARGO_CRATES +=	crypto-common	0.1.7	# MIT OR Apache-2.0
MODCARGO_CRATES +=	crypto-common	0.2.2	# MIT OR Apache-2.0
MODCARGO_CRATES +=	ctr	0.9.2	# MIT OR Apache-2.0
MODCARGO_CRATES +=	ctutils	0.4.2	# Apache-2.0 OR MIT
MODCARGO_CRATES +=	curve25519-dalek	5.0.0	# BSD-3-Clause
MODCARGO_CRATES +=	curve25519-dalek-derive	0.1.1	# MIT/Apache-2.0
MODCARGO_CRATES +=	daemonize	0.5.0	# MIT/Apache-2.0
MODCARGO_CRATES +=	daggy	0.8.1	# MIT/Apache-2.0
MODCARGO_CRATES +=	darling	0.20.11	# MIT
MODCARGO_CRATES +=	darling_core	0.20.11	# MIT
MODCARGO_CRATES +=	darling_macro	0.20.11	# MIT
MODCARGO_CRATES +=	data-encoding	2.11.1	# MIT
MODCARGO_CRATES +=	data-encoding-macro	0.1.21	# MIT
MODCARGO_CRATES +=	data-encoding-macro-internal	0.1.19	# MIT
MODCARGO_CRATES +=	der	0.8.1	# Apache-2.0 OR MIT
MODCARGO_CRATES +=	deranged	0.5.8	# MIT OR Apache-2.0
MODCARGO_CRATES +=	derivative	2.2.0	# MIT/Apache-2.0
MODCARGO_CRATES +=	derive_builder	0.20.2	# MIT OR Apache-2.0
MODCARGO_CRATES +=	derive_builder_core	0.20.2	# MIT OR Apache-2.0
MODCARGO_CRATES +=	derive_builder_macro	0.20.2	# MIT OR Apache-2.0
MODCARGO_CRATES +=	derive_more	1.0.0	# MIT
MODCARGO_CRATES +=	derive_more	2.1.1	# MIT
MODCARGO_CRATES +=	derive_more-impl	1.0.0	# MIT
MODCARGO_CRATES +=	derive_more-impl	2.1.1	# MIT
MODCARGO_CRATES +=	diatomic-waker	0.2.3	# MIT OR Apache-2.0
MODCARGO_CRATES +=	difflib	0.4.0	# MIT
MODCARGO_CRATES +=	digest	0.10.7	# MIT OR Apache-2.0
MODCARGO_CRATES +=	digest	0.11.3	# MIT OR Apache-2.0
MODCARGO_CRATES +=	dispatch2	0.3.1	# Zlib OR Apache-2.0 OR MIT
MODCARGO_CRATES +=	displaydoc	0.2.7	# MIT OR Apache-2.0
MODCARGO_CRATES +=	dlopen2	0.8.2	# MIT
MODCARGO_CRATES +=	drop_bomb	0.1.5	# MIT OR Apache-2.0
MODCARGO_CRATES +=	dyn-clone	1.0.20	# MIT OR Apache-2.0
MODCARGO_CRATES +=	ed25519	3.0.0	# Apache-2.0 OR MIT
MODCARGO_CRATES +=	ed25519-dalek	3.0.0	# BSD-3-Clause
MODCARGO_CRATES +=	educe	0.7.6	# MIT
MODCARGO_CRATES +=	either	1.17.0	# MIT OR Apache-2.0
MODCARGO_CRATES +=	embedded-io	0.4.0	# MIT OR Apache-2.0
MODCARGO_CRATES +=	embedded-io	0.6.1	# MIT OR Apache-2.0
MODCARGO_CRATES +=	encode_unicode	1.0.0	# Apache-2.0 OR MIT
MODCARGO_CRATES +=	encoding_rs	0.8.35	# (Apache-2.0 OR MIT) AND BSD-3-Clause
MODCARGO_CRATES +=	encoding_rs_io	0.1.8	# MIT OR Apache-2.0
MODCARGO_CRATES +=	enum-assoc	1.3.0	# MIT OR Apache-2.0
MODCARGO_CRATES +=	enum-ordinalize	4.4.2	# MIT
MODCARGO_CRATES +=	enum-ordinalize-derive	4.4.2	# MIT
MODCARGO_CRATES +=	equivalent	1.0.2	# Apache-2.0 OR MIT
MODCARGO_CRATES +=	errno	0.3.14	# MIT OR Apache-2.0
MODCARGO_CRATES +=	extension-trait	1.0.2	# MIT OR Apache-2.0
MODCARGO_CRATES +=	fastrand	2.5.0	# Apache-2.0 OR MIT
MODCARGO_CRATES +=	fiat-crypto	0.3.0	# MIT OR Apache-2.0 OR BSD-1-Clause
MODCARGO_CRATES +=	find-msvc-tools	0.1.10	# MIT OR Apache-2.0
MODCARGO_CRATES +=	fixedbitset	0.5.7	# MIT OR Apache-2.0
MODCARGO_CRATES +=	flate2	1.1.9	# MIT OR Apache-2.0
MODCARGO_CRATES +=	float-cmp	0.10.0	# MIT
MODCARGO_CRATES +=	fnv	1.0.7	# Apache-2.0 / MIT
MODCARGO_CRATES +=	foldhash	0.2.0	# Zlib
MODCARGO_CRATES +=	form_urlencoded	1.2.2	# MIT OR Apache-2.0
MODCARGO_CRATES +=	futures	0.3.34	# MIT OR Apache-2.0
MODCARGO_CRATES +=	futures-buffered	0.2.13	# MIT
MODCARGO_CRATES +=	futures-channel	0.3.34	# MIT OR Apache-2.0
MODCARGO_CRATES +=	futures-core	0.3.34	# MIT OR Apache-2.0
MODCARGO_CRATES +=	futures-executor	0.3.34	# MIT OR Apache-2.0
MODCARGO_CRATES +=	futures-io	0.3.34	# MIT OR Apache-2.0
MODCARGO_CRATES +=	futures-lite	2.6.1	# Apache-2.0 OR MIT
MODCARGO_CRATES +=	futures-macro	0.3.34	# MIT OR Apache-2.0
MODCARGO_CRATES +=	futures-sink	0.3.34	# MIT OR Apache-2.0
MODCARGO_CRATES +=	futures-task	0.3.34	# MIT OR Apache-2.0
MODCARGO_CRATES +=	futures-util	0.3.34	# MIT OR Apache-2.0
MODCARGO_CRATES +=	generator	0.8.9	# MIT/Apache-2.0
MODCARGO_CRATES +=	generic-array	0.14.7	# MIT
MODCARGO_CRATES +=	getrandom	0.2.17	# MIT OR Apache-2.0
MODCARGO_CRATES +=	getrandom	0.3.4	# MIT OR Apache-2.0
MODCARGO_CRATES +=	getrandom	0.4.3	# MIT OR Apache-2.0
MODCARGO_CRATES +=	getset	0.1.7	# MIT
MODCARGO_CRATES +=	ghash	0.5.1	# Apache-2.0 OR MIT
MODCARGO_CRATES +=	gimli	0.32.3	# MIT OR Apache-2.0
MODCARGO_CRATES +=	glob	0.3.4	# MIT OR Apache-2.0
MODCARGO_CRATES +=	globset	0.4.20	# Unlicense OR MIT
MODCARGO_CRATES +=	globwalk	0.9.1	# MIT
MODCARGO_CRATES +=	gloo-timers	0.3.0	# MIT OR Apache-2.0
MODCARGO_CRATES +=	granit-parser	0.0.7	# MIT OR Apache-2.0
MODCARGO_CRATES +=	h2	0.4.18	# MIT
MODCARGO_CRATES +=	hashbrown	0.12.3	# MIT OR Apache-2.0
MODCARGO_CRATES +=	hashbrown	0.16.1	# MIT OR Apache-2.0
MODCARGO_CRATES +=	hashbrown	0.17.1	# MIT OR Apache-2.0
MODCARGO_CRATES +=	heck	0.4.1	# MIT OR Apache-2.0
MODCARGO_CRATES +=	heck	0.5.0	# MIT OR Apache-2.0
MODCARGO_CRATES +=	hermit-abi	0.5.2	# MIT OR Apache-2.0
MODCARGO_CRATES +=	hex	0.4.3	# MIT OR Apache-2.0
MODCARGO_CRATES +=	hi-doc	0.3.1	# MIT
MODCARGO_CRATES +=	hi-doc-jumprope	1.2.1	# ISC OR Apache-2.0
MODCARGO_CRATES +=	hickory-net	0.26.1	# MIT OR Apache-2.0
MODCARGO_CRATES +=	hickory-proto	0.26.1	# MIT OR Apache-2.0
MODCARGO_CRATES +=	hickory-resolver	0.26.1	# MIT OR Apache-2.0
MODCARGO_CRATES +=	hostname	0.4.2	# MIT
MODCARGO_CRATES +=	http	1.5.0	# MIT OR Apache-2.0
MODCARGO_CRATES +=	http-body	1.1.0	# MIT
MODCARGO_CRATES +=	http-body-util	0.1.4	# MIT
MODCARGO_CRATES +=	httparse	1.10.1	# MIT OR Apache-2.0
MODCARGO_CRATES +=	httpdate	1.0.3	# MIT OR Apache-2.0
MODCARGO_CRATES +=	hybrid-array	0.4.14	# MIT OR Apache-2.0
MODCARGO_CRATES +=	hyper	1.11.0	# MIT
MODCARGO_CRATES +=	hyper-rustls	0.27.9	# Apache-2.0 OR ISC OR MIT
MODCARGO_CRATES +=	hyper-util	0.1.20	# MIT
MODCARGO_CRATES +=	iana-time-zone	0.1.65	# MIT OR Apache-2.0
MODCARGO_CRATES +=	iana-time-zone-haiku	0.1.2	# MIT OR Apache-2.0
MODCARGO_CRATES +=	icu_collections	2.2.0	# Unicode-3.0
MODCARGO_CRATES +=	icu_locale_core	2.2.0	# Unicode-3.0
MODCARGO_CRATES +=	icu_normalizer	2.2.0	# Unicode-3.0
MODCARGO_CRATES +=	icu_normalizer_data	2.2.0	# Unicode-3.0
MODCARGO_CRATES +=	icu_properties	2.2.0	# Unicode-3.0
MODCARGO_CRATES +=	icu_properties_data	2.2.0	# Unicode-3.0
MODCARGO_CRATES +=	icu_provider	2.2.0	# Unicode-3.0
MODCARGO_CRATES +=	ident_case	1.0.1	# MIT/Apache-2.0
MODCARGO_CRATES +=	identity-hash	0.1.0	# Apache-2.0 OR MIT
MODCARGO_CRATES +=	idna	1.1.0	# MIT OR Apache-2.0
MODCARGO_CRATES +=	idna_adapter	1.2.2	# Apache-2.0 OR MIT
MODCARGO_CRATES +=	ignore	0.4.33	# Unlicense OR MIT
MODCARGO_CRATES +=	indexmap	1.9.3	# Apache-2.0 OR MIT
MODCARGO_CRATES +=	indexmap	2.14.0	# Apache-2.0 OR MIT
MODCARGO_CRATES +=	inout	0.1.4	# MIT OR Apache-2.0
MODCARGO_CRATES +=	insta	1.48.0	# Apache-2.0
MODCARGO_CRATES +=	ipconfig	0.3.4	# MIT/Apache-2.0
MODCARGO_CRATES +=	ipnet	2.12.1	# MIT OR Apache-2.0
MODCARGO_CRATES +=	ipset_derive	0.1.1	# MIT
MODCARGO_CRATES +=	iroh	1.0.3	# MIT OR Apache-2.0
MODCARGO_CRATES +=	iroh-base	1.0.3	# MIT OR Apache-2.0
MODCARGO_CRATES +=	iroh-dns	1.0.3	# MIT OR Apache-2.0
MODCARGO_CRATES +=	iroh-metrics	1.0.1	# MIT OR Apache-2.0
MODCARGO_CRATES +=	iroh-metrics-derive	1.0.1	# MIT OR Apache-2.0
MODCARGO_CRATES +=	iroh-relay	1.0.3	# MIT OR Apache-2.0
MODCARGO_CRATES +=	is_terminal_polyfill	1.70.2	# MIT OR Apache-2.0
MODCARGO_CRATES +=	itertools	0.13.0	# MIT OR Apache-2.0
MODCARGO_CRATES +=	itertools	0.14.0	# MIT OR Apache-2.0
MODCARGO_CRATES +=	itoa	1.0.18	# MIT OR Apache-2.0
MODCARGO_CRATES +=	jni	0.21.1	# MIT/Apache-2.0
MODCARGO_CRATES +=	jni	0.22.4	# MIT OR Apache-2.0
MODCARGO_CRATES +=	jni-macros	0.22.4	# MIT OR Apache-2.0
MODCARGO_CRATES +=	jni-sys	0.3.1	# MIT OR Apache-2.0
MODCARGO_CRATES +=	jni-sys	0.4.1	# MIT OR Apache-2.0
MODCARGO_CRATES +=	jni-sys-macros	0.4.1	# MIT OR Apache-2.0
MODCARGO_CRATES +=	jobserver	0.1.35	# MIT OR Apache-2.0
MODCARGO_CRATES +=	jrsonnet-gcmodule	0.5.0	# MIT
MODCARGO_CRATES +=	jrsonnet-gcmodule-derive	0.5.0	# MIT
MODCARGO_CRATES +=	js-sys	0.3.105	# MIT OR Apache-2.0
MODCARGO_CRATES +=	keccak	0.2.1	# Apache-2.0 OR MIT
MODCARGO_CRATES +=	lazy_static	1.5.0	# MIT OR Apache-2.0
MODCARGO_CRATES +=	libc	0.2.189	# MIT OR Apache-2.0
MODCARGO_CRATES +=	libloading	0.8.9	# ISC
MODCARGO_CRATES +=	libnftables1-sys	1.0.0	# GPL-2.0
MODCARGO_CRATES +=	libz-ng-sys	1.1.29	# MIT OR Apache-2.0
MODCARGO_CRATES +=	linux-raw-sys	0.12.1	# Apache-2.0 WITH LLVM-exception OR Apache-2.0 OR MIT
MODCARGO_CRATES +=	litemap	0.8.2	# Unicode-3.0
MODCARGO_CRATES +=	local-ip-address	0.6.13	# MIT OR Apache-2.0
MODCARGO_CRATES +=	lock_api	0.4.14	# MIT OR Apache-2.0
MODCARGO_CRATES +=	log	0.4.33	# MIT OR Apache-2.0
MODCARGO_CRATES +=	logos	0.16.1	# MIT OR Apache-2.0
MODCARGO_CRATES +=	logos-codegen	0.16.1	# MIT OR Apache-2.0
MODCARGO_CRATES +=	logos-derive	0.16.1	# MIT OR Apache-2.0
MODCARGO_CRATES +=	loom	0.7.2	# MIT
MODCARGO_CRATES +=	lru	0.16.4	# MIT
MODCARGO_CRATES +=	lru	0.18.2	# MIT
MODCARGO_CRATES +=	lru-slab	0.1.2	# MIT OR Apache-2.0 OR Zlib
MODCARGO_CRATES +=	mac-addr	0.3.0	# MIT
MODCARGO_CRATES +=	matchers	0.2.0	# MIT
MODCARGO_CRATES +=	md5	0.8.1	# Apache-2.0 OR MIT
MODCARGO_CRATES +=	memchr	2.8.3	# Unlicense OR MIT
MODCARGO_CRATES +=	memoffset	0.6.5	# MIT
MODCARGO_CRATES +=	minimal-lexical	0.2.1	# MIT/Apache-2.0
MODCARGO_CRATES +=	miniz_oxide	0.8.9	# MIT OR Zlib OR Apache-2.0
MODCARGO_CRATES +=	mio	1.2.2	# MIT
MODCARGO_CRATES +=	moka	0.12.16	# (MIT OR Apache-2.0) AND Apache-2.0
MODCARGO_CRATES +=	n0-error	1.0.0	# MIT OR Apache-2.0
MODCARGO_CRATES +=	n0-error-macros	1.0.0	# MIT OR Apache-2.0
MODCARGO_CRATES +=	n0-future	0.3.2	# MIT OR Apache-2.0
MODCARGO_CRATES +=	n0-watcher	1.0.0	# MIT OR Apache-2.0
MODCARGO_CRATES +=	ndk-context	0.1.1	# MIT OR Apache-2.0
MODCARGO_CRATES +=	neli	0.7.4	# BSD-3-Clause
MODCARGO_CRATES +=	neli-proc-macros	0.2.2	# BSD-3-Clause
MODCARGO_CRATES +=	netdev	0.45.0	# MIT
MODCARGO_CRATES +=	netlink-packet-core	0.8.2	# MIT
MODCARGO_CRATES +=	netlink-packet-route	0.31.0	# MIT
MODCARGO_CRATES +=	netlink-proto	0.12.1	# MIT
MODCARGO_CRATES +=	netlink-sys	0.8.8	# MIT
MODCARGO_CRATES +=	netwatch	0.19.1	# MIT OR Apache-2.0
MODCARGO_CRATES +=	nftables	0.6.3	# MIT OR Apache-2.0
MODCARGO_CRATES +=	nix	0.24.3	# MIT
MODCARGO_CRATES +=	nix	0.29.0	# MIT
MODCARGO_CRATES +=	nohash-hasher	0.2.0	# Apache-2.0 OR MIT
MODCARGO_CRATES +=	nom	7.1.3	# MIT
MODCARGO_CRATES +=	noq	1.1.1	# MIT OR Apache-2.0
MODCARGO_CRATES +=	noq-proto	1.1.1	# MIT OR Apache-2.0
MODCARGO_CRATES +=	noq-udp	1.1.1	# MIT OR Apache-2.0
MODCARGO_CRATES +=	normalize-line-endings	0.3.0	# Apache-2.0
MODCARGO_CRATES +=	nu-ansi-term	0.50.3	# MIT
MODCARGO_CRATES +=	num-bigint	0.5.1	# MIT OR Apache-2.0
MODCARGO_CRATES +=	num-conv	0.2.2	# MIT OR Apache-2.0
MODCARGO_CRATES +=	num-integer	0.1.47	# MIT OR Apache-2.0
MODCARGO_CRATES +=	num-traits	0.2.19	# MIT OR Apache-2.0
MODCARGO_CRATES +=	num_cpus	1.17.0	# MIT OR Apache-2.0
MODCARGO_CRATES +=	num_enum	0.7.6	# BSD-3-Clause OR MIT OR Apache-2.0
MODCARGO_CRATES +=	num_enum_derive	0.7.6	# BSD-3-Clause OR MIT OR Apache-2.0
MODCARGO_CRATES +=	objc2	0.6.4	# MIT
MODCARGO_CRATES +=	objc2-core-foundation	0.3.2	# Zlib OR Apache-2.0 OR MIT
MODCARGO_CRATES +=	objc2-core-wlan	0.3.2	# Zlib OR Apache-2.0 OR MIT
MODCARGO_CRATES +=	objc2-encode	4.1.0	# MIT
MODCARGO_CRATES +=	objc2-foundation	0.3.2	# MIT
MODCARGO_CRATES +=	objc2-security	0.3.2	# Zlib OR Apache-2.0 OR MIT
MODCARGO_CRATES +=	objc2-security-foundation	0.3.2	# Zlib OR Apache-2.0 OR MIT
MODCARGO_CRATES +=	objc2-system-configuration	0.3.2	# Zlib OR Apache-2.0 OR MIT
MODCARGO_CRATES +=	object	0.37.3	# Apache-2.0 OR MIT
MODCARGO_CRATES +=	object	0.39.1	# Apache-2.0 OR MIT
MODCARGO_CRATES +=	once_cell	1.21.4	# MIT OR Apache-2.0
MODCARGO_CRATES +=	once_cell_polyfill	1.70.2	# MIT OR Apache-2.0
MODCARGO_CRATES +=	opaque-debug	0.3.1	# MIT OR Apache-2.0
MODCARGO_CRATES +=	openssl-probe	0.1.6	# MIT/Apache-2.0
MODCARGO_CRATES +=	openssl-probe	0.2.1	# MIT OR Apache-2.0
MODCARGO_CRATES +=	ouroboros	0.18.5	# MIT OR Apache-2.0
MODCARGO_CRATES +=	ouroboros_macro	0.18.5	# MIT OR Apache-2.0
MODCARGO_CRATES +=	papaya	0.2.4	# MIT
MODCARGO_CRATES +=	parking	2.2.1	# Apache-2.0 OR MIT
MODCARGO_CRATES +=	parking_lot	0.12.5	# MIT OR Apache-2.0
MODCARGO_CRATES +=	parking_lot_core	0.9.12	# MIT OR Apache-2.0
MODCARGO_CRATES +=	paste	1.0.15	# MIT OR Apache-2.0
MODCARGO_CRATES +=	pathdiff	0.2.3	# MIT/Apache-2.0
MODCARGO_CRATES +=	peg	0.8.6	# MIT
MODCARGO_CRATES +=	peg-macros	0.8.6	# MIT
MODCARGO_CRATES +=	peg-runtime	0.8.6	# MIT
MODCARGO_CRATES +=	pem-rfc7468	1.0.0	# Apache-2.0 OR MIT
MODCARGO_CRATES +=	percent-encoding	2.3.2	# MIT OR Apache-2.0
MODCARGO_CRATES +=	petgraph	0.7.1	# MIT OR Apache-2.0
MODCARGO_CRATES +=	pharos	0.5.3	# Unlicense
MODCARGO_CRATES +=	pin-project	1.1.13	# Apache-2.0 OR MIT
MODCARGO_CRATES +=	pin-project-internal	1.1.13	# Apache-2.0 OR MIT
MODCARGO_CRATES +=	pin-project-lite	0.2.17	# Apache-2.0 OR MIT
MODCARGO_CRATES +=	pingora-cache	0.8.1	# Apache-2.0
MODCARGO_CRATES +=	pingora-core	0.8.1	# Apache-2.0
MODCARGO_CRATES +=	pingora-error	0.8.1	# Apache-2.0
MODCARGO_CRATES +=	pingora-header-serde	0.8.1	# Apache-2.0
MODCARGO_CRATES +=	pingora-http	0.8.1	# Apache-2.0
MODCARGO_CRATES +=	pingora-lru	0.8.1	# Apache-2.0
MODCARGO_CRATES +=	pingora-pool	0.8.1	# Apache-2.0
MODCARGO_CRATES +=	pingora-proxy	0.8.1	# Apache-2.0
MODCARGO_CRATES +=	pingora-runtime	0.8.1	# Apache-2.0
MODCARGO_CRATES +=	pingora-timeout	0.8.1	# Apache-2.0
MODCARGO_CRATES +=	pkcs8	0.11.0	# Apache-2.0 OR MIT
MODCARGO_CRATES +=	pkg-config	0.3.33	# MIT OR Apache-2.0
MODCARGO_CRATES +=	plist	1.10.0	# MIT
MODCARGO_CRATES +=	polyval	0.6.2	# Apache-2.0 OR MIT
MODCARGO_CRATES +=	portable-atomic	1.15.0	# Apache-2.0 OR MIT
MODCARGO_CRATES +=	postbag	0.4.3	# Apache-2.0
MODCARGO_CRATES +=	postcard	1.1.3	# MIT OR Apache-2.0
MODCARGO_CRATES +=	postcard-derive	0.2.2	# MIT OR Apache-2.0
MODCARGO_CRATES +=	potential_utf	0.1.5	# Unicode-3.0
MODCARGO_CRATES +=	powerfmt	0.2.0	# MIT OR Apache-2.0
MODCARGO_CRATES +=	ppv-lite86	0.2.21	# MIT OR Apache-2.0
MODCARGO_CRATES +=	predicates	3.1.4	# MIT OR Apache-2.0
MODCARGO_CRATES +=	predicates-core	1.0.10	# MIT OR Apache-2.0
MODCARGO_CRATES +=	predicates-tree	1.0.13	# MIT OR Apache-2.0
MODCARGO_CRATES +=	prefix-trie	0.8.4	# MIT OR Apache-2.0
MODCARGO_CRATES +=	prefix-trie	0.10.1	# MIT OR Apache-2.0
MODCARGO_CRATES +=	prettyplease	0.2.37	# MIT OR Apache-2.0
MODCARGO_CRATES +=	proc-macro-crate	3.5.0	# MIT OR Apache-2.0
MODCARGO_CRATES +=	proc-macro2	1.0.107	# MIT OR Apache-2.0
MODCARGO_CRATES +=	proc-macro2-diagnostics	0.10.1	# MIT/Apache-2.0
MODCARGO_CRATES +=	prometheus	0.13.4	# Apache-2.0
MODCARGO_CRATES +=	protobuf	2.28.0	# MIT
MODCARGO_CRATES +=	psm	0.1.32	# MIT OR Apache-2.0
MODCARGO_CRATES +=	quick-xml	0.41.0	# MIT
MODCARGO_CRATES +=	quote	1.0.47	# MIT OR Apache-2.0
MODCARGO_CRATES +=	r-efi	5.3.0	# MIT OR Apache-2.0 OR LGPL-2.1-or-later
MODCARGO_CRATES +=	r-efi	6.0.0	# MIT OR Apache-2.0 OR LGPL-2.1-or-later
MODCARGO_CRATES +=	rand	0.8.7	# MIT OR Apache-2.0
MODCARGO_CRATES +=	rand	0.9.5	# MIT OR Apache-2.0
MODCARGO_CRATES +=	rand	0.10.2	# MIT OR Apache-2.0
MODCARGO_CRATES +=	rand_chacha	0.3.1	# MIT OR Apache-2.0
MODCARGO_CRATES +=	rand_chacha	0.9.0	# MIT OR Apache-2.0
MODCARGO_CRATES +=	rand_core	0.6.4	# MIT OR Apache-2.0
MODCARGO_CRATES +=	rand_core	0.9.5	# MIT OR Apache-2.0
MODCARGO_CRATES +=	rand_core	0.10.1	# MIT OR Apache-2.0
MODCARGO_CRATES +=	rand_pcg	0.10.2	# MIT OR Apache-2.0
MODCARGO_CRATES +=	random_color	1.1.0	# MIT
MODCARGO_CRATES +=	range-map	0.2.0	# MIT/Apache-2.0
MODCARGO_CRATES +=	redox_syscall	0.5.18	# MIT
MODCARGO_CRATES +=	ref-cast	1.0.26	# MIT OR Apache-2.0
MODCARGO_CRATES +=	ref-cast-impl	1.0.26	# MIT OR Apache-2.0
MODCARGO_CRATES +=	regex	1.13.1	# MIT OR Apache-2.0
MODCARGO_CRATES +=	regex-automata	0.4.18	# MIT OR Apache-2.0
MODCARGO_CRATES +=	regex-syntax	0.8.11	# MIT OR Apache-2.0
MODCARGO_CRATES +=	remoc	0.18.3	# Apache-2.0
MODCARGO_CRATES +=	remoc_macro	0.18.3	# Apache-2.0
MODCARGO_CRATES +=	reqwest	0.13.5	# MIT OR Apache-2.0
MODCARGO_CRATES +=	resolv-conf	0.7.6	# MIT OR Apache-2.0
MODCARGO_CRATES +=	ring	0.17.14	# Apache-2.0 AND ISC
MODCARGO_CRATES +=	rmp	0.8.15	# MIT
MODCARGO_CRATES +=	rmp-serde	1.3.1	# MIT
MODCARGO_CRATES +=	roff	1.1.1	# MIT OR Apache-2.0
MODCARGO_CRATES +=	rust_decimal	1.42.1	# MIT
MODCARGO_CRATES +=	rustc-demangle	0.1.28	# MIT/Apache-2.0
MODCARGO_CRATES +=	rustc-hash	1.1.0	# Apache-2.0/MIT
MODCARGO_CRATES +=	rustc-hash	2.1.3	# Apache-2.0 OR MIT
MODCARGO_CRATES +=	rustc_version	0.4.1	# MIT OR Apache-2.0
MODCARGO_CRATES +=	rustix	1.1.4	# Apache-2.0 WITH LLVM-exception OR Apache-2.0 OR MIT
MODCARGO_CRATES +=	rustls	0.23.43	# Apache-2.0 OR ISC OR MIT
MODCARGO_CRATES +=	rustls-native-certs	0.8.4	# Apache-2.0 OR ISC OR MIT
MODCARGO_CRATES +=	rustls-pki-types	1.15.1	# MIT OR Apache-2.0
MODCARGO_CRATES +=	rustls-platform-verifier	0.6.2	# MIT OR Apache-2.0
MODCARGO_CRATES +=	rustls-platform-verifier-android	0.1.1	# MIT OR Apache-2.0
MODCARGO_CRATES +=	rustls-webpki	0.103.14	# ISC
MODCARGO_CRATES +=	rustversion	1.0.23	# MIT OR Apache-2.0
MODCARGO_CRATES +=	ryu	1.0.23	# Apache-2.0 OR BSL-1.0
MODCARGO_CRATES +=	same-file	1.0.6	# Unlicense/MIT
MODCARGO_CRATES +=	saphyr-parser-bw	0.0.611	# MIT OR Apache-2.0
MODCARGO_CRATES +=	schannel	0.1.29	# MIT
MODCARGO_CRATES +=	schemars	1.2.2	# MIT
MODCARGO_CRATES +=	schemars_derive	1.2.2	# MIT
MODCARGO_CRATES +=	scoped-tls	1.0.1	# MIT/Apache-2.0
MODCARGO_CRATES +=	scopeguard	1.2.0	# MIT OR Apache-2.0
MODCARGO_CRATES +=	security-framework	3.7.0	# MIT OR Apache-2.0
MODCARGO_CRATES +=	security-framework-sys	2.17.0	# MIT OR Apache-2.0
MODCARGO_CRATES +=	seize	0.5.1	# MIT
MODCARGO_CRATES +=	semver	1.0.28	# MIT OR Apache-2.0
MODCARGO_CRATES +=	send_wrapper	0.6.0	# MIT/Apache-2.0
MODCARGO_CRATES +=	serde	1.0.229	# MIT OR Apache-2.0
MODCARGO_CRATES +=	serde-saphyr	0.0.25	# MIT OR Apache-2.0
MODCARGO_CRATES +=	serde-saphyr	0.0.29	# MIT OR Apache-2.0
MODCARGO_CRATES +=	serde_bytes	0.11.19	# MIT OR Apache-2.0
MODCARGO_CRATES +=	serde_core	1.0.229	# MIT OR Apache-2.0
MODCARGO_CRATES +=	serde_derive	1.0.229	# MIT OR Apache-2.0
MODCARGO_CRATES +=	serde_derive_internals	0.30.0	# MIT OR Apache-2.0
MODCARGO_CRATES +=	serde_json	1.0.151	# MIT OR Apache-2.0
MODCARGO_CRATES +=	serde_json_borrow	0.9.0	# MIT
MODCARGO_CRATES +=	serde_path_to_error	0.1.20	# MIT OR Apache-2.0
MODCARGO_CRATES +=	serde_yaml	0.9.34+deprecated	# MIT OR Apache-2.0
MODCARGO_CRATES +=	serdect	0.4.3	# Apache-2.0 OR MIT
MODCARGO_CRATES +=	sfv	0.10.4	# MIT/Apache-2.0
MODCARGO_CRATES +=	sha1	0.11.0	# MIT OR Apache-2.0
MODCARGO_CRATES +=	sha1_smol	1.0.1	# BSD-3-Clause
MODCARGO_CRATES +=	sha2	0.11.0	# MIT OR Apache-2.0
MODCARGO_CRATES +=	sha3	0.12.0	# MIT OR Apache-2.0
MODCARGO_CRATES +=	sharded-slab	0.1.7	# MIT
MODCARGO_CRATES +=	shlex	1.3.0	# MIT OR Apache-2.0
MODCARGO_CRATES +=	shlex	2.0.1	# MIT OR Apache-2.0
MODCARGO_CRATES +=	signal-hook-registry	1.4.8	# MIT OR Apache-2.0
MODCARGO_CRATES +=	signature	3.0.0	# Apache-2.0 OR MIT
MODCARGO_CRATES +=	simd-adler32	0.3.10	# MIT
MODCARGO_CRATES +=	simd_cesu8	1.2.0	# Apache-2.0 OR MIT
MODCARGO_CRATES +=	simdutf8	0.1.5	# MIT OR Apache-2.0
MODCARGO_CRATES +=	similar	2.7.0	# Apache-2.0
MODCARGO_CRATES +=	simple-dns	0.11.3	# MIT
MODCARGO_CRATES +=	slab	0.4.12	# MIT
MODCARGO_CRATES +=	smallvec	1.15.2	# MIT OR Apache-2.0
MODCARGO_CRATES +=	socket2	0.6.5	# MIT OR Apache-2.0
MODCARGO_CRATES +=	sorted-index-buffer	0.2.1	# MIT OR Apache-2.0
MODCARGO_CRATES +=	spez	0.1.2	# BSD-2-Clause
MODCARGO_CRATES +=	spin	0.10.1	# MIT
MODCARGO_CRATES +=	spki	0.8.0	# Apache-2.0 OR MIT
MODCARGO_CRATES +=	sponge-cursor	0.1.0	# MIT OR Apache-2.0
MODCARGO_CRATES +=	stable_deref_trait	1.2.1	# MIT OR Apache-2.0
MODCARGO_CRATES +=	stacker	0.1.25	# MIT OR Apache-2.0
MODCARGO_CRATES +=	static_assertions	1.1.0	# MIT OR Apache-2.0
MODCARGO_CRATES +=	str_indices	0.4.4	# MIT OR Apache-2.0
MODCARGO_CRATES +=	strsim	0.11.1	# MIT
MODCARGO_CRATES +=	strum	0.26.3	# MIT
MODCARGO_CRATES +=	strum	0.27.2	# MIT
MODCARGO_CRATES +=	strum	0.28.0	# MIT
MODCARGO_CRATES +=	strum_macros	0.26.4	# MIT
MODCARGO_CRATES +=	strum_macros	0.27.2	# MIT
MODCARGO_CRATES +=	strum_macros	0.28.0	# MIT
MODCARGO_CRATES +=	subtle	2.6.1	# BSD-3-Clause
MODCARGO_CRATES +=	syn	1.0.109	# MIT OR Apache-2.0
MODCARGO_CRATES +=	syn	2.0.119	# MIT OR Apache-2.0
MODCARGO_CRATES +=	syn	3.0.3	# MIT OR Apache-2.0
MODCARGO_CRATES +=	syn-dissect-closure	0.2.1	# MIT
MODCARGO_CRATES +=	sync_wrapper	1.0.2	# Apache-2.0
MODCARGO_CRATES +=	synstructure	0.13.2	# MIT
MODCARGO_CRATES +=	system-configuration	0.7.0	# MIT OR Apache-2.0
MODCARGO_CRATES +=	system-configuration-sys	0.6.0	# MIT OR Apache-2.0
MODCARGO_CRATES +=	tagptr	0.2.0	# MIT/Apache-2.0
MODCARGO_CRATES +=	tempfile	3.27.0	# MIT OR Apache-2.0
MODCARGO_CRATES +=	termtree	0.5.1	# MIT
MODCARGO_CRATES +=	thiserror	1.0.69	# MIT OR Apache-2.0
MODCARGO_CRATES +=	thiserror	2.0.18	# MIT OR Apache-2.0
MODCARGO_CRATES +=	thiserror-impl	1.0.69	# MIT OR Apache-2.0
MODCARGO_CRATES +=	thiserror-impl	2.0.18	# MIT OR Apache-2.0
MODCARGO_CRATES +=	thread_local	1.1.10	# MIT OR Apache-2.0
MODCARGO_CRATES +=	thrift_codec	0.3.2	# MIT
MODCARGO_CRATES +=	time	0.3.55	# MIT OR Apache-2.0
MODCARGO_CRATES +=	time-core	0.1.9	# MIT OR Apache-2.0
MODCARGO_CRATES +=	time-macros	0.2.32	# MIT OR Apache-2.0
MODCARGO_CRATES +=	tinystr	0.8.3	# Unicode-3.0
MODCARGO_CRATES +=	tinyvec	1.12.0	# Zlib OR Apache-2.0 OR MIT
MODCARGO_CRATES +=	tinyvec_macros	0.1.1	# MIT OR Apache-2.0 OR Zlib
MODCARGO_CRATES +=	tokio	1.53.1	# MIT
MODCARGO_CRATES +=	tokio-macros	2.7.2	# MIT
MODCARGO_CRATES +=	tokio-rustls	0.26.4	# MIT OR Apache-2.0
MODCARGO_CRATES +=	tokio-stream	0.1.19	# MIT
MODCARGO_CRATES +=	tokio-test	0.4.5	# MIT
MODCARGO_CRATES +=	tokio-util	0.7.19	# MIT
MODCARGO_CRATES +=	tokio-websockets	0.13.3	# MIT
MODCARGO_CRATES +=	toml_datetime	1.1.1+spec-1.1.0	# MIT OR Apache-2.0
MODCARGO_CRATES +=	toml_edit	0.25.13+spec-1.1.0	# MIT OR Apache-2.0
MODCARGO_CRATES +=	toml_parser	1.1.3+spec-1.1.0	# MIT OR Apache-2.0
MODCARGO_CRATES +=	tower	0.5.3	# MIT
MODCARGO_CRATES +=	tower-http	0.6.11	# MIT
MODCARGO_CRATES +=	tower-layer	0.3.3	# MIT
MODCARGO_CRATES +=	tower-service	0.3.3	# MIT
MODCARGO_CRATES +=	tracing	0.1.44	# MIT
MODCARGO_CRATES +=	tracing-attributes	0.1.31	# MIT
MODCARGO_CRATES +=	tracing-core	0.1.36	# MIT
MODCARGO_CRATES +=	tracing-log	0.2.0	# MIT
MODCARGO_CRATES +=	tracing-subscriber	0.3.23	# MIT
MODCARGO_CRATES +=	trackable	1.3.0	# MIT
MODCARGO_CRATES +=	trackable_derive	1.0.0	# MIT
MODCARGO_CRATES +=	try-lock	0.2.5	# MIT
MODCARGO_CRATES +=	typenum	1.20.1	# MIT OR Apache-2.0
MODCARGO_CRATES +=	unicase	2.9.0	# MIT OR Apache-2.0
MODCARGO_CRATES +=	unicode-box-drawing	0.3.1	# MIT
MODCARGO_CRATES +=	unicode-ident	1.0.24	# (MIT OR Apache-2.0) AND Unicode-3.0
MODCARGO_CRATES +=	unicode-segmentation	1.13.3	# MIT OR Apache-2.0
MODCARGO_CRATES +=	unicode-width	0.2.2	# MIT OR Apache-2.0
MODCARGO_CRATES +=	unicode-xid	0.2.6	# MIT OR Apache-2.0
MODCARGO_CRATES +=	universal-hash	0.5.1	# MIT OR Apache-2.0
MODCARGO_CRATES +=	unsafe-libyaml	0.2.11	# MIT
MODCARGO_CRATES +=	untrusted	0.9.0	# ISC
MODCARGO_CRATES +=	url	2.5.8	# MIT OR Apache-2.0
MODCARGO_CRATES +=	utf8_iter	1.0.4	# Apache-2.0 OR MIT
MODCARGO_CRATES +=	utf8parse	0.2.2	# Apache-2.0 OR MIT
MODCARGO_CRATES +=	uuid	1.24.0	# Apache-2.0 OR MIT
MODCARGO_CRATES +=	valuable	0.1.1	# MIT
MODCARGO_CRATES +=	version_check	0.9.5	# MIT/Apache-2.0
MODCARGO_CRATES +=	wait-timeout	0.2.1	# MIT/Apache-2.0
MODCARGO_CRATES +=	walkdir	2.5.0	# Unlicense/MIT
MODCARGO_CRATES +=	want	0.3.1	# MIT
MODCARGO_CRATES +=	wasi	0.11.1+wasi-snapshot-preview1	# Apache-2.0 WITH LLVM-exception OR Apache-2.0 OR MIT
MODCARGO_CRATES +=	wasip2	1.0.4+wasi-0.2.12	# Apache-2.0 WITH LLVM-exception OR Apache-2.0 OR MIT
MODCARGO_CRATES +=	wasm-bindgen	0.2.128	# MIT OR Apache-2.0
MODCARGO_CRATES +=	wasm-bindgen-futures	0.4.78	# MIT OR Apache-2.0
MODCARGO_CRATES +=	wasm-bindgen-macro	0.2.128	# MIT OR Apache-2.0
MODCARGO_CRATES +=	wasm-bindgen-macro-support	0.2.128	# MIT OR Apache-2.0
MODCARGO_CRATES +=	wasm-bindgen-shared	0.2.128	# MIT OR Apache-2.0
MODCARGO_CRATES +=	wasm-streams	0.5.0	# MIT OR Apache-2.0
MODCARGO_CRATES +=	web-sys	0.3.105	# MIT OR Apache-2.0
MODCARGO_CRATES +=	web-time	1.1.0	# MIT OR Apache-2.0
MODCARGO_CRATES +=	webpki-root-certs	1.0.9	# CDLA-Permissive-2.0
MODCARGO_CRATES +=	webpki-roots	1.0.9	# CDLA-Permissive-2.0
MODCARGO_CRATES +=	widestring	1.2.1	# MIT OR Apache-2.0
MODCARGO_CRATES +=	winapi	0.3.9	# MIT/Apache-2.0
MODCARGO_CRATES +=	winapi-i686-pc-windows-gnu	0.4.0	# MIT/Apache-2.0
MODCARGO_CRATES +=	winapi-util	0.1.11	# Unlicense OR MIT
MODCARGO_CRATES +=	winapi-x86_64-pc-windows-gnu	0.4.0	# MIT/Apache-2.0
MODCARGO_CRATES +=	windows	0.62.2	# MIT OR Apache-2.0
MODCARGO_CRATES +=	windows-collections	0.3.2	# MIT OR Apache-2.0
MODCARGO_CRATES +=	windows-core	0.62.2	# MIT OR Apache-2.0
MODCARGO_CRATES +=	windows-future	0.3.2	# MIT OR Apache-2.0
MODCARGO_CRATES +=	windows-implement	0.60.2	# MIT OR Apache-2.0
MODCARGO_CRATES +=	windows-interface	0.59.3	# MIT OR Apache-2.0
MODCARGO_CRATES +=	windows-link	0.2.1	# MIT OR Apache-2.0
MODCARGO_CRATES +=	windows-numerics	0.3.1	# MIT OR Apache-2.0
MODCARGO_CRATES +=	windows-registry	0.6.1	# MIT OR Apache-2.0
MODCARGO_CRATES +=	windows-result	0.4.1	# MIT OR Apache-2.0
MODCARGO_CRATES +=	windows-strings	0.5.1	# MIT OR Apache-2.0
MODCARGO_CRATES +=	windows-sys	0.45.0	# MIT OR Apache-2.0
MODCARGO_CRATES +=	windows-sys	0.52.0	# MIT OR Apache-2.0
MODCARGO_CRATES +=	windows-sys	0.59.0	# MIT OR Apache-2.0
MODCARGO_CRATES +=	windows-sys	0.61.2	# MIT OR Apache-2.0
MODCARGO_CRATES +=	windows-targets	0.42.2	# MIT OR Apache-2.0
MODCARGO_CRATES +=	windows-targets	0.52.6	# MIT OR Apache-2.0
MODCARGO_CRATES +=	windows-threading	0.2.1	# MIT OR Apache-2.0
MODCARGO_CRATES +=	windows_aarch64_gnullvm	0.42.2	# MIT OR Apache-2.0
MODCARGO_CRATES +=	windows_aarch64_gnullvm	0.52.6	# MIT OR Apache-2.0
MODCARGO_CRATES +=	windows_aarch64_msvc	0.42.2	# MIT OR Apache-2.0
MODCARGO_CRATES +=	windows_aarch64_msvc	0.52.6	# MIT OR Apache-2.0
MODCARGO_CRATES +=	windows_i686_gnu	0.42.2	# MIT OR Apache-2.0
MODCARGO_CRATES +=	windows_i686_gnu	0.52.6	# MIT OR Apache-2.0
MODCARGO_CRATES +=	windows_i686_gnullvm	0.52.6	# MIT OR Apache-2.0
MODCARGO_CRATES +=	windows_i686_msvc	0.42.2	# MIT OR Apache-2.0
MODCARGO_CRATES +=	windows_i686_msvc	0.52.6	# MIT OR Apache-2.0
MODCARGO_CRATES +=	windows_x86_64_gnu	0.42.2	# MIT OR Apache-2.0
MODCARGO_CRATES +=	windows_x86_64_gnu	0.52.6	# MIT OR Apache-2.0
MODCARGO_CRATES +=	windows_x86_64_gnullvm	0.42.2	# MIT OR Apache-2.0
MODCARGO_CRATES +=	windows_x86_64_gnullvm	0.52.6	# MIT OR Apache-2.0
MODCARGO_CRATES +=	windows_x86_64_msvc	0.42.2	# MIT OR Apache-2.0
MODCARGO_CRATES +=	windows_x86_64_msvc	0.52.6	# MIT OR Apache-2.0
MODCARGO_CRATES +=	winnow	1.0.4	# MIT
MODCARGO_CRATES +=	wit-bindgen	0.57.1	# Apache-2.0 WITH LLVM-exception OR Apache-2.0 OR MIT
MODCARGO_CRATES +=	wmi	0.18.4	# MIT OR Apache-2.0
MODCARGO_CRATES +=	writeable	0.6.3	# Unicode-3.0
MODCARGO_CRATES +=	ws_stream_wasm	0.7.5	# Unlicense
MODCARGO_CRATES +=	yansi	1.0.1	# MIT OR Apache-2.0
MODCARGO_CRATES +=	yoke	0.8.3	# Unicode-3.0
MODCARGO_CRATES +=	yoke-derive	0.8.2	# Unicode-3.0
MODCARGO_CRATES +=	zerocopy	0.8.56	# BSD-2-Clause OR Apache-2.0 OR MIT
MODCARGO_CRATES +=	zerocopy-derive	0.8.56	# BSD-2-Clause OR Apache-2.0 OR MIT
MODCARGO_CRATES +=	zerofrom	0.1.8	# Unicode-3.0
MODCARGO_CRATES +=	zerofrom-derive	0.1.7	# Unicode-3.0
MODCARGO_CRATES +=	zeroize	1.9.0	# Apache-2.0 OR MIT
MODCARGO_CRATES +=	zeroize_derive	1.5.0	# Apache-2.0 OR MIT
MODCARGO_CRATES +=	zerotrie	0.2.4	# Unicode-3.0
MODCARGO_CRATES +=	zerovec	0.11.6	# Unicode-3.0
MODCARGO_CRATES +=	zerovec-derive	0.11.3	# Unicode-3.0
MODCARGO_CRATES +=	zmij	1.0.23	# MIT
MODCARGO_CRATES +=	zstd	0.13.3	# MIT
MODCARGO_CRATES +=	zstd-safe	7.2.4	# MIT OR Apache-2.0
MODCARGO_CRATES +=	zstd-sys	2.0.16+zstd.1.5.7	# MIT/Apache-2.0
