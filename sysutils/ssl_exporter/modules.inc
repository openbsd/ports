MODGO_MODULES =	\
	cloud.google.com/go/compute		 v1.20.1 \
	cloud.google.com/go/compute/metadata	 v0.2.3 \
	github.com/!n!y!times/gziphandler	 v0.0.0-20170623195520-56545f4a5d46 \
	github.com/alecthomas/kingpin/v2	 v2.4.0 \
	github.com/alecthomas/units		 v0.0.0-20231202071711-9a357b53e9c9 \
	github.com/armon/go-socks5		 v0.0.0-20160902184237-e75332964ef5 \
	github.com/asaskevich/govalidator	 v0.0.0-20190424111038-f61b66f89f4a \
	github.com/beorn7/perks			 v1.0.1 \
	github.com/bmatcuk/doublestar/v2	 v2.0.4 \
	github.com/cespare/xxhash/v2		 v2.3.0 \
	github.com/davecgh/go-spew		 v1.1.1 \
	github.com/emicklei/go-restful/v3	 v3.12.0 \
	github.com/evanphx/json-patch		 v4.12.0+incompatible \
	github.com/go-kit/log			 v0.2.1 \
	github.com/go-logfmt/logfmt		 v0.6.0 \
	github.com/go-logr/logr			 v1.4.1 \
	github.com/go-openapi/jsonpointer	 v0.21.0 \
	github.com/go-openapi/jsonreference	 v0.21.0 \
	github.com/go-openapi/swag		 v0.23.0 \
	github.com/go-task/slim-sprig		 v0.0.0-20230315185526-52ccab3ef572 \
	github.com/gogo/protobuf		 v1.3.2 \
	github.com/golang/groupcache		 v0.0.0-20210331224755-41bb18bfe9da \
	github.com/golang/protobuf		 v1.5.4 \
	github.com/google/btree			 v1.0.1 \
	github.com/google/gnostic-models	 v0.6.9-0.20230804172637-c7be7c783f49 \
	github.com/google/go-cmp		 v0.6.0 \
	github.com/google/gofuzz		 v1.2.0 \
	github.com/google/pprof			 v0.0.0-20210720184732-4bb14d4b1be1 \
	github.com/google/uuid			 v1.6.0 \
	github.com/gorilla/websocket		 v1.5.0 \
	github.com/gregjones/httpcache		 v0.0.0-20180305231024-9cad4c3443a7 \
	github.com/imdario/mergo		 v0.3.16 \
	github.com/josharian/intern		 v1.0.0 \
	github.com/jpillora/backoff		 v1.0.0 \
	github.com/json-iterator/go		 v1.1.12 \
	github.com/julienschmidt/httprouter	 v1.3.0 \
	github.com/kisielk/errcheck		 v1.5.0 \
	github.com/kisielk/gotool		 v1.0.0 \
	github.com/kr/pretty			 v0.3.1 \
	github.com/kr/text			 v0.2.0 \
	github.com/mailru/easyjson		 v0.7.7 \
	github.com/moby/spdystream		 v0.2.0 \
	github.com/modern-go/concurrent		 v0.0.0-20180306012644-bacd9c7ef1dd \
	github.com/modern-go/reflect2		 v1.0.2 \
	github.com/munnerz/goautoneg		 v0.0.0-20191010083416-a7dc8b61c822 \
	github.com/mwitkow/go-conntrack		 v0.0.0-20190716064945-2f068394615f \
	github.com/mxk/go-flowrate		 v0.0.0-20140419014527-cca7078d478f \
	github.com/onsi/ginkgo/v2		 v2.13.0 \
	github.com/onsi/gomega			 v1.29.0 \
	github.com/peterbourgon/diskv		 v2.0.1+incompatible \
	github.com/pkg/errors			 v0.9.1 \
	github.com/pmezard/go-difflib		 v1.0.0 \
	github.com/prometheus/client_golang	 v1.19.0 \
	github.com/prometheus/client_model	 v0.6.1 \
	github.com/prometheus/common		 v0.53.0 \
	github.com/prometheus/procfs		 v0.14.0 \
	github.com/rogpeppe/go-internal		 v1.11.0 \
	github.com/spf13/pflag			 v1.0.5 \
	github.com/stretchr/objx		 v0.1.0 \
	github.com/stretchr/testify		 v1.9.0 \
	github.com/xhit/go-str2duration/v2	 v2.1.0 \
	github.com/yuin/goldmark		 v1.2.1 \
	golang.org/x/crypto			 v0.22.0 \
	golang.org/x/mod			 v0.15.0 \
	golang.org/x/net			 v0.24.0 \
	golang.org/x/oauth2			 v0.19.0 \
	golang.org/x/sync			 v0.7.0 \
	golang.org/x/sys			 v0.19.0 \
	golang.org/x/term			 v0.19.0 \
	golang.org/x/text			 v0.14.0 \
	golang.org/x/time			 v0.5.0 \
	golang.org/x/tools			 v0.18.0 \
	golang.org/x/xerrors			 v0.0.0-20220907171357-04be3eba64a2 \
	google.golang.org/appengine		 v1.6.7 \
	google.golang.org/protobuf		 v1.33.0 \
	gopkg.in/check.v1			 v1.0.0-20201130134442-10cb98267c6c \
	gopkg.in/inf.v0				 v0.9.1 \
	gopkg.in/yaml.v2			 v2.4.0 \
	gopkg.in/yaml.v3			 v3.0.1 \
	k8s.io/api				 v0.29.0 \
	k8s.io/api				 v0.30.0 \
	k8s.io/apimachinery			 v0.29.0 \
	k8s.io/apimachinery			 v0.30.0 \
	k8s.io/client-go			 v0.29.0 \
	k8s.io/client-go			 v1.5.2 \
	k8s.io/gengo/v2				 v2.0.0-20240228010128-51d4e06bde70 \
	k8s.io/klog/v2				 v2.120.1 \
	k8s.io/kube-openapi			 v0.0.0-20240423202451-8948a665c108 \
	k8s.io/utils				 v0.0.0-20240423183400-0849a56e8f22 \
	sigs.k8s.io/json			 v0.0.0-20221116044647-bc3834ca7abd \
	sigs.k8s.io/structured-merge-diff/v4	 v4.4.1 \
	sigs.k8s.io/yaml			 v1.4.0

MODGO_MODFILES =	\
	github.com/alecthomas/units		 v0.0.0-20211218093645-b94a6e3cc137 \
	github.com/cespare/xxhash/v2		 v2.2.0 \
	github.com/davecgh/go-spew		 v1.1.0 \
	github.com/emicklei/go-restful/v3	 v3.11.0 \
	github.com/emicklei/go-restful/v3	 v3.8.0 \
	github.com/go-logfmt/logfmt		 v0.5.1 \
	github.com/go-logr/logr			 v1.2.0 \
	github.com/go-logr/logr			 v1.3.0 \
	github.com/go-openapi/jsonpointer	 v0.19.6 \
	github.com/go-openapi/jsonreference	 v0.20.1 \
	github.com/go-openapi/jsonreference	 v0.20.2 \
	github.com/go-openapi/swag		 v0.22.3 \
	github.com/golang/protobuf		 v1.5.0 \
	github.com/golang/protobuf		 v1.5.2 \
	github.com/golang/protobuf		 v1.5.3 \
	github.com/google/gnostic-models	 v0.6.8 \
	github.com/google/go-cmp		 v0.5.5 \
	github.com/google/go-cmp		 v0.5.9 \
	github.com/google/gofuzz		 v1.0.0 \
	github.com/google/gofuzz		 v1.1.0 \
	github.com/google/uuid			 v1.1.2 \
	github.com/google/uuid			 v1.3.0 \
	github.com/imdario/mergo		 v0.3.6 \
	github.com/modern-go/concurrent		 v0.0.0-20180228061459-e0a39a4cb421 \
	github.com/munnerz/goautoneg		 v0.0.0-20120707110453-a547fc61f48d \
	github.com/onsi/ginkgo/v2		 v2.1.4 \
	github.com/onsi/gomega			 v1.19.0 \
	github.com/prometheus/client_model	 v0.5.0 \
	github.com/prometheus/client_model	 v0.6.0 \
	github.com/prometheus/common		 v0.48.0 \
	github.com/prometheus/procfs		 v0.12.0 \
	github.com/rogpeppe/go-internal		 v1.10.0 \
	github.com/stretchr/testify		 v1.3.0 \
	github.com/stretchr/testify		 v1.4.0 \
	github.com/stretchr/testify		 v1.8.1 \
	github.com/stretchr/testify		 v1.8.2 \
	github.com/stretchr/testify		 v1.8.4 \
	github.com/yuin/goldmark		 v1.1.27 \
	golang.org/x/crypto			 v0.0.0-20190308221718-c2843e01d9a2 \
	golang.org/x/crypto			 v0.0.0-20191011191535-87dc89f01550 \
	golang.org/x/crypto			 v0.0.0-20200622213623-75b288015ac9 \
	golang.org/x/mod			 v0.2.0 \
	golang.org/x/mod			 v0.3.0 \
	golang.org/x/mod			 v0.8.0 \
	golang.org/x/net			 v0.0.0-20190404232315-eb5bcb51f2a3 \
	golang.org/x/net			 v0.0.0-20190620200207-3b0461eec859 \
	golang.org/x/net			 v0.0.0-20200226121028-0de0cce0169b \
	golang.org/x/net			 v0.0.0-20201021035429-f5854403a974 \
	golang.org/x/net			 v0.17.0 \
	golang.org/x/net			 v0.20.0 \
	golang.org/x/net			 v0.21.0 \
	golang.org/x/net			 v0.22.0 \
	golang.org/x/oauth2			 v0.10.0 \
	golang.org/x/oauth2			 v0.16.0 \
	golang.org/x/oauth2			 v0.18.0 \
	golang.org/x/sync			 v0.0.0-20190423024810-112230192c58 \
	golang.org/x/sync			 v0.0.0-20190911185100-cd5d95a43a6e \
	golang.org/x/sync			 v0.0.0-20201020160332-67f06af15bc9 \
	golang.org/x/sys			 v0.0.0-20190215142949-d0b11bdaac8a \
	golang.org/x/sys			 v0.0.0-20190412213103-97732733099d \
	golang.org/x/sys			 v0.0.0-20200930185726-fdedc70b468f \
	golang.org/x/sys			 v0.13.0 \
	golang.org/x/sys			 v0.16.0 \
	golang.org/x/sys			 v0.17.0 \
	golang.org/x/sys			 v0.18.0 \
	golang.org/x/sys			 v0.5.0 \
	golang.org/x/term			 v0.13.0 \
	golang.org/x/text			 v0.13.0 \
	golang.org/x/text			 v0.3.0 \
	golang.org/x/text			 v0.3.3 \
	golang.org/x/time			 v0.3.0 \
	golang.org/x/tools			 v0.0.0-20180917221912-90fa682c2a6e \
	golang.org/x/tools			 v0.0.0-20191119224855-298f0cb1881e \
	golang.org/x/tools			 v0.0.0-20200619180055-7c47624df98f \
	golang.org/x/tools			 v0.0.0-20210106214847-113979e3529a \
	golang.org/x/tools			 v0.12.0 \
	golang.org/x/tools			 v0.6.0 \
	golang.org/x/xerrors			 v0.0.0-20190717185122-a985d3407aa7 \
	golang.org/x/xerrors			 v0.0.0-20191011141410-1b5146add898 \
	golang.org/x/xerrors			 v0.0.0-20191204190536-9bdfabe68543 \
	golang.org/x/xerrors			 v0.0.0-20200804184101-5ec99f83aff1 \
	google.golang.org/protobuf		 v1.27.1 \
	google.golang.org/protobuf		 v1.31.0 \
	google.golang.org/protobuf		 v1.32.0 \
	gopkg.in/check.v1			 v0.0.0-20161208181325-20d25e280405 \
	gopkg.in/yaml.v2			 v2.2.2 \
	gopkg.in/yaml.v2			 v2.2.8 \
	gopkg.in/yaml.v3			 v3.0.0-20210107192922-496545a6307b \
	k8s.io/klog/v2				 v2.110.1 \
	k8s.io/klog/v2				 v2.80.1 \
	k8s.io/kube-openapi			 v0.0.0-20231010175941-2dd684a91f00 \
	k8s.io/utils				 v0.0.0-20230726121419-3b25d923346b \
	sigs.k8s.io/structured-merge-diff/v4	 v4.2.3 \
	sigs.k8s.io/yaml			 v1.2.0 \
	sigs.k8s.io/yaml			 v1.3.0

