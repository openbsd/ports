MODGO_MODULES =	\
	cel.dev/expr										 v0.25.1 \
	cloud.google.com/go									 v0.116.0 \
	cloud.google.com/go/auth								 v0.13.0 \
	cloud.google.com/go/auth/oauth2adapt							 v0.2.6 \
	cloud.google.com/go/compute/metadata							 v0.9.0 \
	cloud.google.com/go/iam									 v1.2.2 \
	cloud.google.com/go/monitoring								 v1.21.2 \
	cloud.google.com/go/storage								 v1.50.0 \
	cyphar.com/go-pathrs									 v0.2.1 \
	dario.cat/mergo										 v1.0.1 \
	filippo.io/edwards25519									 v1.1.0 \
	github.com/!ada!logics/go-fuzz-headers							 v0.0.0-20230811130428-ced1acdcaa24 \
	github.com/!azure!a!d/microsoft-authentication-library-for-go				 v1.3.3 \
	github.com/!azure/azure-sdk-for-go/sdk/azcore						 v1.17.1 \
	github.com/!azure/azure-sdk-for-go/sdk/azidentity					 v1.8.2 \
	github.com/!azure/azure-sdk-for-go/sdk/internal						 v1.10.0 \
	github.com/!azure/azure-sdk-for-go/sdk/storage/azblob					 v1.6.0 \
	github.com/!azure/go-ansiterm								 v0.0.0-20250102033503-faa5f7b0171c \
	github.com/!burnt!sushi/toml								 v1.6.0 \
	github.com/!d!a!t!a-!d!o!g/go-sqlmock							 v1.5.2 \
	github.com/!google!cloud!platform/opentelemetry-operations-go/detectors/gcp		 v1.31.0 \
	github.com/!google!cloud!platform/opentelemetry-operations-go/exporter/metric		 v0.48.1 \
	github.com/!google!cloud!platform/opentelemetry-operations-go/internal/resourcemapping	 v0.48.1 \
	github.com/!make!now!just/heredoc							 v1.0.0 \
	github.com/!masterminds/goutils								 v1.1.1 \
	github.com/!masterminds/semver/v3							 v3.5.0 \
	github.com/!masterminds/sprig/v3							 v3.3.0 \
	github.com/!masterminds/squirrel							 v1.5.4 \
	github.com/!masterminds/vcs								 v1.13.3 \
	github.com/!n!y!times/gziphandler							 v1.1.1 \
	github.com/!proton!mail/go-crypto							 v1.4.1 \
	github.com/alecthomas/kingpin/v2							 v2.4.0 \
	github.com/alecthomas/template								 v0.0.0-20160405071501-a0175ee3bccc \
	github.com/alecthomas/units								 v0.0.0-20240927000941-0f3dac36c52b \
	github.com/alicebob/miniredis/v2							 v2.35.0 \
	github.com/antihax/optional								 v1.0.0 \
	github.com/antlr4-go/antlr/v4								 v4.13.0 \
	github.com/armon/go-radix								 v1.0.0 \
	github.com/asaskevich/govalidator							 v0.0.0-20230301143203-a9d515a09cc2 \
	github.com/aws/aws-sdk-go								 v1.55.5 \
	github.com/beorn7/perks									 v1.0.1 \
	github.com/bgentry/speakeasy								 v0.1.0 \
	github.com/blang/semver/v4								 v4.0.0 \
	github.com/bshuster-repo/logrus-logstash-hook						 v1.1.0 \
	github.com/bsm/ginkgo/v2								 v2.12.0 \
	github.com/bsm/gomega									 v1.27.10 \
	github.com/bwesterb/go-ristretto							 v1.2.3 \
	github.com/cenkalti/backoff/v4								 v4.3.0 \
	github.com/cenkalti/backoff/v5								 v5.0.3 \
	github.com/cespare/xxhash/v2								 v2.3.0 \
	github.com/chai2010/gettext-go								 v1.0.2 \
	github.com/cloudflare/circl								 v1.6.3 \
	github.com/cncf/xds/go									 v0.0.0-20251210132809-ee656c7534f5 \
	github.com/coreos/go-oidc								 v2.5.0+incompatible \
	github.com/coreos/go-semver								 v0.3.1 \
	github.com/coreos/go-systemd/v22							 v22.7.0 \
	github.com/cpuguy83/go-md2man/v2							 v2.0.6 \
	github.com/creack/pty									 v1.1.18 \
	github.com/cyphar/filepath-securejoin							 v0.6.1 \
	github.com/danieljoos/wincred								 v1.2.3 \
	github.com/davecgh/go-spew								 v1.1.2-0.20180830191138-d8f796af33cc \
	github.com/denisenkom/go-mssqldb							 v0.9.0 \
	github.com/dgryski/go-rendezvous							 v0.0.0-20200823014737-9f7001d12a5f \
	github.com/distribution/distribution/v3							 v3.1.1 \
	github.com/distribution/reference							 v0.6.0 \
	github.com/dlclark/regexp2								 v1.11.0 \
	github.com/docker/docker-credential-helpers						 v0.9.5 \
	github.com/docker/go-events								 v0.0.0-20250808211157-605354379745 \
	github.com/docker/go-metrics								 v0.0.1 \
	github.com/dustin/go-humanize								 v1.0.1 \
	github.com/dylibso/observe-sdk/go							 v0.0.0-20240819160327-2d926c5d788a \
	github.com/emicklei/go-restful/v3							 v3.13.0 \
	github.com/envoyproxy/go-control-plane							 v0.14.0 \
	github.com/envoyproxy/go-control-plane/envoy						 v1.36.0 \
	github.com/envoyproxy/go-control-plane/ratelimit					 v0.1.0 \
	github.com/envoyproxy/protoc-gen-validate						 v1.3.0 \
	github.com/evanphx/json-patch/v5							 v5.9.11 \
	github.com/exponent-io/jsonpath								 v0.0.0-20210407135951-1de76d718b3f \
	github.com/extism/go-sdk								 v1.7.1 \
	github.com/fatih/camelcase								 v1.0.0 \
	github.com/fatih/color									 v1.19.0 \
	github.com/felixge/httpsnoop								 v1.0.4 \
	github.com/fluxcd/cli-utils								 v1.2.1 \
	github.com/foxcpp/go-mockdns								 v1.2.0 \
	github.com/frankban/quicktest								 v1.14.6 \
	github.com/fsnotify/fsnotify								 v1.9.0 \
	github.com/fxamacker/cbor/v2								 v2.9.0 \
	github.com/go-errors/errors								 v1.5.1 \
	github.com/go-gorp/gorp/v3								 v3.1.0 \
	github.com/go-jose/go-jose/v4								 v4.1.4 \
	github.com/go-kit/kit									 v0.8.0 \
	github.com/go-logfmt/logfmt								 v0.6.0 \
	github.com/go-logr/logr									 v1.4.3 \
	github.com/go-logr/stdr									 v1.2.2 \
	github.com/go-logr/zapr									 v1.3.0 \
	github.com/go-openapi/jsonpointer							 v0.21.1 \
	github.com/go-openapi/jsonreference							 v0.21.0 \
	github.com/go-openapi/swag								 v0.23.1 \
	github.com/go-sql-driver/mysql								 v1.8.1 \
	github.com/go-stack/stack								 v1.8.0 \
	github.com/go-task/slim-sprig/v3							 v3.0.0 \
	github.com/gobwas/glob									 v0.2.3 \
	github.com/godbus/dbus/v5								 v5.1.0 \
	github.com/godror/godror								 v0.40.4 \
	github.com/godror/knownpb								 v0.1.1 \
	github.com/gofrs/flock									 v0.13.0 \
	github.com/gogo/protobuf								 v1.3.2 \
	github.com/golang-jwt/jwt/v5								 v5.3.0 \
	github.com/golang-sql/civil								 v0.0.0-20190719163853-cb61b32ac6fe \
	github.com/golang/glog									 v1.2.5 \
	github.com/golang/groupcache								 v0.0.0-20210331224755-41bb18bfe9da \
	github.com/golang/protobuf								 v1.5.4 \
	github.com/google/btree									 v1.1.3 \
	github.com/google/cel-go								 v0.26.0 \
	github.com/google/gnostic-models							 v0.7.0 \
	github.com/google/go-cmp								 v0.7.0 \
	github.com/google/gofuzz								 v1.2.0 \
	github.com/google/pprof									 v0.0.0-20260115054156-294ebfa9ad83 \
	github.com/google/s2a-go								 v0.1.8 \
	github.com/google/uuid									 v1.6.0 \
	github.com/googleapis/enterprise-certificate-proxy					 v0.3.4 \
	github.com/googleapis/gax-go/v2								 v2.14.0 \
	github.com/gorilla/handlers								 v1.5.2 \
	github.com/gorilla/mux									 v1.8.1 \
	github.com/gorilla/websocket								 v1.5.4-0.20250319132907-e064f32e3674 \
	github.com/gosuri/uitable								 v0.0.4 \
	github.com/grpc-ecosystem/go-grpc-middleware/providers/prometheus			 v1.1.0 \
	github.com/grpc-ecosystem/go-grpc-middleware/v2						 v2.3.3 \
	github.com/grpc-ecosystem/grpc-gateway/v2						 v2.28.0 \
	github.com/hashicorp/errwrap								 v1.1.0 \
	github.com/hashicorp/go-multierror							 v1.1.1 \
	github.com/hashicorp/golang-lru/arc/v2							 v2.0.5 \
	github.com/hashicorp/golang-lru/v2							 v2.0.5 \
	github.com/huandu/xstrings								 v1.5.0 \
	github.com/ianlancetaylor/demangle							 v0.0.0-20240805132620-81f5be970eca \
	github.com/imdario/mergo								 v0.3.13 \
	github.com/inconshreveable/mousetrap							 v1.1.0 \
	github.com/jessevdk/go-flags								 v1.6.1 \
	github.com/jmespath/go-jmespath								 v0.4.0 \
	github.com/jmoiron/sqlx									 v1.4.0 \
	github.com/jonboulle/clockwork								 v0.5.0 \
	github.com/josharian/intern								 v1.0.0 \
	github.com/jpillora/backoff								 v1.0.0 \
	github.com/json-iterator/go								 v1.1.12 \
	github.com/julienschmidt/httprouter							 v1.3.0 \
	github.com/keybase/go-keychain								 v0.0.1 \
	github.com/kisielk/sqlstruct								 v0.0.0-20201105191214-5f3e10d3ab46 \
	github.com/klauspost/compress								 v1.18.4 \
	github.com/konsorten/go-windows-terminal-sequences					 v1.0.1 \
	github.com/kr/logfmt									 v0.0.0-20140226030751-b84e30acd515 \
	github.com/kr/pretty									 v0.3.1 \
	github.com/kr/text									 v0.2.0 \
	github.com/kylelemons/godebug								 v1.1.0 \
	github.com/lann/builder									 v0.0.0-20180802200727-47ae307949d0 \
	github.com/lann/ps									 v0.0.0-20150810152359-62de8c46ede0 \
	github.com/lib/pq									 v1.12.3 \
	github.com/liggitt/tabwriter								 v0.0.0-20181228230101-89fcab3d43de \
	github.com/lithammer/dedent								 v1.1.0 \
	github.com/mailru/easyjson								 v0.9.0 \
	github.com/mattn/go-colorable								 v0.1.14 \
	github.com/mattn/go-isatty								 v0.0.20 \
	github.com/mattn/go-oci8								 v0.1.1 \
	github.com/mattn/go-runewidth								 v0.0.9 \
	github.com/mattn/go-shellwords								 v1.0.13 \
	github.com/mattn/go-sqlite3								 v1.14.22 \
	github.com/matttproud/golang_protobuf_extensions					 v1.0.1 \
	github.com/miekg/dns									 v1.1.57 \
	github.com/mitchellh/cli								 v1.1.5 \
	github.com/mitchellh/copystructure							 v1.2.0 \
	github.com/mitchellh/go-wordwrap							 v1.0.1 \
	github.com/mitchellh/mapstructure							 v1.5.0 \
	github.com/mitchellh/reflectwalk							 v1.0.2 \
	github.com/moby/spdystream								 v0.5.1 \
	github.com/moby/term									 v0.5.2 \
	github.com/modern-go/concurrent								 v0.0.0-20180306012644-bacd9c7ef1dd \
	github.com/modern-go/reflect2								 v1.0.3-0.20250322232337-35a7c28c31ee \
	github.com/monochromegane/go-gitignore							 v0.0.0-20200626010858-205db1a8cc00 \
	github.com/munnerz/goautoneg								 v0.0.0-20191010083416-a7dc8b61c822 \
	github.com/mwitkow/go-conntrack								 v0.0.0-20190716064945-2f068394615f \
	github.com/mxk/go-flowrate								 v0.0.0-20140419014527-cca7078d478f \
	github.com/nelsam/hel/v2								 v2.3.3 \
	github.com/olekukonko/tablewriter							 v0.0.5 \
	github.com/onsi/ginkgo/v2								 v2.28.1 \
	github.com/onsi/gomega									 v1.39.1 \
	github.com/opencontainers/go-digest							 v1.0.0 \
	github.com/opencontainers/image-spec							 v1.1.1 \
	github.com/peterbourgon/diskv								 v2.0.1+incompatible \
	github.com/pkg/browser									 v0.0.0-20240102092130-5ac0b6a4141c \
	github.com/pkg/errors									 v0.8.0 \
	github.com/planetscale/vtprotobuf							 v0.6.1-0.20240319094008-0393e58bdf10 \
	github.com/pmezard/go-difflib								 v1.0.1-0.20181226105442-5d4384ee4fb2 \
	github.com/posener/complete								 v1.2.3 \
	github.com/poy/onpar									 v1.1.2 \
	github.com/pquerna/cachecontrol								 v0.1.0 \
	github.com/prometheus/client_golang							 v1.23.2 \
	github.com/prometheus/client_model							 v0.6.2 \
	github.com/prometheus/common								 v0.67.5 \
	github.com/prometheus/otlptranslator							 v1.0.0 \
	github.com/prometheus/procfs								 v0.20.1 \
	github.com/redis/go-redis/extra/rediscmd/v9						 v9.0.5 \
	github.com/redis/go-redis/extra/redisotel/v9						 v9.0.5 \
	github.com/redis/go-redis/v9								 v9.7.3 \
	github.com/rogpeppe/fastuuid								 v1.2.0 \
	github.com/rogpeppe/go-internal								 v1.14.1 \
	github.com/rubenv/sql-migrate								 v1.8.1 \
	github.com/russross/blackfriday								 v1.6.0 \
	github.com/russross/blackfriday/v2							 v2.1.0 \
	github.com/santhosh-tekuri/jsonschema/v5						 v5.3.1 \
	github.com/santhosh-tekuri/jsonschema/v6						 v6.0.2 \
	github.com/sergi/go-diff								 v1.4.0 \
	github.com/shopspring/decimal								 v1.4.0 \
	github.com/sirupsen/logrus								 v1.9.4 \
	github.com/soheilhy/cmux								 v0.1.5 \
	github.com/spf13/cast									 v1.7.0 \
	github.com/spf13/cobra									 v1.10.2 \
	github.com/spf13/pflag									 v1.0.10 \
	github.com/spiffe/go-spiffe/v2								 v2.6.0 \
	github.com/stoewer/go-strcase								 v1.3.0 \
	github.com/stretchr/objx								 v0.5.2 \
	github.com/stretchr/testify								 v1.11.1 \
	github.com/tetratelabs/wabin								 v0.0.0-20230304001439-f6f874872834 \
	github.com/tetratelabs/wazero								 v1.12.0 \
	github.com/tmc/grpc-websocket-proxy							 v0.0.0-20220101234140-673ab2c3ae75 \
	github.com/x448/float16									 v0.8.4 \
	github.com/xhit/go-str2duration/v2							 v2.1.0 \
	github.com/xiang90/probing								 v0.0.0-20221125231312-a49e3df8f510 \
	github.com/xlab/treeprint								 v1.2.0 \
	github.com/yuin/goldmark								 v1.4.13 \
	github.com/yuin/gopher-lua								 v1.1.1 \
	go.etcd.io/bbolt									 v1.4.3 \
	go.etcd.io/etcd/api/v3									 v3.6.8 \
	go.etcd.io/etcd/client/pkg/v3								 v3.6.8 \
	go.etcd.io/etcd/client/v3								 v3.6.8 \
	go.etcd.io/etcd/pkg/v3									 v3.6.8 \
	go.etcd.io/etcd/server/v3								 v3.6.8 \
	go.etcd.io/raft/v3									 v3.6.0 \
	go.opencensus.io									 v0.24.0 \
	go.opentelemetry.io/auto/sdk								 v1.2.1 \
	go.opentelemetry.io/contrib/bridges/prometheus						 v0.67.0 \
	go.opentelemetry.io/contrib/detectors/gcp						 v1.39.0 \
	go.opentelemetry.io/contrib/exporters/autoexport					 v0.67.0 \
	go.opentelemetry.io/contrib/instrumentation/google.golang.org/grpc/otelgrpc		 v0.65.0 \
	go.opentelemetry.io/contrib/instrumentation/net/http/otelhttp				 v0.67.0 \
	go.opentelemetry.io/otel								 v1.43.0 \
	go.opentelemetry.io/otel/exporters/otlp/otlplog/otlploggrpc				 v0.18.0 \
	go.opentelemetry.io/otel/exporters/otlp/otlplog/otlploghttp				 v0.19.0 \
	go.opentelemetry.io/otel/exporters/otlp/otlpmetric/otlpmetricgrpc			 v1.42.0 \
	go.opentelemetry.io/otel/exporters/otlp/otlpmetric/otlpmetrichttp			 v1.43.0 \
	go.opentelemetry.io/otel/exporters/otlp/otlptrace					 v1.43.0 \
	go.opentelemetry.io/otel/exporters/otlp/otlptrace/otlptracegrpc				 v1.42.0 \
	go.opentelemetry.io/otel/exporters/otlp/otlptrace/otlptracehttp				 v1.43.0 \
	go.opentelemetry.io/otel/exporters/prometheus						 v0.64.0 \
	go.opentelemetry.io/otel/exporters/stdout/stdoutlog					 v0.18.0 \
	go.opentelemetry.io/otel/exporters/stdout/stdoutmetric					 v1.42.0 \
	go.opentelemetry.io/otel/exporters/stdout/stdouttrace					 v1.42.0 \
	go.opentelemetry.io/otel/log								 v0.19.0 \
	go.opentelemetry.io/otel/metric								 v1.43.0 \
	go.opentelemetry.io/otel/sdk								 v1.43.0 \
	go.opentelemetry.io/otel/sdk/log							 v0.19.0 \
	go.opentelemetry.io/otel/sdk/log/logtest						 v0.19.0 \
	go.opentelemetry.io/otel/sdk/metric							 v1.43.0 \
	go.opentelemetry.io/otel/trace								 v1.43.0 \
	go.opentelemetry.io/proto/otlp								 v1.10.0 \
	go.uber.org/goleak									 v1.3.0 \
	go.uber.org/multierr									 v1.11.0 \
	go.uber.org/zap										 v1.27.1 \
	go.yaml.in/yaml/v2									 v2.4.3 \
	go.yaml.in/yaml/v3									 v3.0.4 \
	golang.org/x/crypto									 v0.54.0 \
	golang.org/x/exp									 v0.0.0-20251219203646-944ab1f22d93 \
	golang.org/x/mod									 v0.37.0 \
	golang.org/x/net									 v0.56.0 \
	golang.org/x/oauth2									 v0.36.0 \
	golang.org/x/sync									 v0.22.0 \
	golang.org/x/sys									 v0.47.0 \
	golang.org/x/telemetry									 v0.0.0-20260625142307-59b4966ccb57 \
	golang.org/x/term									 v0.45.0 \
	golang.org/x/text									 v0.40.0 \
	golang.org/x/time									 v0.15.0 \
	golang.org/x/tools									 v0.47.0 \
	golang.org/x/tools/go/expect								 v0.1.0-deprecated \
	golang.org/x/tools/go/packages/packagestest						 v0.1.1-deprecated \
	golang.org/x/xerrors									 v0.0.0-20190717185122-a985d3407aa7 \
	gomodules.xyz/jsonpatch/v2								 v2.4.0 \
	gonum.org/v1/gonum									 v0.17.0 \
	google.golang.org/api									 v0.214.0 \
	google.golang.org/genproto								 v0.0.0-20241118233622-e639e219e697 \
	google.golang.org/genproto/googleapis/api						 v0.0.0-20260401024825-9d38bb4040a9 \
	google.golang.org/genproto/googleapis/rpc						 v0.0.0-20260401024825-9d38bb4040a9 \
	google.golang.org/grpc									 v1.80.0 \
	google.golang.org/protobuf								 v1.36.12-0.20260120151049-f2248ac996af \
	gopkg.in/alecthomas/kingpin.v2								 v2.2.6 \
	gopkg.in/check.v1									 v1.0.0-20201130134442-10cb98267c6c \
	gopkg.in/evanphx/json-patch.v4								 v4.13.0 \
	gopkg.in/go-jose/go-jose.v2								 v2.6.3 \
	gopkg.in/inf.v0										 v0.9.1 \
	gopkg.in/natefinch/lumberjack.v2							 v2.2.1 \
	gopkg.in/yaml.v2									 v2.4.0 \
	gopkg.in/yaml.v3									 v3.0.1 \
	k8s.io/api										 v0.36.1 \
	k8s.io/apiextensions-apiserver								 v0.36.1 \
	k8s.io/apimachinery									 v0.36.1 \
	k8s.io/apiserver									 v0.36.1 \
	k8s.io/cli-runtime									 v0.36.1 \
	k8s.io/client-go									 v0.36.1 \
	k8s.io/code-generator									 v0.36.1 \
	k8s.io/component-base									 v0.36.1 \
	k8s.io/component-helpers								 v0.36.1 \
	k8s.io/gengo/v2										 v2.0.0-20250922181213-ec3ebc5fd46b \
	k8s.io/klog/v2										 v2.140.0 \
	k8s.io/kms										 v0.36.1 \
	k8s.io/kube-openapi									 v0.0.0-20260317180543-43fb72c5454a \
	k8s.io/kubectl										 v0.36.1 \
	k8s.io/metrics										 v0.36.1 \
	k8s.io/streaming									 v0.36.1 \
	k8s.io/utils										 v0.0.0-20260210185600-b8788abfbbc2 \
	oras.land/oras-go/v2									 v2.6.1 \
	sigs.k8s.io/apiserver-network-proxy/konnectivity-client					 v0.34.0 \
	sigs.k8s.io/controller-runtime								 v0.24.1 \
	sigs.k8s.io/json									 v0.0.0-20250730193827-2d320260d730 \
	sigs.k8s.io/kustomize/api								 v0.21.1 \
	sigs.k8s.io/kustomize/kustomize/v5							 v5.8.1 \
	sigs.k8s.io/kustomize/kyaml								 v0.21.1 \
	sigs.k8s.io/randfill									 v1.0.0 \
	sigs.k8s.io/structured-merge-diff/v6							 v6.3.2 \
	sigs.k8s.io/yaml									 v1.6.0
MODGO_MODFILES =	\
	cloud.google.com/go/compute/metadata						 v0.3.0 \
	github.com/!ada!logics/go-fuzz-headers						 v0.0.0-20221103172237-443f56ff4ba8 \
	github.com/!azure/go-ansiterm							 v0.0.0-20230124172434-306776ec8161 \
	github.com/!masterminds/semver/v3						 v3.2.0 \
	github.com/!masterminds/semver/v3						 v3.3.0 \
	github.com/!masterminds/semver/v3						 v3.4.0 \
	github.com/!masterminds/sprig/v3						 v3.2.3 \
	github.com/alecthomas/units							 v0.0.0-20151022065526-2efee857e7cf \
	github.com/beorn7/perks								 v0.0.0-20180321164747-3a771d992973 \
	github.com/beorn7/perks								 v1.0.0 \
	github.com/bsm/ginkgo/v2							 v2.7.0 \
	github.com/bsm/gomega								 v1.26.0 \
	github.com/cespare/xxhash/v2							 v2.2.0 \
	github.com/cloudflare/circl							 v1.6.2 \
	github.com/coreos/go-systemd/v22						 v22.5.0 \
	github.com/cyphar/filepath-securejoin						 v0.2.4 \
	github.com/davecgh/go-spew							 v1.1.0 \
	github.com/davecgh/go-spew							 v1.1.1 \
	github.com/emicklei/go-restful/v3						 v3.11.0 \
	github.com/fatih/color								 v1.13.0 \
	github.com/felixge/httpsnoop							 v1.0.3 \
	github.com/go-errors/errors							 v1.4.2 \
	github.com/go-jose/go-jose/v4							 v4.1.3 \
	github.com/go-logfmt/logfmt							 v0.3.0 \
	github.com/go-logfmt/logfmt							 v0.4.0 \
	github.com/go-logr/logr								 v1.2.0 \
	github.com/go-logr/logr								 v1.2.2 \
	github.com/go-logr/logr								 v1.2.4 \
	github.com/go-logr/logr								 v1.4.1 \
	github.com/go-logr/logr								 v1.4.2 \
	github.com/go-openapi/jsonpointer						 v0.21.0 \
	github.com/go-openapi/jsonreference						 v0.20.1 \
	github.com/go-openapi/jsonreference						 v0.20.2 \
	github.com/go-openapi/swag							 v0.23.0 \
	github.com/go-sql-driver/mysql							 v1.6.0 \
	github.com/gogo/protobuf							 v1.1.1 \
	github.com/golang/protobuf							 v1.2.0 \
	github.com/golang/protobuf							 v1.3.1 \
	github.com/golang/protobuf							 v1.3.2 \
	github.com/golang/protobuf							 v1.5.0 \
	github.com/google/gnostic-models						 v0.6.9 \
	github.com/google/go-cmp							 v0.3.0 \
	github.com/google/go-cmp							 v0.5.9 \
	github.com/google/go-cmp							 v0.6.0 \
	github.com/google/gofuzz							 v1.0.0 \
	github.com/google/pprof								 v0.0.0-20250403155104-27863c87afa6 \
	github.com/google/uuid								 v1.3.0 \
	github.com/grpc-ecosystem/grpc-gateway/v2					 v2.21.0 \
	github.com/grpc-ecosystem/grpc-gateway/v2					 v2.27.7 \
	github.com/huandu/xstrings							 v1.4.0 \
	github.com/json-iterator/go							 v1.1.6 \
	github.com/json-iterator/go							 v1.1.7 \
	github.com/julienschmidt/httprouter						 v1.2.0 \
	github.com/klauspost/compress							 v1.18.0 \
	github.com/lib/pq								 v1.10.7 \
	github.com/lib/pq								 v1.10.9 \
	github.com/mailru/easyjson							 v0.7.7 \
	github.com/mattn/go-colorable							 v0.1.13 \
	github.com/mattn/go-isatty							 v0.0.16 \
	github.com/mattn/go-isatty							 v0.0.17 \
	github.com/mattn/go-sqlite3							 v1.14.15 \
	github.com/mattn/go-sqlite3							 v1.14.19 \
	github.com/moby/term								 v0.5.0 \
	github.com/modern-go/concurrent							 v0.0.0-20180228061459-e0a39a4cb421 \
	github.com/modern-go/reflect2							 v0.0.0-20180701023420-4b7aa43c6742 \
	github.com/modern-go/reflect2							 v1.0.1 \
	github.com/modern-go/reflect2							 v1.0.2 \
	github.com/mwitkow/go-conntrack							 v0.0.0-20161129095857-cc309e4a2223 \
	github.com/onsi/ginkgo/v2							 v2.27.4 \
	github.com/onsi/ginkgo/v2							 v2.28.0 \
	github.com/onsi/gomega								 v1.39.0 \
	github.com/pmezard/go-difflib							 v1.0.0 \
	github.com/prometheus/client_golang						 v0.9.1 \
	github.com/prometheus/client_golang						 v1.0.0 \
	github.com/prometheus/client_golang						 v1.1.0 \
	github.com/prometheus/client_golang						 v1.20.4 \
	github.com/prometheus/client_model						 v0.0.0-20180712105110-5c3871d89910 \
	github.com/prometheus/client_model						 v0.0.0-20190129233127-fd36f4220a90 \
	github.com/prometheus/common							 v0.4.1 \
	github.com/prometheus/common							 v0.6.0 \
	github.com/prometheus/common							 v0.66.1 \
	github.com/prometheus/procfs							 v0.0.0-20181005140218-185b4288413d \
	github.com/prometheus/procfs							 v0.0.2 \
	github.com/prometheus/procfs							 v0.0.3 \
	github.com/prometheus/procfs							 v0.15.1 \
	github.com/prometheus/procfs							 v0.16.1 \
	github.com/prometheus/procfs							 v0.19.2 \
	github.com/redis/go-redis/v9							 v9.0.5 \
	github.com/rogpeppe/go-internal							 v1.10.0 \
	github.com/rogpeppe/go-internal							 v1.11.0 \
	github.com/rogpeppe/go-internal							 v1.12.0 \
	github.com/rogpeppe/go-internal							 v1.9.0 \
	github.com/shopspring/decimal							 v1.3.1 \
	github.com/sirupsen/logrus							 v1.2.0 \
	github.com/sirupsen/logrus							 v1.8.1 \
	github.com/sirupsen/logrus							 v1.9.3 \
	github.com/spf13/cast								 v1.5.0 \
	github.com/spf13/cobra								 v1.9.1 \
	github.com/spf13/pflag								 v1.0.5 \
	github.com/spf13/pflag								 v1.0.6 \
	github.com/spf13/pflag								 v1.0.9 \
	github.com/stretchr/objx							 v0.1.0 \
	github.com/stretchr/objx							 v0.1.1 \
	github.com/stretchr/testify							 v1.10.0 \
	github.com/stretchr/testify							 v1.2.2 \
	github.com/stretchr/testify							 v1.3.0 \
	github.com/stretchr/testify							 v1.5.1 \
	github.com/stretchr/testify							 v1.6.1 \
	github.com/stretchr/testify							 v1.7.0 \
	github.com/stretchr/testify							 v1.8.0 \
	github.com/stretchr/testify							 v1.9.0 \
	github.com/tetratelabs/wazero							 v1.8.0 \
	github.com/tetratelabs/wazero							 v1.9.0 \
	go.opentelemetry.io/contrib/instrumentation/google.golang.org/grpc/otelgrpc	 v0.54.0 \
	go.opentelemetry.io/contrib/instrumentation/net/http/otelhttp			 v0.65.0 \
	go.opentelemetry.io/otel							 v1.16.0 \
	go.opentelemetry.io/otel							 v1.28.0 \
	go.opentelemetry.io/otel							 v1.38.0 \
	go.opentelemetry.io/otel							 v1.39.0 \
	go.opentelemetry.io/otel							 v1.41.0 \
	go.opentelemetry.io/otel							 v1.42.0 \
	go.opentelemetry.io/otel/exporters/otlp/otlplog/otlploghttp			 v0.18.0 \
	go.opentelemetry.io/otel/exporters/otlp/otlpmetric/otlpmetrichttp		 v1.42.0 \
	go.opentelemetry.io/otel/exporters/otlp/otlptrace				 v1.28.0 \
	go.opentelemetry.io/otel/exporters/otlp/otlptrace				 v1.40.0 \
	go.opentelemetry.io/otel/exporters/otlp/otlptrace				 v1.42.0 \
	go.opentelemetry.io/otel/exporters/otlp/otlptrace/otlptracegrpc			 v1.28.0 \
	go.opentelemetry.io/otel/exporters/otlp/otlptrace/otlptracegrpc			 v1.40.0 \
	go.opentelemetry.io/otel/exporters/otlp/otlptrace/otlptracehttp			 v1.28.0 \
	go.opentelemetry.io/otel/exporters/otlp/otlptrace/otlptracehttp			 v1.42.0 \
	go.opentelemetry.io/otel/log							 v0.18.0 \
	go.opentelemetry.io/otel/metric							 v1.16.0 \
	go.opentelemetry.io/otel/metric							 v1.28.0 \
	go.opentelemetry.io/otel/metric							 v1.39.0 \
	go.opentelemetry.io/otel/metric							 v1.41.0 \
	go.opentelemetry.io/otel/metric							 v1.42.0 \
	go.opentelemetry.io/otel/sdk							 v1.16.0 \
	go.opentelemetry.io/otel/sdk							 v1.28.0 \
	go.opentelemetry.io/otel/sdk							 v1.39.0 \
	go.opentelemetry.io/otel/sdk							 v1.40.0 \
	go.opentelemetry.io/otel/sdk							 v1.42.0 \
	go.opentelemetry.io/otel/sdk/log						 v0.18.0 \
	go.opentelemetry.io/otel/sdk/log/logtest					 v0.18.0 \
	go.opentelemetry.io/otel/sdk/metric						 v1.39.0 \
	go.opentelemetry.io/otel/sdk/metric						 v1.42.0 \
	go.opentelemetry.io/otel/trace							 v1.16.0 \
	go.opentelemetry.io/otel/trace							 v1.28.0 \
	go.opentelemetry.io/otel/trace							 v1.38.0 \
	go.opentelemetry.io/otel/trace							 v1.39.0 \
	go.opentelemetry.io/otel/trace							 v1.41.0 \
	go.opentelemetry.io/otel/trace							 v1.42.0 \
	go.opentelemetry.io/proto/otlp							 v1.3.1 \
	go.opentelemetry.io/proto/otlp							 v1.9.0 \
	go.yaml.in/yaml/v2								 v2.4.2 \
	go.yaml.in/yaml/v3								 v3.0.3 \
	golang.org/x/crypto								 v0.0.0-20180904163835-0709b304e793 \
	golang.org/x/crypto								 v0.0.0-20190308221718-c2843e01d9a2 \
	golang.org/x/crypto								 v0.0.0-20210921155107-089bfa567519 \
	golang.org/x/crypto								 v0.13.0 \
	golang.org/x/crypto								 v0.14.0 \
	golang.org/x/crypto								 v0.15.0 \
	golang.org/x/crypto								 v0.26.0 \
	golang.org/x/crypto								 v0.30.0 \
	golang.org/x/crypto								 v0.41.0 \
	golang.org/x/crypto								 v0.45.0 \
	golang.org/x/crypto								 v0.47.0 \
	golang.org/x/crypto								 v0.49.0 \
	golang.org/x/crypto								 v0.53.0 \
	golang.org/x/exp								 v0.0.0-20230905200255-921286631fa9 \
	golang.org/x/mod								 v0.12.0 \
	golang.org/x/mod								 v0.14.0 \
	golang.org/x/mod								 v0.27.0 \
	golang.org/x/mod								 v0.32.0 \
	golang.org/x/mod								 v0.6.0-dev.0.20220419223038-86c51ed26bb4 \
	golang.org/x/mod								 v0.8.0 \
	golang.org/x/net								 v0.0.0-20181114220301-adae6a3d119a \
	golang.org/x/net								 v0.0.0-20190613194153-d28f0bde5980 \
	golang.org/x/net								 v0.0.0-20190620200207-3b0461eec859 \
	golang.org/x/net								 v0.0.0-20210226172049-e18ecbb05110 \
	golang.org/x/net								 v0.0.0-20220722155237-a158d28d115b \
	golang.org/x/net								 v0.10.0 \
	golang.org/x/net								 v0.15.0 \
	golang.org/x/net								 v0.17.0 \
	golang.org/x/net								 v0.18.0 \
	golang.org/x/net								 v0.28.0 \
	golang.org/x/net								 v0.43.0 \
	golang.org/x/net								 v0.48.0 \
	golang.org/x/net								 v0.49.0 \
	golang.org/x/net								 v0.50.0 \
	golang.org/x/net								 v0.51.0 \
	golang.org/x/net								 v0.52.0 \
	golang.org/x/net								 v0.6.0 \
	golang.org/x/oauth2								 v0.30.0 \
	golang.org/x/oauth2								 v0.34.0 \
	golang.org/x/oauth2								 v0.35.0 \
	golang.org/x/sync								 v0.0.0-20181108010431-42b317875d0f \
	golang.org/x/sync								 v0.0.0-20181221193216-37e7f081c4d4 \
	golang.org/x/sync								 v0.0.0-20190423024810-112230192c58 \
	golang.org/x/sync								 v0.0.0-20220722155255-886fb9371eb4 \
	golang.org/x/sync								 v0.1.0 \
	golang.org/x/sync								 v0.16.0 \
	golang.org/x/sync								 v0.19.0 \
	golang.org/x/sync								 v0.20.0 \
	golang.org/x/sync								 v0.21.0 \
	golang.org/x/sync								 v0.3.0 \
	golang.org/x/sync								 v0.4.0 \
	golang.org/x/sync								 v0.5.0 \
	golang.org/x/sys								 v0.0.0-20180905080454-ebe1bf3edb33 \
	golang.org/x/sys								 v0.0.0-20181116152217-5ac8a444bdc5 \
	golang.org/x/sys								 v0.0.0-20190215142949-d0b11bdaac8a \
	golang.org/x/sys								 v0.0.0-20190801041406-cbf593c0f2f3 \
	golang.org/x/sys								 v0.0.0-20191026070338-33540a1f6037 \
	golang.org/x/sys								 v0.0.0-20201119102817-f84b799fce68 \
	golang.org/x/sys								 v0.0.0-20210615035016-665e8c7367d1 \
	golang.org/x/sys								 v0.0.0-20210616094352-59db8d763f22 \
	golang.org/x/sys								 v0.0.0-20220520151302-bc2c85ada10a \
	golang.org/x/sys								 v0.0.0-20220722155257-8c9f86f7a55f \
	golang.org/x/sys								 v0.0.0-20221013171732-95e765b1cc43 \
	golang.org/x/sys								 v0.1.0 \
	golang.org/x/sys								 v0.12.0 \
	golang.org/x/sys								 v0.13.0 \
	golang.org/x/sys								 v0.14.0 \
	golang.org/x/sys								 v0.20.0 \
	golang.org/x/sys								 v0.21.0 \
	golang.org/x/sys								 v0.24.0 \
	golang.org/x/sys								 v0.26.0 \
	golang.org/x/sys								 v0.28.0 \
	golang.org/x/sys								 v0.29.0 \
	golang.org/x/sys								 v0.35.0 \
	golang.org/x/sys								 v0.37.0 \
	golang.org/x/sys								 v0.38.0 \
	golang.org/x/sys								 v0.39.0 \
	golang.org/x/sys								 v0.40.0 \
	golang.org/x/sys								 v0.41.0 \
	golang.org/x/sys								 v0.42.0 \
	golang.org/x/sys								 v0.44.0 \
	golang.org/x/sys								 v0.46.0 \
	golang.org/x/sys								 v0.5.0 \
	golang.org/x/sys								 v0.6.0 \
	golang.org/x/sys								 v0.8.0 \
	golang.org/x/term								 v0.0.0-20201126162022-7de9c90e9dd1 \
	golang.org/x/term								 v0.0.0-20210927222741-03fcf44c2211 \
	golang.org/x/term								 v0.12.0 \
	golang.org/x/term								 v0.13.0 \
	golang.org/x/term								 v0.14.0 \
	golang.org/x/term								 v0.39.0 \
	golang.org/x/term								 v0.41.0 \
	golang.org/x/term								 v0.44.0 \
	golang.org/x/term								 v0.5.0 \
	golang.org/x/term								 v0.8.0 \
	golang.org/x/text								 v0.13.0 \
	golang.org/x/text								 v0.14.0 \
	golang.org/x/text								 v0.17.0 \
	golang.org/x/text								 v0.28.0 \
	golang.org/x/text								 v0.3.0 \
	golang.org/x/text								 v0.3.3 \
	golang.org/x/text								 v0.3.7 \
	golang.org/x/text								 v0.32.0 \
	golang.org/x/text								 v0.33.0 \
	golang.org/x/text								 v0.34.0 \
	golang.org/x/text								 v0.35.0 \
	golang.org/x/text								 v0.38.0 \
	golang.org/x/text								 v0.7.0 \
	golang.org/x/text								 v0.9.0 \
	golang.org/x/time								 v0.14.0 \
	golang.org/x/tools								 v0.0.0-20180917221912-90fa682c2a6e \
	golang.org/x/tools								 v0.0.0-20191119224855-298f0cb1881e \
	golang.org/x/tools								 v0.1.12 \
	golang.org/x/tools								 v0.13.0 \
	golang.org/x/tools								 v0.15.0 \
	golang.org/x/tools								 v0.36.0 \
	golang.org/x/tools								 v0.41.0 \
	golang.org/x/tools								 v0.45.0 \
	golang.org/x/tools								 v0.6.0 \
	google.golang.org/genproto/googleapis/api					 v0.0.0-20240814211410-ddb44dafa142 \
	google.golang.org/genproto/googleapis/api					 v0.0.0-20260120221211-b8f7ae30c516 \
	google.golang.org/genproto/googleapis/api					 v0.0.0-20260128011058-8636f8732409 \
	google.golang.org/genproto/googleapis/api					 v0.0.0-20260209200024-4cfbd4190f57 \
	google.golang.org/genproto/googleapis/api					 v0.0.0-20260226221140-a57be14db171 \
	google.golang.org/genproto/googleapis/rpc					 v0.0.0-20240814211410-ddb44dafa142 \
	google.golang.org/genproto/googleapis/rpc					 v0.0.0-20260120221211-b8f7ae30c516 \
	google.golang.org/genproto/googleapis/rpc					 v0.0.0-20260128011058-8636f8732409 \
	google.golang.org/genproto/googleapis/rpc					 v0.0.0-20260209200024-4cfbd4190f57 \
	google.golang.org/genproto/googleapis/rpc					 v0.0.0-20260226221140-a57be14db171 \
	google.golang.org/genproto/googleapis/rpc					 v0.0.0-20260401001100-f93e5f3e9f0f \
	google.golang.org/grpc								 v1.65.0 \
	google.golang.org/grpc								 v1.79.1 \
	google.golang.org/grpc								 v1.79.2 \
	google.golang.org/grpc								 v1.79.3 \
	google.golang.org/protobuf							 v1.33.0 \
	google.golang.org/protobuf							 v1.34.2 \
	google.golang.org/protobuf							 v1.35.1 \
	google.golang.org/protobuf							 v1.36.11 \
	google.golang.org/protobuf							 v1.36.5 \
	google.golang.org/protobuf							 v1.36.6 \
	google.golang.org/protobuf							 v1.36.7 \
	google.golang.org/protobuf							 v1.36.8 \
	gopkg.in/check.v1								 v0.0.0-20161208181325-20d25e280405 \
	gopkg.in/yaml.v2								 v2.2.1 \
	gopkg.in/yaml.v2								 v2.3.0 \
	gopkg.in/yaml.v3								 v3.0.0-20200313102051-9f266ea9e77c \
	k8s.io/api									 v0.36.0 \
	k8s.io/apiextensions-apiserver							 v0.36.0 \
	k8s.io/apimachinery								 v0.36.0 \
	k8s.io/apiserver								 v0.36.0 \
	k8s.io/cli-runtime								 v0.36.0 \
	k8s.io/client-go								 v0.36.0 \
	k8s.io/component-base								 v0.36.0 \
	k8s.io/gengo/v2									 v2.0.0-20250604051438-85fd79dbfd9f \
	k8s.io/klog/v2									 v2.130.1 \
	k8s.io/klog/v2									 v2.80.1 \
	k8s.io/kube-openapi								 v0.0.0-20241212222426-2c72e554b1e7 \
	k8s.io/kubectl									 v0.36.0 \
	k8s.io/streaming								 v0.36.0 \
	k8s.io/utils									 v0.0.0-20240711033017-18e509b52bc8 \
	sigs.k8s.io/json								 v0.0.0-20221116044647-bc3834ca7abd \
	sigs.k8s.io/randfill								 v0.0.0-20250304075658-069ef1bbf016 \
	sigs.k8s.io/structured-merge-diff/v6						 v6.2.0 \
	sigs.k8s.io/yaml								 v1.4.0 \
	sigs.k8s.io/yaml								 v1.5.0

