MODGO_MODULES =	\
	github.com/alecthomas/kingpin/v2			 v2.3.2 \
	github.com/alecthomas/units				 v0.0.0-20211218093645-b94a6e3cc137 \
	github.com/beorn7/perks					 v1.0.1 \
	github.com/cespare/xxhash/v2				 v2.2.0 \
	github.com/coreos/go-systemd/v22			 v22.5.0 \
	github.com/cpuguy83/go-md2man/v2			 v2.0.4 \
	github.com/davecgh/go-spew				 v1.1.1 \
	github.com/felixge/httpsnoop				 v1.0.3 \
	github.com/go-kit/log					 v0.2.1 \
	github.com/go-logfmt/logfmt				 v0.5.1 \
	github.com/godbus/dbus/v5				 v5.0.4 \
	github.com/golang/protobuf				 v1.5.3 \
	github.com/google/go-cmp				 v0.5.9 \
	github.com/gorilla/handlers				 v1.5.2 \
	github.com/inconshreveable/mousetrap			 v1.1.0 \
	github.com/jpillora/backoff				 v1.0.0 \
	github.com/json-iterator/go				 v1.1.12 \
	github.com/julienschmidt/httprouter			 v1.3.0 \
	github.com/klauspost/cpuid/v2				 v2.2.5 \
	github.com/kr/pretty					 v0.3.1 \
	github.com/matttproud/golang_protobuf_extensions/v2	 v2.0.0 \
	github.com/minio/sha256-simd				 v1.0.1 \
	github.com/miolini/datacounter				 v1.0.3 \
	github.com/modern-go/concurrent				 v0.0.0-20180306012644-bacd9c7ef1dd \
	github.com/modern-go/reflect2				 v1.0.2 \
	github.com/mwitkow/go-conntrack				 v0.0.0-20190716064945-2f068394615f \
	github.com/prometheus/client_golang			 v1.18.0 \
	github.com/prometheus/client_model			 v0.5.0 \
	github.com/prometheus/common				 v0.45.0 \
	github.com/prometheus/procfs				 v0.12.0 \
	github.com/rogpeppe/go-internal				 v1.10.0 \
	github.com/russross/blackfriday/v2			 v2.1.0 \
	github.com/spf13/cobra					 v1.8.1 \
	github.com/spf13/pflag					 v1.0.5 \
	github.com/xhit/go-str2duration/v2			 v2.1.0 \
	golang.org/x/crypto					 v0.25.0 \
	golang.org/x/net					 v0.21.0 \
	golang.org/x/oauth2					 v0.12.0 \
	golang.org/x/sync					 v0.3.0 \
	golang.org/x/sys					 v0.22.0 \
	golang.org/x/term					 v0.22.0 \
	golang.org/x/text					 v0.16.0 \
	golang.org/x/xerrors					 v0.0.0-20191204190536-9bdfabe68543 \
	google.golang.org/appengine				 v1.6.7 \
	google.golang.org/protobuf				 v1.33.0 \
	gopkg.in/check.v1					 v1.0.0-20201130134442-10cb98267c6c \
	gopkg.in/yaml.v2					 v2.4.0 \
	gopkg.in/yaml.v3					 v3.0.1

MODGO_MODFILES =	\
	github.com/golang/protobuf		 v1.5.0 \
	github.com/google/go-cmp		 v0.5.5 \
	github.com/klauspost/cpuid/v2		 v2.2.3 \
	github.com/prometheus/client_golang	 v1.17.0 \
	github.com/prometheus/client_model	 v0.4.1-0.20230718164431-9a2bf3000d16 \
	github.com/prometheus/procfs		 v0.11.1 \
	golang.org/x/net			 v0.17.0 \
	golang.org/x/sys			 v0.0.0-20220704084225-05e143d24a9e \
	golang.org/x/sys			 v0.12.0 \
	golang.org/x/sys			 v0.13.0 \
	golang.org/x/sys			 v0.15.0 \
	golang.org/x/sys			 v0.5.0 \
	golang.org/x/text			 v0.13.0 \
	google.golang.org/protobuf		 v1.28.1 \
	google.golang.org/protobuf		 v1.31.0 \
	gopkg.in/check.v1			 v0.0.0-20161208181325-20d25e280405

