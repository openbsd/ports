MODGO_MODULES =	\
	github.com/creack/pty		 v1.1.24 \
	github.com/davecgh/go-spew	 v1.1.1 \
	github.com/fsnotify/fsnotify	 v1.9.0 \
	github.com/go-kit/kit		 v0.12.0 \
	github.com/go-kit/log		 v0.2.0 \
	github.com/go-logfmt/logfmt	 v0.5.1 \
	github.com/go-logr/logr		 v1.3.0 \
	github.com/go-logr/stdr		 v1.2.2 \
	github.com/google/go-cmp	 v0.6.0 \
	github.com/jezek/xgb		 v1.1.1 \
	github.com/rs/zerolog		 v1.26.1 \
	github.com/sirupsen/logrus	 v1.8.1 \
	github.com/yuin/goldmark	 v1.4.13 \
	go.opentelemetry.io/otel	 v1.21.0 \
	go.opentelemetry.io/otel/metric	 v1.21.0 \
	go.opentelemetry.io/otel/sdk	 v1.21.0 \
	go.opentelemetry.io/otel/trace	 v1.21.0 \
	go.uber.org/atomic		 v1.9.0 \
	go.uber.org/multierr		 v1.7.0 \
	go.uber.org/zap			 v1.21.0 \
	golang.org/x/crypto		 v0.48.0 \
	golang.org/x/exp		 v0.0.0-20240325151524-a685a6edb6d8 \
	golang.org/x/exp/event		 v0.0.0-20250819193227-8b4c13bb791b \
	golang.org/x/exp/jsonrpc2	 v0.0.0-20250911091902-df9299821621 \
	golang.org/x/image		 v0.38.0 \
	golang.org/x/mod		 v0.33.0 \
	golang.org/x/net		 v0.50.0 \
	golang.org/x/sync		 v0.20.0 \
	golang.org/x/sys		 v0.41.0 \
	golang.org/x/telemetry		 v0.0.0-20260209163413-e7419c687ee4 \
	golang.org/x/term		 v0.40.0 \
	golang.org/x/text		 v0.35.0 \
	golang.org/x/tools		 v0.42.0 \
	golang.org/x/xerrors		 v0.0.0-20240903120638-7835f813f4da

MODGO_MODFILES =	\
	github.com/google/go-cmp	 v0.5.8 \
	golang.org/x/mod		 v0.16.0 \
	golang.org/x/sync		 v0.19.0 \
	golang.org/x/sys		 v0.13.0 \
	golang.org/x/sys		 v0.35.0 \
	golang.org/x/text		 v0.34.0 \
	golang.org/x/tools		 v0.19.0 \
	golang.org/x/tools		 v0.41.0

