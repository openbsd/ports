MODCARGO_CRATES +=	addr2line	0.22.0	# Apache-2.0 OR MIT
MODCARGO_CRATES +=	adler	1.0.2	# 0BSD OR MIT OR Apache-2.0
MODCARGO_CRATES +=	adler2	2.0.0	# 0BSD OR MIT OR Apache-2.0
MODCARGO_CRATES +=	ahash	0.8.11	# MIT OR Apache-2.0
MODCARGO_CRATES +=	aho-corasick	1.1.3	# Unlicense OR MIT
MODCARGO_CRATES +=	allocator-api2	0.2.18	# MIT OR Apache-2.0
MODCARGO_CRATES +=	android-tzdata	0.1.1	# MIT OR Apache-2.0
MODCARGO_CRATES +=	android_system_properties	0.1.5	# MIT/Apache-2.0
MODCARGO_CRATES +=	anyhow	1.0.95	# MIT OR Apache-2.0
MODCARGO_CRATES +=	arc-swap	1.7.1	# MIT OR Apache-2.0
MODCARGO_CRATES +=	autocfg	1.3.0	# Apache-2.0 OR MIT
MODCARGO_CRATES +=	backtrace	0.3.73	# MIT OR Apache-2.0
MODCARGO_CRATES +=	bitflags	2.7.0	# MIT OR Apache-2.0
MODCARGO_CRATES +=	bstr	1.10.0	# MIT OR Apache-2.0
MODCARGO_CRATES +=	bumpalo	3.16.0	# MIT OR Apache-2.0
MODCARGO_CRATES +=	bytes	1.7.1	# MIT
MODCARGO_CRATES +=	cassowary	0.3.0	# MIT / Apache-2.0
MODCARGO_CRATES +=	cc	1.2.9	# MIT OR Apache-2.0
MODCARGO_CRATES +=	cfg-if	1.0.0	# MIT/Apache-2.0
MODCARGO_CRATES +=	chardetng	0.1.17	# Apache-2.0 OR MIT
MODCARGO_CRATES +=	chrono	0.4.39	# MIT OR Apache-2.0
MODCARGO_CRATES +=	clipboard-win	5.4.0	# BSL-1.0
MODCARGO_CRATES +=	clru	0.6.2	# MIT
MODCARGO_CRATES +=	content_inspector	0.2.4	# MIT/Apache-2.0
MODCARGO_CRATES +=	core-foundation-sys	0.8.7	# MIT OR Apache-2.0
MODCARGO_CRATES +=	crc32fast	1.4.2	# MIT OR Apache-2.0
MODCARGO_CRATES +=	crossbeam-deque	0.8.5	# MIT OR Apache-2.0
MODCARGO_CRATES +=	crossbeam-epoch	0.9.18	# MIT OR Apache-2.0
MODCARGO_CRATES +=	crossbeam-utils	0.8.20	# MIT OR Apache-2.0
MODCARGO_CRATES +=	crossterm	0.28.1	# MIT
MODCARGO_CRATES +=	crossterm_winapi	0.9.1	# MIT
MODCARGO_CRATES +=	dashmap	6.1.0	# MIT
MODCARGO_CRATES +=	displaydoc	0.2.5	# MIT OR Apache-2.0
MODCARGO_CRATES +=	dunce	1.0.5	# CC0-1.0 OR MIT-0 OR Apache-2.0
MODCARGO_CRATES +=	either	1.13.0	# MIT OR Apache-2.0
MODCARGO_CRATES +=	encoding_rs	0.8.35	# (Apache-2.0 OR MIT) AND BSD-3-Clause
MODCARGO_CRATES +=	encoding_rs_io	0.1.7	# MIT OR Apache-2.0
MODCARGO_CRATES +=	env_home	0.1.0	# MIT OR Apache-2.0
MODCARGO_CRATES +=	equivalent	1.0.1	# Apache-2.0 OR MIT
MODCARGO_CRATES +=	errno	0.3.10	# MIT OR Apache-2.0
MODCARGO_CRATES +=	error-code	3.2.0	# BSL-1.0
MODCARGO_CRATES +=	etcetera	0.8.0	# MIT OR Apache-2.0
MODCARGO_CRATES +=	faster-hex	0.9.0	# MIT
MODCARGO_CRATES +=	fastrand	2.1.1	# Apache-2.0 OR MIT
MODCARGO_CRATES +=	fern	0.7.1	# MIT
MODCARGO_CRATES +=	filedescriptor	0.8.2	# MIT
MODCARGO_CRATES +=	filetime	0.2.25	# MIT/Apache-2.0
MODCARGO_CRATES +=	flate2	1.0.33	# MIT OR Apache-2.0
MODCARGO_CRATES +=	fnv	1.0.7	# Apache-2.0 / MIT
MODCARGO_CRATES +=	form_urlencoded	1.2.1	# MIT OR Apache-2.0
MODCARGO_CRATES +=	futures-core	0.3.31	# MIT OR Apache-2.0
MODCARGO_CRATES +=	futures-executor	0.3.31	# MIT OR Apache-2.0
MODCARGO_CRATES +=	futures-task	0.3.31	# MIT OR Apache-2.0
MODCARGO_CRATES +=	futures-util	0.3.31	# MIT OR Apache-2.0
MODCARGO_CRATES +=	getrandom	0.2.15	# MIT OR Apache-2.0
MODCARGO_CRATES +=	gimli	0.29.0	# MIT OR Apache-2.0
MODCARGO_CRATES +=	gix	0.69.1	# MIT OR Apache-2.0
MODCARGO_CRATES +=	gix-actor	0.33.1	# MIT OR Apache-2.0
MODCARGO_CRATES +=	gix-attributes	0.23.1	# MIT OR Apache-2.0
MODCARGO_CRATES +=	gix-bitmap	0.2.13	# MIT OR Apache-2.0
MODCARGO_CRATES +=	gix-chunk	0.4.10	# MIT OR Apache-2.0
MODCARGO_CRATES +=	gix-command	0.4.0	# MIT OR Apache-2.0
MODCARGO_CRATES +=	gix-commitgraph	0.25.1	# MIT OR Apache-2.0
MODCARGO_CRATES +=	gix-config	0.42.0	# MIT OR Apache-2.0
MODCARGO_CRATES +=	gix-config-value	0.14.10	# MIT OR Apache-2.0
MODCARGO_CRATES +=	gix-date	0.9.3	# MIT OR Apache-2.0
MODCARGO_CRATES +=	gix-diff	0.49.0	# MIT OR Apache-2.0
MODCARGO_CRATES +=	gix-dir	0.11.0	# MIT OR Apache-2.0
MODCARGO_CRATES +=	gix-discover	0.37.0	# MIT OR Apache-2.0
MODCARGO_CRATES +=	gix-features	0.39.1	# MIT OR Apache-2.0
MODCARGO_CRATES +=	gix-filter	0.16.0	# MIT OR Apache-2.0
MODCARGO_CRATES +=	gix-fs	0.12.1	# MIT OR Apache-2.0
MODCARGO_CRATES +=	gix-glob	0.17.1	# MIT OR Apache-2.0
MODCARGO_CRATES +=	gix-hash	0.15.1	# MIT OR Apache-2.0
MODCARGO_CRATES +=	gix-hashtable	0.6.0	# MIT OR Apache-2.0
MODCARGO_CRATES +=	gix-ignore	0.12.1	# MIT OR Apache-2.0
MODCARGO_CRATES +=	gix-index	0.37.0	# MIT OR Apache-2.0
MODCARGO_CRATES +=	gix-lock	15.0.0	# MIT OR Apache-2.0
MODCARGO_CRATES +=	gix-object	0.46.1	# MIT OR Apache-2.0
MODCARGO_CRATES +=	gix-odb	0.66.0	# MIT OR Apache-2.0
MODCARGO_CRATES +=	gix-pack	0.56.0	# MIT OR Apache-2.0
MODCARGO_CRATES +=	gix-packetline	0.18.2	# MIT OR Apache-2.0
MODCARGO_CRATES +=	gix-packetline-blocking	0.18.1	# MIT OR Apache-2.0
MODCARGO_CRATES +=	gix-path	0.10.13	# MIT OR Apache-2.0
MODCARGO_CRATES +=	gix-pathspec	0.8.1	# MIT OR Apache-2.0
MODCARGO_CRATES +=	gix-protocol	0.47.0	# MIT OR Apache-2.0
MODCARGO_CRATES +=	gix-quote	0.4.14	# MIT OR Apache-2.0
MODCARGO_CRATES +=	gix-ref	0.49.1	# MIT OR Apache-2.0
MODCARGO_CRATES +=	gix-refspec	0.27.0	# MIT OR Apache-2.0
MODCARGO_CRATES +=	gix-revision	0.31.1	# MIT OR Apache-2.0
MODCARGO_CRATES +=	gix-revwalk	0.17.0	# MIT OR Apache-2.0
MODCARGO_CRATES +=	gix-sec	0.10.10	# MIT OR Apache-2.0
MODCARGO_CRATES +=	gix-shallow	0.1.0	# MIT OR Apache-2.0
MODCARGO_CRATES +=	gix-status	0.16.0	# MIT OR Apache-2.0
MODCARGO_CRATES +=	gix-submodule	0.16.0	# MIT OR Apache-2.0
MODCARGO_CRATES +=	gix-tempfile	15.0.0	# MIT OR Apache-2.0
MODCARGO_CRATES +=	gix-trace	0.1.11	# MIT OR Apache-2.0
MODCARGO_CRATES +=	gix-transport	0.44.0	# MIT OR Apache-2.0
MODCARGO_CRATES +=	gix-traverse	0.43.1	# MIT OR Apache-2.0
MODCARGO_CRATES +=	gix-url	0.28.2	# MIT OR Apache-2.0
MODCARGO_CRATES +=	gix-utils	0.1.13	# MIT OR Apache-2.0
MODCARGO_CRATES +=	gix-validate	0.9.2	# MIT OR Apache-2.0
MODCARGO_CRATES +=	gix-worktree	0.38.0	# MIT OR Apache-2.0
MODCARGO_CRATES +=	globset	0.4.15	# Unlicense OR MIT
MODCARGO_CRATES +=	grep-matcher	0.1.7	# Unlicense OR MIT
MODCARGO_CRATES +=	grep-regex	0.1.13	# Unlicense OR MIT
MODCARGO_CRATES +=	grep-searcher	0.1.14	# Unlicense OR MIT
MODCARGO_CRATES +=	hashbrown	0.14.5	# MIT OR Apache-2.0
MODCARGO_CRATES +=	hermit-abi	0.3.9	# MIT OR Apache-2.0
MODCARGO_CRATES +=	home	0.5.9	# MIT OR Apache-2.0
MODCARGO_CRATES +=	iana-time-zone	0.1.60	# MIT OR Apache-2.0
MODCARGO_CRATES +=	iana-time-zone-haiku	0.1.2	# MIT OR Apache-2.0
MODCARGO_CRATES +=	icu_collections	1.5.0	# Unicode-3.0
MODCARGO_CRATES +=	icu_locid	1.5.0	# Unicode-3.0
MODCARGO_CRATES +=	icu_locid_transform	1.5.0	# Unicode-3.0
MODCARGO_CRATES +=	icu_locid_transform_data	1.5.0	# Unicode-3.0
MODCARGO_CRATES +=	icu_normalizer	1.5.0	# Unicode-3.0
MODCARGO_CRATES +=	icu_normalizer_data	1.5.0	# Unicode-3.0
MODCARGO_CRATES +=	icu_properties	1.5.1	# Unicode-3.0
MODCARGO_CRATES +=	icu_properties_data	1.5.0	# Unicode-3.0
MODCARGO_CRATES +=	icu_provider	1.5.0	# Unicode-3.0
MODCARGO_CRATES +=	icu_provider_macros	1.5.0	# Unicode-3.0
MODCARGO_CRATES +=	idna	1.0.3	# MIT OR Apache-2.0
MODCARGO_CRATES +=	idna_adapter	1.2.0	# Apache-2.0 OR MIT
MODCARGO_CRATES +=	ignore	0.4.23	# Unlicense OR MIT
MODCARGO_CRATES +=	imara-diff	0.1.7	# Apache-2.0
MODCARGO_CRATES +=	indexmap	2.5.0	# Apache-2.0 OR MIT
MODCARGO_CRATES +=	indoc	2.0.5	# MIT OR Apache-2.0
MODCARGO_CRATES +=	is-docker	0.2.0	# MIT
MODCARGO_CRATES +=	is-wsl	0.4.0	# MIT
MODCARGO_CRATES +=	itoa	1.0.11	# MIT OR Apache-2.0
MODCARGO_CRATES +=	jiff	0.1.13	# Unlicense OR MIT
MODCARGO_CRATES +=	jiff-tzdb	0.1.1	# Unlicense OR MIT
MODCARGO_CRATES +=	jiff-tzdb-platform	0.1.1	# Unlicense OR MIT
MODCARGO_CRATES +=	js-sys	0.3.70	# MIT OR Apache-2.0
MODCARGO_CRATES +=	kstring	2.0.2	# MIT OR Apache-2.0
MODCARGO_CRATES +=	libc	0.2.169	# MIT OR Apache-2.0
MODCARGO_CRATES +=	libloading	0.8.6	# ISC
MODCARGO_CRATES +=	libredox	0.1.3	# MIT
MODCARGO_CRATES +=	linux-raw-sys	0.4.14	# Apache-2.0 WITH LLVM-exception OR Apache-2.0 OR MIT
MODCARGO_CRATES +=	litemap	0.7.3	# Unicode-3.0
MODCARGO_CRATES +=	lock_api	0.4.12	# MIT OR Apache-2.0
MODCARGO_CRATES +=	log	0.4.22	# MIT OR Apache-2.0
MODCARGO_CRATES +=	maybe-async	0.2.10	# MIT
MODCARGO_CRATES +=	memchr	2.7.4	# Unlicense OR MIT
MODCARGO_CRATES +=	memmap2	0.9.4	# MIT OR Apache-2.0
MODCARGO_CRATES +=	miniz_oxide	0.7.4	# MIT OR Zlib OR Apache-2.0
MODCARGO_CRATES +=	miniz_oxide	0.8.0	# MIT OR Zlib OR Apache-2.0
MODCARGO_CRATES +=	mio	1.0.2	# MIT
MODCARGO_CRATES +=	nucleo	0.5.0	# MPL-2.0
MODCARGO_CRATES +=	nucleo-matcher	0.3.1	# MPL-2.0
MODCARGO_CRATES +=	num-traits	0.2.19	# MIT OR Apache-2.0
MODCARGO_CRATES +=	num_cpus	1.16.0	# MIT OR Apache-2.0
MODCARGO_CRATES +=	object	0.36.4	# Apache-2.0 OR MIT
MODCARGO_CRATES +=	once_cell	1.20.2	# MIT OR Apache-2.0
MODCARGO_CRATES +=	open	5.3.2	# MIT
MODCARGO_CRATES +=	parking_lot	0.12.3	# MIT OR Apache-2.0
MODCARGO_CRATES +=	parking_lot_core	0.9.10	# MIT OR Apache-2.0
MODCARGO_CRATES +=	pathdiff	0.2.1	# MIT/Apache-2.0
MODCARGO_CRATES +=	percent-encoding	2.3.1	# MIT OR Apache-2.0
MODCARGO_CRATES +=	pin-project-lite	0.2.14	# Apache-2.0 OR MIT
MODCARGO_CRATES +=	pin-utils	0.1.0	# MIT OR Apache-2.0
MODCARGO_CRATES +=	portable-atomic	1.7.0	# Apache-2.0 OR MIT
MODCARGO_CRATES +=	proc-macro2	1.0.86	# MIT OR Apache-2.0
MODCARGO_CRATES +=	prodash	29.0.0	# MIT
MODCARGO_CRATES +=	pulldown-cmark	0.12.2	# MIT
MODCARGO_CRATES +=	quickcheck	1.0.3	# Unlicense/MIT
MODCARGO_CRATES +=	quote	1.0.37	# MIT OR Apache-2.0
MODCARGO_CRATES +=	rand	0.8.5	# MIT OR Apache-2.0
MODCARGO_CRATES +=	rand_core	0.6.4	# MIT OR Apache-2.0
MODCARGO_CRATES +=	rayon	1.10.0	# MIT OR Apache-2.0
MODCARGO_CRATES +=	rayon-core	1.12.1	# MIT OR Apache-2.0
MODCARGO_CRATES +=	redox_syscall	0.5.3	# MIT
MODCARGO_CRATES +=	regex	1.11.1	# MIT OR Apache-2.0
MODCARGO_CRATES +=	regex-automata	0.4.9	# MIT OR Apache-2.0
MODCARGO_CRATES +=	regex-cursor	0.1.4	# MIT OR Apache-2.0
MODCARGO_CRATES +=	regex-syntax	0.8.5	# MIT OR Apache-2.0
MODCARGO_CRATES +=	ropey	1.6.1	# MIT
MODCARGO_CRATES +=	rustc-demangle	0.1.24	# MIT/Apache-2.0
MODCARGO_CRATES +=	rustix	0.38.43	# Apache-2.0 WITH LLVM-exception OR Apache-2.0 OR MIT
MODCARGO_CRATES +=	ryu	1.0.18	# Apache-2.0 OR BSL-1.0
MODCARGO_CRATES +=	same-file	1.0.6	# Unlicense/MIT
MODCARGO_CRATES +=	scopeguard	1.2.0	# MIT OR Apache-2.0
MODCARGO_CRATES +=	serde	1.0.217	# MIT OR Apache-2.0
MODCARGO_CRATES +=	serde_derive	1.0.217	# MIT OR Apache-2.0
MODCARGO_CRATES +=	serde_json	1.0.135	# MIT OR Apache-2.0
MODCARGO_CRATES +=	serde_repr	0.1.19	# MIT OR Apache-2.0
MODCARGO_CRATES +=	serde_spanned	0.6.7	# MIT OR Apache-2.0
MODCARGO_CRATES +=	sha1_smol	1.0.1	# BSD-3-Clause
MODCARGO_CRATES +=	shell-words	1.1.0	# MIT/Apache-2.0
MODCARGO_CRATES +=	shlex	1.3.0	# MIT OR Apache-2.0
MODCARGO_CRATES +=	signal-hook	0.3.17	# Apache-2.0/MIT
MODCARGO_CRATES +=	signal-hook-mio	0.2.4	# Apache-2.0/MIT
MODCARGO_CRATES +=	signal-hook-registry	1.4.2	# Apache-2.0/MIT
MODCARGO_CRATES +=	signal-hook-tokio	0.3.1	# Apache-2.0/MIT
MODCARGO_CRATES +=	slab	0.4.9	# MIT
MODCARGO_CRATES +=	slotmap	1.0.7	# Zlib
MODCARGO_CRATES +=	smallvec	1.13.2	# MIT OR Apache-2.0
MODCARGO_CRATES +=	smartstring	1.0.1	# MPL-2.0+
MODCARGO_CRATES +=	smawk	0.3.2	# MIT
MODCARGO_CRATES +=	socket2	0.5.7	# MIT OR Apache-2.0
MODCARGO_CRATES +=	stable_deref_trait	1.2.0	# MIT/Apache-2.0
MODCARGO_CRATES +=	static_assertions	1.1.0	# MIT OR Apache-2.0
MODCARGO_CRATES +=	str_indices	0.4.3	# MIT OR Apache-2.0
MODCARGO_CRATES +=	syn	2.0.87	# MIT OR Apache-2.0
MODCARGO_CRATES +=	synstructure	0.13.1	# MIT
MODCARGO_CRATES +=	tempfile	3.15.0	# MIT OR Apache-2.0
MODCARGO_CRATES +=	termini	1.0.0	# MIT
MODCARGO_CRATES +=	textwrap	0.16.1	# MIT
MODCARGO_CRATES +=	thiserror	1.0.69	# MIT OR Apache-2.0
MODCARGO_CRATES +=	thiserror	2.0.11	# MIT OR Apache-2.0
MODCARGO_CRATES +=	thiserror-impl	1.0.69	# MIT OR Apache-2.0
MODCARGO_CRATES +=	thiserror-impl	2.0.11	# MIT OR Apache-2.0
MODCARGO_CRATES +=	threadpool	1.8.1	# MIT/Apache-2.0
MODCARGO_CRATES +=	tinystr	0.7.6	# Unicode-3.0
MODCARGO_CRATES +=	tinyvec	1.8.0	# Zlib OR Apache-2.0 OR MIT
MODCARGO_CRATES +=	tinyvec_macros	0.1.1	# MIT OR Apache-2.0 OR Zlib
MODCARGO_CRATES +=	tokio	1.43.0	# MIT
MODCARGO_CRATES +=	tokio-macros	2.5.0	# MIT
MODCARGO_CRATES +=	tokio-stream	0.1.17	# MIT
MODCARGO_CRATES +=	toml	0.8.19	# MIT OR Apache-2.0
MODCARGO_CRATES +=	toml_datetime	0.6.8	# MIT OR Apache-2.0
MODCARGO_CRATES +=	toml_edit	0.22.20	# MIT OR Apache-2.0
MODCARGO_CRATES +=	tree-sitter	0.22.6	# MIT
MODCARGO_CRATES +=	unicase	2.7.0	# MIT/Apache-2.0
MODCARGO_CRATES +=	unicode-bom	2.0.3	# Apache-2.0
MODCARGO_CRATES +=	unicode-general-category	1.0.0	# Apache-2.0
MODCARGO_CRATES +=	unicode-ident	1.0.12	# (MIT OR Apache-2.0) AND Unicode-DFS-2016
MODCARGO_CRATES +=	unicode-linebreak	0.1.5	# Apache-2.0
MODCARGO_CRATES +=	unicode-normalization	0.1.23	# MIT/Apache-2.0
MODCARGO_CRATES +=	unicode-segmentation	1.12.0	# MIT OR Apache-2.0
MODCARGO_CRATES +=	unicode-width	0.1.12	# MIT OR Apache-2.0
MODCARGO_CRATES +=	url	2.5.4	# MIT OR Apache-2.0
MODCARGO_CRATES +=	utf16_iter	1.0.5	# Apache-2.0 OR MIT
MODCARGO_CRATES +=	utf8_iter	1.0.4	# Apache-2.0 OR MIT
MODCARGO_CRATES +=	version_check	0.9.5	# MIT/Apache-2.0
MODCARGO_CRATES +=	walkdir	2.5.0	# Unlicense/MIT
MODCARGO_CRATES +=	wasi	0.11.0+wasi-snapshot-preview1	# Apache-2.0 WITH LLVM-exception OR Apache-2.0 OR MIT
MODCARGO_CRATES +=	wasm-bindgen	0.2.93	# MIT OR Apache-2.0
MODCARGO_CRATES +=	wasm-bindgen-backend	0.2.93	# MIT OR Apache-2.0
MODCARGO_CRATES +=	wasm-bindgen-macro	0.2.93	# MIT OR Apache-2.0
MODCARGO_CRATES +=	wasm-bindgen-macro-support	0.2.93	# MIT OR Apache-2.0
MODCARGO_CRATES +=	wasm-bindgen-shared	0.2.93	# MIT OR Apache-2.0
MODCARGO_CRATES +=	which	7.0.1	# MIT
MODCARGO_CRATES +=	winapi	0.3.9	# MIT/Apache-2.0
MODCARGO_CRATES +=	winapi-i686-pc-windows-gnu	0.4.0	# MIT/Apache-2.0
MODCARGO_CRATES +=	winapi-util	0.1.9	# Unlicense OR MIT
MODCARGO_CRATES +=	winapi-x86_64-pc-windows-gnu	0.4.0	# MIT/Apache-2.0
MODCARGO_CRATES +=	windows-core	0.52.0	# MIT OR Apache-2.0
MODCARGO_CRATES +=	windows-sys	0.48.0	# MIT OR Apache-2.0
MODCARGO_CRATES +=	windows-sys	0.52.0	# MIT OR Apache-2.0
MODCARGO_CRATES +=	windows-sys	0.59.0	# MIT OR Apache-2.0
MODCARGO_CRATES +=	windows-targets	0.48.5	# MIT OR Apache-2.0
MODCARGO_CRATES +=	windows-targets	0.52.6	# MIT OR Apache-2.0
MODCARGO_CRATES +=	windows_aarch64_gnullvm	0.48.5	# MIT OR Apache-2.0
MODCARGO_CRATES +=	windows_aarch64_gnullvm	0.52.6	# MIT OR Apache-2.0
MODCARGO_CRATES +=	windows_aarch64_msvc	0.48.5	# MIT OR Apache-2.0
MODCARGO_CRATES +=	windows_aarch64_msvc	0.52.6	# MIT OR Apache-2.0
MODCARGO_CRATES +=	windows_i686_gnu	0.48.5	# MIT OR Apache-2.0
MODCARGO_CRATES +=	windows_i686_gnu	0.52.6	# MIT OR Apache-2.0
MODCARGO_CRATES +=	windows_i686_gnullvm	0.52.6	# MIT OR Apache-2.0
MODCARGO_CRATES +=	windows_i686_msvc	0.48.5	# MIT OR Apache-2.0
MODCARGO_CRATES +=	windows_i686_msvc	0.52.6	# MIT OR Apache-2.0
MODCARGO_CRATES +=	windows_x86_64_gnu	0.48.5	# MIT OR Apache-2.0
MODCARGO_CRATES +=	windows_x86_64_gnu	0.52.6	# MIT OR Apache-2.0
MODCARGO_CRATES +=	windows_x86_64_gnullvm	0.48.5	# MIT OR Apache-2.0
MODCARGO_CRATES +=	windows_x86_64_gnullvm	0.52.6	# MIT OR Apache-2.0
MODCARGO_CRATES +=	windows_x86_64_msvc	0.48.5	# MIT OR Apache-2.0
MODCARGO_CRATES +=	windows_x86_64_msvc	0.52.6	# MIT OR Apache-2.0
MODCARGO_CRATES +=	winnow	0.6.18	# MIT
MODCARGO_CRATES +=	winsafe	0.0.19	# MIT
MODCARGO_CRATES +=	write16	1.0.0	# Apache-2.0 OR MIT
MODCARGO_CRATES +=	writeable	0.5.5	# Unicode-3.0
MODCARGO_CRATES +=	yoke	0.7.4	# Unicode-3.0
MODCARGO_CRATES +=	yoke-derive	0.7.4	# Unicode-3.0
MODCARGO_CRATES +=	zerocopy	0.7.35	# BSD-2-Clause OR Apache-2.0 OR MIT
MODCARGO_CRATES +=	zerocopy-derive	0.7.35	# BSD-2-Clause OR Apache-2.0 OR MIT
MODCARGO_CRATES +=	zerofrom	0.1.4	# Unicode-3.0
MODCARGO_CRATES +=	zerofrom-derive	0.1.4	# Unicode-3.0
MODCARGO_CRATES +=	zerovec	0.10.4	# Unicode-3.0
MODCARGO_CRATES +=	zerovec-derive	0.10.3	# Unicode-3.0
