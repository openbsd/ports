MODCARGO_CRATES +=	aho-corasick	0.7.19	# Unlicense/MIT
MODCARGO_CRATES +=	bitflags	1.3.2	# MIT/Apache-2.0
MODCARGO_CRATES +=	bitflags	2.10.0	# MIT OR Apache-2.0
MODCARGO_CRATES +=	block-buffer	0.10.3	# MIT OR Apache-2.0
MODCARGO_CRATES +=	bstr	0.2.17	# MIT OR Apache-2.0
MODCARGO_CRATES +=	bstr	1.10.0	# MIT OR Apache-2.0
MODCARGO_CRATES +=	camino	1.1.6	# MIT OR Apache-2.0
MODCARGO_CRATES +=	cargo-platform	0.1.3	# MIT OR Apache-2.0
MODCARGO_CRATES +=	cargo_metadata	0.18.0	# MIT
MODCARGO_CRATES +=	cc	1.0.79	# MIT OR Apache-2.0
MODCARGO_CRATES +=	cfg-if	1.0.0	# MIT/Apache-2.0
MODCARGO_CRATES +=	clap	4.1.14	# MIT OR Apache-2.0
MODCARGO_CRATES +=	clap_builder	4.1.14	# MIT OR Apache-2.0
MODCARGO_CRATES +=	clap_derive	4.1.14	# MIT OR Apache-2.0
MODCARGO_CRATES +=	clap_lex	0.4.1	# MIT OR Apache-2.0
MODCARGO_CRATES +=	console	0.15.4	# MIT
MODCARGO_CRATES +=	cpufeatures	0.2.5	# MIT OR Apache-2.0
MODCARGO_CRATES +=	crossbeam-utils	0.8.11	# MIT OR Apache-2.0
MODCARGO_CRATES +=	crypto-common	0.1.6	# MIT OR Apache-2.0
MODCARGO_CRATES +=	csv	1.1.6	# Unlicense/MIT
MODCARGO_CRATES +=	csv-core	0.1.11	# Unlicense/MIT
MODCARGO_CRATES +=	digest	0.10.7	# MIT OR Apache-2.0
MODCARGO_CRATES +=	either	1.13.0	# MIT OR Apache-2.0
MODCARGO_CRATES +=	encode_unicode	0.3.6	# MIT/Apache-2.0
MODCARGO_CRATES +=	errno	0.3.1	# MIT OR Apache-2.0
MODCARGO_CRATES +=	errno-dragonfly	0.1.2	# MIT
MODCARGO_CRATES +=	fastrand	1.9.0	# Apache-2.0 OR MIT
MODCARGO_CRATES +=	fnv	1.0.7	# Apache-2.0 / MIT
MODCARGO_CRATES +=	generic-array	0.14.6	# MIT
MODCARGO_CRATES +=	getrandom	0.2.7	# MIT OR Apache-2.0
MODCARGO_CRATES +=	globset	0.4.9	# Unlicense OR MIT
MODCARGO_CRATES +=	heck	0.4.1	# MIT OR Apache-2.0
MODCARGO_CRATES +=	hermit-abi	0.3.9	# MIT OR Apache-2.0
MODCARGO_CRATES +=	ignore	0.4.18	# Unlicense/MIT
MODCARGO_CRATES +=	instant	0.1.12	# BSD-3-Clause
MODCARGO_CRATES +=	io-lifetimes	1.0.11	# Apache-2.0 WITH LLVM-exception OR Apache-2.0 OR MIT
MODCARGO_CRATES +=	is-docker	0.2.0	# MIT
MODCARGO_CRATES +=	is-terminal	0.4.12	# MIT
MODCARGO_CRATES +=	is-wsl	0.4.0	# MIT
MODCARGO_CRATES +=	itertools	0.10.5	# MIT/Apache-2.0
MODCARGO_CRATES +=	itoa	0.4.8	# MIT OR Apache-2.0
MODCARGO_CRATES +=	itoa	1.0.3	# MIT OR Apache-2.0
MODCARGO_CRATES +=	lazy_static	1.4.0	# MIT/Apache-2.0
MODCARGO_CRATES +=	libc	0.2.174	# MIT OR Apache-2.0
MODCARGO_CRATES +=	linux-raw-sys	0.3.8	# Apache-2.0 WITH LLVM-exception OR Apache-2.0 OR MIT
MODCARGO_CRATES +=	log	0.4.17	# MIT OR Apache-2.0
MODCARGO_CRATES +=	memchr	2.7.4	# Unlicense OR MIT
MODCARGO_CRATES +=	once_cell	1.20.2	# MIT OR Apache-2.0
MODCARGO_CRATES +=	open	5.3.0	# MIT
MODCARGO_CRATES +=	os_pipe	1.2.1	# MIT
MODCARGO_CRATES +=	pathdiff	0.2.3	# MIT/Apache-2.0
MODCARGO_CRATES +=	pest	2.7.11	# MIT OR Apache-2.0
MODCARGO_CRATES +=	pest_derive	2.7.11	# MIT OR Apache-2.0
MODCARGO_CRATES +=	pest_generator	2.7.11	# MIT OR Apache-2.0
MODCARGO_CRATES +=	pest_meta	2.7.11	# MIT OR Apache-2.0
MODCARGO_CRATES +=	proc-macro2	1.0.94	# MIT OR Apache-2.0
MODCARGO_CRATES +=	quote	1.0.36	# MIT OR Apache-2.0
MODCARGO_CRATES +=	redox_syscall	0.3.5	# MIT
MODCARGO_CRATES +=	regex	1.6.0	# MIT OR Apache-2.0
MODCARGO_CRATES +=	regex-automata	0.1.10	# Unlicense/MIT
MODCARGO_CRATES +=	regex-automata	0.4.7	# MIT OR Apache-2.0
MODCARGO_CRATES +=	regex-syntax	0.6.27	# MIT OR Apache-2.0
MODCARGO_CRATES +=	ron	0.12.0	# MIT OR Apache-2.0
MODCARGO_CRATES +=	rust-strings	0.6.0	# MIT
MODCARGO_CRATES +=	rustc_version	0.4.0	# MIT/Apache-2.0
MODCARGO_CRATES +=	rustix	0.37.27	# Apache-2.0 WITH LLVM-exception OR Apache-2.0 OR MIT
MODCARGO_CRATES +=	ryu	1.0.11	# Apache-2.0 OR BSL-1.0
MODCARGO_CRATES +=	same-file	1.0.6	# Unlicense/MIT
MODCARGO_CRATES +=	semver	1.0.19	# MIT OR Apache-2.0
MODCARGO_CRATES +=	serde	1.0.228	# MIT OR Apache-2.0
MODCARGO_CRATES +=	serde_core	1.0.228	# MIT OR Apache-2.0
MODCARGO_CRATES +=	serde_derive	1.0.228	# MIT OR Apache-2.0
MODCARGO_CRATES +=	serde_json	1.0.85	# MIT OR Apache-2.0
MODCARGO_CRATES +=	sha2	0.10.8	# MIT OR Apache-2.0
MODCARGO_CRATES +=	similar	2.6.0	# Apache-2.0
MODCARGO_CRATES +=	similar-asserts	1.5.0	# Apache-2.0
MODCARGO_CRATES +=	strsim	0.10.0	# MIT
MODCARGO_CRATES +=	syn	2.0.100	# MIT OR Apache-2.0
MODCARGO_CRATES +=	tempfile	3.5.0	# MIT OR Apache-2.0
MODCARGO_CRATES +=	termcolor	1.4.1	# Unlicense OR MIT
MODCARGO_CRATES +=	thiserror	1.0.40	# MIT OR Apache-2.0
MODCARGO_CRATES +=	thiserror-impl	1.0.40	# MIT OR Apache-2.0
MODCARGO_CRATES +=	thread_local	1.1.4	# Apache-2.0/MIT
MODCARGO_CRATES +=	toml	0.5.11	# MIT/Apache-2.0
MODCARGO_CRATES +=	typeid	1.0.3	# MIT OR Apache-2.0
MODCARGO_CRATES +=	typenum	1.15.0	# MIT OR Apache-2.0
MODCARGO_CRATES +=	ucd-trie	0.1.5	# MIT OR Apache-2.0
MODCARGO_CRATES +=	unicode-ident	1.0.4	# (MIT OR Apache-2.0) AND Unicode-DFS-2016
MODCARGO_CRATES +=	unicode-segmentation	1.10.0	# MIT/Apache-2.0
MODCARGO_CRATES +=	unicode-width	0.1.10	# MIT/Apache-2.0
MODCARGO_CRATES +=	uuid	1.1.2	# Apache-2.0 OR MIT
MODCARGO_CRATES +=	version_check	0.9.4	# MIT/Apache-2.0
MODCARGO_CRATES +=	walkdir	2.3.2	# Unlicense/MIT
MODCARGO_CRATES +=	wasi	0.11.0+wasi-snapshot-preview1	# Apache-2.0 WITH LLVM-exception OR Apache-2.0 OR MIT
MODCARGO_CRATES +=	winapi	0.3.9	# MIT/Apache-2.0
MODCARGO_CRATES +=	winapi-i686-pc-windows-gnu	0.4.0	# MIT/Apache-2.0
MODCARGO_CRATES +=	winapi-util	0.1.5	# Unlicense/MIT
MODCARGO_CRATES +=	winapi-x86_64-pc-windows-gnu	0.4.0	# MIT/Apache-2.0
MODCARGO_CRATES +=	windows-sys	0.42.0	# MIT OR Apache-2.0
MODCARGO_CRATES +=	windows-sys	0.45.0	# MIT OR Apache-2.0
MODCARGO_CRATES +=	windows-sys	0.48.0	# MIT OR Apache-2.0
MODCARGO_CRATES +=	windows-sys	0.52.0	# MIT OR Apache-2.0
MODCARGO_CRATES +=	windows-sys	0.59.0	# MIT OR Apache-2.0
MODCARGO_CRATES +=	windows-targets	0.42.2	# MIT OR Apache-2.0
MODCARGO_CRATES +=	windows-targets	0.48.0	# MIT OR Apache-2.0
MODCARGO_CRATES +=	windows-targets	0.52.6	# MIT OR Apache-2.0
MODCARGO_CRATES +=	windows_aarch64_gnullvm	0.42.2	# MIT OR Apache-2.0
MODCARGO_CRATES +=	windows_aarch64_gnullvm	0.48.0	# MIT OR Apache-2.0
MODCARGO_CRATES +=	windows_aarch64_gnullvm	0.52.6	# MIT OR Apache-2.0
MODCARGO_CRATES +=	windows_aarch64_msvc	0.42.2	# MIT OR Apache-2.0
MODCARGO_CRATES +=	windows_aarch64_msvc	0.48.0	# MIT OR Apache-2.0
MODCARGO_CRATES +=	windows_aarch64_msvc	0.52.6	# MIT OR Apache-2.0
MODCARGO_CRATES +=	windows_i686_gnu	0.42.2	# MIT OR Apache-2.0
MODCARGO_CRATES +=	windows_i686_gnu	0.48.0	# MIT OR Apache-2.0
MODCARGO_CRATES +=	windows_i686_gnu	0.52.6	# MIT OR Apache-2.0
MODCARGO_CRATES +=	windows_i686_gnullvm	0.52.6	# MIT OR Apache-2.0
MODCARGO_CRATES +=	windows_i686_msvc	0.42.2	# MIT OR Apache-2.0
MODCARGO_CRATES +=	windows_i686_msvc	0.48.0	# MIT OR Apache-2.0
MODCARGO_CRATES +=	windows_i686_msvc	0.52.6	# MIT OR Apache-2.0
MODCARGO_CRATES +=	windows_x86_64_gnu	0.42.2	# MIT OR Apache-2.0
MODCARGO_CRATES +=	windows_x86_64_gnu	0.48.0	# MIT OR Apache-2.0
MODCARGO_CRATES +=	windows_x86_64_gnu	0.52.6	# MIT OR Apache-2.0
MODCARGO_CRATES +=	windows_x86_64_gnullvm	0.42.2	# MIT OR Apache-2.0
MODCARGO_CRATES +=	windows_x86_64_gnullvm	0.48.0	# MIT OR Apache-2.0
MODCARGO_CRATES +=	windows_x86_64_gnullvm	0.52.6	# MIT OR Apache-2.0
MODCARGO_CRATES +=	windows_x86_64_msvc	0.42.2	# MIT OR Apache-2.0
MODCARGO_CRATES +=	windows_x86_64_msvc	0.48.0	# MIT OR Apache-2.0
MODCARGO_CRATES +=	windows_x86_64_msvc	0.52.6	# MIT OR Apache-2.0
