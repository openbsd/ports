MODGO_MODULES =	\
	github.com/!burnt!sushi/toml		 v1.5.0 \
	github.com/!make!now!just/heredoc	 v1.0.0 \
	github.com/atotto/clipboard		 v0.1.4 \
	github.com/aymanbagabas/go-osc52/v2	 v2.0.1 \
	github.com/aymanbagabas/go-udiff	 v0.2.0 \
	github.com/bits-and-blooms/bitset	 v1.24.3 \
	github.com/charmbracelet/bubbles	 v0.21.0 \
	github.com/charmbracelet/bubbletea	 v1.3.10 \
	github.com/charmbracelet/colorprofile	 v0.3.3 \
	github.com/charmbracelet/harmonica	 v0.2.0 \
	github.com/charmbracelet/lipgloss	 v1.1.0 \
	github.com/charmbracelet/x/ansi		 v0.11.1 \
	github.com/charmbracelet/x/cellbuf	 v0.0.14 \
	github.com/charmbracelet/x/exp/golden	 v0.0.0-20241011142426-46044092ad91 \
	github.com/charmbracelet/x/term		 v0.2.2 \
	github.com/chzyer/logex			 v1.1.10 \
	github.com/chzyer/readline		 v0.0.0-20180603132655-2972be24d48e \
	github.com/chzyer/test			 v0.0.0-20180213035817-a1ea475d72b1 \
	github.com/clipperhouse/displaywidth	 v0.6.0 \
	github.com/clipperhouse/stringish	 v0.1.1 \
	github.com/clipperhouse/uax29/v2	 v2.3.0 \
	github.com/davecgh/go-spew		 v1.1.1 \
	github.com/dustin/go-humanize		 v1.0.1 \
	github.com/erikgeiser/coninput		 v0.0.0-20211004153227-1c3628e74d0f \
	github.com/kylelemons/godebug		 v1.1.0 \
	github.com/lucasb-eyer/go-colorful	 v1.3.0 \
	github.com/mattn/go-isatty		 v0.0.20 \
	github.com/mattn/go-localereader	 v0.0.1 \
	github.com/mattn/go-runewidth		 v0.0.19 \
	github.com/muesli/ansi			 v0.0.0-20230316100256-276c6243b2f6 \
	github.com/muesli/cancelreader		 v0.2.2 \
	github.com/muesli/termenv		 v0.16.0 \
	github.com/pmezard/go-difflib		 v1.0.0 \
	github.com/rivo/uniseg			 v0.4.7 \
	github.com/sahilm/fuzzy			 v0.1.1 \
	github.com/stretchr/objx		 v0.5.2 \
	github.com/stretchr/testify		 v1.11.1 \
	github.com/xo/terminfo			 v0.0.0-20220910002029-abceb7e1c41e \
	github.com/yuin/gopher-lua		 v1.1.1 \
	golang.org/x/exp			 v0.0.0-20231006140011-7918f672742d \
	golang.org/x/mod			 v0.29.0 \
	golang.org/x/sync			 v0.18.0 \
	golang.org/x/sys			 v0.38.0 \
	golang.org/x/text			 v0.31.0 \
	golang.org/x/tools			 v0.38.0 \
	gopkg.in/check.v1			 v0.0.0-20161208181325-20d25e280405 \
	gopkg.in/yaml.v3			 v3.0.1

MODGO_MODFILES =	\
	github.com/charmbracelet/bubbletea	 v1.3.4 \
	github.com/charmbracelet/colorprofile	 v0.2.3-0.20250311203215-f60798e515dc \
	github.com/charmbracelet/x/ansi		 v0.10.1 \
	github.com/charmbracelet/x/ansi		 v0.10.3 \
	github.com/charmbracelet/x/ansi		 v0.11.0 \
	github.com/charmbracelet/x/ansi		 v0.8.0 \
	github.com/charmbracelet/x/cellbuf	 v0.0.13-0.20250311204145-2c3ea96c31dd \
	github.com/charmbracelet/x/exp/golden	 v0.0.0-20240806155701-69247e0abc2a \
	github.com/charmbracelet/x/term		 v0.2.1 \
	github.com/clipperhouse/displaywidth	 v0.4.1 \
	github.com/clipperhouse/displaywidth	 v0.5.0 \
	github.com/clipperhouse/uax29/v2	 v2.2.0 \
	github.com/lucasb-eyer/go-colorful	 v1.2.0 \
	github.com/mattn/go-runewidth		 v0.0.14 \
	github.com/mattn/go-runewidth		 v0.0.16 \
	github.com/rivo/uniseg			 v0.2.0 \
	golang.org/x/exp			 v0.0.0-20220909182711-5c715a9e8561 \
	golang.org/x/sync			 v0.11.0 \
	golang.org/x/sys			 v0.0.0-20190204203706-41f3e6584952 \
	golang.org/x/sys			 v0.0.0-20210809222454-d867a43fc93e \
	golang.org/x/sys			 v0.0.0-20220204135822-1c1b9b1eba6a \
	golang.org/x/sys			 v0.30.0 \
	golang.org/x/sys			 v0.36.0 \
	golang.org/x/sys			 v0.37.0 \
	golang.org/x/sys			 v0.6.0 \
	golang.org/x/text			 v0.3.8

