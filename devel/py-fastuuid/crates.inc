MODCARGO_CRATES +=	atomic	0.6.1	# Apache-2.0/MIT
MODCARGO_CRATES +=	autocfg	1.5.0	# Apache-2.0 OR MIT
MODCARGO_CRATES +=	block-buffer	0.10.4	# MIT OR Apache-2.0
MODCARGO_CRATES +=	bumpalo	3.19.0	# MIT OR Apache-2.0
MODCARGO_CRATES +=	bytemuck	1.24.0	# Zlib OR Apache-2.0 OR MIT
MODCARGO_CRATES +=	cfg-if	1.0.4	# MIT OR Apache-2.0
MODCARGO_CRATES +=	crypto-common	0.1.6	# MIT OR Apache-2.0
MODCARGO_CRATES +=	digest	0.10.7	# MIT OR Apache-2.0
MODCARGO_CRATES +=	generic-array	0.14.9	# MIT
MODCARGO_CRATES +=	getrandom	0.2.16	# MIT OR Apache-2.0
MODCARGO_CRATES +=	getrandom	0.3.4	# MIT OR Apache-2.0
MODCARGO_CRATES +=	heck	0.5.0	# MIT OR Apache-2.0
MODCARGO_CRATES +=	indoc	2.0.6	# MIT OR Apache-2.0
MODCARGO_CRATES +=	js-sys	0.3.81	# MIT OR Apache-2.0
MODCARGO_CRATES +=	libc	0.2.177	# MIT OR Apache-2.0
MODCARGO_CRATES +=	log	0.4.28	# MIT OR Apache-2.0
MODCARGO_CRATES +=	md-5	0.10.6	# MIT OR Apache-2.0
MODCARGO_CRATES +=	memoffset	0.9.1	# MIT
MODCARGO_CRATES +=	once_cell	1.21.3	# MIT OR Apache-2.0
MODCARGO_CRATES +=	portable-atomic	1.11.1	# Apache-2.0 OR MIT
MODCARGO_CRATES +=	ppv-lite86	0.2.21	# MIT OR Apache-2.0
MODCARGO_CRATES +=	proc-macro2	1.0.101	# MIT OR Apache-2.0
MODCARGO_CRATES +=	pyo3	0.26.0	# MIT OR Apache-2.0
MODCARGO_CRATES +=	pyo3-build-config	0.26.0	# MIT OR Apache-2.0
MODCARGO_CRATES +=	pyo3-ffi	0.26.0	# MIT OR Apache-2.0
MODCARGO_CRATES +=	pyo3-macros	0.26.0	# MIT OR Apache-2.0
MODCARGO_CRATES +=	pyo3-macros-backend	0.26.0	# MIT OR Apache-2.0
MODCARGO_CRATES +=	quote	1.0.41	# MIT OR Apache-2.0
MODCARGO_CRATES +=	r-efi	5.3.0	# MIT OR Apache-2.0 OR LGPL-2.1-or-later
MODCARGO_CRATES +=	rand	0.8.5	# MIT OR Apache-2.0
MODCARGO_CRATES +=	rand_chacha	0.3.1	# MIT OR Apache-2.0
MODCARGO_CRATES +=	rand_core	0.6.4	# MIT OR Apache-2.0
MODCARGO_CRATES +=	rustversion	1.0.22	# MIT OR Apache-2.0
MODCARGO_CRATES +=	sha1_smol	1.0.1	# BSD-3-Clause
MODCARGO_CRATES +=	syn	2.0.107	# MIT OR Apache-2.0
MODCARGO_CRATES +=	target-lexicon	0.13.3	# Apache-2.0 WITH LLVM-exception
MODCARGO_CRATES +=	typenum	1.19.0	# MIT OR Apache-2.0
MODCARGO_CRATES +=	unicode-ident	1.0.19	# (MIT OR Apache-2.0) AND Unicode-3.0
MODCARGO_CRATES +=	unindent	0.2.4	# MIT OR Apache-2.0
MODCARGO_CRATES +=	uuid	1.18.1	# Apache-2.0 OR MIT
MODCARGO_CRATES +=	version_check	0.9.5	# MIT/Apache-2.0
MODCARGO_CRATES +=	wasi	0.11.1+wasi-snapshot-preview1	# Apache-2.0 WITH LLVM-exception OR Apache-2.0 OR MIT
MODCARGO_CRATES +=	wasip2	1.0.1+wasi-0.2.4	# Apache-2.0 WITH LLVM-exception OR Apache-2.0 OR MIT
MODCARGO_CRATES +=	wasm-bindgen	0.2.104	# MIT OR Apache-2.0
MODCARGO_CRATES +=	wasm-bindgen-backend	0.2.104	# MIT OR Apache-2.0
MODCARGO_CRATES +=	wasm-bindgen-macro	0.2.104	# MIT OR Apache-2.0
MODCARGO_CRATES +=	wasm-bindgen-macro-support	0.2.104	# MIT OR Apache-2.0
MODCARGO_CRATES +=	wasm-bindgen-shared	0.2.104	# MIT OR Apache-2.0
MODCARGO_CRATES +=	wit-bindgen	0.46.0	# Apache-2.0 WITH LLVM-exception OR Apache-2.0 OR MIT
MODCARGO_CRATES +=	zerocopy	0.8.27	# BSD-2-Clause OR Apache-2.0 OR MIT
MODCARGO_CRATES +=	zerocopy-derive	0.8.27	# BSD-2-Clause OR Apache-2.0 OR MIT
