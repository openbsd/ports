===>  Generating configure for jujutsu-0.34.0
===>  Configuring for jujutsu-0.34.0
MODCARGO_CRATES +=	addr2line	0.24.2	# Apache-2.0 OR MIT
MODCARGO_CRATES +=	adler2	2.0.1	# 0BSD OR MIT OR Apache-2.0
MODCARGO_CRATES +=	ahash	0.8.12	# MIT OR Apache-2.0
MODCARGO_CRATES +=	aho-corasick	1.1.3	# Unlicense OR MIT
MODCARGO_CRATES +=	allocator-api2	0.2.21	# MIT OR Apache-2.0
MODCARGO_CRATES +=	android_system_properties	0.1.5	# MIT/Apache-2.0
MODCARGO_CRATES +=	anes	0.1.6	# MIT OR Apache-2.0
MODCARGO_CRATES +=	anstream	0.6.20	# MIT OR Apache-2.0
MODCARGO_CRATES +=	anstyle	1.0.11	# MIT OR Apache-2.0
MODCARGO_CRATES +=	anstyle-parse	0.2.7	# MIT OR Apache-2.0
MODCARGO_CRATES +=	anstyle-query	1.1.4	# MIT OR Apache-2.0
MODCARGO_CRATES +=	anstyle-wincon	3.0.10	# MIT OR Apache-2.0
MODCARGO_CRATES +=	anyhow	1.0.99	# MIT OR Apache-2.0
MODCARGO_CRATES +=	arc-swap	1.7.1	# MIT OR Apache-2.0
MODCARGO_CRATES +=	arrayvec	0.7.6	# MIT OR Apache-2.0
MODCARGO_CRATES +=	assert_cmd	2.0.17	# MIT OR Apache-2.0
MODCARGO_CRATES +=	assert_matches	1.5.0	# MIT/Apache-2.0
MODCARGO_CRATES +=	async-trait	0.1.89	# MIT OR Apache-2.0
MODCARGO_CRATES +=	atomic	0.6.1	# Apache-2.0/MIT
MODCARGO_CRATES +=	autocfg	1.5.0	# Apache-2.0 OR MIT
MODCARGO_CRATES +=	backtrace	0.3.75	# MIT OR Apache-2.0
MODCARGO_CRATES +=	base64	0.22.1	# MIT OR Apache-2.0
MODCARGO_CRATES +=	beef	0.5.2	# MIT OR Apache-2.0
MODCARGO_CRATES +=	bit-set	0.5.3	# MIT/Apache-2.0
MODCARGO_CRATES +=	bit-set	0.8.0	# Apache-2.0 OR MIT
MODCARGO_CRATES +=	bit-vec	0.6.3	# MIT/Apache-2.0
MODCARGO_CRATES +=	bit-vec	0.8.0	# Apache-2.0 OR MIT
MODCARGO_CRATES +=	bitflags	1.3.2	# MIT/Apache-2.0
MODCARGO_CRATES +=	bitflags	2.9.1	# MIT OR Apache-2.0
MODCARGO_CRATES +=	blake2	0.10.6	# MIT OR Apache-2.0
MODCARGO_CRATES +=	block-buffer	0.10.4	# MIT OR Apache-2.0
MODCARGO_CRATES +=	borrow-or-share	0.2.2	# MIT-0
MODCARGO_CRATES +=	bstr	1.12.0	# MIT OR Apache-2.0
MODCARGO_CRATES +=	bumpalo	3.19.0	# MIT OR Apache-2.0
MODCARGO_CRATES +=	bytecount	0.6.9	# Apache-2.0/MIT
MODCARGO_CRATES +=	bytemuck	1.23.2	# Zlib OR Apache-2.0 OR MIT
MODCARGO_CRATES +=	byteorder	1.5.0	# Unlicense OR MIT
MODCARGO_CRATES +=	bytes	1.10.1	# MIT
MODCARGO_CRATES +=	camino	1.1.11	# MIT OR Apache-2.0
MODCARGO_CRATES +=	cassowary	0.3.0	# MIT / Apache-2.0
MODCARGO_CRATES +=	cast	0.3.0	# MIT OR Apache-2.0
MODCARGO_CRATES +=	castaway	0.2.4	# MIT
MODCARGO_CRATES +=	cc	1.2.32	# MIT OR Apache-2.0
MODCARGO_CRATES +=	cfg-if	1.0.1	# MIT OR Apache-2.0
MODCARGO_CRATES +=	cfg_aliases	0.2.1	# MIT
MODCARGO_CRATES +=	chrono	0.4.42	# MIT OR Apache-2.0
MODCARGO_CRATES +=	ciborium	0.2.2	# Apache-2.0
MODCARGO_CRATES +=	ciborium-io	0.2.2	# Apache-2.0
MODCARGO_CRATES +=	ciborium-ll	0.2.2	# Apache-2.0
MODCARGO_CRATES +=	clap	4.5.48	# MIT OR Apache-2.0
MODCARGO_CRATES +=	clap-markdown	0.1.5	# MIT OR Apache-2.0
MODCARGO_CRATES +=	clap_builder	4.5.48	# MIT OR Apache-2.0
MODCARGO_CRATES +=	clap_complete	4.5.58	# MIT OR Apache-2.0
MODCARGO_CRATES +=	clap_complete_nushell	4.5.8	# MIT OR Apache-2.0
MODCARGO_CRATES +=	clap_derive	4.5.47	# MIT OR Apache-2.0
MODCARGO_CRATES +=	clap_lex	0.7.5	# MIT OR Apache-2.0
MODCARGO_CRATES +=	clap_mangen	0.2.29	# MIT OR Apache-2.0
MODCARGO_CRATES +=	clru	0.6.2	# MIT
MODCARGO_CRATES +=	colorchoice	1.0.4	# MIT OR Apache-2.0
MODCARGO_CRATES +=	compact_str	0.8.1	# MIT
MODCARGO_CRATES +=	console	0.15.11	# MIT
MODCARGO_CRATES +=	core-foundation-sys	0.8.7	# MIT OR Apache-2.0
MODCARGO_CRATES +=	cpufeatures	0.2.17	# MIT OR Apache-2.0
MODCARGO_CRATES +=	crc32fast	1.5.0	# MIT OR Apache-2.0
MODCARGO_CRATES +=	criterion	0.5.1	# Apache-2.0 OR MIT
MODCARGO_CRATES +=	criterion-plot	0.5.0	# MIT/Apache-2.0
MODCARGO_CRATES +=	crossbeam-channel	0.5.15	# MIT OR Apache-2.0
MODCARGO_CRATES +=	crossbeam-deque	0.8.6	# MIT OR Apache-2.0
MODCARGO_CRATES +=	crossbeam-epoch	0.9.18	# MIT OR Apache-2.0
MODCARGO_CRATES +=	crossbeam-utils	0.8.21	# MIT OR Apache-2.0
MODCARGO_CRATES +=	crossterm	0.28.1	# MIT
MODCARGO_CRATES +=	crossterm_winapi	0.9.1	# MIT
MODCARGO_CRATES +=	crunchy	0.2.4	# MIT
MODCARGO_CRATES +=	crypto-common	0.1.6	# MIT OR Apache-2.0
MODCARGO_CRATES +=	csscolorparser	0.6.2	# MIT OR Apache-2.0
MODCARGO_CRATES +=	darling	0.20.11	# MIT
MODCARGO_CRATES +=	darling_core	0.20.11	# MIT
MODCARGO_CRATES +=	darling_macro	0.20.11	# MIT
MODCARGO_CRATES +=	dashmap	6.1.0	# MIT
MODCARGO_CRATES +=	datatest-stable	0.3.2	# MIT OR Apache-2.0
MODCARGO_CRATES +=	deltae	0.3.2	# MIT
MODCARGO_CRATES +=	diff	0.1.13	# MIT OR Apache-2.0
MODCARGO_CRATES +=	difflib	0.4.0	# MIT
MODCARGO_CRATES +=	digest	0.10.7	# MIT OR Apache-2.0
MODCARGO_CRATES +=	dirs	6.0.0	# MIT OR Apache-2.0
MODCARGO_CRATES +=	dirs-sys	0.5.0	# MIT OR Apache-2.0
MODCARGO_CRATES +=	displaydoc	0.2.5	# MIT OR Apache-2.0
MODCARGO_CRATES +=	doc-comment	0.3.3	# MIT
MODCARGO_CRATES +=	dunce	1.0.5	# CC0-1.0 OR MIT-0 OR Apache-2.0
MODCARGO_CRATES +=	either	1.15.0	# MIT OR Apache-2.0
MODCARGO_CRATES +=	email_address	0.2.9	# MIT
MODCARGO_CRATES +=	encode_unicode	1.0.0	# Apache-2.0 OR MIT
MODCARGO_CRATES +=	encoding_rs	0.8.35	# (Apache-2.0 OR MIT) AND BSD-3-Clause
MODCARGO_CRATES +=	enum_dispatch	0.3.13	# MIT OR Apache-2.0
MODCARGO_CRATES +=	equivalent	1.0.2	# Apache-2.0 OR MIT
MODCARGO_CRATES +=	erased-serde	0.4.8	# MIT OR Apache-2.0
MODCARGO_CRATES +=	errno	0.3.13	# MIT OR Apache-2.0
MODCARGO_CRATES +=	escape8259	0.5.3	# MIT
MODCARGO_CRATES +=	etcetera	0.10.0	# MIT OR Apache-2.0
MODCARGO_CRATES +=	euclid	0.22.11	# MIT OR Apache-2.0
MODCARGO_CRATES +=	fancy-regex	0.11.0	# MIT
MODCARGO_CRATES +=	fancy-regex	0.14.0	# MIT
MODCARGO_CRATES +=	fancy-regex	0.16.1	# MIT
MODCARGO_CRATES +=	faster-hex	0.10.0	# MIT
MODCARGO_CRATES +=	fastrand	2.3.0	# Apache-2.0 OR MIT
MODCARGO_CRATES +=	filedescriptor	0.8.3	# MIT
MODCARGO_CRATES +=	filetime	0.2.25	# MIT/Apache-2.0
MODCARGO_CRATES +=	finl_unicode	1.3.0	# (MIT OR Apache-2.0) AND Unicode-DFS-2016
MODCARGO_CRATES +=	fixedbitset	0.4.2	# MIT/Apache-2.0
MODCARGO_CRATES +=	fixedbitset	0.5.7	# MIT OR Apache-2.0
MODCARGO_CRATES +=	flate2	1.1.2	# MIT OR Apache-2.0
MODCARGO_CRATES +=	fluent-uri	0.3.2	# MIT
MODCARGO_CRATES +=	fnv	1.0.7	# Apache-2.0 / MIT
MODCARGO_CRATES +=	foldhash	0.1.5	# Zlib
MODCARGO_CRATES +=	form_urlencoded	1.2.1	# MIT OR Apache-2.0
MODCARGO_CRATES +=	fraction	0.15.3	# MIT/Apache-2.0
MODCARGO_CRATES +=	futures	0.1.31	# MIT/Apache-2.0
MODCARGO_CRATES +=	futures	0.3.31	# MIT OR Apache-2.0
MODCARGO_CRATES +=	futures-channel	0.3.31	# MIT OR Apache-2.0
MODCARGO_CRATES +=	futures-core	0.3.31	# MIT OR Apache-2.0
MODCARGO_CRATES +=	futures-executor	0.3.31	# MIT OR Apache-2.0
MODCARGO_CRATES +=	futures-io	0.3.31	# MIT OR Apache-2.0
MODCARGO_CRATES +=	futures-macro	0.3.31	# MIT OR Apache-2.0
MODCARGO_CRATES +=	futures-sink	0.3.31	# MIT OR Apache-2.0
MODCARGO_CRATES +=	futures-task	0.3.31	# MIT OR Apache-2.0
MODCARGO_CRATES +=	futures-util	0.3.31	# MIT OR Apache-2.0
MODCARGO_CRATES +=	generic-array	0.14.7	# MIT
MODCARGO_CRATES +=	getrandom	0.2.16	# MIT OR Apache-2.0
MODCARGO_CRATES +=	getrandom	0.3.3	# MIT OR Apache-2.0
MODCARGO_CRATES +=	gimli	0.31.1	# MIT OR Apache-2.0
MODCARGO_CRATES +=	gix	0.73.0	# MIT OR Apache-2.0
MODCARGO_CRATES +=	gix-actor	0.35.4	# MIT OR Apache-2.0
MODCARGO_CRATES +=	gix-attributes	0.27.0	# MIT OR Apache-2.0
MODCARGO_CRATES +=	gix-bitmap	0.2.14	# MIT OR Apache-2.0
MODCARGO_CRATES +=	gix-chunk	0.4.11	# MIT OR Apache-2.0
MODCARGO_CRATES +=	gix-command	0.6.2	# MIT OR Apache-2.0
MODCARGO_CRATES +=	gix-commitgraph	0.29.0	# MIT OR Apache-2.0
MODCARGO_CRATES +=	gix-config	0.46.0	# MIT OR Apache-2.0
MODCARGO_CRATES +=	gix-config-value	0.15.1	# MIT OR Apache-2.0
MODCARGO_CRATES +=	gix-date	0.10.5	# MIT OR Apache-2.0
MODCARGO_CRATES +=	gix-diff	0.53.0	# MIT OR Apache-2.0
MODCARGO_CRATES +=	gix-dir	0.15.0	# MIT OR Apache-2.0
MODCARGO_CRATES +=	gix-discover	0.41.0	# MIT OR Apache-2.0
MODCARGO_CRATES +=	gix-features	0.43.1	# MIT OR Apache-2.0
MODCARGO_CRATES +=	gix-filter	0.20.0	# MIT OR Apache-2.0
MODCARGO_CRATES +=	gix-fs	0.16.1	# MIT OR Apache-2.0
MODCARGO_CRATES +=	gix-glob	0.21.0	# MIT OR Apache-2.0
MODCARGO_CRATES +=	gix-hash	0.19.0	# MIT OR Apache-2.0
MODCARGO_CRATES +=	gix-hashtable	0.9.0	# MIT OR Apache-2.0
MODCARGO_CRATES +=	gix-ignore	0.16.0	# MIT OR Apache-2.0
MODCARGO_CRATES +=	gix-index	0.41.0	# MIT OR Apache-2.0
MODCARGO_CRATES +=	gix-lock	18.0.0	# MIT OR Apache-2.0
MODCARGO_CRATES +=	gix-object	0.50.2	# MIT OR Apache-2.0
MODCARGO_CRATES +=	gix-odb	0.70.0	# MIT OR Apache-2.0
MODCARGO_CRATES +=	gix-pack	0.60.0	# MIT OR Apache-2.0
MODCARGO_CRATES +=	gix-packetline	0.19.1	# MIT OR Apache-2.0
MODCARGO_CRATES +=	gix-packetline-blocking	0.19.1	# MIT OR Apache-2.0
MODCARGO_CRATES +=	gix-path	0.10.20	# MIT OR Apache-2.0
MODCARGO_CRATES +=	gix-pathspec	0.12.0	# MIT OR Apache-2.0
MODCARGO_CRATES +=	gix-protocol	0.51.0	# MIT OR Apache-2.0
MODCARGO_CRATES +=	gix-quote	0.6.0	# MIT OR Apache-2.0
MODCARGO_CRATES +=	gix-ref	0.53.1	# MIT OR Apache-2.0
MODCARGO_CRATES +=	gix-refspec	0.31.0	# MIT OR Apache-2.0
MODCARGO_CRATES +=	gix-revision	0.35.0	# MIT OR Apache-2.0
MODCARGO_CRATES +=	gix-revwalk	0.21.0	# MIT OR Apache-2.0
MODCARGO_CRATES +=	gix-sec	0.12.0	# MIT OR Apache-2.0
MODCARGO_CRATES +=	gix-shallow	0.5.0	# MIT OR Apache-2.0
MODCARGO_CRATES +=	gix-status	0.20.0	# MIT OR Apache-2.0
MODCARGO_CRATES +=	gix-submodule	0.20.0	# MIT OR Apache-2.0
MODCARGO_CRATES +=	gix-tempfile	18.0.0	# MIT OR Apache-2.0
MODCARGO_CRATES +=	gix-trace	0.1.13	# MIT OR Apache-2.0
MODCARGO_CRATES +=	gix-transport	0.48.0	# MIT OR Apache-2.0
MODCARGO_CRATES +=	gix-traverse	0.47.0	# MIT OR Apache-2.0
MODCARGO_CRATES +=	gix-url	0.32.0	# MIT OR Apache-2.0
MODCARGO_CRATES +=	gix-utils	0.3.0	# MIT OR Apache-2.0
MODCARGO_CRATES +=	gix-validate	0.10.0	# MIT OR Apache-2.0
MODCARGO_CRATES +=	gix-worktree	0.42.0	# MIT OR Apache-2.0
MODCARGO_CRATES +=	gix-worktree-state	0.20.0	# MIT OR Apache-2.0
MODCARGO_CRATES +=	globset	0.4.16	# Unlicense OR MIT
MODCARGO_CRATES +=	half	2.6.0	# MIT OR Apache-2.0
MODCARGO_CRATES +=	hash32	0.3.1	# MIT OR Apache-2.0
MODCARGO_CRATES +=	hashbrown	0.14.5	# MIT OR Apache-2.0
MODCARGO_CRATES +=	hashbrown	0.15.5	# MIT OR Apache-2.0
MODCARGO_CRATES +=	hashbrown	0.16.0	# MIT OR Apache-2.0
MODCARGO_CRATES +=	heapless	0.8.0	# MIT OR Apache-2.0
MODCARGO_CRATES +=	heck	0.5.0	# MIT OR Apache-2.0
MODCARGO_CRATES +=	hermit-abi	0.5.2	# MIT OR Apache-2.0
MODCARGO_CRATES +=	hex	0.4.3	# MIT OR Apache-2.0
MODCARGO_CRATES +=	home	0.5.11	# MIT OR Apache-2.0
MODCARGO_CRATES +=	iana-time-zone	0.1.63	# MIT OR Apache-2.0
MODCARGO_CRATES +=	iana-time-zone-haiku	0.1.2	# MIT OR Apache-2.0
MODCARGO_CRATES +=	icu_collections	2.0.0	# Unicode-3.0
MODCARGO_CRATES +=	icu_locale_core	2.0.0	# Unicode-3.0
MODCARGO_CRATES +=	icu_normalizer	2.0.0	# Unicode-3.0
MODCARGO_CRATES +=	icu_normalizer_data	2.0.0	# Unicode-3.0
MODCARGO_CRATES +=	icu_properties	2.0.1	# Unicode-3.0
MODCARGO_CRATES +=	icu_properties_data	2.0.1	# Unicode-3.0
MODCARGO_CRATES +=	icu_provider	2.0.0	# Unicode-3.0
MODCARGO_CRATES +=	ident_case	1.0.1	# MIT/Apache-2.0
MODCARGO_CRATES +=	idna	1.0.3	# MIT OR Apache-2.0
MODCARGO_CRATES +=	idna_adapter	1.2.1	# Apache-2.0 OR MIT
MODCARGO_CRATES +=	ignore	0.4.23	# Unlicense OR MIT
MODCARGO_CRATES +=	imara-diff	0.1.8	# Apache-2.0
MODCARGO_CRATES +=	indexmap	2.11.4	# Apache-2.0 OR MIT
MODCARGO_CRATES +=	indoc	2.0.6	# MIT OR Apache-2.0
MODCARGO_CRATES +=	insta	1.43.2	# Apache-2.0
MODCARGO_CRATES +=	instability	0.3.9	# MIT
MODCARGO_CRATES +=	interim	0.2.1	# MIT
MODCARGO_CRATES +=	io-close	0.3.7	# MIT OR Apache-2.0
MODCARGO_CRATES +=	io-uring	0.7.9	# MIT OR Apache-2.0
MODCARGO_CRATES +=	is-terminal	0.4.16	# MIT
MODCARGO_CRATES +=	is_executable	1.0.4	# Apache-2.0/MIT
MODCARGO_CRATES +=	is_terminal_polyfill	1.70.1	# MIT OR Apache-2.0
MODCARGO_CRATES +=	itertools	0.10.5	# MIT/Apache-2.0
MODCARGO_CRATES +=	itertools	0.13.0	# MIT OR Apache-2.0
MODCARGO_CRATES +=	itertools	0.14.0	# MIT OR Apache-2.0
MODCARGO_CRATES +=	itoa	1.0.15	# MIT OR Apache-2.0
MODCARGO_CRATES +=	jiff	0.2.15	# Unlicense OR MIT
MODCARGO_CRATES +=	jiff-static	0.2.15	# Unlicense OR MIT
MODCARGO_CRATES +=	jiff-tzdb	0.1.4	# Unlicense OR MIT
MODCARGO_CRATES +=	jiff-tzdb-platform	0.1.3	# Unlicense OR MIT
MODCARGO_CRATES +=	js-sys	0.3.77	# MIT OR Apache-2.0
MODCARGO_CRATES +=	jsonschema	0.32.1	# MIT
MODCARGO_CRATES +=	kstring	2.0.2	# MIT OR Apache-2.0
MODCARGO_CRATES +=	lab	0.11.0	# MIT
MODCARGO_CRATES +=	lazy_static	1.5.0	# MIT OR Apache-2.0
MODCARGO_CRATES +=	libc	0.2.176	# MIT OR Apache-2.0
MODCARGO_CRATES +=	libredox	0.1.9	# MIT
MODCARGO_CRATES +=	libtest-mimic	0.8.1	# MIT/Apache-2.0
MODCARGO_CRATES +=	libz-rs-sys	0.5.1	# Zlib
MODCARGO_CRATES +=	linux-raw-sys	0.4.15	# Apache-2.0 WITH LLVM-exception OR Apache-2.0 OR MIT
MODCARGO_CRATES +=	linux-raw-sys	0.11.0	# Apache-2.0 WITH LLVM-exception OR Apache-2.0 OR MIT
MODCARGO_CRATES +=	litemap	0.8.0	# Unicode-3.0
MODCARGO_CRATES +=	lock_api	0.4.13	# MIT OR Apache-2.0
MODCARGO_CRATES +=	log	0.4.27	# MIT OR Apache-2.0
MODCARGO_CRATES +=	logos	0.15.1	# MIT OR Apache-2.0
MODCARGO_CRATES +=	logos-codegen	0.15.1	# MIT OR Apache-2.0
MODCARGO_CRATES +=	logos-derive	0.15.1	# MIT OR Apache-2.0
MODCARGO_CRATES +=	lru	0.12.4	# MIT
MODCARGO_CRATES +=	mac_address	1.1.8	# MIT OR Apache-2.0
MODCARGO_CRATES +=	maplit	1.0.2	# MIT/Apache-2.0
MODCARGO_CRATES +=	matchers	0.2.0	# MIT
MODCARGO_CRATES +=	maybe-async	0.2.10	# MIT
MODCARGO_CRATES +=	memchr	2.7.5	# Unlicense OR MIT
MODCARGO_CRATES +=	memmap2	0.5.10	# MIT OR Apache-2.0
MODCARGO_CRATES +=	memmap2	0.9.7	# MIT OR Apache-2.0
MODCARGO_CRATES +=	memmem	0.1.1	# MIT/Apache-2.0
MODCARGO_CRATES +=	memoffset	0.9.1	# MIT
MODCARGO_CRATES +=	minimal-lexical	0.2.1	# MIT/Apache-2.0
MODCARGO_CRATES +=	miniz_oxide	0.8.9	# MIT OR Zlib OR Apache-2.0
MODCARGO_CRATES +=	mio	1.0.4	# MIT
MODCARGO_CRATES +=	multimap	0.10.1	# MIT OR Apache-2.0
MODCARGO_CRATES +=	nix	0.29.0	# MIT
MODCARGO_CRATES +=	nix	0.30.1	# MIT
MODCARGO_CRATES +=	nom	7.1.3	# MIT
MODCARGO_CRATES +=	nu-ansi-term	0.50.1	# MIT
MODCARGO_CRATES +=	num	0.4.3	# MIT OR Apache-2.0
MODCARGO_CRATES +=	num-bigint	0.4.6	# MIT OR Apache-2.0
MODCARGO_CRATES +=	num-cmp	0.1.0	# MIT/Apache-2.0
MODCARGO_CRATES +=	num-complex	0.4.6	# MIT OR Apache-2.0
MODCARGO_CRATES +=	num-derive	0.4.2	# MIT OR Apache-2.0
MODCARGO_CRATES +=	num-integer	0.1.46	# MIT OR Apache-2.0
MODCARGO_CRATES +=	num-iter	0.1.45	# MIT OR Apache-2.0
MODCARGO_CRATES +=	num-rational	0.4.2	# MIT OR Apache-2.0
MODCARGO_CRATES +=	num-traits	0.2.19	# MIT OR Apache-2.0
MODCARGO_CRATES +=	num_cpus	1.17.0	# MIT OR Apache-2.0
MODCARGO_CRATES +=	object	0.36.7	# Apache-2.0 OR MIT
MODCARGO_CRATES +=	once_cell	1.21.3	# MIT OR Apache-2.0
MODCARGO_CRATES +=	once_cell_polyfill	1.70.1	# MIT OR Apache-2.0
MODCARGO_CRATES +=	oorandom	11.1.5	# MIT
MODCARGO_CRATES +=	option-ext	0.2.0	# MPL-2.0
MODCARGO_CRATES +=	ordered-float	4.6.0	# MIT
MODCARGO_CRATES +=	outref	0.5.2	# MIT
MODCARGO_CRATES +=	parking_lot	0.12.4	# MIT OR Apache-2.0
MODCARGO_CRATES +=	parking_lot_core	0.9.11	# MIT OR Apache-2.0
MODCARGO_CRATES +=	paste	1.0.15	# MIT OR Apache-2.0
MODCARGO_CRATES +=	percent-encoding	2.3.1	# MIT OR Apache-2.0
MODCARGO_CRATES +=	pest	2.8.2	# MIT OR Apache-2.0
MODCARGO_CRATES +=	pest_derive	2.8.2	# MIT OR Apache-2.0
MODCARGO_CRATES +=	pest_generator	2.8.2	# MIT OR Apache-2.0
MODCARGO_CRATES +=	pest_meta	2.8.2	# MIT OR Apache-2.0
MODCARGO_CRATES +=	petgraph	0.7.1	# MIT OR Apache-2.0
MODCARGO_CRATES +=	phf	0.11.3	# MIT
MODCARGO_CRATES +=	phf_codegen	0.11.3	# MIT
MODCARGO_CRATES +=	phf_generator	0.11.3	# MIT
MODCARGO_CRATES +=	phf_macros	0.11.3	# MIT
MODCARGO_CRATES +=	phf_shared	0.11.3	# MIT
MODCARGO_CRATES +=	pin-project-lite	0.2.16	# Apache-2.0 OR MIT
MODCARGO_CRATES +=	pin-utils	0.1.0	# MIT OR Apache-2.0
MODCARGO_CRATES +=	plotters	0.3.7	# MIT
MODCARGO_CRATES +=	plotters-backend	0.3.7	# MIT
MODCARGO_CRATES +=	plotters-svg	0.3.7	# MIT
MODCARGO_CRATES +=	pollster	0.4.0	# Apache-2.0/MIT
MODCARGO_CRATES +=	portable-atomic	1.11.1	# Apache-2.0 OR MIT
MODCARGO_CRATES +=	portable-atomic-util	0.2.4	# Apache-2.0 OR MIT
MODCARGO_CRATES +=	potential_utf	0.1.2	# Unicode-3.0
MODCARGO_CRATES +=	ppv-lite86	0.2.21	# MIT OR Apache-2.0
MODCARGO_CRATES +=	predicates	3.1.3	# MIT OR Apache-2.0
MODCARGO_CRATES +=	predicates-core	1.0.9	# MIT OR Apache-2.0
MODCARGO_CRATES +=	predicates-tree	1.0.12	# MIT OR Apache-2.0
MODCARGO_CRATES +=	pretty_assertions	1.4.1	# MIT OR Apache-2.0
MODCARGO_CRATES +=	prettyplease	0.2.36	# MIT OR Apache-2.0
MODCARGO_CRATES +=	proc-macro2	1.0.101	# MIT OR Apache-2.0
MODCARGO_CRATES +=	prodash	30.0.1	# MIT
MODCARGO_CRATES +=	proptest	1.8.0	# MIT OR Apache-2.0
MODCARGO_CRATES +=	proptest-derive	0.6.0	# MIT OR Apache-2.0
MODCARGO_CRATES +=	proptest-state-machine	0.3.1	# MIT OR Apache-2.0
MODCARGO_CRATES +=	prost	0.13.5	# Apache-2.0
MODCARGO_CRATES +=	prost-build	0.13.5	# Apache-2.0
MODCARGO_CRATES +=	prost-derive	0.13.5	# Apache-2.0
MODCARGO_CRATES +=	prost-types	0.13.5	# Apache-2.0
MODCARGO_CRATES +=	quick-error	1.2.3	# MIT/Apache-2.0
MODCARGO_CRATES +=	quote	1.0.41	# MIT OR Apache-2.0
MODCARGO_CRATES +=	r-efi	5.3.0	# MIT OR Apache-2.0 OR LGPL-2.1-or-later
MODCARGO_CRATES +=	rand	0.8.5	# MIT OR Apache-2.0
MODCARGO_CRATES +=	rand	0.9.2	# MIT OR Apache-2.0
MODCARGO_CRATES +=	rand_chacha	0.9.0	# MIT OR Apache-2.0
MODCARGO_CRATES +=	rand_core	0.6.4	# MIT OR Apache-2.0
MODCARGO_CRATES +=	rand_core	0.9.3	# MIT OR Apache-2.0
MODCARGO_CRATES +=	rand_xorshift	0.4.0	# MIT OR Apache-2.0
MODCARGO_CRATES +=	ratatui	0.29.0	# MIT
MODCARGO_CRATES +=	rayon	1.11.0	# MIT OR Apache-2.0
MODCARGO_CRATES +=	rayon-core	1.13.0	# MIT OR Apache-2.0
MODCARGO_CRATES +=	redox_syscall	0.5.17	# MIT
MODCARGO_CRATES +=	redox_users	0.5.2	# MIT
MODCARGO_CRATES +=	ref-cast	1.0.25	# MIT OR Apache-2.0
MODCARGO_CRATES +=	ref-cast-impl	1.0.25	# MIT OR Apache-2.0
MODCARGO_CRATES +=	referencing	0.32.1	# MIT
MODCARGO_CRATES +=	regex	1.11.3	# MIT OR Apache-2.0
MODCARGO_CRATES +=	regex-automata	0.4.11	# MIT OR Apache-2.0
MODCARGO_CRATES +=	regex-syntax	0.8.5	# MIT OR Apache-2.0
MODCARGO_CRATES +=	roff	0.2.2	# MIT OR Apache-2.0
MODCARGO_CRATES +=	rpassword	7.4.0	# Apache-2.0
MODCARGO_CRATES +=	rtoolbox	0.0.3	# Apache-2.0
MODCARGO_CRATES +=	rustc-demangle	0.1.26	# MIT/Apache-2.0
MODCARGO_CRATES +=	rustc_version	0.4.1	# MIT OR Apache-2.0
MODCARGO_CRATES +=	rustix	0.38.44	# Apache-2.0 WITH LLVM-exception OR Apache-2.0 OR MIT
MODCARGO_CRATES +=	rustix	1.1.2	# Apache-2.0 WITH LLVM-exception OR Apache-2.0 OR MIT
MODCARGO_CRATES +=	rustversion	1.0.22	# MIT OR Apache-2.0
MODCARGO_CRATES +=	rusty-fork	0.3.0	# MIT/Apache-2.0
MODCARGO_CRATES +=	ryu	1.0.20	# Apache-2.0 OR BSL-1.0
MODCARGO_CRATES +=	same-file	1.0.6	# Unlicense/MIT
MODCARGO_CRATES +=	sapling-renderdag	0.1.0	# MIT
MODCARGO_CRATES +=	sapling-streampager	0.11.0	# MIT
MODCARGO_CRATES +=	scm-record	0.8.0	# MIT OR Apache-2.0
MODCARGO_CRATES +=	scopeguard	1.2.0	# MIT OR Apache-2.0
MODCARGO_CRATES +=	semver	1.0.26	# MIT OR Apache-2.0
MODCARGO_CRATES +=	serde	1.0.226	# MIT OR Apache-2.0
MODCARGO_CRATES +=	serde_bser	0.4.0	# MIT
MODCARGO_CRATES +=	serde_bytes	0.11.17	# MIT OR Apache-2.0
MODCARGO_CRATES +=	serde_core	1.0.226	# MIT OR Apache-2.0
MODCARGO_CRATES +=	serde_derive	1.0.226	# MIT OR Apache-2.0
MODCARGO_CRATES +=	serde_json	1.0.145	# MIT OR Apache-2.0
MODCARGO_CRATES +=	serde_spanned	0.6.9	# MIT OR Apache-2.0
MODCARGO_CRATES +=	serde_spanned	1.0.2	# MIT OR Apache-2.0
MODCARGO_CRATES +=	sha1	0.10.6	# MIT OR Apache-2.0
MODCARGO_CRATES +=	sha1-checked	0.10.0	# MIT OR Apache-2.0
MODCARGO_CRATES +=	sha2	0.10.9	# MIT OR Apache-2.0
MODCARGO_CRATES +=	sharded-slab	0.1.7	# MIT
MODCARGO_CRATES +=	shell-words	1.1.0	# MIT/Apache-2.0
MODCARGO_CRATES +=	shlex	1.3.0	# MIT OR Apache-2.0
MODCARGO_CRATES +=	signal-hook	0.3.18	# Apache-2.0/MIT
MODCARGO_CRATES +=	signal-hook-mio	0.2.4	# Apache-2.0/MIT
MODCARGO_CRATES +=	signal-hook-registry	1.4.6	# Apache-2.0/MIT
MODCARGO_CRATES +=	similar	2.7.0	# Apache-2.0
MODCARGO_CRATES +=	siphasher	1.0.1	# MIT/Apache-2.0
MODCARGO_CRATES +=	slab	0.4.11	# MIT
MODCARGO_CRATES +=	smallvec	1.15.1	# MIT OR Apache-2.0
MODCARGO_CRATES +=	smawk	0.3.2	# MIT
MODCARGO_CRATES +=	socket2	0.6.0	# MIT OR Apache-2.0
MODCARGO_CRATES +=	stable_deref_trait	1.2.0	# MIT/Apache-2.0
MODCARGO_CRATES +=	static_assertions	1.1.0	# MIT OR Apache-2.0
MODCARGO_CRATES +=	strsim	0.11.1	# MIT
MODCARGO_CRATES +=	strum	0.26.3	# MIT
MODCARGO_CRATES +=	strum_macros	0.26.4	# MIT
MODCARGO_CRATES +=	subtle	2.6.1	# BSD-3-Clause
MODCARGO_CRATES +=	syn	1.0.109	# MIT OR Apache-2.0
MODCARGO_CRATES +=	syn	2.0.106	# MIT OR Apache-2.0
MODCARGO_CRATES +=	synstructure	0.13.2	# MIT
MODCARGO_CRATES +=	tempfile	3.23.0	# MIT OR Apache-2.0
MODCARGO_CRATES +=	terminal_size	0.4.3	# MIT OR Apache-2.0
MODCARGO_CRATES +=	terminfo	0.9.0	# WTFPL
MODCARGO_CRATES +=	termios	0.3.3	# MIT
MODCARGO_CRATES +=	termtree	0.5.1	# MIT
MODCARGO_CRATES +=	termwiz	0.23.3	# MIT
MODCARGO_CRATES +=	test-case	3.3.1	# MIT
MODCARGO_CRATES +=	test-case-core	3.3.1	# MIT
MODCARGO_CRATES +=	test-case-macros	3.3.1	# MIT
MODCARGO_CRATES +=	textwrap	0.16.2	# MIT
MODCARGO_CRATES +=	thiserror	1.0.69	# MIT OR Apache-2.0
MODCARGO_CRATES +=	thiserror	2.0.17	# MIT OR Apache-2.0
MODCARGO_CRATES +=	thiserror-impl	1.0.69	# MIT OR Apache-2.0
MODCARGO_CRATES +=	thiserror-impl	2.0.17	# MIT OR Apache-2.0
MODCARGO_CRATES +=	thread_local	1.1.9	# MIT OR Apache-2.0
MODCARGO_CRATES +=	timeago	0.4.2	# MIT OR Apache-2.0
MODCARGO_CRATES +=	tinystr	0.8.1	# Unicode-3.0
MODCARGO_CRATES +=	tinytemplate	1.2.1	# Apache-2.0 OR MIT
MODCARGO_CRATES +=	tinyvec	1.9.0	# Zlib OR Apache-2.0 OR MIT
MODCARGO_CRATES +=	tinyvec_macros	0.1.1	# MIT OR Apache-2.0 OR Zlib
MODCARGO_CRATES +=	tokio	1.47.1	# MIT
MODCARGO_CRATES +=	tokio-macros	2.5.0	# MIT
MODCARGO_CRATES +=	tokio-util	0.6.10	# MIT
MODCARGO_CRATES +=	toml	0.8.23	# MIT OR Apache-2.0
MODCARGO_CRATES +=	toml	0.9.7	# MIT OR Apache-2.0
MODCARGO_CRATES +=	toml_datetime	0.6.11	# MIT OR Apache-2.0
MODCARGO_CRATES +=	toml_datetime	0.7.2	# MIT OR Apache-2.0
MODCARGO_CRATES +=	toml_edit	0.22.27	# MIT OR Apache-2.0
MODCARGO_CRATES +=	toml_edit	0.23.6	# MIT OR Apache-2.0
MODCARGO_CRATES +=	toml_parser	1.0.3	# MIT OR Apache-2.0
MODCARGO_CRATES +=	toml_write	0.1.2	# MIT OR Apache-2.0
MODCARGO_CRATES +=	toml_writer	1.0.3	# MIT OR Apache-2.0
MODCARGO_CRATES +=	tracing	0.1.41	# MIT
MODCARGO_CRATES +=	tracing-attributes	0.1.30	# MIT
MODCARGO_CRATES +=	tracing-chrome	0.7.2	# MIT
MODCARGO_CRATES +=	tracing-core	0.1.34	# MIT
MODCARGO_CRATES +=	tracing-log	0.2.0	# MIT
MODCARGO_CRATES +=	tracing-subscriber	0.3.20	# MIT
MODCARGO_CRATES +=	typeid	1.0.3	# MIT OR Apache-2.0
MODCARGO_CRATES +=	typenum	1.18.0	# MIT OR Apache-2.0
MODCARGO_CRATES +=	ucd-trie	0.1.7	# MIT OR Apache-2.0
MODCARGO_CRATES +=	uluru	3.1.0	# MPL-2.0
MODCARGO_CRATES +=	unarray	0.1.4	# MIT OR Apache-2.0
MODCARGO_CRATES +=	unicode-bom	2.0.3	# Apache-2.0
MODCARGO_CRATES +=	unicode-ident	1.0.18	# (MIT OR Apache-2.0) AND Unicode-3.0
MODCARGO_CRATES +=	unicode-linebreak	0.1.5	# Apache-2.0
MODCARGO_CRATES +=	unicode-normalization	0.1.24	# MIT/Apache-2.0
MODCARGO_CRATES +=	unicode-segmentation	1.12.0	# MIT OR Apache-2.0
MODCARGO_CRATES +=	unicode-truncate	1.1.0	# MIT OR Apache-2.0
MODCARGO_CRATES +=	unicode-width	0.1.12	# MIT OR Apache-2.0
MODCARGO_CRATES +=	unicode-width	0.2.0	# MIT OR Apache-2.0
MODCARGO_CRATES +=	url	2.5.4	# MIT OR Apache-2.0
MODCARGO_CRATES +=	utf8_iter	1.0.4	# Apache-2.0 OR MIT
MODCARGO_CRATES +=	utf8parse	0.2.2	# Apache-2.0 OR MIT
MODCARGO_CRATES +=	uuid	1.18.0	# Apache-2.0 OR MIT
MODCARGO_CRATES +=	uuid-simd	0.8.0	# MIT
MODCARGO_CRATES +=	valuable	0.1.1	# MIT
MODCARGO_CRATES +=	vec_map	0.8.2	# MIT/Apache-2.0
MODCARGO_CRATES +=	version_check	0.9.5	# MIT/Apache-2.0
MODCARGO_CRATES +=	vsimd	0.8.0	# MIT
MODCARGO_CRATES +=	vtparse	0.6.2	# MIT
MODCARGO_CRATES +=	wait-timeout	0.2.1	# MIT/Apache-2.0
MODCARGO_CRATES +=	walkdir	2.5.0	# Unlicense/MIT
MODCARGO_CRATES +=	wasi	0.11.1+wasi-snapshot-preview1	# Apache-2.0 WITH LLVM-exception OR Apache-2.0 OR MIT
MODCARGO_CRATES +=	wasi	0.14.2+wasi-0.2.4	# Apache-2.0 WITH LLVM-exception OR Apache-2.0 OR MIT
MODCARGO_CRATES +=	wasite	0.1.0	# Apache-2.0 OR BSL-1.0 OR MIT
MODCARGO_CRATES +=	wasm-bindgen	0.2.100	# MIT OR Apache-2.0
MODCARGO_CRATES +=	wasm-bindgen-backend	0.2.100	# MIT OR Apache-2.0
MODCARGO_CRATES +=	wasm-bindgen-macro	0.2.100	# MIT OR Apache-2.0
MODCARGO_CRATES +=	wasm-bindgen-macro-support	0.2.100	# MIT OR Apache-2.0
MODCARGO_CRATES +=	wasm-bindgen-shared	0.2.100	# MIT OR Apache-2.0
MODCARGO_CRATES +=	watchman_client	0.9.0	# MIT
MODCARGO_CRATES +=	web-sys	0.3.77	# MIT OR Apache-2.0
MODCARGO_CRATES +=	wezterm-bidi	0.2.3	# MIT AND Unicode-DFS-2016
MODCARGO_CRATES +=	wezterm-blob-leases	0.1.1	# MIT
MODCARGO_CRATES +=	wezterm-color-types	0.3.0	# MIT
MODCARGO_CRATES +=	wezterm-dynamic	0.2.1	# MIT
MODCARGO_CRATES +=	wezterm-dynamic-derive	0.1.1	# MIT
MODCARGO_CRATES +=	wezterm-input-types	0.1.0	# MIT
MODCARGO_CRATES +=	whoami	1.6.1	# Apache-2.0 OR BSL-1.0 OR MIT
MODCARGO_CRATES +=	winapi	0.3.9	# MIT/Apache-2.0
MODCARGO_CRATES +=	winapi-i686-pc-windows-gnu	0.4.0	# MIT/Apache-2.0
MODCARGO_CRATES +=	winapi-util	0.1.9	# Unlicense OR MIT
MODCARGO_CRATES +=	winapi-x86_64-pc-windows-gnu	0.4.0	# MIT/Apache-2.0
MODCARGO_CRATES +=	windows-core	0.61.2	# MIT OR Apache-2.0
MODCARGO_CRATES +=	windows-implement	0.60.0	# MIT OR Apache-2.0
MODCARGO_CRATES +=	windows-interface	0.59.1	# MIT OR Apache-2.0
MODCARGO_CRATES +=	windows-link	0.1.3	# MIT OR Apache-2.0
MODCARGO_CRATES +=	windows-link	0.2.0	# MIT OR Apache-2.0
MODCARGO_CRATES +=	windows-result	0.3.4	# MIT OR Apache-2.0
MODCARGO_CRATES +=	windows-strings	0.4.2	# MIT OR Apache-2.0
MODCARGO_CRATES +=	windows-sys	0.48.0	# MIT OR Apache-2.0
MODCARGO_CRATES +=	windows-sys	0.52.0	# MIT OR Apache-2.0
MODCARGO_CRATES +=	windows-sys	0.59.0	# MIT OR Apache-2.0
MODCARGO_CRATES +=	windows-sys	0.60.2	# MIT OR Apache-2.0
MODCARGO_CRATES +=	windows-targets	0.48.5	# MIT OR Apache-2.0
MODCARGO_CRATES +=	windows-targets	0.52.6	# MIT OR Apache-2.0
MODCARGO_CRATES +=	windows-targets	0.53.3	# MIT OR Apache-2.0
MODCARGO_CRATES +=	windows_aarch64_gnullvm	0.48.5	# MIT OR Apache-2.0
MODCARGO_CRATES +=	windows_aarch64_gnullvm	0.52.6	# MIT OR Apache-2.0
MODCARGO_CRATES +=	windows_aarch64_gnullvm	0.53.0	# MIT OR Apache-2.0
MODCARGO_CRATES +=	windows_aarch64_msvc	0.48.5	# MIT OR Apache-2.0
MODCARGO_CRATES +=	windows_aarch64_msvc	0.52.6	# MIT OR Apache-2.0
MODCARGO_CRATES +=	windows_aarch64_msvc	0.53.0	# MIT OR Apache-2.0
MODCARGO_CRATES +=	windows_i686_gnu	0.48.5	# MIT OR Apache-2.0
MODCARGO_CRATES +=	windows_i686_gnu	0.52.6	# MIT OR Apache-2.0
MODCARGO_CRATES +=	windows_i686_gnu	0.53.0	# MIT OR Apache-2.0
MODCARGO_CRATES +=	windows_i686_gnullvm	0.52.6	# MIT OR Apache-2.0
MODCARGO_CRATES +=	windows_i686_gnullvm	0.53.0	# MIT OR Apache-2.0
MODCARGO_CRATES +=	windows_i686_msvc	0.48.5	# MIT OR Apache-2.0
MODCARGO_CRATES +=	windows_i686_msvc	0.52.6	# MIT OR Apache-2.0
MODCARGO_CRATES +=	windows_i686_msvc	0.53.0	# MIT OR Apache-2.0
MODCARGO_CRATES +=	windows_x86_64_gnu	0.48.5	# MIT OR Apache-2.0
MODCARGO_CRATES +=	windows_x86_64_gnu	0.52.6	# MIT OR Apache-2.0
MODCARGO_CRATES +=	windows_x86_64_gnu	0.53.0	# MIT OR Apache-2.0
MODCARGO_CRATES +=	windows_x86_64_gnullvm	0.48.5	# MIT OR Apache-2.0
MODCARGO_CRATES +=	windows_x86_64_gnullvm	0.52.6	# MIT OR Apache-2.0
MODCARGO_CRATES +=	windows_x86_64_gnullvm	0.53.0	# MIT OR Apache-2.0
MODCARGO_CRATES +=	windows_x86_64_msvc	0.48.5	# MIT OR Apache-2.0
MODCARGO_CRATES +=	windows_x86_64_msvc	0.52.6	# MIT OR Apache-2.0
MODCARGO_CRATES +=	windows_x86_64_msvc	0.53.0	# MIT OR Apache-2.0
MODCARGO_CRATES +=	winnow	0.7.13	# MIT
MODCARGO_CRATES +=	winreg	0.52.0	# MIT
MODCARGO_CRATES +=	wit-bindgen-rt	0.39.0	# Apache-2.0 WITH LLVM-exception OR Apache-2.0 OR MIT
MODCARGO_CRATES +=	writeable	0.6.1	# Unicode-3.0
MODCARGO_CRATES +=	yansi	1.0.1	# MIT OR Apache-2.0
MODCARGO_CRATES +=	yoke	0.8.0	# Unicode-3.0
MODCARGO_CRATES +=	yoke-derive	0.8.0	# Unicode-3.0
MODCARGO_CRATES +=	zerocopy	0.8.26	# BSD-2-Clause OR Apache-2.0 OR MIT
MODCARGO_CRATES +=	zerocopy-derive	0.8.26	# BSD-2-Clause OR Apache-2.0 OR MIT
MODCARGO_CRATES +=	zerofrom	0.1.6	# Unicode-3.0
MODCARGO_CRATES +=	zerofrom-derive	0.1.6	# Unicode-3.0
MODCARGO_CRATES +=	zerotrie	0.2.2	# Unicode-3.0
MODCARGO_CRATES +=	zerovec	0.11.4	# Unicode-3.0
MODCARGO_CRATES +=	zerovec-derive	0.11.1	# Unicode-3.0
MODCARGO_CRATES +=	zlib-rs	0.5.1	# Zlib
