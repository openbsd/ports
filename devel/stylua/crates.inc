MODCARGO_CRATES +=	aho-corasick	1.1.2	# Unlicense OR MIT
MODCARGO_CRATES +=	anes	0.1.6	# MIT OR Apache-2.0
MODCARGO_CRATES +=	anstyle	1.0.4	# MIT OR Apache-2.0
MODCARGO_CRATES +=	anyhow	1.0.79	# MIT OR Apache-2.0
MODCARGO_CRATES +=	assert_cmd	2.0.13	# MIT OR Apache-2.0
MODCARGO_CRATES +=	assert_fs	1.1.1	# MIT OR Apache-2.0
MODCARGO_CRATES +=	atty	0.2.14	# MIT
MODCARGO_CRATES +=	autocfg	1.1.0	# Apache-2.0 OR MIT
MODCARGO_CRATES +=	bitflags	1.3.2	# MIT/Apache-2.0
MODCARGO_CRATES +=	bitflags	2.4.2	# MIT OR Apache-2.0
MODCARGO_CRATES +=	borsh	1.5.1	# MIT OR Apache-2.0
MODCARGO_CRATES +=	bstr	1.9.0	# MIT OR Apache-2.0
MODCARGO_CRATES +=	bumpalo	3.14.0	# MIT OR Apache-2.0
MODCARGO_CRATES +=	bytecount	0.6.7	# Apache-2.0/MIT
MODCARGO_CRATES +=	cast	0.3.0	# MIT OR Apache-2.0
MODCARGO_CRATES +=	cfg-if	1.0.0	# MIT/Apache-2.0
MODCARGO_CRATES +=	cfg_aliases	0.2.1	# MIT
MODCARGO_CRATES +=	ciborium	0.2.2	# Apache-2.0
MODCARGO_CRATES +=	ciborium-io	0.2.2	# Apache-2.0
MODCARGO_CRATES +=	ciborium-ll	0.2.2	# Apache-2.0
MODCARGO_CRATES +=	clap	3.2.25	# MIT OR Apache-2.0
MODCARGO_CRATES +=	clap_derive	3.2.25	# MIT OR Apache-2.0
MODCARGO_CRATES +=	clap_lex	0.2.4	# MIT OR Apache-2.0
MODCARGO_CRATES +=	console	0.15.8	# MIT
MODCARGO_CRATES +=	criterion	0.4.0	# Apache-2.0/MIT
MODCARGO_CRATES +=	criterion-plot	0.5.0	# MIT/Apache-2.0
MODCARGO_CRATES +=	crossbeam-channel	0.5.15	# MIT OR Apache-2.0
MODCARGO_CRATES +=	crossbeam-deque	0.8.5	# MIT OR Apache-2.0
MODCARGO_CRATES +=	crossbeam-epoch	0.9.18	# MIT OR Apache-2.0
MODCARGO_CRATES +=	crossbeam-utils	0.8.19	# MIT OR Apache-2.0
MODCARGO_CRATES +=	crunchy	0.2.2	# MIT
MODCARGO_CRATES +=	derive_more	1.0.0	# MIT
MODCARGO_CRATES +=	derive_more-impl	1.0.0	# MIT
MODCARGO_CRATES +=	difflib	0.4.0	# MIT
MODCARGO_CRATES +=	doc-comment	0.3.3	# MIT
MODCARGO_CRATES +=	ec4rs	1.0.2	# Apache-2.0
MODCARGO_CRATES +=	either	1.9.0	# MIT OR Apache-2.0
MODCARGO_CRATES +=	encode_unicode	0.3.6	# MIT/Apache-2.0
MODCARGO_CRATES +=	env_logger	0.10.2	# MIT OR Apache-2.0
MODCARGO_CRATES +=	equivalent	1.0.1	# Apache-2.0 OR MIT
MODCARGO_CRATES +=	errno	0.3.8	# MIT OR Apache-2.0
MODCARGO_CRATES +=	fastrand	2.0.1	# Apache-2.0 OR MIT
MODCARGO_CRATES +=	full_moon	2.0.0	# MPL-2.0
MODCARGO_CRATES +=	full_moon_derive	0.11.0	# MPL-2.0
MODCARGO_CRATES +=	globset	0.4.14	# Unlicense OR MIT
MODCARGO_CRATES +=	globwalk	0.9.1	# MIT
MODCARGO_CRATES +=	half	2.3.1	# MIT OR Apache-2.0
MODCARGO_CRATES +=	hashbrown	0.12.3	# MIT OR Apache-2.0
MODCARGO_CRATES +=	hashbrown	0.14.3	# MIT OR Apache-2.0
MODCARGO_CRATES +=	heck	0.4.1	# MIT OR Apache-2.0
MODCARGO_CRATES +=	hermit-abi	0.1.19	# MIT/Apache-2.0
MODCARGO_CRATES +=	hermit-abi	0.3.4	# MIT OR Apache-2.0
MODCARGO_CRATES +=	ignore	0.4.22	# Unlicense OR MIT
MODCARGO_CRATES +=	indexmap	1.9.3	# Apache-2.0 OR MIT
MODCARGO_CRATES +=	indexmap	2.1.0	# Apache-2.0 OR MIT
MODCARGO_CRATES +=	insta	1.34.0	# Apache-2.0
MODCARGO_CRATES +=	itertools	0.10.5	# MIT/Apache-2.0
MODCARGO_CRATES +=	itoa	1.0.10	# MIT OR Apache-2.0
MODCARGO_CRATES +=	js-sys	0.3.67	# MIT OR Apache-2.0
MODCARGO_CRATES +=	lazy_static	1.4.0	# MIT/Apache-2.0
MODCARGO_CRATES +=	libc	0.2.155	# MIT OR Apache-2.0
MODCARGO_CRATES +=	linked-hash-map	0.5.6	# MIT/Apache-2.0
MODCARGO_CRATES +=	linux-raw-sys	0.4.13	# Apache-2.0 WITH LLVM-exception OR Apache-2.0 OR MIT
MODCARGO_CRATES +=	log	0.4.20	# MIT OR Apache-2.0
MODCARGO_CRATES +=	memchr	2.7.1	# Unlicense OR MIT
MODCARGO_CRATES +=	num-traits	0.2.17	# MIT OR Apache-2.0
MODCARGO_CRATES +=	num_cpus	1.16.0	# MIT OR Apache-2.0
MODCARGO_CRATES +=	once_cell	1.19.0	# MIT OR Apache-2.0
MODCARGO_CRATES +=	oorandom	11.1.3	# MIT
MODCARGO_CRATES +=	os_str_bytes	6.6.1	# MIT OR Apache-2.0
MODCARGO_CRATES +=	paste	1.0.14	# MIT OR Apache-2.0
MODCARGO_CRATES +=	plotters	0.3.5	# MIT
MODCARGO_CRATES +=	plotters-backend	0.3.5	# MIT
MODCARGO_CRATES +=	plotters-svg	0.3.5	# MIT
MODCARGO_CRATES +=	predicates	3.1.0	# MIT OR Apache-2.0
MODCARGO_CRATES +=	predicates-core	1.0.6	# MIT OR Apache-2.0
MODCARGO_CRATES +=	predicates-tree	1.0.9	# MIT OR Apache-2.0
MODCARGO_CRATES +=	proc-macro-error	1.0.4	# MIT OR Apache-2.0
MODCARGO_CRATES +=	proc-macro-error-attr	1.0.4	# MIT OR Apache-2.0
MODCARGO_CRATES +=	proc-macro2	1.0.78	# MIT OR Apache-2.0
MODCARGO_CRATES +=	quote	1.0.35	# MIT OR Apache-2.0
MODCARGO_CRATES +=	rayon	1.8.1	# MIT OR Apache-2.0
MODCARGO_CRATES +=	rayon-core	1.12.1	# MIT OR Apache-2.0
MODCARGO_CRATES +=	redox_syscall	0.4.1	# MIT
MODCARGO_CRATES +=	regex	1.10.3	# MIT OR Apache-2.0
MODCARGO_CRATES +=	regex-automata	0.4.5	# MIT OR Apache-2.0
MODCARGO_CRATES +=	regex-syntax	0.8.2	# MIT OR Apache-2.0
MODCARGO_CRATES +=	rustix	0.38.30	# Apache-2.0 WITH LLVM-exception OR Apache-2.0 OR MIT
MODCARGO_CRATES +=	rustversion	1.0.14	# MIT OR Apache-2.0
MODCARGO_CRATES +=	ryu	1.0.16	# Apache-2.0 OR BSL-1.0
MODCARGO_CRATES +=	same-file	1.0.6	# Unlicense/MIT
MODCARGO_CRATES +=	serde	1.0.196	# MIT OR Apache-2.0
MODCARGO_CRATES +=	serde_derive	1.0.196	# MIT OR Apache-2.0
MODCARGO_CRATES +=	serde_json	1.0.112	# MIT OR Apache-2.0
MODCARGO_CRATES +=	serde_spanned	0.6.5	# MIT OR Apache-2.0
MODCARGO_CRATES +=	similar	2.4.0	# Apache-2.0
MODCARGO_CRATES +=	smol_str	0.3.2	# MIT OR Apache-2.0
MODCARGO_CRATES +=	strsim	0.10.0	# MIT
MODCARGO_CRATES +=	strum	0.25.0	# MIT
MODCARGO_CRATES +=	strum_macros	0.25.3	# MIT
MODCARGO_CRATES +=	syn	1.0.109	# MIT OR Apache-2.0
MODCARGO_CRATES +=	syn	2.0.48	# MIT OR Apache-2.0
MODCARGO_CRATES +=	tempfile	3.9.0	# MIT OR Apache-2.0
MODCARGO_CRATES +=	termcolor	1.4.1	# Unlicense OR MIT
MODCARGO_CRATES +=	termtree	0.4.1	# MIT
MODCARGO_CRATES +=	textwrap	0.16.0	# MIT
MODCARGO_CRATES +=	thiserror	1.0.56	# MIT OR Apache-2.0
MODCARGO_CRATES +=	thiserror-impl	1.0.56	# MIT OR Apache-2.0
MODCARGO_CRATES +=	threadpool	1.8.1	# MIT/Apache-2.0
MODCARGO_CRATES +=	tinytemplate	1.2.1	# Apache-2.0 OR MIT
MODCARGO_CRATES +=	toml	0.8.8	# MIT OR Apache-2.0
MODCARGO_CRATES +=	toml_datetime	0.6.5	# MIT OR Apache-2.0
MODCARGO_CRATES +=	toml_edit	0.21.0	# MIT OR Apache-2.0
MODCARGO_CRATES +=	unicode-ident	1.0.12	# (MIT OR Apache-2.0) AND Unicode-DFS-2016
MODCARGO_CRATES +=	unicode-width	0.1.11	# MIT/Apache-2.0
MODCARGO_CRATES +=	unicode-xid	0.2.6	# MIT OR Apache-2.0
MODCARGO_CRATES +=	version_check	0.9.4	# MIT/Apache-2.0
MODCARGO_CRATES +=	wait-timeout	0.2.0	# MIT/Apache-2.0
MODCARGO_CRATES +=	walkdir	2.4.0	# Unlicense/MIT
MODCARGO_CRATES +=	wasm-bindgen	0.2.90	# MIT OR Apache-2.0
MODCARGO_CRATES +=	wasm-bindgen-backend	0.2.90	# MIT OR Apache-2.0
MODCARGO_CRATES +=	wasm-bindgen-macro	0.2.90	# MIT OR Apache-2.0
MODCARGO_CRATES +=	wasm-bindgen-macro-support	0.2.90	# MIT OR Apache-2.0
MODCARGO_CRATES +=	wasm-bindgen-shared	0.2.90	# MIT OR Apache-2.0
MODCARGO_CRATES +=	web-sys	0.3.67	# MIT OR Apache-2.0
MODCARGO_CRATES +=	winapi	0.3.9	# MIT/Apache-2.0
MODCARGO_CRATES +=	winapi-i686-pc-windows-gnu	0.4.0	# MIT/Apache-2.0
MODCARGO_CRATES +=	winapi-util	0.1.6	# Unlicense/MIT
MODCARGO_CRATES +=	winapi-x86_64-pc-windows-gnu	0.4.0	# MIT/Apache-2.0
MODCARGO_CRATES +=	windows-sys	0.52.0	# MIT OR Apache-2.0
MODCARGO_CRATES +=	windows-targets	0.52.0	# MIT OR Apache-2.0
MODCARGO_CRATES +=	windows_aarch64_gnullvm	0.52.0	# MIT OR Apache-2.0
MODCARGO_CRATES +=	windows_aarch64_msvc	0.52.0	# MIT OR Apache-2.0
MODCARGO_CRATES +=	windows_i686_gnu	0.52.0	# MIT OR Apache-2.0
MODCARGO_CRATES +=	windows_i686_msvc	0.52.0	# MIT OR Apache-2.0
MODCARGO_CRATES +=	windows_x86_64_gnu	0.52.0	# MIT OR Apache-2.0
MODCARGO_CRATES +=	windows_x86_64_gnullvm	0.52.0	# MIT OR Apache-2.0
MODCARGO_CRATES +=	windows_x86_64_msvc	0.52.0	# MIT OR Apache-2.0
MODCARGO_CRATES +=	winnow	0.5.35	# MIT
MODCARGO_CRATES +=	yaml-rust	0.4.5	# MIT/Apache-2.0
