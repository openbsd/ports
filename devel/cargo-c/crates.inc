MODCARGO_CRATES +=	adler2	2.0.1	# 0BSD OR MIT OR Apache-2.0
MODCARGO_CRATES +=	aho-corasick	1.1.3	# Unlicense OR MIT
MODCARGO_CRATES +=	allocator-api2	0.2.21	# MIT OR Apache-2.0
MODCARGO_CRATES +=	annotate-snippets	0.11.5	# MIT OR Apache-2.0
MODCARGO_CRATES +=	anstream	0.6.20	# MIT OR Apache-2.0
MODCARGO_CRATES +=	anstyle	1.0.11	# MIT OR Apache-2.0
MODCARGO_CRATES +=	anstyle-parse	0.2.7	# MIT OR Apache-2.0
MODCARGO_CRATES +=	anstyle-query	1.1.4	# MIT OR Apache-2.0
MODCARGO_CRATES +=	anstyle-wincon	3.0.10	# MIT OR Apache-2.0
MODCARGO_CRATES +=	anyhow	1.0.100	# MIT OR Apache-2.0
MODCARGO_CRATES +=	arc-swap	1.7.1	# MIT OR Apache-2.0
MODCARGO_CRATES +=	arrayref	0.3.9	# BSD-2-Clause
MODCARGO_CRATES +=	arrayvec	0.7.6	# MIT OR Apache-2.0
MODCARGO_CRATES +=	autocfg	1.5.0	# Apache-2.0 OR MIT
MODCARGO_CRATES +=	base16ct	0.2.0	# Apache-2.0 OR MIT
MODCARGO_CRATES +=	base64	0.22.1	# MIT OR Apache-2.0
MODCARGO_CRATES +=	base64ct	1.8.0	# Apache-2.0 OR MIT
MODCARGO_CRATES +=	bitflags	2.9.4	# MIT OR Apache-2.0
MODCARGO_CRATES +=	bitmaps	2.1.0	# MPL-2.0+
MODCARGO_CRATES +=	blake3	1.8.2	# CC0-1.0 OR Apache-2.0 OR Apache-2.0 WITH LLVM-exception
MODCARGO_CRATES +=	block-buffer	0.10.4	# MIT OR Apache-2.0
MODCARGO_CRATES +=	bstr	1.12.0	# MIT OR Apache-2.0
MODCARGO_CRATES +=	bumpalo	3.19.0	# MIT OR Apache-2.0
MODCARGO_CRATES +=	byteorder	1.5.0	# Unlicense OR MIT
MODCARGO_CRATES +=	bytes	1.10.1	# MIT
MODCARGO_CRATES +=	cargo	0.91.0	# MIT OR Apache-2.0
MODCARGO_CRATES +=	cargo-credential	0.4.9	# MIT OR Apache-2.0
MODCARGO_CRATES +=	cargo-credential-libsecret	0.5.1	# MIT OR Apache-2.0
MODCARGO_CRATES +=	cargo-credential-macos-keychain	0.4.16	# MIT OR Apache-2.0
MODCARGO_CRATES +=	cargo-credential-wincred	0.4.16	# MIT OR Apache-2.0
MODCARGO_CRATES +=	cargo-platform	0.3.1	# MIT OR Apache-2.0
MODCARGO_CRATES +=	cargo-util	0.2.23	# MIT OR Apache-2.0
MODCARGO_CRATES +=	cargo-util-schemas	0.10.0	# MIT OR Apache-2.0
MODCARGO_CRATES +=	cbindgen	0.29.0	# MPL-2.0
MODCARGO_CRATES +=	cc	1.2.38	# MIT OR Apache-2.0
MODCARGO_CRATES +=	cfg-if	1.0.3	# MIT OR Apache-2.0
MODCARGO_CRATES +=	clap	4.5.48	# MIT OR Apache-2.0
MODCARGO_CRATES +=	clap_builder	4.5.48	# MIT OR Apache-2.0
MODCARGO_CRATES +=	clap_complete	4.5.58	# MIT OR Apache-2.0
MODCARGO_CRATES +=	clap_derive	4.5.47	# MIT OR Apache-2.0
MODCARGO_CRATES +=	clap_lex	0.7.5	# MIT OR Apache-2.0
MODCARGO_CRATES +=	clru	0.6.2	# MIT
MODCARGO_CRATES +=	color-print	0.3.7	# MIT OR Apache-2.0
MODCARGO_CRATES +=	color-print-proc-macro	0.3.7	# MIT OR Apache-2.0
MODCARGO_CRATES +=	colorchoice	1.0.4	# MIT OR Apache-2.0
MODCARGO_CRATES +=	const-oid	0.9.6	# Apache-2.0 OR MIT
MODCARGO_CRATES +=	constant_time_eq	0.3.1	# CC0-1.0 OR MIT-0 OR Apache-2.0
MODCARGO_CRATES +=	core-foundation	0.10.1	# MIT OR Apache-2.0
MODCARGO_CRATES +=	core-foundation-sys	0.8.7	# MIT OR Apache-2.0
MODCARGO_CRATES +=	cpufeatures	0.2.17	# MIT OR Apache-2.0
MODCARGO_CRATES +=	crates-io	0.40.13	# MIT OR Apache-2.0
MODCARGO_CRATES +=	crc32fast	1.5.0	# MIT OR Apache-2.0
MODCARGO_CRATES +=	crossbeam-channel	0.5.15	# MIT OR Apache-2.0
MODCARGO_CRATES +=	crossbeam-deque	0.8.6	# MIT OR Apache-2.0
MODCARGO_CRATES +=	crossbeam-epoch	0.9.18	# MIT OR Apache-2.0
MODCARGO_CRATES +=	crossbeam-utils	0.8.21	# MIT OR Apache-2.0
MODCARGO_CRATES +=	crypto-bigint	0.5.5	# Apache-2.0 OR MIT
MODCARGO_CRATES +=	crypto-common	0.1.6	# MIT OR Apache-2.0
MODCARGO_CRATES +=	ct-codecs	1.1.6	# MIT
MODCARGO_CRATES +=	curl	0.4.49	# MIT
MODCARGO_CRATES +=	curl-sys	0.4.83+curl-8.15.0	# MIT
MODCARGO_CRATES +=	dashmap	6.1.0	# MIT
MODCARGO_CRATES +=	der	0.7.10	# Apache-2.0 OR MIT
MODCARGO_CRATES +=	deranged	0.5.3	# MIT OR Apache-2.0
MODCARGO_CRATES +=	digest	0.10.7	# MIT OR Apache-2.0
MODCARGO_CRATES +=	displaydoc	0.2.5	# MIT OR Apache-2.0
MODCARGO_CRATES +=	dunce	1.0.5	# CC0-1.0 OR MIT-0 OR Apache-2.0
MODCARGO_CRATES +=	ecdsa	0.16.9	# Apache-2.0 OR MIT
MODCARGO_CRATES +=	ed25519-compact	2.1.1	# MIT
MODCARGO_CRATES +=	either	1.15.0	# MIT OR Apache-2.0
MODCARGO_CRATES +=	elliptic-curve	0.13.8	# Apache-2.0 OR MIT
MODCARGO_CRATES +=	encoding_rs	0.8.35	# (Apache-2.0 OR MIT) AND BSD-3-Clause
MODCARGO_CRATES +=	equivalent	1.0.2	# Apache-2.0 OR MIT
MODCARGO_CRATES +=	erased-serde	0.4.8	# MIT OR Apache-2.0
MODCARGO_CRATES +=	errno	0.3.14	# MIT OR Apache-2.0
MODCARGO_CRATES +=	fallible-iterator	0.3.0	# MIT/Apache-2.0
MODCARGO_CRATES +=	fallible-streaming-iterator	0.1.9	# MIT/Apache-2.0
MODCARGO_CRATES +=	faster-hex	0.10.0	# MIT
MODCARGO_CRATES +=	fastrand	2.3.0	# Apache-2.0 OR MIT
MODCARGO_CRATES +=	ff	0.13.1	# MIT/Apache-2.0
MODCARGO_CRATES +=	fiat-crypto	0.3.0	# MIT OR Apache-2.0 OR BSD-1-Clause
MODCARGO_CRATES +=	filetime	0.2.26	# MIT/Apache-2.0
MODCARGO_CRATES +=	find-msvc-tools	0.1.2	# MIT OR Apache-2.0
MODCARGO_CRATES +=	flate2	1.1.2	# MIT OR Apache-2.0
MODCARGO_CRATES +=	fnv	1.0.7	# Apache-2.0 / MIT
MODCARGO_CRATES +=	foldhash	0.1.5	# Zlib
MODCARGO_CRATES +=	foreign-types	0.3.2	# MIT/Apache-2.0
MODCARGO_CRATES +=	foreign-types-shared	0.1.1	# MIT/Apache-2.0
MODCARGO_CRATES +=	form_urlencoded	1.2.2	# MIT OR Apache-2.0
MODCARGO_CRATES +=	generic-array	0.14.7	# MIT
MODCARGO_CRATES +=	getrandom	0.2.16	# MIT OR Apache-2.0
MODCARGO_CRATES +=	getrandom	0.3.3	# MIT OR Apache-2.0
MODCARGO_CRATES +=	git2	0.20.2	# MIT OR Apache-2.0
MODCARGO_CRATES +=	git2-curl	0.21.0	# MIT OR Apache-2.0
MODCARGO_CRATES +=	gix	0.73.0	# MIT OR Apache-2.0
MODCARGO_CRATES +=	gix-actor	0.35.4	# MIT OR Apache-2.0
MODCARGO_CRATES +=	gix-attributes	0.27.0	# MIT OR Apache-2.0
MODCARGO_CRATES +=	gix-bitmap	0.2.14	# MIT OR Apache-2.0
MODCARGO_CRATES +=	gix-chunk	0.4.11	# MIT OR Apache-2.0
MODCARGO_CRATES +=	gix-command	0.6.2	# MIT OR Apache-2.0
MODCARGO_CRATES +=	gix-commitgraph	0.29.0	# MIT OR Apache-2.0
MODCARGO_CRATES +=	gix-config	0.46.0	# MIT OR Apache-2.0
MODCARGO_CRATES +=	gix-config-value	0.15.1	# MIT OR Apache-2.0
MODCARGO_CRATES +=	gix-credentials	0.30.0	# MIT OR Apache-2.0
MODCARGO_CRATES +=	gix-date	0.10.5	# MIT OR Apache-2.0
MODCARGO_CRATES +=	gix-diff	0.53.0	# MIT OR Apache-2.0
MODCARGO_CRATES +=	gix-dir	0.15.0	# MIT OR Apache-2.0
MODCARGO_CRATES +=	gix-discover	0.41.0	# MIT OR Apache-2.0
MODCARGO_CRATES +=	gix-features	0.43.1	# MIT OR Apache-2.0
MODCARGO_CRATES +=	gix-filter	0.20.0	# MIT OR Apache-2.0
MODCARGO_CRATES +=	gix-fs	0.16.1	# MIT OR Apache-2.0
MODCARGO_CRATES +=	gix-glob	0.21.0	# MIT OR Apache-2.0
MODCARGO_CRATES +=	gix-hash	0.19.0	# MIT OR Apache-2.0
MODCARGO_CRATES +=	gix-hashtable	0.9.0	# MIT OR Apache-2.0
MODCARGO_CRATES +=	gix-ignore	0.16.0	# MIT OR Apache-2.0
MODCARGO_CRATES +=	gix-index	0.41.0	# MIT OR Apache-2.0
MODCARGO_CRATES +=	gix-lock	18.0.0	# MIT OR Apache-2.0
MODCARGO_CRATES +=	gix-negotiate	0.21.0	# MIT OR Apache-2.0
MODCARGO_CRATES +=	gix-object	0.50.2	# MIT OR Apache-2.0
MODCARGO_CRATES +=	gix-odb	0.70.0	# MIT OR Apache-2.0
MODCARGO_CRATES +=	gix-pack	0.60.0	# MIT OR Apache-2.0
MODCARGO_CRATES +=	gix-packetline	0.19.1	# MIT OR Apache-2.0
MODCARGO_CRATES +=	gix-packetline-blocking	0.19.1	# MIT OR Apache-2.0
MODCARGO_CRATES +=	gix-path	0.10.20	# MIT OR Apache-2.0
MODCARGO_CRATES +=	gix-pathspec	0.12.0	# MIT OR Apache-2.0
MODCARGO_CRATES +=	gix-prompt	0.11.1	# MIT OR Apache-2.0
MODCARGO_CRATES +=	gix-protocol	0.51.0	# MIT OR Apache-2.0
MODCARGO_CRATES +=	gix-quote	0.6.0	# MIT OR Apache-2.0
MODCARGO_CRATES +=	gix-ref	0.53.1	# MIT OR Apache-2.0
MODCARGO_CRATES +=	gix-refspec	0.31.0	# MIT OR Apache-2.0
MODCARGO_CRATES +=	gix-revision	0.35.0	# MIT OR Apache-2.0
MODCARGO_CRATES +=	gix-revwalk	0.21.0	# MIT OR Apache-2.0
MODCARGO_CRATES +=	gix-sec	0.12.0	# MIT OR Apache-2.0
MODCARGO_CRATES +=	gix-shallow	0.5.0	# MIT OR Apache-2.0
MODCARGO_CRATES +=	gix-status	0.20.0	# MIT OR Apache-2.0
MODCARGO_CRATES +=	gix-submodule	0.20.0	# MIT OR Apache-2.0
MODCARGO_CRATES +=	gix-tempfile	18.0.0	# MIT OR Apache-2.0
MODCARGO_CRATES +=	gix-trace	0.1.13	# MIT OR Apache-2.0
MODCARGO_CRATES +=	gix-transport	0.48.0	# MIT OR Apache-2.0
MODCARGO_CRATES +=	gix-traverse	0.47.0	# MIT OR Apache-2.0
MODCARGO_CRATES +=	gix-url	0.32.0	# MIT OR Apache-2.0
MODCARGO_CRATES +=	gix-utils	0.3.0	# MIT OR Apache-2.0
MODCARGO_CRATES +=	gix-validate	0.10.0	# MIT OR Apache-2.0
MODCARGO_CRATES +=	gix-worktree	0.42.0	# MIT OR Apache-2.0
MODCARGO_CRATES +=	glob	0.3.3	# MIT OR Apache-2.0
MODCARGO_CRATES +=	globset	0.4.16	# Unlicense OR MIT
MODCARGO_CRATES +=	group	0.13.0	# MIT/Apache-2.0
MODCARGO_CRATES +=	hash32	0.3.1	# MIT OR Apache-2.0
MODCARGO_CRATES +=	hashbrown	0.14.5	# MIT OR Apache-2.0
MODCARGO_CRATES +=	hashbrown	0.15.5	# MIT OR Apache-2.0
MODCARGO_CRATES +=	hashbrown	0.16.0	# MIT OR Apache-2.0
MODCARGO_CRATES +=	hashlink	0.10.0	# MIT OR Apache-2.0
MODCARGO_CRATES +=	heapless	0.8.0	# MIT OR Apache-2.0
MODCARGO_CRATES +=	heck	0.5.0	# MIT OR Apache-2.0
MODCARGO_CRATES +=	hex	0.4.3	# MIT OR Apache-2.0
MODCARGO_CRATES +=	hkdf	0.12.4	# MIT OR Apache-2.0
MODCARGO_CRATES +=	hmac	0.12.1	# MIT OR Apache-2.0
MODCARGO_CRATES +=	home	0.5.11	# MIT OR Apache-2.0
MODCARGO_CRATES +=	http-auth	0.1.10	# MIT/Apache-2.0
MODCARGO_CRATES +=	icu_collections	2.0.0	# Unicode-3.0
MODCARGO_CRATES +=	icu_locale_core	2.0.0	# Unicode-3.0
MODCARGO_CRATES +=	icu_normalizer	2.0.0	# Unicode-3.0
MODCARGO_CRATES +=	icu_normalizer_data	2.0.0	# Unicode-3.0
MODCARGO_CRATES +=	icu_properties	2.0.1	# Unicode-3.0
MODCARGO_CRATES +=	icu_properties_data	2.0.1	# Unicode-3.0
MODCARGO_CRATES +=	icu_provider	2.0.0	# Unicode-3.0
MODCARGO_CRATES +=	idna	1.1.0	# MIT OR Apache-2.0
MODCARGO_CRATES +=	idna_adapter	1.2.1	# Apache-2.0 OR MIT
MODCARGO_CRATES +=	ignore	0.4.23	# Unlicense OR MIT
MODCARGO_CRATES +=	im-rc	15.1.0	# MPL-2.0+
MODCARGO_CRATES +=	imara-diff	0.1.8	# Apache-2.0
MODCARGO_CRATES +=	implib	0.4.0	# MIT
MODCARGO_CRATES +=	indexmap	2.11.4	# Apache-2.0 OR MIT
MODCARGO_CRATES +=	is_executable	1.0.5	# MIT OR Apache-2.0
MODCARGO_CRATES +=	is_terminal_polyfill	1.70.1	# MIT OR Apache-2.0
MODCARGO_CRATES +=	itertools	0.14.0	# MIT OR Apache-2.0
MODCARGO_CRATES +=	itoa	1.0.15	# MIT OR Apache-2.0
MODCARGO_CRATES +=	jiff	0.2.15	# Unlicense OR MIT
MODCARGO_CRATES +=	jiff-static	0.2.15	# Unlicense OR MIT
MODCARGO_CRATES +=	jiff-tzdb	0.1.4	# Unlicense OR MIT
MODCARGO_CRATES +=	jiff-tzdb-platform	0.1.3	# Unlicense OR MIT
MODCARGO_CRATES +=	jobserver	0.1.34	# MIT OR Apache-2.0
MODCARGO_CRATES +=	js-sys	0.3.80	# MIT OR Apache-2.0
MODCARGO_CRATES +=	kstring	2.0.2	# MIT OR Apache-2.0
MODCARGO_CRATES +=	lazy_static	1.5.0	# MIT OR Apache-2.0
MODCARGO_CRATES +=	lazycell	1.3.0	# MIT/Apache-2.0
MODCARGO_CRATES +=	libc	0.2.175	# MIT OR Apache-2.0
MODCARGO_CRATES +=	libgit2-sys	0.18.2+1.9.1	# MIT OR Apache-2.0
MODCARGO_CRATES +=	libloading	0.8.8	# ISC
MODCARGO_CRATES +=	libnghttp2-sys	0.1.11+1.64.0	# MIT/Apache-2.0
MODCARGO_CRATES +=	libredox	0.1.10	# MIT
MODCARGO_CRATES +=	libsqlite3-sys	0.34.0	# MIT
MODCARGO_CRATES +=	libssh2-sys	0.3.1	# MIT OR Apache-2.0
MODCARGO_CRATES +=	libz-rs-sys	0.5.2	# Zlib
MODCARGO_CRATES +=	libz-sys	1.1.22	# MIT OR Apache-2.0
MODCARGO_CRATES +=	linux-raw-sys	0.11.0	# Apache-2.0 WITH LLVM-exception OR Apache-2.0 OR MIT
MODCARGO_CRATES +=	litemap	0.8.0	# Unicode-3.0
MODCARGO_CRATES +=	lock_api	0.4.13	# MIT OR Apache-2.0
MODCARGO_CRATES +=	log	0.4.28	# MIT OR Apache-2.0
MODCARGO_CRATES +=	matchers	0.2.0	# MIT
MODCARGO_CRATES +=	maybe-async	0.2.10	# MIT
MODCARGO_CRATES +=	memchr	2.7.5	# Unlicense OR MIT
MODCARGO_CRATES +=	memmap2	0.9.8	# MIT OR Apache-2.0
MODCARGO_CRATES +=	memoffset	0.9.1	# MIT
MODCARGO_CRATES +=	minimal-lexical	0.2.1	# MIT/Apache-2.0
MODCARGO_CRATES +=	miniz_oxide	0.8.9	# MIT OR Zlib OR Apache-2.0
MODCARGO_CRATES +=	miow	0.6.1	# MIT OR Apache-2.0
MODCARGO_CRATES +=	nom	7.1.3	# MIT
MODCARGO_CRATES +=	normpath	1.4.0	# MIT OR Apache-2.0
MODCARGO_CRATES +=	nu-ansi-term	0.50.1	# MIT
MODCARGO_CRATES +=	num-conv	0.1.0	# MIT OR Apache-2.0
MODCARGO_CRATES +=	num-traits	0.2.19	# MIT OR Apache-2.0
MODCARGO_CRATES +=	object	0.37.3	# Apache-2.0 OR MIT
MODCARGO_CRATES +=	once_cell	1.21.3	# MIT OR Apache-2.0
MODCARGO_CRATES +=	once_cell_polyfill	1.70.1	# MIT OR Apache-2.0
MODCARGO_CRATES +=	opener	0.8.3	# MIT OR Apache-2.0
MODCARGO_CRATES +=	openssl	0.10.73	# Apache-2.0
MODCARGO_CRATES +=	openssl-macros	0.1.1	# MIT/Apache-2.0
MODCARGO_CRATES +=	openssl-probe	0.1.6	# MIT/Apache-2.0
MODCARGO_CRATES +=	openssl-src	300.5.2+3.5.2	# MIT/Apache-2.0
MODCARGO_CRATES +=	openssl-sys	0.9.109	# MIT
MODCARGO_CRATES +=	ordered-float	2.10.1	# MIT
MODCARGO_CRATES +=	orion	0.17.11	# MIT
MODCARGO_CRATES +=	os_info	3.12.0	# MIT
MODCARGO_CRATES +=	p384	0.13.1	# Apache-2.0 OR MIT
MODCARGO_CRATES +=	parking_lot	0.12.4	# MIT OR Apache-2.0
MODCARGO_CRATES +=	parking_lot_core	0.9.11	# MIT OR Apache-2.0
MODCARGO_CRATES +=	pasetors	0.7.7	# MIT
MODCARGO_CRATES +=	pathdiff	0.2.3	# MIT/Apache-2.0
MODCARGO_CRATES +=	pem-rfc7468	0.7.0	# Apache-2.0 OR MIT
MODCARGO_CRATES +=	percent-encoding	2.3.2	# MIT OR Apache-2.0
MODCARGO_CRATES +=	pin-project-lite	0.2.16	# Apache-2.0 OR MIT
MODCARGO_CRATES +=	pkcs8	0.10.2	# Apache-2.0 OR MIT
MODCARGO_CRATES +=	pkg-config	0.3.32	# MIT OR Apache-2.0
MODCARGO_CRATES +=	plist	1.8.0	# MIT
MODCARGO_CRATES +=	portable-atomic	1.11.1	# Apache-2.0 OR MIT
MODCARGO_CRATES +=	portable-atomic-util	0.2.4	# Apache-2.0 OR MIT
MODCARGO_CRATES +=	potential_utf	0.1.3	# Unicode-3.0
MODCARGO_CRATES +=	powerfmt	0.2.0	# MIT OR Apache-2.0
MODCARGO_CRATES +=	ppv-lite86	0.2.21	# MIT OR Apache-2.0
MODCARGO_CRATES +=	primeorder	0.13.6	# Apache-2.0 OR MIT
MODCARGO_CRATES +=	proc-macro2	1.0.101	# MIT OR Apache-2.0
MODCARGO_CRATES +=	prodash	30.0.1	# MIT
MODCARGO_CRATES +=	quick-xml	0.38.3	# MIT
MODCARGO_CRATES +=	quote	1.0.40	# MIT OR Apache-2.0
MODCARGO_CRATES +=	r-efi	5.3.0	# MIT OR Apache-2.0 OR LGPL-2.1-or-later
MODCARGO_CRATES +=	rand	0.9.2	# MIT OR Apache-2.0
MODCARGO_CRATES +=	rand_chacha	0.9.0	# MIT OR Apache-2.0
MODCARGO_CRATES +=	rand_core	0.6.4	# MIT OR Apache-2.0
MODCARGO_CRATES +=	rand_core	0.9.3	# MIT OR Apache-2.0
MODCARGO_CRATES +=	rand_xoshiro	0.6.0	# MIT OR Apache-2.0
MODCARGO_CRATES +=	redox_syscall	0.5.17	# MIT
MODCARGO_CRATES +=	regex	1.11.2	# MIT OR Apache-2.0
MODCARGO_CRATES +=	regex-automata	0.4.10	# MIT OR Apache-2.0
MODCARGO_CRATES +=	regex-syntax	0.8.6	# MIT OR Apache-2.0
MODCARGO_CRATES +=	rfc6979	0.4.0	# Apache-2.0 OR MIT
MODCARGO_CRATES +=	rusqlite	0.36.0	# MIT
MODCARGO_CRATES +=	rustc-hash	2.1.1	# Apache-2.0 OR MIT
MODCARGO_CRATES +=	rustc-stable-hash	0.1.2	# Apache-2.0 OR MIT
MODCARGO_CRATES +=	rustfix	0.9.2	# MIT OR Apache-2.0
MODCARGO_CRATES +=	rustix	1.1.2	# Apache-2.0 WITH LLVM-exception OR Apache-2.0 OR MIT
MODCARGO_CRATES +=	ryu	1.0.20	# Apache-2.0 OR BSL-1.0
MODCARGO_CRATES +=	same-file	1.0.6	# Unlicense/MIT
MODCARGO_CRATES +=	schannel	0.1.28	# MIT
MODCARGO_CRATES +=	scopeguard	1.2.0	# MIT OR Apache-2.0
MODCARGO_CRATES +=	sec1	0.7.3	# Apache-2.0 OR MIT
MODCARGO_CRATES +=	security-framework	3.4.0	# MIT OR Apache-2.0
MODCARGO_CRATES +=	security-framework-sys	2.15.0	# MIT OR Apache-2.0
MODCARGO_CRATES +=	semver	1.0.27	# MIT OR Apache-2.0
MODCARGO_CRATES +=	serde	1.0.226	# MIT OR Apache-2.0
MODCARGO_CRATES +=	serde-untagged	0.1.9	# MIT OR Apache-2.0
MODCARGO_CRATES +=	serde-value	0.7.0	# MIT
MODCARGO_CRATES +=	serde_core	1.0.226	# MIT OR Apache-2.0
MODCARGO_CRATES +=	serde_derive	1.0.226	# MIT OR Apache-2.0
MODCARGO_CRATES +=	serde_ignored	0.1.14	# MIT OR Apache-2.0
MODCARGO_CRATES +=	serde_json	1.0.145	# MIT OR Apache-2.0
MODCARGO_CRATES +=	serde_spanned	0.6.9	# MIT OR Apache-2.0
MODCARGO_CRATES +=	serde_spanned	1.0.2	# MIT OR Apache-2.0
MODCARGO_CRATES +=	sha1	0.10.6	# MIT OR Apache-2.0
MODCARGO_CRATES +=	sha1-checked	0.10.0	# MIT OR Apache-2.0
MODCARGO_CRATES +=	sha2	0.10.9	# MIT OR Apache-2.0
MODCARGO_CRATES +=	sharded-slab	0.1.7	# MIT
MODCARGO_CRATES +=	shell-escape	0.1.5	# MIT/Apache-2.0
MODCARGO_CRATES +=	shell-words	1.1.0	# MIT/Apache-2.0
MODCARGO_CRATES +=	shlex	1.3.0	# MIT OR Apache-2.0
MODCARGO_CRATES +=	signature	2.2.0	# Apache-2.0 OR MIT
MODCARGO_CRATES +=	sized-chunks	0.6.5	# MPL-2.0+
MODCARGO_CRATES +=	smallvec	1.15.1	# MIT OR Apache-2.0
MODCARGO_CRATES +=	socket2	0.6.0	# MIT OR Apache-2.0
MODCARGO_CRATES +=	spki	0.7.3	# Apache-2.0 OR MIT
MODCARGO_CRATES +=	stable_deref_trait	1.2.0	# MIT/Apache-2.0
MODCARGO_CRATES +=	static_assertions	1.1.0	# MIT OR Apache-2.0
MODCARGO_CRATES +=	strsim	0.11.1	# MIT
MODCARGO_CRATES +=	subtle	2.6.1	# BSD-3-Clause
MODCARGO_CRATES +=	supports-hyperlinks	3.1.0	# Apache-2.0
MODCARGO_CRATES +=	supports-unicode	3.0.0	# Apache-2.0
MODCARGO_CRATES +=	syn	2.0.106	# MIT OR Apache-2.0
MODCARGO_CRATES +=	synstructure	0.13.2	# MIT
MODCARGO_CRATES +=	tar	0.4.44	# MIT OR Apache-2.0
MODCARGO_CRATES +=	tempfile	3.22.0	# MIT OR Apache-2.0
MODCARGO_CRATES +=	terminal_size	0.4.3	# MIT OR Apache-2.0
MODCARGO_CRATES +=	thiserror	2.0.16	# MIT OR Apache-2.0
MODCARGO_CRATES +=	thiserror-impl	2.0.16	# MIT OR Apache-2.0
MODCARGO_CRATES +=	thread_local	1.1.9	# MIT OR Apache-2.0
MODCARGO_CRATES +=	time	0.3.44	# MIT OR Apache-2.0
MODCARGO_CRATES +=	time-core	0.1.6	# MIT OR Apache-2.0
MODCARGO_CRATES +=	time-macros	0.2.24	# MIT OR Apache-2.0
MODCARGO_CRATES +=	tinystr	0.8.1	# Unicode-3.0
MODCARGO_CRATES +=	tinyvec	1.10.0	# Zlib OR Apache-2.0 OR MIT
MODCARGO_CRATES +=	tinyvec_macros	0.1.1	# MIT OR Apache-2.0 OR Zlib
MODCARGO_CRATES +=	toml	0.8.23	# MIT OR Apache-2.0
MODCARGO_CRATES +=	toml	0.9.7	# MIT OR Apache-2.0
MODCARGO_CRATES +=	toml_datetime	0.6.11	# MIT OR Apache-2.0
MODCARGO_CRATES +=	toml_datetime	0.7.2	# MIT OR Apache-2.0
MODCARGO_CRATES +=	toml_edit	0.22.27	# MIT OR Apache-2.0
MODCARGO_CRATES +=	toml_edit	0.23.6	# MIT OR Apache-2.0
MODCARGO_CRATES +=	toml_parser	1.0.3	# MIT OR Apache-2.0
MODCARGO_CRATES +=	toml_write	0.1.2	# MIT OR Apache-2.0
MODCARGO_CRATES +=	toml_writer	1.0.3	# MIT OR Apache-2.0
MODCARGO_CRATES +=	tracing	0.1.41	# MIT
MODCARGO_CRATES +=	tracing-attributes	0.1.30	# MIT
MODCARGO_CRATES +=	tracing-chrome	0.7.2	# MIT
MODCARGO_CRATES +=	tracing-core	0.1.34	# MIT
MODCARGO_CRATES +=	tracing-log	0.2.0	# MIT
MODCARGO_CRATES +=	tracing-subscriber	0.3.20	# MIT
MODCARGO_CRATES +=	typeid	1.0.3	# MIT OR Apache-2.0
MODCARGO_CRATES +=	typenum	1.18.0	# MIT OR Apache-2.0
MODCARGO_CRATES +=	unicase	2.8.1	# MIT OR Apache-2.0
MODCARGO_CRATES +=	unicode-bom	2.0.3	# Apache-2.0
MODCARGO_CRATES +=	unicode-ident	1.0.19	# (MIT OR Apache-2.0) AND Unicode-3.0
MODCARGO_CRATES +=	unicode-normalization	0.1.24	# MIT/Apache-2.0
MODCARGO_CRATES +=	unicode-width	0.2.1	# MIT OR Apache-2.0
MODCARGO_CRATES +=	unicode-xid	0.2.6	# MIT OR Apache-2.0
MODCARGO_CRATES +=	url	2.5.7	# MIT OR Apache-2.0
MODCARGO_CRATES +=	utf8_iter	1.0.4	# Apache-2.0 OR MIT
MODCARGO_CRATES +=	utf8parse	0.2.2	# Apache-2.0 OR MIT
MODCARGO_CRATES +=	valuable	0.1.1	# MIT
MODCARGO_CRATES +=	vcpkg	0.2.15	# MIT/Apache-2.0
MODCARGO_CRATES +=	version_check	0.9.5	# MIT/Apache-2.0
MODCARGO_CRATES +=	walkdir	2.5.0	# Unlicense/MIT
MODCARGO_CRATES +=	wasi	0.11.1+wasi-snapshot-preview1	# Apache-2.0 WITH LLVM-exception OR Apache-2.0 OR MIT
MODCARGO_CRATES +=	wasi	0.14.7+wasi-0.2.4	# Apache-2.0 WITH LLVM-exception OR Apache-2.0 OR MIT
MODCARGO_CRATES +=	wasip2	1.0.1+wasi-0.2.4	# Apache-2.0 WITH LLVM-exception OR Apache-2.0 OR MIT
MODCARGO_CRATES +=	wasm-bindgen	0.2.103	# MIT OR Apache-2.0
MODCARGO_CRATES +=	wasm-bindgen-backend	0.2.103	# MIT OR Apache-2.0
MODCARGO_CRATES +=	wasm-bindgen-macro	0.2.103	# MIT OR Apache-2.0
MODCARGO_CRATES +=	wasm-bindgen-macro-support	0.2.103	# MIT OR Apache-2.0
MODCARGO_CRATES +=	wasm-bindgen-shared	0.2.103	# MIT OR Apache-2.0
MODCARGO_CRATES +=	winapi-util	0.1.11	# Unlicense OR MIT
MODCARGO_CRATES +=	windows-link	0.1.3	# MIT OR Apache-2.0
MODCARGO_CRATES +=	windows-link	0.2.0	# MIT OR Apache-2.0
MODCARGO_CRATES +=	windows-sys	0.52.0	# MIT OR Apache-2.0
MODCARGO_CRATES +=	windows-sys	0.59.0	# MIT OR Apache-2.0
MODCARGO_CRATES +=	windows-sys	0.60.2	# MIT OR Apache-2.0
MODCARGO_CRATES +=	windows-sys	0.61.0	# MIT OR Apache-2.0
MODCARGO_CRATES +=	windows-targets	0.52.6	# MIT OR Apache-2.0
MODCARGO_CRATES +=	windows-targets	0.53.3	# MIT OR Apache-2.0
MODCARGO_CRATES +=	windows_aarch64_gnullvm	0.52.6	# MIT OR Apache-2.0
MODCARGO_CRATES +=	windows_aarch64_gnullvm	0.53.0	# MIT OR Apache-2.0
MODCARGO_CRATES +=	windows_aarch64_msvc	0.52.6	# MIT OR Apache-2.0
MODCARGO_CRATES +=	windows_aarch64_msvc	0.53.0	# MIT OR Apache-2.0
MODCARGO_CRATES +=	windows_i686_gnu	0.52.6	# MIT OR Apache-2.0
MODCARGO_CRATES +=	windows_i686_gnu	0.53.0	# MIT OR Apache-2.0
MODCARGO_CRATES +=	windows_i686_gnullvm	0.52.6	# MIT OR Apache-2.0
MODCARGO_CRATES +=	windows_i686_gnullvm	0.53.0	# MIT OR Apache-2.0
MODCARGO_CRATES +=	windows_i686_msvc	0.52.6	# MIT OR Apache-2.0
MODCARGO_CRATES +=	windows_i686_msvc	0.53.0	# MIT OR Apache-2.0
MODCARGO_CRATES +=	windows_x86_64_gnu	0.52.6	# MIT OR Apache-2.0
MODCARGO_CRATES +=	windows_x86_64_gnu	0.53.0	# MIT OR Apache-2.0
MODCARGO_CRATES +=	windows_x86_64_gnullvm	0.52.6	# MIT OR Apache-2.0
MODCARGO_CRATES +=	windows_x86_64_gnullvm	0.53.0	# MIT OR Apache-2.0
MODCARGO_CRATES +=	windows_x86_64_msvc	0.52.6	# MIT OR Apache-2.0
MODCARGO_CRATES +=	windows_x86_64_msvc	0.53.0	# MIT OR Apache-2.0
MODCARGO_CRATES +=	winnow	0.7.13	# MIT
MODCARGO_CRATES +=	wit-bindgen	0.46.0	# Apache-2.0 WITH LLVM-exception OR Apache-2.0 OR MIT
MODCARGO_CRATES +=	writeable	0.6.1	# Unicode-3.0
MODCARGO_CRATES +=	yoke	0.8.0	# Unicode-3.0
MODCARGO_CRATES +=	yoke-derive	0.8.0	# Unicode-3.0
MODCARGO_CRATES +=	zerocopy	0.8.27	# BSD-2-Clause OR Apache-2.0 OR MIT
MODCARGO_CRATES +=	zerocopy-derive	0.8.27	# BSD-2-Clause OR Apache-2.0 OR MIT
MODCARGO_CRATES +=	zerofrom	0.1.6	# Unicode-3.0
MODCARGO_CRATES +=	zerofrom-derive	0.1.6	# Unicode-3.0
MODCARGO_CRATES +=	zeroize	1.8.1	# Apache-2.0 OR MIT
MODCARGO_CRATES +=	zerotrie	0.2.2	# Unicode-3.0
MODCARGO_CRATES +=	zerovec	0.11.4	# Unicode-3.0
MODCARGO_CRATES +=	zerovec-derive	0.11.1	# Unicode-3.0
MODCARGO_CRATES +=	zlib-rs	0.5.2	# Zlib
