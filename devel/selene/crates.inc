MODCARGO_CRATES +=	addr2line	0.19.0	# Apache-2.0 OR MIT
MODCARGO_CRATES +=	adler	1.0.2	# 0BSD OR MIT OR Apache-2.0
MODCARGO_CRATES +=	aho-corasick	0.7.20	# Unlicense OR MIT
MODCARGO_CRATES +=	android_system_properties	0.1.5	# MIT/Apache-2.0
MODCARGO_CRATES +=	ansi_term	0.12.1	# MIT
MODCARGO_CRATES +=	atty	0.2.14	# MIT
MODCARGO_CRATES +=	autocfg	1.1.0	# Apache-2.0 OR MIT
MODCARGO_CRATES +=	backtrace	0.3.67	# MIT OR Apache-2.0
MODCARGO_CRATES +=	base64	0.21.7	# MIT OR Apache-2.0
MODCARGO_CRATES +=	beef	0.5.2	# MIT OR Apache-2.0
MODCARGO_CRATES +=	bitflags	1.3.2	# MIT/Apache-2.0
MODCARGO_CRATES +=	bstr	1.1.0	# MIT OR Apache-2.0
MODCARGO_CRATES +=	bumpalo	3.12.0	# MIT/Apache-2.0
MODCARGO_CRATES +=	bytecount	0.6.3	# Apache-2.0/MIT
MODCARGO_CRATES +=	cc	1.0.78	# MIT OR Apache-2.0
MODCARGO_CRATES +=	cfg-if	1.0.0	# MIT/Apache-2.0
MODCARGO_CRATES +=	chrono	0.4.23	# MIT/Apache-2.0
MODCARGO_CRATES +=	clap	2.34.0	# MIT
MODCARGO_CRATES +=	codespan	0.11.1	# Apache-2.0
MODCARGO_CRATES +=	codespan-reporting	0.11.1	# Apache-2.0
MODCARGO_CRATES +=	color-eyre	0.6.2	# MIT OR Apache-2.0
MODCARGO_CRATES +=	color-spantrace	0.2.0	# MIT OR Apache-2.0
MODCARGO_CRATES +=	convert_case	0.4.0	# MIT
MODCARGO_CRATES +=	core-foundation-sys	0.8.3	# MIT / Apache-2.0
MODCARGO_CRATES +=	crc32fast	1.3.2	# MIT OR Apache-2.0
MODCARGO_CRATES +=	ctor	0.1.26	# Apache-2.0 OR MIT
MODCARGO_CRATES +=	cxx	1.0.86	# MIT OR Apache-2.0
MODCARGO_CRATES +=	cxx-build	1.0.86	# MIT OR Apache-2.0
MODCARGO_CRATES +=	cxxbridge-flags	1.0.86	# MIT OR Apache-2.0
MODCARGO_CRATES +=	cxxbridge-macro	1.0.86	# MIT OR Apache-2.0
MODCARGO_CRATES +=	derive_more	0.99.17	# MIT
MODCARGO_CRATES +=	diff	0.1.13	# MIT OR Apache-2.0
MODCARGO_CRATES +=	dirs	4.0.0	# MIT OR Apache-2.0
MODCARGO_CRATES +=	dirs-sys	0.3.7	# MIT OR Apache-2.0
MODCARGO_CRATES +=	eyre	0.6.8	# MIT OR Apache-2.0
MODCARGO_CRATES +=	flate2	1.0.25	# MIT OR Apache-2.0
MODCARGO_CRATES +=	fnv	1.0.7	# Apache-2.0 / MIT
MODCARGO_CRATES +=	form_urlencoded	1.1.0	# MIT OR Apache-2.0
MODCARGO_CRATES +=	full_moon	0.19.0	# MPL-2.0
MODCARGO_CRATES +=	full_moon_derive	0.11.0	# MPL-2.0
MODCARGO_CRATES +=	generator	0.7.2	# MIT/Apache-2.0
MODCARGO_CRATES +=	getrandom	0.2.8	# MIT OR Apache-2.0
MODCARGO_CRATES +=	gimli	0.27.0	# MIT OR Apache-2.0
MODCARGO_CRATES +=	glob	0.3.1	# MIT OR Apache-2.0
MODCARGO_CRATES +=	globset	0.4.10	# Unlicense OR MIT
MODCARGO_CRATES +=	hashbrown	0.12.3	# MIT OR Apache-2.0
MODCARGO_CRATES +=	heck	0.3.3	# MIT OR Apache-2.0
MODCARGO_CRATES +=	hermit-abi	0.1.19	# MIT/Apache-2.0
MODCARGO_CRATES +=	hermit-abi	0.2.6	# MIT/Apache-2.0
MODCARGO_CRATES +=	iana-time-zone	0.1.53	# MIT OR Apache-2.0
MODCARGO_CRATES +=	iana-time-zone-haiku	0.1.1	# MIT OR Apache-2.0
MODCARGO_CRATES +=	id-arena	2.2.1	# MIT/Apache-2.0
MODCARGO_CRATES +=	idna	0.3.0	# MIT OR Apache-2.0
MODCARGO_CRATES +=	if_chain	1.0.2	# MIT/Apache-2.0
MODCARGO_CRATES +=	indenter	0.3.3	# MIT OR Apache-2.0
MODCARGO_CRATES +=	indexmap	1.9.2	# Apache-2.0 OR MIT
MODCARGO_CRATES +=	itoa	1.0.5	# MIT OR Apache-2.0
MODCARGO_CRATES +=	js-sys	0.3.60	# MIT/Apache-2.0
MODCARGO_CRATES +=	lazy_static	1.4.0	# MIT/Apache-2.0
MODCARGO_CRATES +=	libc	0.2.139	# MIT OR Apache-2.0
MODCARGO_CRATES +=	link-cplusplus	1.0.8	# MIT OR Apache-2.0
MODCARGO_CRATES +=	log	0.4.17	# MIT OR Apache-2.0
MODCARGO_CRATES +=	logos	0.12.1	# MIT OR Apache-2.0
MODCARGO_CRATES +=	logos-derive	0.12.1	# MIT OR Apache-2.0
MODCARGO_CRATES +=	loom	0.5.6	# MIT
MODCARGO_CRATES +=	matchers	0.1.0	# MIT
MODCARGO_CRATES +=	memchr	2.5.0	# Unlicense/MIT
MODCARGO_CRATES +=	miniz_oxide	0.6.2	# MIT OR Zlib OR Apache-2.0
MODCARGO_CRATES +=	nom8	0.2.0	# MIT
MODCARGO_CRATES +=	nu-ansi-term	0.46.0	# MIT
MODCARGO_CRATES +=	num-integer	0.1.45	# MIT OR Apache-2.0
MODCARGO_CRATES +=	num-traits	0.2.15	# MIT OR Apache-2.0
MODCARGO_CRATES +=	num_cpus	1.15.0	# MIT OR Apache-2.0
MODCARGO_CRATES +=	object	0.30.2	# Apache-2.0 OR MIT
MODCARGO_CRATES +=	once_cell	1.17.0	# MIT OR Apache-2.0
MODCARGO_CRATES +=	output_vt100	0.1.3	# MIT
MODCARGO_CRATES +=	overload	0.1.1	# MIT
MODCARGO_CRATES +=	owo-colors	3.5.0	# MIT
MODCARGO_CRATES +=	paste	1.0.11	# MIT OR Apache-2.0
MODCARGO_CRATES +=	percent-encoding	2.2.0	# MIT OR Apache-2.0
MODCARGO_CRATES +=	pin-project-lite	0.2.9	# Apache-2.0 OR MIT
MODCARGO_CRATES +=	pretty_assertions	1.3.0	# MIT OR Apache-2.0
MODCARGO_CRATES +=	proc-macro-error	1.0.4	# MIT OR Apache-2.0
MODCARGO_CRATES +=	proc-macro-error-attr	1.0.4	# MIT OR Apache-2.0
MODCARGO_CRATES +=	proc-macro2	1.0.66	# MIT OR Apache-2.0
MODCARGO_CRATES +=	profiling	1.0.7	# MIT OR Apache-2.0
MODCARGO_CRATES +=	profiling-procmacros	1.0.7	# MIT OR Apache-2.0
MODCARGO_CRATES +=	quote	1.0.23	# MIT OR Apache-2.0
MODCARGO_CRATES +=	redox_syscall	0.2.16	# MIT
MODCARGO_CRATES +=	redox_users	0.4.3	# MIT
MODCARGO_CRATES +=	regex	1.7.1	# MIT OR Apache-2.0
MODCARGO_CRATES +=	regex-automata	0.1.10	# Unlicense/MIT
MODCARGO_CRATES +=	regex-syntax	0.6.28	# MIT OR Apache-2.0
MODCARGO_CRATES +=	ring	0.17.3	# LICENSE
MODCARGO_CRATES +=	rustc-demangle	0.1.21	# MIT/Apache-2.0
MODCARGO_CRATES +=	rustc_version	0.4.0	# MIT/Apache-2.0
MODCARGO_CRATES +=	rustls	0.21.10	# Apache-2.0 OR ISC OR MIT
MODCARGO_CRATES +=	rustls-webpki	0.101.7	# ISC
MODCARGO_CRATES +=	rustversion	1.0.11	# MIT OR Apache-2.0
MODCARGO_CRATES +=	ryu	1.0.12	# Apache-2.0 OR BSL-1.0
MODCARGO_CRATES +=	scoped-tls	1.0.1	# MIT/Apache-2.0
MODCARGO_CRATES +=	scratch	1.0.3	# MIT OR Apache-2.0
MODCARGO_CRATES +=	sct	0.7.1	# Apache-2.0 OR ISC OR MIT
MODCARGO_CRATES +=	semver	1.0.16	# MIT OR Apache-2.0
MODCARGO_CRATES +=	serde	1.0.152	# MIT OR Apache-2.0
MODCARGO_CRATES +=	serde_derive	1.0.152	# MIT OR Apache-2.0
MODCARGO_CRATES +=	serde_json	1.0.99	# MIT OR Apache-2.0
MODCARGO_CRATES +=	serde_spanned	0.6.1	# MIT OR Apache-2.0
MODCARGO_CRATES +=	serde_yaml	0.9.16	# MIT OR Apache-2.0
MODCARGO_CRATES +=	sharded-slab	0.1.4	# MIT
MODCARGO_CRATES +=	smallvec	1.10.0	# MIT OR Apache-2.0
MODCARGO_CRATES +=	smol_str	0.1.23	# MIT OR Apache-2.0
MODCARGO_CRATES +=	spin	0.9.8	# MIT
MODCARGO_CRATES +=	strsim	0.8.0	# MIT
MODCARGO_CRATES +=	structopt	0.3.26	# Apache-2.0 OR MIT
MODCARGO_CRATES +=	structopt-derive	0.4.18	# Apache-2.0/MIT
MODCARGO_CRATES +=	syn	1.0.107	# MIT OR Apache-2.0
MODCARGO_CRATES +=	termcolor	1.2.0	# Unlicense OR MIT
MODCARGO_CRATES +=	textwrap	0.11.0	# MIT
MODCARGO_CRATES +=	thiserror	1.0.38	# MIT OR Apache-2.0
MODCARGO_CRATES +=	thiserror-impl	1.0.38	# MIT OR Apache-2.0
MODCARGO_CRATES +=	thread_local	1.1.4	# Apache-2.0/MIT
MODCARGO_CRATES +=	threadpool	1.8.1	# MIT/Apache-2.0
MODCARGO_CRATES +=	time	0.1.45	# MIT/Apache-2.0
MODCARGO_CRATES +=	tinyvec	1.6.0	# Zlib OR Apache-2.0 OR MIT
MODCARGO_CRATES +=	tinyvec_macros	0.1.0	# MIT OR Apache-2.0 OR Zlib
MODCARGO_CRATES +=	toml	0.7.2	# MIT OR Apache-2.0
MODCARGO_CRATES +=	toml_datetime	0.6.1	# MIT OR Apache-2.0
MODCARGO_CRATES +=	toml_edit	0.19.3	# MIT OR Apache-2.0
MODCARGO_CRATES +=	tracing	0.1.37	# MIT
MODCARGO_CRATES +=	tracing-attributes	0.1.23	# MIT
MODCARGO_CRATES +=	tracing-core	0.1.30	# MIT
MODCARGO_CRATES +=	tracing-error	0.2.0	# MIT
MODCARGO_CRATES +=	tracing-log	0.1.3	# MIT
MODCARGO_CRATES +=	tracing-subscriber	0.3.16	# MIT
MODCARGO_CRATES +=	tracy-client	0.14.2	# MIT/Apache-2.0
MODCARGO_CRATES +=	tracy-client-sys	0.19.0	# (MIT OR Apache-2.0) AND BSD-3-Clause
MODCARGO_CRATES +=	unicode-bidi	0.3.8	# MIT OR Apache-2.0
MODCARGO_CRATES +=	unicode-ident	1.0.6	# (MIT OR Apache-2.0) AND Unicode-DFS-2016
MODCARGO_CRATES +=	unicode-normalization	0.1.22	# MIT/Apache-2.0
MODCARGO_CRATES +=	unicode-segmentation	1.10.0	# MIT/Apache-2.0
MODCARGO_CRATES +=	unicode-width	0.1.10	# MIT/Apache-2.0
MODCARGO_CRATES +=	unsafe-libyaml	0.2.5	# MIT
MODCARGO_CRATES +=	untrusted	0.9.0	# ISC
MODCARGO_CRATES +=	ureq	2.9.1	# MIT OR Apache-2.0
MODCARGO_CRATES +=	url	2.3.1	# MIT OR Apache-2.0
MODCARGO_CRATES +=	valuable	0.1.0	# MIT
MODCARGO_CRATES +=	vec_map	0.8.2	# MIT/Apache-2.0
MODCARGO_CRATES +=	version_check	0.9.4	# MIT/Apache-2.0
MODCARGO_CRATES +=	wasi	0.10.0+wasi-snapshot-preview1	# Apache-2.0 WITH LLVM-exception OR Apache-2.0 OR MIT
MODCARGO_CRATES +=	wasi	0.11.0+wasi-snapshot-preview1	# Apache-2.0 WITH LLVM-exception OR Apache-2.0 OR MIT
MODCARGO_CRATES +=	wasm-bindgen	0.2.83	# MIT/Apache-2.0
MODCARGO_CRATES +=	wasm-bindgen-backend	0.2.83	# MIT/Apache-2.0
MODCARGO_CRATES +=	wasm-bindgen-macro	0.2.83	# MIT/Apache-2.0
MODCARGO_CRATES +=	wasm-bindgen-macro-support	0.2.83	# MIT/Apache-2.0
MODCARGO_CRATES +=	wasm-bindgen-shared	0.2.83	# MIT/Apache-2.0
MODCARGO_CRATES +=	webpki-roots	0.25.3	# MPL-2.0
MODCARGO_CRATES +=	winapi	0.3.9	# MIT/Apache-2.0
MODCARGO_CRATES +=	winapi-i686-pc-windows-gnu	0.4.0	# MIT/Apache-2.0
MODCARGO_CRATES +=	winapi-util	0.1.5	# Unlicense/MIT
MODCARGO_CRATES +=	winapi-x86_64-pc-windows-gnu	0.4.0	# MIT/Apache-2.0
MODCARGO_CRATES +=	windows	0.39.0	# MIT OR Apache-2.0
MODCARGO_CRATES +=	windows-sys	0.48.0	# MIT OR Apache-2.0
MODCARGO_CRATES +=	windows-targets	0.48.5	# MIT OR Apache-2.0
MODCARGO_CRATES +=	windows_aarch64_gnullvm	0.48.5	# MIT OR Apache-2.0
MODCARGO_CRATES +=	windows_aarch64_msvc	0.39.0	# MIT OR Apache-2.0
MODCARGO_CRATES +=	windows_aarch64_msvc	0.48.5	# MIT OR Apache-2.0
MODCARGO_CRATES +=	windows_i686_gnu	0.39.0	# MIT OR Apache-2.0
MODCARGO_CRATES +=	windows_i686_gnu	0.48.5	# MIT OR Apache-2.0
MODCARGO_CRATES +=	windows_i686_msvc	0.39.0	# MIT OR Apache-2.0
MODCARGO_CRATES +=	windows_i686_msvc	0.48.5	# MIT OR Apache-2.0
MODCARGO_CRATES +=	windows_x86_64_gnu	0.39.0	# MIT OR Apache-2.0
MODCARGO_CRATES +=	windows_x86_64_gnu	0.48.5	# MIT OR Apache-2.0
MODCARGO_CRATES +=	windows_x86_64_gnullvm	0.48.5	# MIT OR Apache-2.0
MODCARGO_CRATES +=	windows_x86_64_msvc	0.39.0	# MIT OR Apache-2.0
MODCARGO_CRATES +=	windows_x86_64_msvc	0.48.5	# MIT OR Apache-2.0
MODCARGO_CRATES +=	yansi	0.5.1	# MIT/Apache-2.0
