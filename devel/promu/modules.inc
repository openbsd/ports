MODGO_MODULES =	\
	cloud.google.com/go/compute/metadata			 v0.2.0 \
	github.com/!masterminds/semver				 v1.5.0 \
	github.com/alecthomas/kingpin/v2			 v2.3.2 \
	github.com/alecthomas/units				 v0.0.0-20211218093645-b94a6e3cc137 \
	github.com/beorn7/perks					 v1.0.1 \
	github.com/cespare/xxhash/v2				 v2.2.0 \
	github.com/creack/pty					 v1.1.9 \
	github.com/davecgh/go-spew				 v1.1.1 \
	github.com/go-kit/log					 v0.2.1 \
	github.com/go-logfmt/logfmt				 v0.5.1 \
	github.com/golang/protobuf				 v1.5.3 \
	github.com/google/go-cmp				 v0.5.9 \
	github.com/google/go-github/v25				 v25.1.3 \
	github.com/google/go-querystring			 v1.0.0 \
	github.com/jpillora/backoff				 v1.0.0 \
	github.com/json-iterator/go				 v1.1.12 \
	github.com/julienschmidt/httprouter			 v1.3.0 \
	github.com/kr/pretty					 v0.3.1 \
	github.com/kr/text					 v0.2.0 \
	github.com/matttproud/golang_protobuf_extensions	 v1.0.4 \
	github.com/modern-go/concurrent				 v0.0.0-20180306012644-bacd9c7ef1dd \
	github.com/modern-go/reflect2				 v1.0.2 \
	github.com/mwitkow/go-conntrack				 v0.0.0-20190716064945-2f068394615f \
	github.com/pkg/errors					 v0.9.1 \
	github.com/pmezard/go-difflib				 v1.0.0 \
	github.com/prometheus/client_golang			 v1.15.1 \
	github.com/prometheus/client_model			 v0.4.0 \
	github.com/prometheus/common				 v0.44.0 \
	github.com/prometheus/procfs				 v0.9.0 \
	github.com/rogpeppe/go-internal				 v1.10.0 \
	github.com/stretchr/objx				 v0.1.0 \
	github.com/stretchr/testify				 v1.8.2 \
	github.com/xhit/go-str2duration/v2			 v2.1.0 \
	go.uber.org/atomic					 v1.11.0 \
	golang.org/x/crypto					 v0.10.0 \
	golang.org/x/net					 v0.11.0 \
	golang.org/x/oauth2					 v0.9.0 \
	golang.org/x/sync					 v0.1.0 \
	golang.org/x/sys					 v0.9.0 \
	golang.org/x/term					 v0.9.0 \
	golang.org/x/text					 v0.10.0 \
	golang.org/x/tools					 v0.0.0-20180917221912-90fa682c2a6e \
	golang.org/x/xerrors					 v0.0.0-20191204190536-9bdfabe68543 \
	google.golang.org/appengine				 v1.6.7 \
	google.golang.org/protobuf				 v1.30.0 \
	gopkg.in/check.v1					 v1.0.0-20201130134442-10cb98267c6c \
	gopkg.in/yaml.v2					 v2.4.0 \
	gopkg.in/yaml.v3					 v3.0.1

MODGO_MODFILES =	\
	github.com/davecgh/go-spew		 v1.1.0 \
	github.com/golang/protobuf		 v1.2.0 \
	github.com/golang/protobuf		 v1.3.1 \
	github.com/golang/protobuf		 v1.5.0 \
	github.com/golang/protobuf		 v1.5.2 \
	github.com/google/go-cmp		 v0.5.5 \
	github.com/google/go-cmp		 v0.5.8 \
	github.com/prometheus/client_model	 v0.3.0 \
	github.com/prometheus/common		 v0.42.0 \
	github.com/stretchr/testify		 v1.3.0 \
	github.com/stretchr/testify		 v1.4.0 \
	golang.org/x/crypto			 v0.0.0-20190308221718-c2843e01d9a2 \
	golang.org/x/net			 v0.0.0-20190311183353-d8887717615a \
	golang.org/x/net			 v0.0.0-20190603091049-60506f45cf65 \
	golang.org/x/net			 v0.10.0 \
	golang.org/x/net			 v0.7.0 \
	golang.org/x/oauth2			 v0.0.0-20180821212333-d2e6202438be \
	golang.org/x/oauth2			 v0.5.0 \
	golang.org/x/oauth2			 v0.8.0 \
	golang.org/x/sync			 v0.0.0-20181221193216-37e7f081c4d4 \
	golang.org/x/sync			 v0.0.0-20190227155943-e225da77a7e6 \
	golang.org/x/sys			 v0.0.0-20190215142949-d0b11bdaac8a \
	golang.org/x/sys			 v0.3.0 \
	golang.org/x/sys			 v0.6.0 \
	golang.org/x/sys			 v0.8.0 \
	golang.org/x/text			 v0.3.0 \
	golang.org/x/text			 v0.3.2 \
	golang.org/x/text			 v0.7.0 \
	golang.org/x/text			 v0.9.0 \
	google.golang.org/appengine		 v1.1.0 \
	google.golang.org/protobuf		 v1.26.0 \
	google.golang.org/protobuf		 v1.26.0-rc.1 \
	google.golang.org/protobuf		 v1.28.0 \
	gopkg.in/check.v1			 v0.0.0-20161208181325-20d25e280405 \
	gopkg.in/yaml.v2			 v2.2.2

