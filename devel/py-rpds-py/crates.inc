MODCARGO_CRATES +=	archery	1.2.2	# MIT
MODCARGO_CRATES +=	autocfg	1.5.0	# Apache-2.0 OR MIT
MODCARGO_CRATES +=	cc	1.2.48	# MIT OR Apache-2.0
MODCARGO_CRATES +=	find-msvc-tools	0.1.5	# MIT OR Apache-2.0
MODCARGO_CRATES +=	heck	0.5.0	# MIT OR Apache-2.0
MODCARGO_CRATES +=	indoc	2.0.7	# MIT OR Apache-2.0
MODCARGO_CRATES +=	libc	0.2.177	# MIT OR Apache-2.0
MODCARGO_CRATES +=	memoffset	0.9.1	# MIT
MODCARGO_CRATES +=	once_cell	1.21.3	# MIT OR Apache-2.0
MODCARGO_CRATES +=	portable-atomic	1.11.1	# Apache-2.0 OR MIT
MODCARGO_CRATES +=	proc-macro2	1.0.103	# MIT OR Apache-2.0
MODCARGO_CRATES +=	pyo3	0.27.2	# MIT OR Apache-2.0
MODCARGO_CRATES +=	pyo3-build-config	0.27.2	# MIT OR Apache-2.0
MODCARGO_CRATES +=	pyo3-ffi	0.27.2	# MIT OR Apache-2.0
MODCARGO_CRATES +=	pyo3-macros	0.27.2	# MIT OR Apache-2.0
MODCARGO_CRATES +=	pyo3-macros-backend	0.27.2	# MIT OR Apache-2.0
MODCARGO_CRATES +=	python3-dll-a	0.2.14	# MIT
MODCARGO_CRATES +=	quote	1.0.42	# MIT OR Apache-2.0
MODCARGO_CRATES +=	rpds	1.2.0	# MIT
MODCARGO_CRATES +=	rustversion	1.0.22	# MIT OR Apache-2.0
MODCARGO_CRATES +=	shlex	1.3.0	# MIT OR Apache-2.0
MODCARGO_CRATES +=	syn	2.0.111	# MIT OR Apache-2.0
MODCARGO_CRATES +=	target-lexicon	0.13.3	# Apache-2.0 WITH LLVM-exception
MODCARGO_CRATES +=	triomphe	0.1.15	# MIT OR Apache-2.0
MODCARGO_CRATES +=	unicode-ident	1.0.22	# (MIT OR Apache-2.0) AND Unicode-3.0
MODCARGO_CRATES +=	unindent	0.2.4	# MIT OR Apache-2.0
