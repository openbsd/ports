MODCARGO_CRATES +=	adler	1.0.2	# 0BSD OR MIT OR Apache-2.0
MODCARGO_CRATES +=	ahash	0.8.11	# MIT OR Apache-2.0
MODCARGO_CRATES +=	aho-corasick	1.1.3	# Unlicense OR MIT
MODCARGO_CRATES +=	allocator-api2	0.2.18	# MIT OR Apache-2.0
MODCARGO_CRATES +=	anstream	0.6.14	# MIT OR Apache-2.0
MODCARGO_CRATES +=	anstyle	1.0.7	# MIT OR Apache-2.0
MODCARGO_CRATES +=	anstyle-parse	0.2.4	# MIT OR Apache-2.0
MODCARGO_CRATES +=	anstyle-query	1.1.0	# MIT OR Apache-2.0
MODCARGO_CRATES +=	anstyle-wincon	3.0.3	# MIT OR Apache-2.0
MODCARGO_CRATES +=	anyhow	1.0.86	# MIT OR Apache-2.0
MODCARGO_CRATES +=	arbitrary	1.3.2	# MIT OR Apache-2.0
MODCARGO_CRATES +=	autocfg	1.3.0	# Apache-2.0 OR MIT
MODCARGO_CRATES +=	automod	1.0.14	# MIT OR Apache-2.0
MODCARGO_CRATES +=	base64	0.13.1	# MIT/Apache-2.0
MODCARGO_CRATES +=	base64	0.21.7	# MIT OR Apache-2.0
MODCARGO_CRATES +=	base64	0.22.1	# MIT OR Apache-2.0
MODCARGO_CRATES +=	bitflags	1.3.2	# MIT/Apache-2.0
MODCARGO_CRATES +=	bitflags	2.5.0	# MIT OR Apache-2.0
MODCARGO_CRATES +=	block-buffer	0.10.4	# MIT OR Apache-2.0
MODCARGO_CRATES +=	bstr	1.9.1	# MIT OR Apache-2.0
MODCARGO_CRATES +=	byteorder	1.5.0	# Unlicense OR MIT
MODCARGO_CRATES +=	bytes	1.6.0	# MIT
MODCARGO_CRATES +=	bytesize	1.3.0	# Apache-2.0
MODCARGO_CRATES +=	bzip2	0.4.4	# MIT/Apache-2.0
MODCARGO_CRATES +=	bzip2-sys	0.1.11+1.0.8	# MIT/Apache-2.0
MODCARGO_CRATES +=	cab	0.5.0	# MIT
MODCARGO_CRATES +=	camino	1.1.7	# MIT OR Apache-2.0
MODCARGO_CRATES +=	cargo-config2	0.1.26	# Apache-2.0 OR MIT
MODCARGO_CRATES +=	cargo-options	0.7.4	# MIT
MODCARGO_CRATES +=	cargo-platform	0.1.8	# MIT OR Apache-2.0
MODCARGO_CRATES +=	cargo-xwin	0.16.5	# MIT
MODCARGO_CRATES +=	cargo-zigbuild	0.18.4	# MIT
MODCARGO_CRATES +=	cargo_metadata	0.18.1	# MIT
MODCARGO_CRATES +=	cbindgen	0.26.0	# MPL-2.0
MODCARGO_CRATES +=	cc	1.0.104	# MIT OR Apache-2.0
MODCARGO_CRATES +=	cfb	0.9.0	# MIT
MODCARGO_CRATES +=	cfg-if	1.0.0	# MIT/Apache-2.0
MODCARGO_CRATES +=	charset	0.1.3	# MIT/Apache-2.0
MODCARGO_CRATES +=	chumsky	0.9.3	# MIT
MODCARGO_CRATES +=	clap	4.5.7	# MIT OR Apache-2.0
MODCARGO_CRATES +=	clap_builder	4.5.7	# MIT OR Apache-2.0
MODCARGO_CRATES +=	clap_complete	4.5.5	# MIT OR Apache-2.0
MODCARGO_CRATES +=	clap_complete_command	0.5.1	# MIT
MODCARGO_CRATES +=	clap_complete_nushell	0.1.11	# MIT OR Apache-2.0
MODCARGO_CRATES +=	clap_derive	4.5.5	# MIT OR Apache-2.0
MODCARGO_CRATES +=	clap_lex	0.7.1	# MIT OR Apache-2.0
MODCARGO_CRATES +=	cli-table	0.4.7	# MIT/Apache-2.0
MODCARGO_CRATES +=	colorchoice	1.0.1	# MIT OR Apache-2.0
MODCARGO_CRATES +=	configparser	3.1.0	# MIT OR LGPL-3.0-or-later
MODCARGO_CRATES +=	console	0.15.8	# MIT
MODCARGO_CRATES +=	content_inspector	0.2.4	# MIT/Apache-2.0
MODCARGO_CRATES +=	core-foundation	0.9.4	# MIT OR Apache-2.0
MODCARGO_CRATES +=	core-foundation-sys	0.8.6	# MIT OR Apache-2.0
MODCARGO_CRATES +=	cpufeatures	0.2.12	# MIT OR Apache-2.0
MODCARGO_CRATES +=	crc32fast	1.4.2	# MIT OR Apache-2.0
MODCARGO_CRATES +=	crossbeam-channel	0.5.13	# MIT OR Apache-2.0
MODCARGO_CRATES +=	crossbeam-deque	0.8.5	# MIT OR Apache-2.0
MODCARGO_CRATES +=	crossbeam-epoch	0.9.18	# MIT OR Apache-2.0
MODCARGO_CRATES +=	crossbeam-utils	0.8.20	# MIT OR Apache-2.0
MODCARGO_CRATES +=	crypto-common	0.1.6	# MIT OR Apache-2.0
MODCARGO_CRATES +=	data-encoding	2.6.0	# MIT
MODCARGO_CRATES +=	deranged	0.3.11	# MIT OR Apache-2.0
MODCARGO_CRATES +=	derivative	2.2.0	# MIT/Apache-2.0
MODCARGO_CRATES +=	derive_arbitrary	1.3.2	# MIT/Apache-2.0
MODCARGO_CRATES +=	dialoguer	0.11.0	# MIT
MODCARGO_CRATES +=	diff	0.1.13	# MIT OR Apache-2.0
MODCARGO_CRATES +=	digest	0.10.7	# MIT OR Apache-2.0
MODCARGO_CRATES +=	dirs	5.0.1	# MIT OR Apache-2.0
MODCARGO_CRATES +=	dirs-sys	0.4.1	# MIT OR Apache-2.0
MODCARGO_CRATES +=	displaydoc	0.2.4	# MIT OR Apache-2.0
MODCARGO_CRATES +=	dissimilar	1.0.9	# Apache-2.0
MODCARGO_CRATES +=	dunce	1.0.4	# CC0-1.0 OR MIT-0 OR Apache-2.0
MODCARGO_CRATES +=	dyn-clone	1.0.17	# MIT OR Apache-2.0
MODCARGO_CRATES +=	either	1.12.0	# MIT OR Apache-2.0
MODCARGO_CRATES +=	encode_unicode	0.3.6	# MIT/Apache-2.0
MODCARGO_CRATES +=	encoding_rs	0.8.34	# (Apache-2.0 OR MIT) AND BSD-3-Clause
MODCARGO_CRATES +=	equivalent	1.0.1	# Apache-2.0 OR MIT
MODCARGO_CRATES +=	errno	0.3.9	# MIT OR Apache-2.0
MODCARGO_CRATES +=	expect-test	1.5.0	# MIT OR Apache-2.0
MODCARGO_CRATES +=	fastrand	2.1.0	# Apache-2.0 OR MIT
MODCARGO_CRATES +=	fat-macho	0.4.8	# MIT
MODCARGO_CRATES +=	filetime	0.2.23	# MIT/Apache-2.0
MODCARGO_CRATES +=	flate2	1.0.30	# MIT OR Apache-2.0
MODCARGO_CRATES +=	fnv	1.0.7	# Apache-2.0 / MIT
MODCARGO_CRATES +=	foreign-types	0.3.2	# MIT/Apache-2.0
MODCARGO_CRATES +=	foreign-types-shared	0.1.1	# MIT/Apache-2.0
MODCARGO_CRATES +=	form_urlencoded	1.2.1	# MIT OR Apache-2.0
MODCARGO_CRATES +=	fs-err	2.11.0	# MIT/Apache-2.0
MODCARGO_CRATES +=	futures	0.3.30	# MIT OR Apache-2.0
MODCARGO_CRATES +=	futures-channel	0.3.30	# MIT OR Apache-2.0
MODCARGO_CRATES +=	futures-core	0.3.30	# MIT OR Apache-2.0
MODCARGO_CRATES +=	futures-executor	0.3.30	# MIT OR Apache-2.0
MODCARGO_CRATES +=	futures-io	0.3.30	# MIT OR Apache-2.0
MODCARGO_CRATES +=	futures-macro	0.3.30	# MIT OR Apache-2.0
MODCARGO_CRATES +=	futures-sink	0.3.30	# MIT OR Apache-2.0
MODCARGO_CRATES +=	futures-task	0.3.30	# MIT OR Apache-2.0
MODCARGO_CRATES +=	futures-timer	3.0.3	# MIT/Apache-2.0
MODCARGO_CRATES +=	futures-util	0.3.30	# MIT OR Apache-2.0
MODCARGO_CRATES +=	generic-array	0.14.7	# MIT
MODCARGO_CRATES +=	getrandom	0.2.15	# MIT OR Apache-2.0
MODCARGO_CRATES +=	glob	0.3.1	# MIT OR Apache-2.0
MODCARGO_CRATES +=	globset	0.4.14	# Unlicense OR MIT
MODCARGO_CRATES +=	goblin	0.8.2	# MIT
MODCARGO_CRATES +=	hashbrown	0.12.3	# MIT OR Apache-2.0
MODCARGO_CRATES +=	hashbrown	0.14.5	# MIT OR Apache-2.0
MODCARGO_CRATES +=	heck	0.4.1	# MIT OR Apache-2.0
MODCARGO_CRATES +=	heck	0.5.0	# MIT OR Apache-2.0
MODCARGO_CRATES +=	home	0.5.9	# MIT OR Apache-2.0
MODCARGO_CRATES +=	humantime	2.1.0	# MIT/Apache-2.0
MODCARGO_CRATES +=	humantime-serde	1.1.1	# MIT OR Apache-2.0
MODCARGO_CRATES +=	idna	0.5.0	# MIT OR Apache-2.0
MODCARGO_CRATES +=	ignore	0.4.22	# Unlicense OR MIT
MODCARGO_CRATES +=	indexmap	1.9.3	# Apache-2.0 OR MIT
MODCARGO_CRATES +=	indexmap	2.2.6	# Apache-2.0 OR MIT
MODCARGO_CRATES +=	indicatif	0.17.8	# MIT
MODCARGO_CRATES +=	indoc	2.0.5	# MIT OR Apache-2.0
MODCARGO_CRATES +=	instant	0.1.13	# BSD-3-Clause
MODCARGO_CRATES +=	is_terminal_polyfill	1.70.0	# MIT OR Apache-2.0
MODCARGO_CRATES +=	itertools	0.12.1	# MIT OR Apache-2.0
MODCARGO_CRATES +=	itoa	1.0.11	# MIT OR Apache-2.0
MODCARGO_CRATES +=	keyring	2.3.3	# MIT OR Apache-2.0
MODCARGO_CRATES +=	lazy_static	1.4.0	# MIT/Apache-2.0
MODCARGO_CRATES +=	lddtree	0.3.5	# MIT
MODCARGO_CRATES +=	libc	0.2.155	# MIT OR Apache-2.0
MODCARGO_CRATES +=	libmimalloc-sys	0.1.38	# MIT
MODCARGO_CRATES +=	libredox	0.1.3	# MIT
MODCARGO_CRATES +=	linux-keyutils	0.2.4	# Apache-2.0 OR MIT
MODCARGO_CRATES +=	linux-raw-sys	0.4.14	# Apache-2.0 WITH LLVM-exception OR Apache-2.0 OR MIT
MODCARGO_CRATES +=	lock_api	0.4.12	# MIT OR Apache-2.0
MODCARGO_CRATES +=	log	0.4.21	# MIT OR Apache-2.0
MODCARGO_CRATES +=	lzxd	0.2.5	# MIT OR Apache-2.0
MODCARGO_CRATES +=	mailparse	0.15.0	# 0BSD
MODCARGO_CRATES +=	matchers	0.1.0	# MIT
MODCARGO_CRATES +=	memchr	2.7.2	# Unlicense OR MIT
MODCARGO_CRATES +=	mimalloc	0.1.42	# MIT
MODCARGO_CRATES +=	mime	0.3.17	# MIT OR Apache-2.0
MODCARGO_CRATES +=	mime_guess	2.0.4	# MIT
MODCARGO_CRATES +=	minijinja	1.0.21	# Apache-2.0
MODCARGO_CRATES +=	minimal-lexical	0.2.1	# MIT/Apache-2.0
MODCARGO_CRATES +=	miniz_oxide	0.7.3	# MIT OR Zlib OR Apache-2.0
MODCARGO_CRATES +=	msi	0.7.0	# MIT
MODCARGO_CRATES +=	multipart	0.18.0	# MIT OR Apache-2.0
MODCARGO_CRATES +=	native-tls	0.2.12	# MIT OR Apache-2.0
MODCARGO_CRATES +=	nom	7.1.3	# MIT
MODCARGO_CRATES +=	normalize-line-endings	0.3.0	# Apache-2.0
MODCARGO_CRATES +=	normpath	1.2.0	# MIT OR Apache-2.0
MODCARGO_CRATES +=	nu-ansi-term	0.46.0	# MIT
MODCARGO_CRATES +=	num-conv	0.1.0	# MIT OR Apache-2.0
MODCARGO_CRATES +=	num_enum	0.7.2	# BSD-3-Clause OR MIT OR Apache-2.0
MODCARGO_CRATES +=	num_enum_derive	0.7.2	# BSD-3-Clause OR MIT OR Apache-2.0
MODCARGO_CRATES +=	number_prefix	0.4.0	# MIT
MODCARGO_CRATES +=	once_cell	1.19.0	# MIT OR Apache-2.0
MODCARGO_CRATES +=	openssl	0.10.64	# Apache-2.0
MODCARGO_CRATES +=	openssl-macros	0.1.1	# MIT/Apache-2.0
MODCARGO_CRATES +=	openssl-probe	0.1.5	# MIT/Apache-2.0
MODCARGO_CRATES +=	openssl-sys	0.9.102	# MIT
MODCARGO_CRATES +=	option-ext	0.2.0	# MPL-2.0
MODCARGO_CRATES +=	os_pipe	1.2.0	# MIT
MODCARGO_CRATES +=	overload	0.1.1	# MIT
MODCARGO_CRATES +=	parking_lot	0.12.3	# MIT OR Apache-2.0
MODCARGO_CRATES +=	parking_lot_core	0.9.10	# MIT OR Apache-2.0
MODCARGO_CRATES +=	paste	1.0.15	# MIT OR Apache-2.0
MODCARGO_CRATES +=	path-slash	0.2.1	# MIT
MODCARGO_CRATES +=	pep440_rs	0.5.0	# Apache-2.0 OR BSD-2-Clause
MODCARGO_CRATES +=	pep508_rs	0.4.2	# Apache-2.0 OR BSD-2-Clause
MODCARGO_CRATES +=	percent-encoding	2.3.1	# MIT OR Apache-2.0
MODCARGO_CRATES +=	pin-project-lite	0.2.14	# Apache-2.0 OR MIT
MODCARGO_CRATES +=	pin-utils	0.1.0	# MIT OR Apache-2.0
MODCARGO_CRATES +=	pkg-config	0.3.30	# MIT OR Apache-2.0
MODCARGO_CRATES +=	plain	0.2.3	# MIT/Apache-2.0
MODCARGO_CRATES +=	platform-info	2.0.3	# MIT
MODCARGO_CRATES +=	portable-atomic	1.6.0	# Apache-2.0 OR MIT
MODCARGO_CRATES +=	powerfmt	0.2.0	# MIT OR Apache-2.0
MODCARGO_CRATES +=	ppv-lite86	0.2.17	# MIT/Apache-2.0
MODCARGO_CRATES +=	pretty_assertions	1.4.0	# MIT OR Apache-2.0
MODCARGO_CRATES +=	proc-macro-crate	3.1.0	# MIT OR Apache-2.0
MODCARGO_CRATES +=	proc-macro2	1.0.85	# MIT OR Apache-2.0
MODCARGO_CRATES +=	psm	0.1.21	# MIT OR Apache-2.0
MODCARGO_CRATES +=	pyproject-toml	0.10.0	# MIT
MODCARGO_CRATES +=	python-pkginfo	0.6.2	# MIT
MODCARGO_CRATES +=	quote	1.0.36	# MIT OR Apache-2.0
MODCARGO_CRATES +=	quoted_printable	0.5.0	# 0BSD
MODCARGO_CRATES +=	rand	0.8.5	# MIT OR Apache-2.0
MODCARGO_CRATES +=	rand_chacha	0.3.1	# MIT OR Apache-2.0
MODCARGO_CRATES +=	rand_core	0.6.4	# MIT OR Apache-2.0
MODCARGO_CRATES +=	rayon	1.10.0	# MIT OR Apache-2.0
MODCARGO_CRATES +=	rayon-core	1.12.1	# MIT OR Apache-2.0
MODCARGO_CRATES +=	redox_syscall	0.4.1	# MIT
MODCARGO_CRATES +=	redox_syscall	0.5.1	# MIT
MODCARGO_CRATES +=	redox_users	0.4.5	# MIT
MODCARGO_CRATES +=	regex	1.10.5	# MIT OR Apache-2.0
MODCARGO_CRATES +=	regex-automata	0.1.10	# Unlicense/MIT
MODCARGO_CRATES +=	regex-automata	0.4.7	# MIT OR Apache-2.0
MODCARGO_CRATES +=	regex-syntax	0.6.29	# MIT OR Apache-2.0
MODCARGO_CRATES +=	regex-syntax	0.8.4	# MIT OR Apache-2.0
MODCARGO_CRATES +=	relative-path	1.9.3	# MIT OR Apache-2.0
MODCARGO_CRATES +=	rfc2047-decoder	1.0.5	# MIT
MODCARGO_CRATES +=	ring	0.17.8	# LICENSE
MODCARGO_CRATES +=	rstest	0.21.0	# MIT OR Apache-2.0
MODCARGO_CRATES +=	rstest_macros	0.21.0	# MIT OR Apache-2.0
MODCARGO_CRATES +=	rustc_version	0.4.0	# MIT/Apache-2.0
MODCARGO_CRATES +=	rustix	0.38.34	# Apache-2.0 WITH LLVM-exception OR Apache-2.0 OR MIT
MODCARGO_CRATES +=	rustls	0.22.4	# Apache-2.0 OR ISC OR MIT
MODCARGO_CRATES +=	rustls-pemfile	2.1.2	# Apache-2.0 OR ISC OR MIT
MODCARGO_CRATES +=	rustls-pki-types	1.7.0	# MIT OR Apache-2.0
MODCARGO_CRATES +=	rustls-webpki	0.102.4	# ISC
MODCARGO_CRATES +=	rustversion	1.0.17	# MIT OR Apache-2.0
MODCARGO_CRATES +=	ryu	1.0.18	# Apache-2.0 OR BSL-1.0
MODCARGO_CRATES +=	same-file	1.0.6	# Unlicense/MIT
MODCARGO_CRATES +=	schannel	0.1.23	# MIT
MODCARGO_CRATES +=	schemars	0.8.21	# MIT
MODCARGO_CRATES +=	schemars_derive	0.8.21	# MIT
MODCARGO_CRATES +=	scopeguard	1.2.0	# MIT OR Apache-2.0
MODCARGO_CRATES +=	scroll	0.12.0	# MIT
MODCARGO_CRATES +=	scroll_derive	0.12.0	# MIT
MODCARGO_CRATES +=	security-framework	2.11.0	# MIT OR Apache-2.0
MODCARGO_CRATES +=	security-framework-sys	2.11.0	# MIT OR Apache-2.0
MODCARGO_CRATES +=	semver	1.0.23	# MIT OR Apache-2.0
MODCARGO_CRATES +=	serde	1.0.204	# MIT OR Apache-2.0
MODCARGO_CRATES +=	serde_derive	1.0.204	# MIT OR Apache-2.0
MODCARGO_CRATES +=	serde_derive_internals	0.29.1	# MIT OR Apache-2.0
MODCARGO_CRATES +=	serde_json	1.0.120	# MIT OR Apache-2.0
MODCARGO_CRATES +=	serde_spanned	0.6.6	# MIT OR Apache-2.0
MODCARGO_CRATES +=	sha2	0.10.8	# MIT OR Apache-2.0
MODCARGO_CRATES +=	sharded-slab	0.1.7	# MIT
MODCARGO_CRATES +=	shell-words	1.1.0	# MIT/Apache-2.0
MODCARGO_CRATES +=	shlex	1.3.0	# MIT OR Apache-2.0
MODCARGO_CRATES +=	similar	2.5.0	# Apache-2.0
MODCARGO_CRATES +=	slab	0.4.9	# MIT
MODCARGO_CRATES +=	smallvec	1.13.2	# MIT OR Apache-2.0
MODCARGO_CRATES +=	smawk	0.3.2	# MIT
MODCARGO_CRATES +=	snapbox	0.6.10	# MIT OR Apache-2.0
MODCARGO_CRATES +=	snapbox-macros	0.3.9	# MIT OR Apache-2.0
MODCARGO_CRATES +=	socks	0.3.4	# MIT/Apache-2.0
MODCARGO_CRATES +=	spin	0.9.8	# MIT
MODCARGO_CRATES +=	stacker	0.1.15	# MIT OR Apache-2.0
MODCARGO_CRATES +=	static_assertions	1.1.0	# MIT OR Apache-2.0
MODCARGO_CRATES +=	strsim	0.11.1	# MIT
MODCARGO_CRATES +=	subtle	2.5.0	# BSD-3-Clause
MODCARGO_CRATES +=	syn	1.0.109	# MIT OR Apache-2.0
MODCARGO_CRATES +=	syn	2.0.66	# MIT OR Apache-2.0
MODCARGO_CRATES +=	tar	0.4.41	# MIT OR Apache-2.0
MODCARGO_CRATES +=	target-lexicon	0.12.14	# Apache-2.0 WITH LLVM-exception
MODCARGO_CRATES +=	tempfile	3.10.1	# MIT OR Apache-2.0
MODCARGO_CRATES +=	termcolor	1.4.1	# Unlicense OR MIT
MODCARGO_CRATES +=	terminal_size	0.3.0	# MIT OR Apache-2.0
MODCARGO_CRATES +=	textwrap	0.16.1	# MIT
MODCARGO_CRATES +=	thiserror	1.0.61	# MIT OR Apache-2.0
MODCARGO_CRATES +=	thiserror-impl	1.0.61	# MIT OR Apache-2.0
MODCARGO_CRATES +=	thread_local	1.1.8	# MIT OR Apache-2.0
MODCARGO_CRATES +=	time	0.3.36	# MIT OR Apache-2.0
MODCARGO_CRATES +=	time-core	0.1.2	# MIT OR Apache-2.0
MODCARGO_CRATES +=	time-macros	0.2.18	# MIT OR Apache-2.0
MODCARGO_CRATES +=	tinyvec	1.7.0	# Zlib OR Apache-2.0 OR MIT
MODCARGO_CRATES +=	tinyvec_macros	0.1.1	# MIT OR Apache-2.0 OR Zlib
MODCARGO_CRATES +=	toml	0.5.11	# MIT/Apache-2.0
MODCARGO_CRATES +=	toml	0.8.14	# MIT OR Apache-2.0
MODCARGO_CRATES +=	toml_datetime	0.6.6	# MIT OR Apache-2.0
MODCARGO_CRATES +=	toml_edit	0.21.1	# MIT OR Apache-2.0
MODCARGO_CRATES +=	toml_edit	0.22.14	# MIT OR Apache-2.0
MODCARGO_CRATES +=	tracing	0.1.40	# MIT
MODCARGO_CRATES +=	tracing-attributes	0.1.27	# MIT
MODCARGO_CRATES +=	tracing-core	0.1.32	# MIT
MODCARGO_CRATES +=	tracing-log	0.2.0	# MIT
MODCARGO_CRATES +=	tracing-serde	0.1.3	# MIT
MODCARGO_CRATES +=	tracing-subscriber	0.3.18	# MIT
MODCARGO_CRATES +=	trycmd	0.15.4	# MIT OR Apache-2.0
MODCARGO_CRATES +=	twox-hash	1.6.3	# MIT
MODCARGO_CRATES +=	typenum	1.17.0	# MIT OR Apache-2.0
MODCARGO_CRATES +=	unicase	2.7.0	# MIT/Apache-2.0
MODCARGO_CRATES +=	unicode-bidi	0.3.15	# MIT OR Apache-2.0
MODCARGO_CRATES +=	unicode-ident	1.0.12	# (MIT OR Apache-2.0) AND Unicode-DFS-2016
MODCARGO_CRATES +=	unicode-linebreak	0.1.5	# Apache-2.0
MODCARGO_CRATES +=	unicode-normalization	0.1.23	# MIT/Apache-2.0
MODCARGO_CRATES +=	unicode-width	0.1.13	# MIT OR Apache-2.0
MODCARGO_CRATES +=	unicode-xid	0.2.4	# MIT OR Apache-2.0
MODCARGO_CRATES +=	unscanny	0.1.0	# MIT OR Apache-2.0
MODCARGO_CRATES +=	untrusted	0.9.0	# ISC
MODCARGO_CRATES +=	ureq	2.9.7	# MIT OR Apache-2.0
MODCARGO_CRATES +=	url	2.5.2	# MIT OR Apache-2.0
MODCARGO_CRATES +=	urlencoding	2.1.3	# MIT
MODCARGO_CRATES +=	utf8parse	0.2.2	# Apache-2.0 OR MIT
MODCARGO_CRATES +=	uuid	1.8.0	# Apache-2.0 OR MIT
MODCARGO_CRATES +=	valuable	0.1.0	# MIT
MODCARGO_CRATES +=	vcpkg	0.2.15	# MIT/Apache-2.0
MODCARGO_CRATES +=	version_check	0.9.4	# MIT/Apache-2.0
MODCARGO_CRATES +=	versions	6.2.0	# MIT
MODCARGO_CRATES +=	wait-timeout	0.2.0	# MIT/Apache-2.0
MODCARGO_CRATES +=	walkdir	2.5.0	# Unlicense/MIT
MODCARGO_CRATES +=	wasi	0.11.0+wasi-snapshot-preview1	# Apache-2.0 WITH LLVM-exception OR Apache-2.0 OR MIT
MODCARGO_CRATES +=	webpki-roots	0.26.2	# MPL-2.0
MODCARGO_CRATES +=	which	5.0.0	# MIT
MODCARGO_CRATES +=	which	6.0.1	# MIT
MODCARGO_CRATES +=	wild	2.2.1	# Apache-2.0 OR MIT
MODCARGO_CRATES +=	winapi	0.3.9	# MIT/Apache-2.0
MODCARGO_CRATES +=	winapi-i686-pc-windows-gnu	0.4.0	# MIT/Apache-2.0
MODCARGO_CRATES +=	winapi-util	0.1.8	# Unlicense OR MIT
MODCARGO_CRATES +=	winapi-x86_64-pc-windows-gnu	0.4.0	# MIT/Apache-2.0
MODCARGO_CRATES +=	windows-sys	0.48.0	# MIT OR Apache-2.0
MODCARGO_CRATES +=	windows-sys	0.52.0	# MIT OR Apache-2.0
MODCARGO_CRATES +=	windows-targets	0.48.5	# MIT OR Apache-2.0
MODCARGO_CRATES +=	windows-targets	0.52.5	# MIT OR Apache-2.0
MODCARGO_CRATES +=	windows_aarch64_gnullvm	0.48.5	# MIT OR Apache-2.0
MODCARGO_CRATES +=	windows_aarch64_gnullvm	0.52.5	# MIT OR Apache-2.0
MODCARGO_CRATES +=	windows_aarch64_msvc	0.48.5	# MIT OR Apache-2.0
MODCARGO_CRATES +=	windows_aarch64_msvc	0.52.5	# MIT OR Apache-2.0
MODCARGO_CRATES +=	windows_i686_gnu	0.48.5	# MIT OR Apache-2.0
MODCARGO_CRATES +=	windows_i686_gnu	0.52.5	# MIT OR Apache-2.0
MODCARGO_CRATES +=	windows_i686_gnullvm	0.52.5	# MIT OR Apache-2.0
MODCARGO_CRATES +=	windows_i686_msvc	0.48.5	# MIT OR Apache-2.0
MODCARGO_CRATES +=	windows_i686_msvc	0.52.5	# MIT OR Apache-2.0
MODCARGO_CRATES +=	windows_x86_64_gnu	0.48.5	# MIT OR Apache-2.0
MODCARGO_CRATES +=	windows_x86_64_gnu	0.52.5	# MIT OR Apache-2.0
MODCARGO_CRATES +=	windows_x86_64_gnullvm	0.48.5	# MIT OR Apache-2.0
MODCARGO_CRATES +=	windows_x86_64_gnullvm	0.52.5	# MIT OR Apache-2.0
MODCARGO_CRATES +=	windows_x86_64_msvc	0.48.5	# MIT OR Apache-2.0
MODCARGO_CRATES +=	windows_x86_64_msvc	0.52.5	# MIT OR Apache-2.0
MODCARGO_CRATES +=	winnow	0.5.40	# MIT
MODCARGO_CRATES +=	winnow	0.6.13	# MIT
MODCARGO_CRATES +=	winsafe	0.0.19	# MIT
MODCARGO_CRATES +=	xattr	1.3.1	# MIT/Apache-2.0
MODCARGO_CRATES +=	xwin	0.5.1	# Apache-2.0 OR MIT
MODCARGO_CRATES +=	yansi	0.5.1	# MIT/Apache-2.0
MODCARGO_CRATES +=	zerocopy	0.7.34	# BSD-2-Clause OR Apache-2.0 OR MIT
MODCARGO_CRATES +=	zerocopy-derive	0.7.34	# BSD-2-Clause OR Apache-2.0 OR MIT
MODCARGO_CRATES +=	zeroize	1.8.1	# Apache-2.0 OR MIT
MODCARGO_CRATES +=	zip	0.6.6	# MIT
MODCARGO_CRATES +=	zip	1.1.4	# MIT
