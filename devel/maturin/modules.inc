# $OpenBSD: modules.inc,v 1.3 2021/10/11 05:13:50 gnezdo Exp $
MODCARGO_CRATES +=	addr2line	0.16.0	# Apache-2.0/MIT
MODCARGO_CRATES +=	adler	1.0.2	# 0BSD OR MIT OR Apache-2.0
MODCARGO_CRATES +=	aes	0.6.0	# MIT OR Apache-2.0
MODCARGO_CRATES +=	aes-soft	0.6.4	# MIT OR Apache-2.0
MODCARGO_CRATES +=	aesni	0.10.0	# MIT OR Apache-2.0
MODCARGO_CRATES +=	aho-corasick	0.7.18	# Unlicense/MIT
MODCARGO_CRATES +=	ansi_term	0.11.0	# MIT
MODCARGO_CRATES +=	anyhow	1.0.44	# MIT OR Apache-2.0
MODCARGO_CRATES +=	atty	0.2.14	# MIT
MODCARGO_CRATES +=	autocfg	1.0.1	# Apache-2.0 OR MIT
MODCARGO_CRATES +=	backtrace	0.3.61	# MIT/Apache-2.0
MODCARGO_CRATES +=	base64	0.10.1	# MIT/Apache-2.0
MODCARGO_CRATES +=	base64	0.13.0	# MIT/Apache-2.0
MODCARGO_CRATES +=	bitflags	1.3.2	# MIT/Apache-2.0
MODCARGO_CRATES +=	block-buffer	0.9.0	# MIT OR Apache-2.0
MODCARGO_CRATES +=	block-modes	0.7.0	# MIT OR Apache-2.0
MODCARGO_CRATES +=	block-padding	0.2.1	# MIT OR Apache-2.0
MODCARGO_CRATES +=	bumpalo	3.7.1	# MIT/Apache-2.0
MODCARGO_CRATES +=	byteorder	1.4.3	# Unlicense OR MIT
MODCARGO_CRATES +=	bytes	1.1.0	# MIT
MODCARGO_CRATES +=	bytesize	1.1.0	# Apache-2.0
MODCARGO_CRATES +=	bzip2	0.4.3	# MIT/Apache-2.0
MODCARGO_CRATES +=	bzip2-sys	0.1.11+1.0.8	# MIT/Apache-2.0
MODCARGO_CRATES +=	camino	1.0.5	# MIT OR Apache-2.0
MODCARGO_CRATES +=	cargo-platform	0.1.2	# MIT OR Apache-2.0
MODCARGO_CRATES +=	cargo_metadata	0.14.0	# MIT
MODCARGO_CRATES +=	cbindgen	0.20.0	# MPL-2.0
MODCARGO_CRATES +=	cc	1.0.70	# MIT/Apache-2.0
MODCARGO_CRATES +=	cfg-if	1.0.0	# MIT/Apache-2.0
MODCARGO_CRATES +=	charset	0.1.2	# MIT/Apache-2.0
MODCARGO_CRATES +=	cipher	0.2.5	# MIT OR Apache-2.0
MODCARGO_CRATES +=	clap	2.33.3	# MIT
MODCARGO_CRATES +=	configparser	2.1.0	# MIT OR LGPL-3.0-or-later
MODCARGO_CRATES +=	core-foundation	0.7.0	# MIT / Apache-2.0
MODCARGO_CRATES +=	core-foundation-sys	0.7.0	# MIT / Apache-2.0
MODCARGO_CRATES +=	cpufeatures	0.2.1	# MIT OR Apache-2.0
MODCARGO_CRATES +=	crc32fast	1.2.1	# MIT OR Apache-2.0
MODCARGO_CRATES +=	crypto-mac	0.10.1	# MIT OR Apache-2.0
MODCARGO_CRATES +=	dbus	0.2.3	# Apache-2.0/MIT
MODCARGO_CRATES +=	digest	0.9.0	# MIT OR Apache-2.0
MODCARGO_CRATES +=	dirs	4.0.0	# MIT OR Apache-2.0
MODCARGO_CRATES +=	dirs-sys	0.3.6	# MIT OR Apache-2.0
MODCARGO_CRATES +=	encoding_rs	0.8.28	# Apache-2.0 OR MIT
MODCARGO_CRATES +=	env_logger	0.7.1	# MIT/Apache-2.0
MODCARGO_CRATES +=	fat-macho	0.4.4	# MIT
MODCARGO_CRATES +=	filetime	0.2.15	# MIT/Apache-2.0
MODCARGO_CRATES +=	flate2	1.0.22	# MIT/Apache-2.0
MODCARGO_CRATES +=	fnv	1.0.7	# Apache-2.0 / MIT
MODCARGO_CRATES +=	form_urlencoded	1.0.1	# MIT/Apache-2.0
MODCARGO_CRATES +=	fs-err	2.6.0	# MIT/Apache-2.0
MODCARGO_CRATES +=	futures-channel	0.3.17	# MIT OR Apache-2.0
MODCARGO_CRATES +=	futures-core	0.3.17	# MIT OR Apache-2.0
MODCARGO_CRATES +=	futures-io	0.3.17	# MIT OR Apache-2.0
MODCARGO_CRATES +=	futures-macro	0.3.17	# MIT OR Apache-2.0
MODCARGO_CRATES +=	futures-sink	0.3.17	# MIT OR Apache-2.0
MODCARGO_CRATES +=	futures-task	0.3.17	# MIT OR Apache-2.0
MODCARGO_CRATES +=	futures-util	0.3.17	# MIT OR Apache-2.0
MODCARGO_CRATES +=	generic-array	0.14.4	# MIT
MODCARGO_CRATES +=	getrandom	0.1.16	# MIT OR Apache-2.0
MODCARGO_CRATES +=	getrandom	0.2.3	# MIT OR Apache-2.0
MODCARGO_CRATES +=	gimli	0.25.0	# Apache-2.0/MIT
MODCARGO_CRATES +=	glob	0.3.0	# MIT/Apache-2.0
MODCARGO_CRATES +=	goblin	0.4.3	# MIT
MODCARGO_CRATES +=	h2	0.3.4	# MIT
MODCARGO_CRATES +=	hashbrown	0.11.2	# Apache-2.0/MIT
MODCARGO_CRATES +=	heck	0.3.3	# MIT OR Apache-2.0
MODCARGO_CRATES +=	hermit-abi	0.1.19	# MIT/Apache-2.0
MODCARGO_CRATES +=	hkdf	0.10.0	# MIT/Apache-2.0
MODCARGO_CRATES +=	hmac	0.10.1	# MIT OR Apache-2.0
MODCARGO_CRATES +=	http	0.2.5	# MIT/Apache-2.0
MODCARGO_CRATES +=	http-body	0.4.3	# MIT
MODCARGO_CRATES +=	httparse	1.5.1	# MIT/Apache-2.0
MODCARGO_CRATES +=	httpdate	1.0.1	# MIT/Apache-2.0
MODCARGO_CRATES +=	human-panic	1.0.3	# MIT OR Apache-2.0
MODCARGO_CRATES +=	humantime	1.3.0	# MIT/Apache-2.0
MODCARGO_CRATES +=	hyper	0.14.13	# MIT
MODCARGO_CRATES +=	hyper-rustls	0.22.1	# Apache-2.0/ISC/MIT
MODCARGO_CRATES +=	idna	0.2.3	# MIT/Apache-2.0
MODCARGO_CRATES +=	indexmap	1.7.0	# Apache-2.0/MIT
MODCARGO_CRATES +=	indoc	1.0.3	# MIT OR Apache-2.0
MODCARGO_CRATES +=	ipnet	2.3.1	# MIT OR Apache-2.0
MODCARGO_CRATES +=	itoa	0.4.8	# MIT OR Apache-2.0
MODCARGO_CRATES +=	js-sys	0.3.55	# MIT/Apache-2.0
MODCARGO_CRATES +=	keyring	0.10.1	# MIT OR Apache-2.0
MODCARGO_CRATES +=	lazy_static	1.4.0	# MIT/Apache-2.0
MODCARGO_CRATES +=	libc	0.2.103	# MIT OR Apache-2.0
MODCARGO_CRATES +=	log	0.4.14	# MIT OR Apache-2.0
MODCARGO_CRATES +=	mailparse	0.13.6	# 0BSD
MODCARGO_CRATES +=	matches	0.1.9	# MIT
MODCARGO_CRATES +=	memchr	2.4.1	# Unlicense/MIT
MODCARGO_CRATES +=	mime	0.3.16	# MIT/Apache-2.0
MODCARGO_CRATES +=	mime_guess	2.0.3	# MIT
MODCARGO_CRATES +=	miniz_oxide	0.4.4	# MIT OR Zlib OR Apache-2.0
MODCARGO_CRATES +=	mio	0.7.13	# MIT
MODCARGO_CRATES +=	miow	0.3.7	# MIT/Apache-2.0
MODCARGO_CRATES +=	ntapi	0.3.6	# Apache-2.0 OR MIT
MODCARGO_CRATES +=	num	0.3.1	# MIT OR Apache-2.0
MODCARGO_CRATES +=	num-bigint	0.3.3	# MIT OR Apache-2.0
MODCARGO_CRATES +=	num-complex	0.3.1	# MIT OR Apache-2.0
MODCARGO_CRATES +=	num-integer	0.1.44	# MIT OR Apache-2.0
MODCARGO_CRATES +=	num-iter	0.1.42	# MIT OR Apache-2.0
MODCARGO_CRATES +=	num-rational	0.3.2	# MIT OR Apache-2.0
MODCARGO_CRATES +=	num-traits	0.2.14	# MIT OR Apache-2.0
MODCARGO_CRATES +=	num_cpus	1.13.0	# MIT/Apache-2.0
MODCARGO_CRATES +=	object	0.26.2	# Apache-2.0/MIT
MODCARGO_CRATES +=	once_cell	1.8.0	# MIT OR Apache-2.0
MODCARGO_CRATES +=	opaque-debug	0.3.0	# MIT OR Apache-2.0
MODCARGO_CRATES +=	os_type	2.3.0	# MIT
MODCARGO_CRATES +=	percent-encoding	2.1.0	# MIT/Apache-2.0
MODCARGO_CRATES +=	pin-project-lite	0.2.7	# Apache-2.0 OR MIT
MODCARGO_CRATES +=	pin-utils	0.1.0	# MIT OR Apache-2.0
MODCARGO_CRATES +=	pkg-config	0.3.20	# MIT/Apache-2.0
MODCARGO_CRATES +=	plain	0.2.3	# MIT/Apache-2.0
MODCARGO_CRATES +=	platform-info	0.1.0	# MIT
MODCARGO_CRATES +=	ppv-lite86	0.2.10	# MIT/Apache-2.0
MODCARGO_CRATES +=	pretty_env_logger	0.4.0	# MIT/Apache-2.0
MODCARGO_CRATES +=	proc-macro-error	1.0.4	# MIT OR Apache-2.0
MODCARGO_CRATES +=	proc-macro-error-attr	1.0.4	# MIT OR Apache-2.0
MODCARGO_CRATES +=	proc-macro-hack	0.5.19	# MIT OR Apache-2.0
MODCARGO_CRATES +=	proc-macro-nested	0.1.7	# MIT OR Apache-2.0
MODCARGO_CRATES +=	proc-macro2	1.0.29	# MIT OR Apache-2.0
MODCARGO_CRATES +=	pyproject-toml	0.2.0	# MIT
MODCARGO_CRATES +=	python-pkginfo	0.4.0	# MIT
MODCARGO_CRATES +=	quick-error	1.2.3	# MIT/Apache-2.0
MODCARGO_CRATES +=	quote	1.0.9	# MIT OR Apache-2.0
MODCARGO_CRATES +=	quoted_printable	0.4.3	# 0BSD
MODCARGO_CRATES +=	rand	0.7.3	# MIT OR Apache-2.0
MODCARGO_CRATES +=	rand	0.8.4	# MIT OR Apache-2.0
MODCARGO_CRATES +=	rand_chacha	0.2.2	# MIT OR Apache-2.0
MODCARGO_CRATES +=	rand_chacha	0.3.1	# MIT OR Apache-2.0
MODCARGO_CRATES +=	rand_core	0.5.1	# MIT OR Apache-2.0
MODCARGO_CRATES +=	rand_core	0.6.3	# MIT OR Apache-2.0
MODCARGO_CRATES +=	rand_hc	0.2.0	# MIT/Apache-2.0
MODCARGO_CRATES +=	rand_hc	0.3.1	# MIT OR Apache-2.0
MODCARGO_CRATES +=	redox_syscall	0.2.10	# MIT
MODCARGO_CRATES +=	redox_users	0.4.0	# MIT
MODCARGO_CRATES +=	regex	1.5.4	# MIT OR Apache-2.0
MODCARGO_CRATES +=	regex-syntax	0.6.25	# MIT/Apache-2.0
MODCARGO_CRATES +=	remove_dir_all	0.5.3	# MIT/Apache-2.0
MODCARGO_CRATES +=	reqwest	0.11.4	# MIT/Apache-2.0
MODCARGO_CRATES +=	ring	0.16.20	# LICENSE
MODCARGO_CRATES +=	rpassword	5.0.1	# Apache-2.0
MODCARGO_CRATES +=	rustc-demangle	0.1.21	# MIT/Apache-2.0
MODCARGO_CRATES +=	rustls	0.19.1	# Apache-2.0/ISC/MIT
MODCARGO_CRATES +=	ryu	1.0.5	# Apache-2.0 OR BSL-1.0
MODCARGO_CRATES +=	same-file	1.0.6	# Unlicense/MIT
MODCARGO_CRATES +=	scroll	0.10.2	# MIT
MODCARGO_CRATES +=	scroll_derive	0.10.5	# MIT
MODCARGO_CRATES +=	sct	0.6.1	# Apache-2.0/ISC/MIT
MODCARGO_CRATES +=	secret-service	1.1.3	# MIT OR Apache-2.0
MODCARGO_CRATES +=	security-framework	0.4.4	# MIT OR Apache-2.0
MODCARGO_CRATES +=	security-framework-sys	0.4.3	# MIT OR Apache-2.0
MODCARGO_CRATES +=	semver	1.0.4	# MIT OR Apache-2.0
MODCARGO_CRATES +=	serde	1.0.130	# MIT OR Apache-2.0
MODCARGO_CRATES +=	serde_derive	1.0.130	# MIT OR Apache-2.0
MODCARGO_CRATES +=	serde_json	1.0.68	# MIT OR Apache-2.0
MODCARGO_CRATES +=	serde_urlencoded	0.7.0	# MIT/Apache-2.0
MODCARGO_CRATES +=	sha2	0.9.8	# MIT OR Apache-2.0
MODCARGO_CRATES +=	shlex	1.1.0	# MIT OR Apache-2.0
MODCARGO_CRATES +=	slab	0.4.4	# MIT
MODCARGO_CRATES +=	smawk	0.3.1	# MIT
MODCARGO_CRATES +=	socket2	0.4.2	# MIT/Apache-2.0
MODCARGO_CRATES +=	spin	0.5.2	# MIT
MODCARGO_CRATES +=	strsim	0.8.0	# MIT
MODCARGO_CRATES +=	structopt	0.3.23	# Apache-2.0 OR MIT
MODCARGO_CRATES +=	structopt-derive	0.4.16	# Apache-2.0/MIT
MODCARGO_CRATES +=	subtle	2.4.1	# BSD-3-Clause
MODCARGO_CRATES +=	syn	1.0.77	# MIT OR Apache-2.0
MODCARGO_CRATES +=	tar	0.4.37	# MIT/Apache-2.0
MODCARGO_CRATES +=	target-lexicon	0.12.2	# Apache-2.0 WITH LLVM-exception
MODCARGO_CRATES +=	tempfile	3.2.0	# MIT OR Apache-2.0
MODCARGO_CRATES +=	termcolor	1.1.2	# Unlicense OR MIT
MODCARGO_CRATES +=	textwrap	0.11.0	# MIT
MODCARGO_CRATES +=	textwrap	0.14.2	# MIT
MODCARGO_CRATES +=	thiserror	1.0.29	# MIT OR Apache-2.0
MODCARGO_CRATES +=	thiserror-impl	1.0.29	# MIT OR Apache-2.0
MODCARGO_CRATES +=	time	0.1.43	# MIT/Apache-2.0
MODCARGO_CRATES +=	tinyvec	1.5.0	# Zlib OR Apache-2.0 OR MIT
MODCARGO_CRATES +=	tinyvec_macros	0.1.0	# MIT OR Apache-2.0 OR Zlib
MODCARGO_CRATES +=	tokio	1.12.0	# MIT
MODCARGO_CRATES +=	tokio-rustls	0.22.0	# MIT/Apache-2.0
MODCARGO_CRATES +=	tokio-util	0.6.8	# MIT
MODCARGO_CRATES +=	toml	0.5.8	# MIT/Apache-2.0
MODCARGO_CRATES +=	tower-service	0.3.1	# MIT
MODCARGO_CRATES +=	tracing	0.1.28	# MIT
MODCARGO_CRATES +=	tracing-core	0.1.20	# MIT
MODCARGO_CRATES +=	try-lock	0.2.3	# MIT
MODCARGO_CRATES +=	typenum	1.14.0	# MIT OR Apache-2.0
MODCARGO_CRATES +=	unicase	2.6.0	# MIT/Apache-2.0
MODCARGO_CRATES +=	unicode-bidi	0.3.6	# MIT / Apache-2.0
MODCARGO_CRATES +=	unicode-linebreak	0.1.2	# Apache-2.0
MODCARGO_CRATES +=	unicode-normalization	0.1.19	# MIT/Apache-2.0
MODCARGO_CRATES +=	unicode-segmentation	1.8.0	# MIT/Apache-2.0
MODCARGO_CRATES +=	unicode-width	0.1.9	# MIT/Apache-2.0
MODCARGO_CRATES +=	unicode-xid	0.2.2	# MIT OR Apache-2.0
MODCARGO_CRATES +=	unindent	0.1.7	# MIT OR Apache-2.0
MODCARGO_CRATES +=	untrusted	0.7.1	# ISC
MODCARGO_CRATES +=	url	2.2.2	# MIT/Apache-2.0
MODCARGO_CRATES +=	uuid	0.8.2	# Apache-2.0 OR MIT
MODCARGO_CRATES +=	vec_map	0.8.2	# MIT/Apache-2.0
MODCARGO_CRATES +=	version_check	0.9.3	# MIT/Apache-2.0
MODCARGO_CRATES +=	walkdir	2.3.2	# Unlicense/MIT
MODCARGO_CRATES +=	want	0.3.0	# MIT
MODCARGO_CRATES +=	wasi	0.9.0+wasi-snapshot-preview1	# Apache-2.0 WITH LLVM-exception OR Apache-2.0 OR MIT
MODCARGO_CRATES +=	wasi	0.10.2+wasi-snapshot-preview1	# Apache-2.0 WITH LLVM-exception OR Apache-2.0 OR MIT
MODCARGO_CRATES +=	wasm-bindgen	0.2.78	# MIT/Apache-2.0
MODCARGO_CRATES +=	wasm-bindgen-backend	0.2.78	# MIT/Apache-2.0
MODCARGO_CRATES +=	wasm-bindgen-futures	0.4.28	# MIT/Apache-2.0
MODCARGO_CRATES +=	wasm-bindgen-macro	0.2.78	# MIT/Apache-2.0
MODCARGO_CRATES +=	wasm-bindgen-macro-support	0.2.78	# MIT/Apache-2.0
MODCARGO_CRATES +=	wasm-bindgen-shared	0.2.78	# MIT/Apache-2.0
MODCARGO_CRATES +=	web-sys	0.3.55	# MIT/Apache-2.0
MODCARGO_CRATES +=	webpki	0.21.4	# LICENSE
MODCARGO_CRATES +=	webpki-roots	0.21.1	# MPL-2.0
MODCARGO_CRATES +=	winapi	0.3.9	# MIT/Apache-2.0
MODCARGO_CRATES +=	winapi-i686-pc-windows-gnu	0.4.0	# MIT/Apache-2.0
MODCARGO_CRATES +=	winapi-util	0.1.5	# Unlicense/MIT
MODCARGO_CRATES +=	winapi-x86_64-pc-windows-gnu	0.4.0	# MIT/Apache-2.0
MODCARGO_CRATES +=	winreg	0.7.0	# MIT
MODCARGO_CRATES +=	xattr	0.2.2	# MIT/Apache-2.0
MODCARGO_CRATES +=	zip	0.5.13	# MIT
