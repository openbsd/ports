MODCARGO_CRATES +=	addr2line	0.24.2	# Apache-2.0 OR MIT
MODCARGO_CRATES +=	adler2	2.0.0	# 0BSD OR MIT OR Apache-2.0
MODCARGO_CRATES +=	aho-corasick	1.1.3	# Unlicense OR MIT
MODCARGO_CRATES +=	anstream	0.6.18	# MIT OR Apache-2.0
MODCARGO_CRATES +=	anstyle	1.0.10	# MIT OR Apache-2.0
MODCARGO_CRATES +=	anstyle-parse	0.2.6	# MIT OR Apache-2.0
MODCARGO_CRATES +=	anstyle-query	1.1.2	# MIT OR Apache-2.0
MODCARGO_CRATES +=	anstyle-wincon	3.0.7	# MIT OR Apache-2.0
MODCARGO_CRATES +=	arbitrary	1.4.1	# MIT OR Apache-2.0
MODCARGO_CRATES +=	array-init	2.1.0	# MIT OR Apache-2.0
MODCARGO_CRATES +=	backtrace	0.3.74	# MIT OR Apache-2.0
MODCARGO_CRATES +=	bit-vec	0.8.0	# Apache-2.0 OR MIT
MODCARGO_CRATES +=	bitflags	2.8.0	# MIT OR Apache-2.0
MODCARGO_CRATES +=	block-buffer	0.10.4	# MIT OR Apache-2.0
MODCARGO_CRATES +=	bstr	1.11.3	# MIT OR Apache-2.0
MODCARGO_CRATES +=	byteorder	1.5.0	# Unlicense OR MIT
MODCARGO_CRATES +=	bzip2	0.5.1	# MIT OR Apache-2.0
MODCARGO_CRATES +=	bzip2-sys	0.1.12+1.0.8	# MIT/Apache-2.0
MODCARGO_CRATES +=	cc	1.2.15	# MIT OR Apache-2.0
MODCARGO_CRATES +=	cfg-if	1.0.0	# MIT/Apache-2.0
MODCARGO_CRATES +=	clap	4.5.31	# MIT OR Apache-2.0
MODCARGO_CRATES +=	clap_builder	4.5.31	# MIT OR Apache-2.0
MODCARGO_CRATES +=	clap_derive	4.5.28	# MIT OR Apache-2.0
MODCARGO_CRATES +=	clap_lex	0.7.4	# MIT OR Apache-2.0
MODCARGO_CRATES +=	colorchoice	1.0.3	# MIT OR Apache-2.0
MODCARGO_CRATES +=	concat_const	0.1.3	# MIT OR Apache-2.0
MODCARGO_CRATES +=	cpufeatures	0.2.17	# MIT OR Apache-2.0
MODCARGO_CRATES +=	crc32fast	1.4.2	# MIT OR Apache-2.0
MODCARGO_CRATES +=	crossbeam-utils	0.8.21	# MIT OR Apache-2.0
MODCARGO_CRATES +=	crypto-common	0.1.6	# MIT OR Apache-2.0
MODCARGO_CRATES +=	cstr	0.2.12	# MIT
MODCARGO_CRATES +=	curl-sys	0.4.80+curl-8.12.1	# MIT
MODCARGO_CRATES +=	derive_arbitrary	1.4.1	# MIT/Apache-2.0
MODCARGO_CRATES +=	derive_more	1.0.0	# MIT
MODCARGO_CRATES +=	derive_more-impl	1.0.0	# MIT
MODCARGO_CRATES +=	digest	0.10.7	# MIT OR Apache-2.0
MODCARGO_CRATES +=	displaydoc	0.2.5	# MIT OR Apache-2.0
MODCARGO_CRATES +=	either	1.14.0	# MIT OR Apache-2.0
MODCARGO_CRATES +=	equivalent	1.0.2	# Apache-2.0 OR MIT
MODCARGO_CRATES +=	errno	0.3.10	# MIT OR Apache-2.0
MODCARGO_CRATES +=	fastrand	2.3.0	# Apache-2.0 OR MIT
MODCARGO_CRATES +=	filetime	0.2.25	# MIT/Apache-2.0
MODCARGO_CRATES +=	flate2	1.1.0	# MIT OR Apache-2.0
MODCARGO_CRATES +=	form_urlencoded	1.2.1	# MIT OR Apache-2.0
MODCARGO_CRATES +=	generic-array	0.14.7	# MIT
MODCARGO_CRATES +=	getrandom	0.2.15	# MIT OR Apache-2.0
MODCARGO_CRATES +=	getset	0.1.5	# MIT
MODCARGO_CRATES +=	gimli	0.31.1	# MIT OR Apache-2.0
MODCARGO_CRATES +=	git-version	0.3.9	# BSD-2-Clause
MODCARGO_CRATES +=	git-version-macro	0.3.9	# BSD-2-Clause
MODCARGO_CRATES +=	hashbrown	0.15.2	# MIT OR Apache-2.0
MODCARGO_CRATES +=	heck	0.5.0	# MIT OR Apache-2.0
MODCARGO_CRATES +=	hex	0.4.3	# MIT OR Apache-2.0
MODCARGO_CRATES +=	hex-literal	0.4.1	# MIT OR Apache-2.0
MODCARGO_CRATES +=	icu_collections	1.5.0	# Unicode-3.0
MODCARGO_CRATES +=	icu_locid	1.5.0	# Unicode-3.0
MODCARGO_CRATES +=	icu_locid_transform	1.5.0	# Unicode-3.0
MODCARGO_CRATES +=	icu_locid_transform_data	1.5.0	# Unicode-3.0
MODCARGO_CRATES +=	icu_normalizer	1.5.0	# Unicode-3.0
MODCARGO_CRATES +=	icu_normalizer_data	1.5.0	# Unicode-3.0
MODCARGO_CRATES +=	icu_properties	1.5.1	# Unicode-3.0
MODCARGO_CRATES +=	icu_properties_data	1.5.0	# Unicode-3.0
MODCARGO_CRATES +=	icu_provider	1.5.0	# Unicode-3.0
MODCARGO_CRATES +=	icu_provider_macros	1.5.0	# Unicode-3.0
MODCARGO_CRATES +=	idna	1.0.3	# MIT OR Apache-2.0
MODCARGO_CRATES +=	idna_adapter	1.2.0	# Apache-2.0 OR MIT
MODCARGO_CRATES +=	indexmap	2.7.1	# Apache-2.0 OR MIT
MODCARGO_CRATES +=	is_terminal_polyfill	1.70.1	# MIT OR Apache-2.0
MODCARGO_CRATES +=	itertools	0.14.0	# MIT OR Apache-2.0
MODCARGO_CRATES +=	jobserver	0.1.32	# MIT OR Apache-2.0
MODCARGO_CRATES +=	libc	0.2.170	# MIT OR Apache-2.0
MODCARGO_CRATES +=	libredox	0.1.3	# MIT
MODCARGO_CRATES +=	libz-sys	1.1.21	# MIT OR Apache-2.0
MODCARGO_CRATES +=	linux-raw-sys	0.4.15	# Apache-2.0 WITH LLVM-exception OR Apache-2.0 OR MIT
MODCARGO_CRATES +=	litemap	0.7.4	# Unicode-3.0
MODCARGO_CRATES +=	log	0.4.26	# MIT OR Apache-2.0
MODCARGO_CRATES +=	lru	0.12.5	# MIT
MODCARGO_CRATES +=	lzma-sys	0.1.20	# MIT/Apache-2.0
MODCARGO_CRATES +=	make-cmd	0.1.0	# MIT
MODCARGO_CRATES +=	memchr	2.7.4	# Unlicense OR MIT
MODCARGO_CRATES +=	miniz_oxide	0.8.5	# MIT OR Zlib OR Apache-2.0
MODCARGO_CRATES +=	mio	1.0.3	# MIT
MODCARGO_CRATES +=	object	0.36.7	# Apache-2.0 OR MIT
MODCARGO_CRATES +=	once_cell	1.20.3	# MIT OR Apache-2.0
MODCARGO_CRATES +=	openssl-sys	0.9.106	# MIT
MODCARGO_CRATES +=	percent-encoding	2.3.1	# MIT OR Apache-2.0
MODCARGO_CRATES +=	pkg-config	0.3.31	# MIT OR Apache-2.0
MODCARGO_CRATES +=	ppv-lite86	0.2.20	# MIT/Apache-2.0
MODCARGO_CRATES +=	proc-macro-error-attr2	2.0.0	# MIT OR Apache-2.0
MODCARGO_CRATES +=	proc-macro-error2	2.0.1	# MIT OR Apache-2.0
MODCARGO_CRATES +=	proc-macro2	1.0.93	# MIT OR Apache-2.0
MODCARGO_CRATES +=	quote	1.0.38	# MIT OR Apache-2.0
MODCARGO_CRATES +=	rand	0.8.5	# MIT OR Apache-2.0
MODCARGO_CRATES +=	rand_chacha	0.3.1	# MIT OR Apache-2.0
MODCARGO_CRATES +=	rand_core	0.6.4	# MIT OR Apache-2.0
MODCARGO_CRATES +=	redox_syscall	0.5.9	# MIT
MODCARGO_CRATES +=	regex	1.11.1	# MIT OR Apache-2.0
MODCARGO_CRATES +=	regex-automata	0.4.9	# MIT OR Apache-2.0
MODCARGO_CRATES +=	regex-syntax	0.8.5	# MIT OR Apache-2.0
MODCARGO_CRATES +=	rustc-demangle	0.1.24	# MIT/Apache-2.0
MODCARGO_CRATES +=	rustflags	0.1.6	# MIT OR Apache-2.0
MODCARGO_CRATES +=	rustix	0.38.44	# Apache-2.0 WITH LLVM-exception OR Apache-2.0 OR MIT
MODCARGO_CRATES +=	semver	1.0.25	# MIT OR Apache-2.0
MODCARGO_CRATES +=	serde	1.0.218	# MIT OR Apache-2.0
MODCARGO_CRATES +=	serde_derive	1.0.218	# MIT OR Apache-2.0
MODCARGO_CRATES +=	sha1	0.10.6	# MIT OR Apache-2.0
MODCARGO_CRATES +=	shared_child	1.0.1	# MIT
MODCARGO_CRATES +=	shlex	1.3.0	# MIT OR Apache-2.0
MODCARGO_CRATES +=	smallvec	1.14.0	# MIT OR Apache-2.0
MODCARGO_CRATES +=	stable_deref_trait	1.2.0	# MIT/Apache-2.0
MODCARGO_CRATES +=	strsim	0.11.1	# MIT
MODCARGO_CRATES +=	syn	2.0.98	# MIT OR Apache-2.0
MODCARGO_CRATES +=	synstructure	0.13.1	# MIT
MODCARGO_CRATES +=	tar	0.4.44	# MIT OR Apache-2.0
MODCARGO_CRATES +=	target	2.1.0	# CC0-1.0
MODCARGO_CRATES +=	tee	0.1.0	# MIT
MODCARGO_CRATES +=	tempfile	3.15.0	# MIT OR Apache-2.0
MODCARGO_CRATES +=	thiserror	2.0.11	# MIT OR Apache-2.0
MODCARGO_CRATES +=	thiserror-impl	2.0.11	# MIT OR Apache-2.0
MODCARGO_CRATES +=	tinystr	0.7.6	# Unicode-3.0
MODCARGO_CRATES +=	typenum	1.18.0	# MIT OR Apache-2.0
MODCARGO_CRATES +=	unicode-ident	1.0.17	# (MIT OR Apache-2.0) AND Unicode-3.0
MODCARGO_CRATES +=	unicode-xid	0.2.6	# MIT OR Apache-2.0
MODCARGO_CRATES +=	url	2.5.4	# MIT OR Apache-2.0
MODCARGO_CRATES +=	utf16_iter	1.0.5	# Apache-2.0 OR MIT
MODCARGO_CRATES +=	utf8_iter	1.0.4	# Apache-2.0 OR MIT
MODCARGO_CRATES +=	utf8parse	0.2.2	# Apache-2.0 OR MIT
MODCARGO_CRATES +=	vcpkg	0.2.15	# MIT/Apache-2.0
MODCARGO_CRATES +=	version_check	0.9.5	# MIT/Apache-2.0
MODCARGO_CRATES +=	wasi	0.11.0+wasi-snapshot-preview1	# Apache-2.0 WITH LLVM-exception OR Apache-2.0 OR MIT
MODCARGO_CRATES +=	windows-sys	0.52.0	# MIT OR Apache-2.0
MODCARGO_CRATES +=	windows-sys	0.59.0	# MIT OR Apache-2.0
MODCARGO_CRATES +=	windows-targets	0.52.6	# MIT OR Apache-2.0
MODCARGO_CRATES +=	windows_aarch64_gnullvm	0.52.6	# MIT OR Apache-2.0
MODCARGO_CRATES +=	windows_aarch64_msvc	0.52.6	# MIT OR Apache-2.0
MODCARGO_CRATES +=	windows_i686_gnu	0.52.6	# MIT OR Apache-2.0
MODCARGO_CRATES +=	windows_i686_gnullvm	0.52.6	# MIT OR Apache-2.0
MODCARGO_CRATES +=	windows_i686_msvc	0.52.6	# MIT OR Apache-2.0
MODCARGO_CRATES +=	windows_x86_64_gnu	0.52.6	# MIT OR Apache-2.0
MODCARGO_CRATES +=	windows_x86_64_gnullvm	0.52.6	# MIT OR Apache-2.0
MODCARGO_CRATES +=	windows_x86_64_msvc	0.52.6	# MIT OR Apache-2.0
MODCARGO_CRATES +=	write16	1.0.0	# Apache-2.0 OR MIT
MODCARGO_CRATES +=	writeable	0.5.5	# Unicode-3.0
MODCARGO_CRATES +=	xattr	1.4.0	# MIT/Apache-2.0
MODCARGO_CRATES +=	xz2	0.1.7	# MIT/Apache-2.0
MODCARGO_CRATES +=	yoke	0.7.5	# Unicode-3.0
MODCARGO_CRATES +=	yoke-derive	0.7.5	# Unicode-3.0
MODCARGO_CRATES +=	zerocopy	0.7.35	# BSD-2-Clause OR Apache-2.0 OR MIT
MODCARGO_CRATES +=	zerocopy-derive	0.7.35	# BSD-2-Clause OR Apache-2.0 OR MIT
MODCARGO_CRATES +=	zerofrom	0.1.5	# Unicode-3.0
MODCARGO_CRATES +=	zerofrom-derive	0.1.5	# Unicode-3.0
MODCARGO_CRATES +=	zerovec	0.10.4	# Unicode-3.0
MODCARGO_CRATES +=	zerovec-derive	0.10.3	# Unicode-3.0
MODCARGO_CRATES +=	zip	2.2.3	# MIT
MODCARGO_CRATES +=	zstd	0.13.3	# MIT
MODCARGO_CRATES +=	zstd-safe	7.2.3	# MIT OR Apache-2.0
MODCARGO_CRATES +=	zstd-sys	2.0.14+zstd.1.5.7	# MIT/Apache-2.0
