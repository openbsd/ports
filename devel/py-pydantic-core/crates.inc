MODCARGO_CRATES +=	ahash	0.8.12	# MIT OR Apache-2.0
MODCARGO_CRATES +=	aho-corasick	1.1.3	# Unlicense OR MIT
MODCARGO_CRATES +=	autocfg	1.3.0	# Apache-2.0 OR MIT
MODCARGO_CRATES +=	base64	0.22.1	# MIT OR Apache-2.0
MODCARGO_CRATES +=	bitflags	2.9.1	# MIT OR Apache-2.0
MODCARGO_CRATES +=	bitvec	1.0.1	# MIT
MODCARGO_CRATES +=	bumpalo	3.19.0	# MIT OR Apache-2.0
MODCARGO_CRATES +=	cc	1.0.101	# MIT OR Apache-2.0
MODCARGO_CRATES +=	cfg-if	1.0.0	# MIT/Apache-2.0
MODCARGO_CRATES +=	displaydoc	0.2.5	# MIT OR Apache-2.0
MODCARGO_CRATES +=	enum_dispatch	0.3.13	# MIT OR Apache-2.0
MODCARGO_CRATES +=	form_urlencoded	1.2.1	# MIT OR Apache-2.0
MODCARGO_CRATES +=	funty	2.0.0	# MIT
MODCARGO_CRATES +=	getrandom	0.3.3	# MIT OR Apache-2.0
MODCARGO_CRATES +=	heck	0.5.0	# MIT OR Apache-2.0
MODCARGO_CRATES +=	hex	0.4.3	# MIT OR Apache-2.0
MODCARGO_CRATES +=	icu_collections	1.5.0	# Unicode-3.0
MODCARGO_CRATES +=	icu_locid	1.5.0	# Unicode-3.0
MODCARGO_CRATES +=	icu_locid_transform	1.5.0	# Unicode-3.0
MODCARGO_CRATES +=	icu_locid_transform_data	1.5.0	# Unicode-3.0
MODCARGO_CRATES +=	icu_normalizer	1.5.0	# Unicode-3.0
MODCARGO_CRATES +=	icu_normalizer_data	1.5.0	# Unicode-3.0
MODCARGO_CRATES +=	icu_properties	1.5.1	# Unicode-3.0
MODCARGO_CRATES +=	icu_properties_data	1.5.0	# Unicode-3.0
MODCARGO_CRATES +=	icu_provider	1.5.0	# Unicode-3.0
MODCARGO_CRATES +=	icu_provider_macros	1.5.0	# Unicode-3.0
MODCARGO_CRATES +=	idna	1.1.0	# MIT OR Apache-2.0
MODCARGO_CRATES +=	idna_adapter	1.2.0	# Apache-2.0 OR MIT
MODCARGO_CRATES +=	indoc	2.0.5	# MIT OR Apache-2.0
MODCARGO_CRATES +=	itoa	1.0.11	# MIT OR Apache-2.0
MODCARGO_CRATES +=	jiter	0.11.1	# MIT
MODCARGO_CRATES +=	js-sys	0.3.77	# MIT OR Apache-2.0
MODCARGO_CRATES +=	lexical-parse-float	1.0.5	# MIT/Apache-2.0
MODCARGO_CRATES +=	lexical-parse-integer	1.0.5	# MIT/Apache-2.0
MODCARGO_CRATES +=	lexical-util	1.0.6	# MIT/Apache-2.0
MODCARGO_CRATES +=	libc	0.2.155	# MIT OR Apache-2.0
MODCARGO_CRATES +=	litemap	0.7.3	# Unicode-3.0
MODCARGO_CRATES +=	log	0.4.27	# MIT OR Apache-2.0
MODCARGO_CRATES +=	memchr	2.7.4	# Unlicense OR MIT
MODCARGO_CRATES +=	memoffset	0.9.1	# MIT
MODCARGO_CRATES +=	num-bigint	0.4.6	# MIT OR Apache-2.0
MODCARGO_CRATES +=	num-integer	0.1.46	# MIT OR Apache-2.0
MODCARGO_CRATES +=	num-traits	0.2.19	# MIT OR Apache-2.0
MODCARGO_CRATES +=	once_cell	1.21.3	# MIT OR Apache-2.0
MODCARGO_CRATES +=	percent-encoding	2.3.2	# MIT OR Apache-2.0
MODCARGO_CRATES +=	portable-atomic	1.6.0	# Apache-2.0 OR MIT
MODCARGO_CRATES +=	proc-macro2	1.0.86	# MIT OR Apache-2.0
MODCARGO_CRATES +=	pyo3	0.26.0	# MIT OR Apache-2.0
MODCARGO_CRATES +=	pyo3-build-config	0.26.0	# MIT OR Apache-2.0
MODCARGO_CRATES +=	pyo3-ffi	0.26.0	# MIT OR Apache-2.0
MODCARGO_CRATES +=	pyo3-macros	0.26.0	# MIT OR Apache-2.0
MODCARGO_CRATES +=	pyo3-macros-backend	0.26.0	# MIT OR Apache-2.0
MODCARGO_CRATES +=	python3-dll-a	0.2.14	# MIT
MODCARGO_CRATES +=	quote	1.0.36	# MIT OR Apache-2.0
MODCARGO_CRATES +=	r-efi	5.2.0	# MIT OR Apache-2.0 OR LGPL-2.1-or-later
MODCARGO_CRATES +=	radium	0.7.0	# MIT
MODCARGO_CRATES +=	regex	1.12.2	# MIT OR Apache-2.0
MODCARGO_CRATES +=	regex-automata	0.4.13	# MIT OR Apache-2.0
MODCARGO_CRATES +=	regex-syntax	0.8.5	# MIT OR Apache-2.0
MODCARGO_CRATES +=	rustversion	1.0.17	# MIT OR Apache-2.0
MODCARGO_CRATES +=	ryu	1.0.18	# Apache-2.0 OR BSL-1.0
MODCARGO_CRATES +=	serde	1.0.228	# MIT OR Apache-2.0
MODCARGO_CRATES +=	serde_core	1.0.228	# MIT OR Apache-2.0
MODCARGO_CRATES +=	serde_derive	1.0.228	# MIT OR Apache-2.0
MODCARGO_CRATES +=	serde_json	1.0.145	# MIT OR Apache-2.0
MODCARGO_CRATES +=	smallvec	1.15.1	# MIT OR Apache-2.0
MODCARGO_CRATES +=	speedate	0.17.0	# MIT
MODCARGO_CRATES +=	stable_deref_trait	1.2.0	# MIT/Apache-2.0
MODCARGO_CRATES +=	static_assertions	1.1.0	# MIT OR Apache-2.0
MODCARGO_CRATES +=	strum	0.27.2	# MIT
MODCARGO_CRATES +=	strum_macros	0.27.2	# MIT
MODCARGO_CRATES +=	syn	2.0.82	# MIT OR Apache-2.0
MODCARGO_CRATES +=	synstructure	0.13.1	# MIT
MODCARGO_CRATES +=	tap	1.0.1	# MIT
MODCARGO_CRATES +=	target-lexicon	0.13.2	# Apache-2.0 WITH LLVM-exception
MODCARGO_CRATES +=	tinystr	0.7.6	# Unicode-3.0
MODCARGO_CRATES +=	unicode-ident	1.0.12	# (MIT OR Apache-2.0) AND Unicode-DFS-2016
MODCARGO_CRATES +=	unindent	0.2.3	# MIT OR Apache-2.0
MODCARGO_CRATES +=	url	2.5.4	# MIT OR Apache-2.0
MODCARGO_CRATES +=	utf16_iter	1.0.5	# Apache-2.0 OR MIT
MODCARGO_CRATES +=	utf8_iter	1.0.4	# Apache-2.0 OR MIT
MODCARGO_CRATES +=	uuid	1.18.1	# Apache-2.0 OR MIT
MODCARGO_CRATES +=	version_check	0.9.5	# MIT/Apache-2.0
MODCARGO_CRATES +=	wasi	0.14.2+wasi-0.2.4	# Apache-2.0 WITH LLVM-exception OR Apache-2.0 OR MIT
MODCARGO_CRATES +=	wasm-bindgen	0.2.100	# MIT OR Apache-2.0
MODCARGO_CRATES +=	wasm-bindgen-backend	0.2.100	# MIT OR Apache-2.0
MODCARGO_CRATES +=	wasm-bindgen-macro	0.2.100	# MIT OR Apache-2.0
MODCARGO_CRATES +=	wasm-bindgen-macro-support	0.2.100	# MIT OR Apache-2.0
MODCARGO_CRATES +=	wasm-bindgen-shared	0.2.100	# MIT OR Apache-2.0
MODCARGO_CRATES +=	wit-bindgen-rt	0.39.0	# Apache-2.0 WITH LLVM-exception OR Apache-2.0 OR MIT
MODCARGO_CRATES +=	write16	1.0.0	# Apache-2.0 OR MIT
MODCARGO_CRATES +=	writeable	0.5.5	# Unicode-3.0
MODCARGO_CRATES +=	wyz	0.5.1	# MIT
MODCARGO_CRATES +=	yoke	0.7.4	# Unicode-3.0
MODCARGO_CRATES +=	yoke-derive	0.7.4	# Unicode-3.0
MODCARGO_CRATES +=	zerocopy	0.8.25	# BSD-2-Clause OR Apache-2.0 OR MIT
MODCARGO_CRATES +=	zerocopy-derive	0.8.25	# BSD-2-Clause OR Apache-2.0 OR MIT
MODCARGO_CRATES +=	zerofrom	0.1.4	# Unicode-3.0
MODCARGO_CRATES +=	zerofrom-derive	0.1.4	# Unicode-3.0
MODCARGO_CRATES +=	zerovec	0.10.4	# Unicode-3.0
MODCARGO_CRATES +=	zerovec-derive	0.10.3	# Unicode-3.0
