MODCARGO_CRATES +=	adler2	2.0.1	# 0BSD OR MIT OR Apache-2.0
MODCARGO_CRATES +=	aho-corasick	1.1.4	# Unlicense OR MIT
MODCARGO_CRATES +=	android_system_properties	0.1.5	# MIT/Apache-2.0
MODCARGO_CRATES +=	anstream	1.0.0	# MIT OR Apache-2.0
MODCARGO_CRATES +=	anstyle	1.0.14	# MIT OR Apache-2.0
MODCARGO_CRATES +=	anstyle-parse	1.0.0	# MIT OR Apache-2.0
MODCARGO_CRATES +=	anstyle-query	1.1.5	# MIT OR Apache-2.0
MODCARGO_CRATES +=	anstyle-wincon	3.0.11	# MIT OR Apache-2.0
MODCARGO_CRATES +=	arrayvec	0.7.8	# MIT OR Apache-2.0
MODCARGO_CRATES +=	assert_cmd	2.2.2	# MIT OR Apache-2.0
MODCARGO_CRATES +=	autocfg	1.5.1	# Apache-2.0 OR MIT
MODCARGO_CRATES +=	bitflags	2.13.0	# MIT OR Apache-2.0
MODCARGO_CRATES +=	boxcar	0.2.14	# MIT
MODCARGO_CRATES +=	bstr	1.12.3	# MIT OR Apache-2.0
MODCARGO_CRATES +=	bumpalo	3.20.3	# MIT OR Apache-2.0
MODCARGO_CRATES +=	caplog	0.3.0	# MIT OR Apache-2.0
MODCARGO_CRATES +=	cc	1.2.67	# MIT OR Apache-2.0
MODCARGO_CRATES +=	cfg-if	1.0.4	# MIT OR Apache-2.0
MODCARGO_CRATES +=	chrono	0.4.45	# MIT OR Apache-2.0
MODCARGO_CRATES +=	clap	4.6.1	# MIT OR Apache-2.0
MODCARGO_CRATES +=	clap_builder	4.6.0	# MIT OR Apache-2.0
MODCARGO_CRATES +=	clap_derive	4.6.1	# MIT OR Apache-2.0
MODCARGO_CRATES +=	clap_lex	1.1.0	# MIT OR Apache-2.0
MODCARGO_CRATES +=	colorchoice	1.0.5	# MIT OR Apache-2.0
MODCARGO_CRATES +=	console	0.16.4	# MIT
MODCARGO_CRATES +=	core-foundation-sys	0.8.7	# MIT OR Apache-2.0
MODCARGO_CRATES +=	crc32fast	1.5.0	# MIT OR Apache-2.0
MODCARGO_CRATES +=	derive_more	0.99.20	# MIT
MODCARGO_CRATES +=	derive_more	2.1.1	# MIT
MODCARGO_CRATES +=	derive_more-impl	2.1.1	# MIT
MODCARGO_CRATES +=	diff	0.1.13	# MIT OR Apache-2.0
MODCARGO_CRATES +=	difflib	0.4.0	# MIT
MODCARGO_CRATES +=	diffy-imara	0.3.2	# MIT OR Apache-2.0
MODCARGO_CRATES +=	either	1.16.0	# MIT OR Apache-2.0
MODCARGO_CRATES +=	encode_unicode	1.0.0	# Apache-2.0 OR MIT
MODCARGO_CRATES +=	equivalent	1.0.2	# Apache-2.0 OR MIT
MODCARGO_CRATES +=	errno	0.3.14	# MIT OR Apache-2.0
MODCARGO_CRATES +=	etcetera	0.11.0	# MIT OR Apache-2.0
MODCARGO_CRATES +=	fastrand	2.4.1	# Apache-2.0 OR MIT
MODCARGO_CRATES +=	find-msvc-tools	0.1.9	# MIT OR Apache-2.0
MODCARGO_CRATES +=	fixedbitset	0.4.2	# MIT/Apache-2.0
MODCARGO_CRATES +=	flate2	1.1.9	# MIT OR Apache-2.0
MODCARGO_CRATES +=	foldhash	0.1.5	# Zlib
MODCARGO_CRATES +=	futures-core	0.3.32	# MIT OR Apache-2.0
MODCARGO_CRATES +=	futures-task	0.3.32	# MIT OR Apache-2.0
MODCARGO_CRATES +=	futures-util	0.3.32	# MIT OR Apache-2.0
MODCARGO_CRATES +=	getrandom	0.3.4	# MIT OR Apache-2.0
MODCARGO_CRATES +=	getrandom	0.4.3	# MIT OR Apache-2.0
MODCARGO_CRATES +=	glob	0.3.3	# MIT OR Apache-2.0
MODCARGO_CRATES +=	hashbrown	0.12.3	# MIT OR Apache-2.0
MODCARGO_CRATES +=	hashbrown	0.15.5	# MIT OR Apache-2.0
MODCARGO_CRATES +=	hashbrown	0.17.1	# MIT OR Apache-2.0
MODCARGO_CRATES +=	heck	0.5.0	# MIT OR Apache-2.0
MODCARGO_CRATES +=	hermit-abi	0.5.2	# MIT OR Apache-2.0
MODCARGO_CRATES +=	iana-time-zone	0.1.65	# MIT OR Apache-2.0
MODCARGO_CRATES +=	iana-time-zone-haiku	0.1.2	# MIT OR Apache-2.0
MODCARGO_CRATES +=	imara-diff	0.1.8	# Apache-2.0
MODCARGO_CRATES +=	indexmap	1.9.3	# Apache-2.0 OR MIT
MODCARGO_CRATES +=	indexmap	2.14.0	# Apache-2.0 OR MIT
MODCARGO_CRATES +=	insta	1.48.0	# Apache-2.0
MODCARGO_CRATES +=	integer-sqrt	0.1.5	# Apache-2.0/MIT
MODCARGO_CRATES +=	is-terminal	0.4.17	# MIT
MODCARGO_CRATES +=	is_terminal_polyfill	1.70.2	# MIT OR Apache-2.0
MODCARGO_CRATES +=	itertools	0.10.5	# MIT/Apache-2.0
MODCARGO_CRATES +=	itertools	0.15.0	# MIT OR Apache-2.0
MODCARGO_CRATES +=	itoa	1.0.18	# MIT OR Apache-2.0
MODCARGO_CRATES +=	js-sys	0.3.103	# MIT OR Apache-2.0
MODCARGO_CRATES +=	lazy_static	1.5.0	# MIT OR Apache-2.0
MODCARGO_CRATES +=	libc	0.2.186	# MIT OR Apache-2.0
MODCARGO_CRATES +=	linux-raw-sys	0.12.1	# Apache-2.0 WITH LLVM-exception OR Apache-2.0 OR MIT
MODCARGO_CRATES +=	log	0.4.33	# MIT OR Apache-2.0
MODCARGO_CRATES +=	memchr	2.8.3	# Unlicense OR MIT
MODCARGO_CRATES +=	miniz_oxide	0.8.9	# MIT OR Zlib OR Apache-2.0
MODCARGO_CRATES +=	nonempty-collections	1.3.0	# MIT
MODCARGO_CRATES +=	nu-ansi-term	0.50.3	# MIT
MODCARGO_CRATES +=	num-traits	0.2.19	# MIT OR Apache-2.0
MODCARGO_CRATES +=	once_cell	1.21.4	# MIT OR Apache-2.0
MODCARGO_CRATES +=	once_cell_polyfill	1.70.2	# MIT OR Apache-2.0
MODCARGO_CRATES +=	oneshot	0.2.1	# MIT OR Apache-2.0
MODCARGO_CRATES +=	pathfinding	3.0.14	# Apache-2.0/MIT
MODCARGO_CRATES +=	pin-project-lite	0.2.17	# Apache-2.0 OR MIT
MODCARGO_CRATES +=	ppv-lite86	0.2.21	# MIT OR Apache-2.0
MODCARGO_CRATES +=	predicates	3.1.4	# MIT OR Apache-2.0
MODCARGO_CRATES +=	predicates-core	1.0.10	# MIT OR Apache-2.0
MODCARGO_CRATES +=	predicates-tree	1.0.13	# MIT OR Apache-2.0
MODCARGO_CRATES +=	pretty_assertions	1.4.1	# MIT OR Apache-2.0
MODCARGO_CRATES +=	proc-macro2	1.0.106	# MIT OR Apache-2.0
MODCARGO_CRATES +=	quote	1.0.46	# MIT OR Apache-2.0
MODCARGO_CRATES +=	r-efi	5.3.0	# MIT OR Apache-2.0 OR LGPL-2.1-or-later
MODCARGO_CRATES +=	r-efi	6.0.0	# MIT OR Apache-2.0 OR LGPL-2.1-or-later
MODCARGO_CRATES +=	rand	0.9.5	# MIT OR Apache-2.0
MODCARGO_CRATES +=	rand_chacha	0.9.0	# MIT OR Apache-2.0
MODCARGO_CRATES +=	rand_core	0.9.5	# MIT OR Apache-2.0
MODCARGO_CRATES +=	regex	1.13.0	# MIT OR Apache-2.0
MODCARGO_CRATES +=	regex-automata	0.4.15	# MIT OR Apache-2.0
MODCARGO_CRATES +=	regex-syntax	0.8.11	# MIT OR Apache-2.0
MODCARGO_CRATES +=	relative-path	1.9.3	# MIT OR Apache-2.0
MODCARGO_CRATES +=	rstest	0.26.1	# MIT OR Apache-2.0
MODCARGO_CRATES +=	rstest_macros	0.26.1	# MIT OR Apache-2.0
MODCARGO_CRATES +=	rustc-hash	1.1.0	# Apache-2.0/MIT
MODCARGO_CRATES +=	rustc-hash	2.1.3	# Apache-2.0 OR MIT
MODCARGO_CRATES +=	rustc_version	0.4.1	# MIT OR Apache-2.0
MODCARGO_CRATES +=	rustix	1.1.4	# Apache-2.0 WITH LLVM-exception OR Apache-2.0 OR MIT
MODCARGO_CRATES +=	rustversion	1.0.23	# MIT OR Apache-2.0
MODCARGO_CRATES +=	semver	1.0.28	# MIT OR Apache-2.0
MODCARGO_CRATES +=	serde	1.0.228	# MIT OR Apache-2.0
MODCARGO_CRATES +=	serde_core	1.0.228	# MIT OR Apache-2.0
MODCARGO_CRATES +=	serde_derive	1.0.228	# MIT OR Apache-2.0
MODCARGO_CRATES +=	serde_json	1.0.150	# MIT OR Apache-2.0
MODCARGO_CRATES +=	shlex	2.0.1	# MIT OR Apache-2.0
MODCARGO_CRATES +=	simd-adler32	0.3.9	# MIT
MODCARGO_CRATES +=	similar	2.7.0	# Apache-2.0
MODCARGO_CRATES +=	slab	0.4.12	# MIT
MODCARGO_CRATES +=	stderrlog	0.6.0	# MIT OR Apache-2.0
MODCARGO_CRATES +=	streaming-iterator	0.1.9	# MIT OR Apache-2.0
MODCARGO_CRATES +=	strsim	0.11.1	# MIT
MODCARGO_CRATES +=	syn	2.0.118	# MIT OR Apache-2.0
MODCARGO_CRATES +=	tempfile	3.27.0	# MIT OR Apache-2.0
MODCARGO_CRATES +=	termcolor	1.1.3	# Unlicense OR MIT
MODCARGO_CRATES +=	termtree	0.5.1	# MIT
MODCARGO_CRATES +=	thiserror	1.0.69	# MIT OR Apache-2.0
MODCARGO_CRATES +=	thiserror	2.0.18	# MIT OR Apache-2.0
MODCARGO_CRATES +=	thiserror-impl	1.0.69	# MIT OR Apache-2.0
MODCARGO_CRATES +=	thiserror-impl	2.0.18	# MIT OR Apache-2.0
MODCARGO_CRATES +=	thread_local	1.1.10	# MIT OR Apache-2.0
MODCARGO_CRATES +=	tree-edit-distance	0.4.0	# MIT
MODCARGO_CRATES +=	tree-sitter	0.26.11	# MIT
MODCARGO_CRATES +=	tree-sitter-bash	0.25.1	# MIT
MODCARGO_CRATES +=	tree-sitter-c	0.24.2	# MIT
MODCARGO_CRATES +=	tree-sitter-c-sharp	0.23.5	# MIT
MODCARGO_CRATES +=	tree-sitter-cmake	0.7.4	# MIT
MODCARGO_CRATES +=	tree-sitter-cpp	0.23.4	# MIT
MODCARGO_CRATES +=	tree-sitter-dart-orchard	0.3.2	# MIT
MODCARGO_CRATES +=	tree-sitter-devicetree	0.15.0	# MIT
MODCARGO_CRATES +=	tree-sitter-elixir	0.3.5	# Apache-2.0
MODCARGO_CRATES +=	tree-sitter-fortran	0.6.0	# MIT
MODCARGO_CRATES +=	tree-sitter-gleam	1.0.0	# Apache-2.0
MODCARGO_CRATES +=	tree-sitter-go	0.25.0	# MIT
MODCARGO_CRATES +=	tree-sitter-gomod-orchard	0.5.3	# MIT
MODCARGO_CRATES +=	tree-sitter-gosum-orchard	0.3.2	# MIT
MODCARGO_CRATES +=	tree-sitter-haskell	0.23.1	# MIT
MODCARGO_CRATES +=	tree-sitter-hcl	1.1.0	# Apache-2.0
MODCARGO_CRATES +=	tree-sitter-html	0.23.2	# MIT
MODCARGO_CRATES +=	tree-sitter-ini	1.4.0	# Apache-2.0
MODCARGO_CRATES +=	tree-sitter-java-orchard	0.5.8	# MIT
MODCARGO_CRATES +=	tree-sitter-javascript	0.25.0	# MIT
MODCARGO_CRATES +=	tree-sitter-json	0.24.8	# MIT
MODCARGO_CRATES +=	tree-sitter-kotlin-ng	1.1.0	# MIT
MODCARGO_CRATES +=	tree-sitter-language	0.1.7	# MIT
MODCARGO_CRATES +=	tree-sitter-lua	0.5.0	# MIT
MODCARGO_CRATES +=	tree-sitter-make	1.1.1	# MIT
MODCARGO_CRATES +=	tree-sitter-md	0.5.3	# MIT
MODCARGO_CRATES +=	tree-sitter-nix	0.3.0	# MIT
MODCARGO_CRATES +=	tree-sitter-ocaml	0.25.0	# MIT
MODCARGO_CRATES +=	tree-sitter-php	0.24.2	# MIT
MODCARGO_CRATES +=	tree-sitter-properties	0.3.0	# MIT
MODCARGO_CRATES +=	tree-sitter-python-orchard	0.4.2	# MIT
MODCARGO_CRATES +=	tree-sitter-r	1.3.0	# MIT
MODCARGO_CRATES +=	tree-sitter-requirements	0.6.1	# MIT
MODCARGO_CRATES +=	tree-sitter-ruby	0.23.1	# MIT
MODCARGO_CRATES +=	tree-sitter-rust-orchard	0.16.8	# MIT
MODCARGO_CRATES +=	tree-sitter-scala	0.26.0	# MIT
MODCARGO_CRATES +=	tree-sitter-scheme	0.24.7	# MIT
MODCARGO_CRATES +=	tree-sitter-solidity	1.2.13	# MIT
MODCARGO_CRATES +=	tree-sitter-starlark	1.3.0	# MIT
MODCARGO_CRATES +=	tree-sitter-systemverilog	0.3.1	# MIT
MODCARGO_CRATES +=	tree-sitter-toml-ng	0.7.0	# MIT
MODCARGO_CRATES +=	tree-sitter-typescript	0.23.2	# MIT
MODCARGO_CRATES +=	tree-sitter-xml	0.7.0	# MIT
MODCARGO_CRATES +=	tree-sitter-yaml	0.7.2	# MIT
MODCARGO_CRATES +=	typed-arena	2.0.2	# MIT
MODCARGO_CRATES +=	typed-path	0.12.3	# MIT OR Apache-2.0
MODCARGO_CRATES +=	unicode-ident	1.0.24	# (MIT OR Apache-2.0) AND Unicode-3.0
MODCARGO_CRATES +=	utf8parse	0.2.2	# Apache-2.0 OR MIT
MODCARGO_CRATES +=	wait-timeout	0.2.1	# MIT/Apache-2.0
MODCARGO_CRATES +=	wasip2	1.0.4+wasi-0.2.12	# Apache-2.0 WITH LLVM-exception OR Apache-2.0 OR MIT
MODCARGO_CRATES +=	wasm-bindgen	0.2.126	# MIT OR Apache-2.0
MODCARGO_CRATES +=	wasm-bindgen-macro	0.2.126	# MIT OR Apache-2.0
MODCARGO_CRATES +=	wasm-bindgen-macro-support	0.2.126	# MIT OR Apache-2.0
MODCARGO_CRATES +=	wasm-bindgen-shared	0.2.126	# MIT OR Apache-2.0
MODCARGO_CRATES +=	winapi-util	0.1.11	# Unlicense OR MIT
MODCARGO_CRATES +=	windows-core	0.62.2	# MIT OR Apache-2.0
MODCARGO_CRATES +=	windows-implement	0.60.2	# MIT OR Apache-2.0
MODCARGO_CRATES +=	windows-interface	0.59.3	# MIT OR Apache-2.0
MODCARGO_CRATES +=	windows-link	0.2.1	# MIT OR Apache-2.0
MODCARGO_CRATES +=	windows-result	0.4.1	# MIT OR Apache-2.0
MODCARGO_CRATES +=	windows-strings	0.5.1	# MIT OR Apache-2.0
MODCARGO_CRATES +=	windows-sys	0.61.2	# MIT OR Apache-2.0
MODCARGO_CRATES +=	wit-bindgen	0.57.1	# Apache-2.0 WITH LLVM-exception OR Apache-2.0 OR MIT
MODCARGO_CRATES +=	yansi	1.0.1	# MIT OR Apache-2.0
MODCARGO_CRATES +=	zerocopy	0.8.54	# BSD-2-Clause OR Apache-2.0 OR MIT
MODCARGO_CRATES +=	zerocopy-derive	0.8.54	# BSD-2-Clause OR Apache-2.0 OR MIT
MODCARGO_CRATES +=	zip	8.6.0	# MIT
MODCARGO_CRATES +=	zlib-rs	0.6.6	# Zlib
MODCARGO_CRATES +=	zmij	1.0.23	# MIT
MODCARGO_CRATES +=	zopfli	0.8.3	# Apache-2.0
