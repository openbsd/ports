MODGO_MODULES =	\
	cel.dev/expr									 v0.19.1 \
	cloud.google.com/go/compute/metadata						 v0.6.0 \
	filippo.io/edwards25519								 v1.1.0 \
	github.com/!burnt!sushi/toml							 v0.3.1 \
	github.com/!google!cloud!platform/opentelemetry-operations-go/detectors/gcp	 v1.25.0 \
	github.com/!masterminds/semver/v3						 v3.1.1 \
	github.com/antlr4-go/antlr/v4							 v4.13.1 \
	github.com/benbjohnson/clock							 v1.1.0 \
	github.com/cespare/xxhash/v2							 v2.3.0 \
	github.com/cncf/xds/go								 v0.0.0-20241223141626-cff3c89139a3 \
	github.com/cockroachdb/apd							 v1.1.0 \
	github.com/coreos/go-systemd							 v0.0.0-20190719114852-fd7a80b32e1f \
	github.com/cpuguy83/go-md2man/v2						 v2.0.6 \
	github.com/creack/pty								 v1.1.7 \
	github.com/cubicdaiya/gonp							 v1.0.4 \
	github.com/cznic/mathutil							 v0.0.0-20181122101859-297441e03548 \
	github.com/cznic/sortutil							 v0.0.0-20181122101858-f5f958428db8 \
	github.com/cznic/strutil							 v0.0.0-20181122101858-275e90344537 \
	github.com/davecgh/go-spew							 v1.1.1 \
	github.com/dustin/go-humanize							 v1.0.1 \
	github.com/envoyproxy/go-control-plane						 v0.13.4 \
	github.com/envoyproxy/go-control-plane/envoy					 v1.32.4 \
	github.com/envoyproxy/go-control-plane/ratelimit				 v0.1.0 \
	github.com/envoyproxy/protoc-gen-validate					 v1.2.1 \
	github.com/fatih/structtag							 v1.2.0 \
	github.com/go-kit/log								 v0.1.0 \
	github.com/go-logfmt/logfmt							 v0.5.0 \
	github.com/go-logr/logr								 v1.4.2 \
	github.com/go-logr/stdr								 v1.2.2 \
	github.com/go-sql-driver/mysql							 v1.9.2 \
	github.com/go-stack/stack							 v1.8.0 \
	github.com/gofrs/uuid								 v4.0.0+incompatible \
	github.com/golang/glog								 v1.2.4 \
	github.com/golang/protobuf							 v1.5.4 \
	github.com/google/cel-go							 v0.24.1 \
	github.com/google/go-cmp							 v0.7.0 \
	github.com/google/pprof								 v0.0.0-20250317173921-a4b03ec1a45e \
	github.com/google/renameio							 v0.1.0 \
	github.com/google/uuid								 v1.6.0 \
	github.com/inconshreveable/mousetrap						 v1.1.0 \
	github.com/jackc/chunkreader							 v1.0.0 \
	github.com/jackc/chunkreader/v2							 v2.0.1 \
	github.com/jackc/pgconn								 v1.14.3 \
	github.com/jackc/pgio								 v1.0.0 \
	github.com/jackc/pgmock								 v0.0.0-20210724152146-4ad1a8207f65 \
	github.com/jackc/pgpassfile							 v1.0.0 \
	github.com/jackc/pgproto3							 v1.1.0 \
	github.com/jackc/pgproto3/v2							 v2.3.3 \
	github.com/jackc/pgservicefile							 v0.0.0-20240606120523-5a60cdf6a761 \
	github.com/jackc/pgtype								 v1.14.0 \
	github.com/jackc/pgx/v4								 v4.18.3 \
	github.com/jackc/pgx/v5								 v5.7.4 \
	github.com/jackc/puddle								 v1.3.0 \
	github.com/jackc/puddle/v2							 v2.2.2 \
	github.com/jinzhu/inflection							 v1.0.0 \
	github.com/kisielk/gotool							 v1.0.0 \
	github.com/konsorten/go-windows-terminal-sequences				 v1.0.2 \
	github.com/kr/pretty								 v0.3.0 \
	github.com/kr/pty								 v1.1.8 \
	github.com/kr/text								 v0.2.0 \
	github.com/lib/pq								 v1.10.9 \
	github.com/mattn/go-colorable							 v0.1.6 \
	github.com/mattn/go-isatty							 v0.0.20 \
	github.com/ncruces/go-strftime							 v0.1.9 \
	github.com/pganalyze/pg_query_go/v6						 v6.1.0 \
	github.com/pingcap/errors							 v0.11.5-0.20240311024730-e056997136bb \
	github.com/pingcap/failpoint							 v0.0.0-20240528011301-b51a646c7c86 \
	github.com/pingcap/log								 v1.1.0 \
	github.com/pingcap/tidb/pkg/parser						 v0.0.0-20250324122243-d51e00e5bbf0 \
	github.com/pkg/errors								 v0.9.1 \
	github.com/planetscale/vtprotobuf						 v0.6.1-0.20240319094008-0393e58bdf10 \
	github.com/pmezard/go-difflib							 v1.0.0 \
	github.com/remyoudompheng/bigfft						 v0.0.0-20230129092748-24d4a6f8daec \
	github.com/riza-io/grpc-go							 v0.2.0 \
	github.com/rogpeppe/go-internal							 v1.10.0 \
	github.com/rs/xid								 v1.2.1 \
	github.com/rs/zerolog								 v1.15.0 \
	github.com/russross/blackfriday/v2						 v2.1.0 \
	github.com/satori/go.uuid							 v1.2.0 \
	github.com/sergi/go-diff							 v1.1.0 \
	github.com/shopspring/decimal							 v1.2.0 \
	github.com/sirupsen/logrus							 v1.4.2 \
	github.com/spf13/cobra								 v1.9.1 \
	github.com/spf13/pflag								 v1.0.6 \
	github.com/stoewer/go-strcase							 v1.2.0 \
	github.com/stretchr/objx							 v0.2.0 \
	github.com/stretchr/testify							 v1.9.0 \
	github.com/tetratelabs/wazero							 v1.9.0 \
	github.com/wasilibs/go-pgquery							 v0.0.0-20250409022910-10ac41983c07 \
	github.com/wasilibs/wazero-helpers						 v0.0.0-20240620070341-3dff1577cd52 \
	github.com/xeipuuv/gojsonpointer						 v0.0.0-20180127040702-4e3ac2762d5f \
	github.com/xeipuuv/gojsonreference						 v0.0.0-20180127040603-bd5ef7bd5415 \
	github.com/xeipuuv/gojsonschema							 v1.2.0 \
	github.com/zenazn/goji								 v0.9.0 \
	go.opentelemetry.io/auto/sdk							 v1.1.0 \
	go.opentelemetry.io/contrib/detectors/gcp					 v1.34.0 \
	go.opentelemetry.io/otel							 v1.34.0 \
	go.opentelemetry.io/otel/metric							 v1.34.0 \
	go.opentelemetry.io/otel/sdk							 v1.34.0 \
	go.opentelemetry.io/otel/sdk/metric						 v1.34.0 \
	go.opentelemetry.io/otel/trace							 v1.34.0 \
	go.uber.org/atomic								 v1.11.0 \
	go.uber.org/goleak								 v1.3.0 \
	go.uber.org/multierr								 v1.11.0 \
	go.uber.org/tools								 v0.0.0-20190618225709-2cfd321de3ee \
	go.uber.org/zap									 v1.27.0 \
	golang.org/x/crypto								 v0.36.0 \
	golang.org/x/exp								 v0.0.0-20250305212735-054e65f0b394 \
	golang.org/x/lint								 v0.0.0-20190930215403-16217165b5de \
	golang.org/x/mod								 v0.24.0 \
	golang.org/x/net								 v0.38.0 \
	golang.org/x/oauth2								 v0.25.0 \
	golang.org/x/sync								 v0.13.0 \
	golang.org/x/sys								 v0.31.0 \
	golang.org/x/term								 v0.30.0 \
	golang.org/x/text								 v0.23.0 \
	golang.org/x/tools								 v0.31.0 \
	golang.org/x/xerrors								 v0.0.0-20200804184101-5ec99f83aff1 \
	google.golang.org/genproto/googleapis/api					 v0.0.0-20250106144421-5f5ef82da422 \
	google.golang.org/genproto/googleapis/rpc					 v0.0.0-20250115164207-1a7da9e5054f \
	google.golang.org/grpc								 v1.71.1 \
	google.golang.org/protobuf							 v1.36.6 \
	gopkg.in/check.v1								 v1.0.0-20201130134442-10cb98267c6c \
	gopkg.in/errgo.v2								 v2.1.0 \
	gopkg.in/inconshreveable/log15.v2						 v2.0.0-20180818164646-67afb5ed74ec \
	gopkg.in/natefinch/lumberjack.v2						 v2.2.1 \
	gopkg.in/yaml.v2								 v2.2.8 \
	gopkg.in/yaml.v3								 v3.0.1 \
	honnef.co/go/tools								 v0.0.1-2019.2.3 \
	modernc.org/cc/v4								 v4.25.2 \
	modernc.org/ccgo/v4								 v4.25.1 \
	modernc.org/fileutil								 v1.3.0 \
	modernc.org/gc/v2								 v2.6.5 \
	modernc.org/golex								 v1.1.0 \
	modernc.org/libc								 v1.62.1 \
	modernc.org/mathutil								 v1.7.1 \
	modernc.org/memory								 v1.9.1 \
	modernc.org/opt									 v0.1.4 \
	modernc.org/parser								 v1.1.0 \
	modernc.org/sortutil								 v1.2.1 \
	modernc.org/sqlite								 v1.37.0 \
	modernc.org/strutil								 v1.2.1 \
	modernc.org/token								 v1.1.0 \
	modernc.org/y									 v1.1.0

MODGO_MODFILES =	\
	github.com/antlr4-go/antlr/v4				 v4.13.0 \
	github.com/coreos/go-systemd				 v0.0.0-20190321100706-95778dfbb74e \
	github.com/davecgh/go-spew				 v1.1.0 \
	github.com/go-sql-driver/mysql				 v1.7.1 \
	github.com/golang/protobuf				 v1.5.0 \
	github.com/golang/protobuf				 v1.5.2 \
	github.com/google/go-cmp				 v0.5.5 \
	github.com/google/go-cmp				 v0.5.9 \
	github.com/google/go-cmp				 v0.6.0 \
	github.com/jackc/chunkreader/v2				 v2.0.0 \
	github.com/jackc/pgconn					 v0.0.0-20190420214824-7e0022ef6ba3 \
	github.com/jackc/pgconn					 v0.0.0-20190824142844-760dd75542eb \
	github.com/jackc/pgconn					 v0.0.0-20190831204454-2fabfa3c18b7 \
	github.com/jackc/pgconn					 v1.8.0 \
	github.com/jackc/pgconn					 v1.9.0 \
	github.com/jackc/pgconn					 v1.9.1-0.20210724152538-d89c8390a530 \
	github.com/jackc/pgmock					 v0.0.0-20190831213851-13a1b77aafa2 \
	github.com/jackc/pgmock					 v0.0.0-20201204152224-4fe30f7445fd \
	github.com/jackc/pgproto3/v2				 v2.0.0-alpha1.0.20190420180111-c116219b62db \
	github.com/jackc/pgproto3/v2				 v2.0.0-alpha1.0.20190609003834-432c2951c711 \
	github.com/jackc/pgproto3/v2				 v2.0.0-rc3 \
	github.com/jackc/pgproto3/v2				 v2.0.0-rc3.0.20190831210041-4c03ce451f29 \
	github.com/jackc/pgproto3/v2				 v2.0.6 \
	github.com/jackc/pgproto3/v2				 v2.1.1 \
	github.com/jackc/pgservicefile				 v0.0.0-20200714003250-2b9c44734f2b \
	github.com/jackc/pgservicefile				 v0.0.0-20221227161230-091c0ba34f0a \
	github.com/jackc/pgtype					 v0.0.0-20190421001408-4ed0de4755e0 \
	github.com/jackc/pgtype					 v0.0.0-20190824184912-ab885b375b90 \
	github.com/jackc/pgtype					 v0.0.0-20190828014616-a8802b16cc59 \
	github.com/jackc/pgtype					 v1.8.1-0.20210724151600-32e20a603178 \
	github.com/jackc/pgx/v4					 v4.0.0-20190420224344-cc3461e65d96 \
	github.com/jackc/pgx/v4					 v4.0.0-20190421002000-1b8f0016e912 \
	github.com/jackc/pgx/v4					 v4.0.0-pre1.0.20190824185557-6972a5742186 \
	github.com/jackc/pgx/v4					 v4.12.1-0.20210724153913-640aa07df17c \
	github.com/jackc/puddle					 v0.0.0-20190413234325-e4ced69a3a2b \
	github.com/jackc/puddle					 v0.0.0-20190608224051-11cab39313c9 \
	github.com/jackc/puddle					 v1.1.3 \
	github.com/konsorten/go-windows-terminal-sequences	 v1.0.1 \
	github.com/kr/pretty					 v0.1.0 \
	github.com/kr/pty					 v1.1.1 \
	github.com/kr/text					 v0.1.0 \
	github.com/lib/pq					 v1.0.0 \
	github.com/lib/pq					 v1.1.0 \
	github.com/lib/pq					 v1.10.2 \
	github.com/lib/pq					 v1.2.0 \
	github.com/mattn/go-colorable				 v0.1.1 \
	github.com/mattn/go-isatty				 v0.0.12 \
	github.com/mattn/go-isatty				 v0.0.5 \
	github.com/mattn/go-isatty				 v0.0.7 \
	github.com/pingcap/errors				 v0.11.0 \
	github.com/pingcap/errors				 v0.11.4 \
	github.com/pkg/errors					 v0.8.1 \
	github.com/rogpeppe/go-internal				 v1.3.0 \
	github.com/rs/zerolog					 v1.13.0 \
	github.com/shopspring/decimal				 v0.0.0-20180709203117-cd690d0c9e24 \
	github.com/sirupsen/logrus				 v1.4.1 \
	github.com/stretchr/objx				 v0.1.0 \
	github.com/stretchr/objx				 v0.1.1 \
	github.com/stretchr/testify				 v1.2.2 \
	github.com/stretchr/testify				 v1.3.0 \
	github.com/stretchr/testify				 v1.4.0 \
	github.com/stretchr/testify				 v1.5.1 \
	github.com/stretchr/testify				 v1.7.0 \
	github.com/stretchr/testify				 v1.8.1 \
	github.com/stretchr/testify				 v1.8.4 \
	github.com/tetratelabs/wazero				 v1.7.2 \
	go.uber.org/atomic					 v1.3.2 \
	go.uber.org/atomic					 v1.4.0 \
	go.uber.org/atomic					 v1.5.0 \
	go.uber.org/atomic					 v1.6.0 \
	go.uber.org/atomic					 v1.7.0 \
	go.uber.org/atomic					 v1.9.0 \
	go.uber.org/goleak					 v1.1.10 \
	go.uber.org/multierr					 v1.1.0 \
	go.uber.org/multierr					 v1.10.0 \
	go.uber.org/multierr					 v1.3.0 \
	go.uber.org/multierr					 v1.5.0 \
	go.uber.org/multierr					 v1.6.0 \
	go.uber.org/multierr					 v1.7.0 \
	go.uber.org/zap						 v1.10.0 \
	go.uber.org/zap						 v1.13.0 \
	go.uber.org/zap						 v1.19.0 \
	go.uber.org/zap						 v1.9.1 \
	golang.org/x/crypto					 v0.0.0-20190308221718-c2843e01d9a2 \
	golang.org/x/crypto					 v0.0.0-20190411191339-88737f569e3a \
	golang.org/x/crypto					 v0.0.0-20190510104115-cbcb75029529 \
	golang.org/x/crypto					 v0.0.0-20190820162420-60c769a6c586 \
	golang.org/x/crypto					 v0.0.0-20191011191535-87dc89f01550 \
	golang.org/x/crypto					 v0.0.0-20200622213623-75b288015ac9 \
	golang.org/x/crypto					 v0.0.0-20201203163018-be400aefbc4c \
	golang.org/x/crypto					 v0.0.0-20210616213533-5ff15b29337e \
	golang.org/x/crypto					 v0.0.0-20210711020723-a769d52b0f97 \
	golang.org/x/crypto					 v0.20.0 \
	golang.org/x/crypto					 v0.31.0 \
	golang.org/x/exp					 v0.0.0-20230515195305-f3d0a9c9a5cc \
	golang.org/x/exp					 v0.0.0-20240506185415-9bf2ced13842 \
	golang.org/x/mod					 v0.0.0-20190513183733-4bf6d317e70e \
	golang.org/x/mod					 v0.1.1-0.20191105210325-c90efee705ee \
	golang.org/x/mod					 v0.17.0 \
	golang.org/x/net					 v0.0.0-20190311183353-d8887717615a \
	golang.org/x/net					 v0.0.0-20190404232315-eb5bcb51f2a3 \
	golang.org/x/net					 v0.0.0-20190620200207-3b0461eec859 \
	golang.org/x/net					 v0.0.0-20190813141303-74dc4d7220e7 \
	golang.org/x/net					 v0.0.0-20210226172049-e18ecbb05110 \
	golang.org/x/net					 v0.21.0 \
	golang.org/x/net					 v0.33.0 \
	golang.org/x/net					 v0.34.0 \
	golang.org/x/sync					 v0.0.0-20190423024810-112230192c58 \
	golang.org/x/sync					 v0.1.0 \
	golang.org/x/sync					 v0.10.0 \
	golang.org/x/sync					 v0.12.0 \
	golang.org/x/sys					 v0.0.0-20180905080454-ebe1bf3edb33 \
	golang.org/x/sys					 v0.0.0-20190215142949-d0b11bdaac8a \
	golang.org/x/sys					 v0.0.0-20190222072716-a9d3bda3a223 \
	golang.org/x/sys					 v0.0.0-20190403152447-81d4e9dc473e \
	golang.org/x/sys					 v0.0.0-20190412213103-97732733099d \
	golang.org/x/sys					 v0.0.0-20190422165155-953cdadca894 \
	golang.org/x/sys					 v0.0.0-20190813064441-fde4db37ae7a \
	golang.org/x/sys					 v0.0.0-20191026070338-33540a1f6037 \
	golang.org/x/sys					 v0.0.0-20200116001909-b77594299b42 \
	golang.org/x/sys					 v0.0.0-20200223170610-d5e6a3e2c0ae \
	golang.org/x/sys					 v0.0.0-20201119102817-f84b799fce68 \
	golang.org/x/sys					 v0.0.0-20210615035016-665e8c7367d1 \
	golang.org/x/sys					 v0.17.0 \
	golang.org/x/sys					 v0.21.0 \
	golang.org/x/sys					 v0.28.0 \
	golang.org/x/sys					 v0.29.0 \
	golang.org/x/sys					 v0.6.0 \
	golang.org/x/term					 v0.0.0-20201117132131-f5c789dd3221 \
	golang.org/x/term					 v0.0.0-20201126162022-7de9c90e9dd1 \
	golang.org/x/text					 v0.14.0 \
	golang.org/x/text					 v0.16.0 \
	golang.org/x/text					 v0.19.0 \
	golang.org/x/text					 v0.21.0 \
	golang.org/x/text					 v0.3.0 \
	golang.org/x/text					 v0.3.2 \
	golang.org/x/text					 v0.3.3 \
	golang.org/x/text					 v0.3.4 \
	golang.org/x/text					 v0.3.6 \
	golang.org/x/tools					 v0.0.0-20180917221912-90fa682c2a6e \
	golang.org/x/tools					 v0.0.0-20190311212946-11955173bddd \
	golang.org/x/tools					 v0.0.0-20190425163242-31fd60d6bfdc \
	golang.org/x/tools					 v0.0.0-20190621195816-6e04913cbbac \
	golang.org/x/tools					 v0.0.0-20190823170909-c4a336ef6a2f \
	golang.org/x/tools					 v0.0.0-20191029041327-9cc4af7d6b2c \
	golang.org/x/tools					 v0.0.0-20191029190741-b9c20aec41a5 \
	golang.org/x/tools					 v0.0.0-20191108193012-7d206e10da11 \
	golang.org/x/tools					 v0.0.0-20200103221440-774c71fcf114 \
	golang.org/x/tools					 v0.13.0 \
	golang.org/x/tools					 v0.21.1-0.20240508182429-e35e4ccd0d2d \
	golang.org/x/tools					 v0.6.0 \
	golang.org/x/xerrors					 v0.0.0-20190410155217-1f06c39b4373 \
	golang.org/x/xerrors					 v0.0.0-20190513163551-3ee3066db522 \
	golang.org/x/xerrors					 v0.0.0-20190717185122-a985d3407aa7 \
	golang.org/x/xerrors					 v0.0.0-20191011141410-1b5146add898 \
	golang.org/x/xerrors					 v0.0.0-20191204190536-9bdfabe68543 \
	google.golang.org/genproto/googleapis/api		 v0.0.0-20240826202546-f6391c0de4c7 \
	google.golang.org/genproto/googleapis/rpc		 v0.0.0-20240826202546-f6391c0de4c7 \
	google.golang.org/genproto/googleapis/rpc		 v0.0.0-20250102185135-69823020774d \
	google.golang.org/grpc					 v1.54.0 \
	google.golang.org/grpc					 v1.67.1 \
	google.golang.org/protobuf				 v1.26.0-rc.1 \
	google.golang.org/protobuf				 v1.28.1 \
	google.golang.org/protobuf				 v1.31.0 \
	google.golang.org/protobuf				 v1.34.2 \
	google.golang.org/protobuf				 v1.36.1 \
	google.golang.org/protobuf				 v1.36.3 \
	google.golang.org/protobuf				 v1.36.4 \
	gopkg.in/check.v1					 v0.0.0-20161208181325-20d25e280405 \
	gopkg.in/check.v1					 v1.0.0-20180628173108-788fd7840127 \
	gopkg.in/natefinch/lumberjack.v2			 v2.0.0 \
	gopkg.in/yaml.v2					 v2.2.2 \
	gopkg.in/yaml.v3					 v3.0.0 \
	gopkg.in/yaml.v3					 v3.0.0-20200313102051-9f266ea9e77c \
	gopkg.in/yaml.v3					 v3.0.0-20210107192922-496545a6307b \
	modernc.org/mathutil					 v1.6.0 \
	modernc.org/sortutil					 v1.2.0 \
	modernc.org/strutil					 v1.2.0

