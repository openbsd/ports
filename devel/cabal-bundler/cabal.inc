MODCABAL_MANIFEST	= \
	Glob	0.10.2	3	\
	HsYAML	0.2.1.5	1	\
	HsYAML-aeson	0.2.0.2	0	\
	OneTuple	0.4.2	1	\
	QuickCheck	2.15.0.1	1	\
	StateVar	1.2.2	0	\
	aeson	2.2.3.0	4	\
	alex	3.5.4.0	0	\
	ansi-terminal	1.1.5	0	\
	ansi-terminal-types	1.1.3	0	\
	ansi-wl-pprint	1.0.2	0	\
	appar	0.1.8	0	\
	assoc	1.1.1	2	\
	async	2.2.5	4	\
	atomic-counter	0.1.2.4	0	\
	attoparsec	0.14.4	6	\
	auto-update	0.2.6	0	\
	base-orphans	0.9.3	0	\
	base16-bytestring	1.0.2.0	1	\
	base64-bytestring	1.2.1.0	1	\
	bifunctors	5.6.2	2	\
	binary-instances	1.0.6	0	\
	binary-orphans	1.0.5	1	\
	bitvec	1.1.5.0	3	\
	blaze-builder	0.4.4.1	0	\
	boring	0.2.2	1	\
	bsb-http-chunked	0.0.0.4	4	\
	byteorder	1.0.4	0	\
	cabal-install-parsers	0.6.2	0	\
	cabal-plan	0.7.6.1	0	\
	call-stack	0.4.0	0	\
	case-insensitive	1.2.1.0	0	\
	cborg	0.2.10.0	3	\
	character-ps	0.1	0	\
	charset	0.3.12	0	\
	clock	0.8.4	0	\
	colour	2.3.6	0	\
	comonad	5.0.9	1	\
	conduit	1.3.6.1	0	\
	conduit-extra	1.3.8	1	\
	contravariant	1.5.5	0	\
	cryptohash-sha256	0.11.102.1	6	\
	data-fix	0.3.4	2	\
	debruijn	0.3.1	0	\
	dec	0.0.6	1	\
	directory-ospath-streaming	0.3	1	\
	distributive	0.6.2.1	1	\
	dlist	1.0	2	\
	edit-distance	0.2.2.1	1	\
	file-embed-lzma	0.1	1	\
	file-io	0.1.5	0	\
	fin	0.3.2	1	\
	generic-lens-lite	0.1.1	1	\
	generically	0.1.1	5	\
	ghc-lib-parser	9.10.3.20250912	0	\
	ghc-lib-parser-ex	9.10.0.0	0	\
	half	0.3.3	1	\
	happy	2.1.7	0	\
	happy-lib	2.1.7	0	\
	hashable	1.4.7.0	0	\
	haskell-lexer	1.1.2	0	\
	hsc2hs	0.68.10	5	\
	http-date	0.0.11	0	\
	http-semantics	0.3.0	0	\
	http-types	0.12.4	0	\
	http2	5.3.8	0	\
	indexed-profunctors	0.1.1.1	0	\
	indexed-traversable	0.1.4	1	\
	indexed-traversable-instances	0.1.2	1	\
	integer-conversion	0.1.1	2	\
	integer-logarithms	1.0.4	0	\
	iproute	1.7.15	0	\
	lattices	2.2.1	3	\
	logict	0.8.1.0	1	\
	lucid	2.11.20250303	0	\
	lukko	0.1.2	1	\
	lzma	0.0.1.1	1	\
	mmorph	1.2.1	1	\
	mono-traversable	1.0.21.0	0	\
	network	3.2.8.0	0	\
	network-byte-order	0.1.7	0	\
	network-control	0.1.7	0	\
	network-uri	2.6.4.2	1	\
	old-locale	1.0.0.7	2	\
	old-time	1.1.0.4	0	\
	optics-core	0.4.1.1	1	\
	optics-extra	0.4.2.1	4	\
	optparse-applicative	0.18.1.0	1	\
	parsers	0.12.12	1	\
	polyparse	1.13.1	0	\
	prettyprinter	1.7.1	0	\
	prettyprinter-ansi-terminal	1.1.3	0	\
	prettyprinter-compat-ansi-wl-pprint	1.0.2	0	\
	primitive	0.9.1.0	1	\
	psqueues	0.2.8.3	0	\
	random	1.3.1	0	\
	recv	0.1.1	0	\
	resourcet	1.3.0	0	\
	scientific	0.3.8.0	2	\
	semialign	1.3.1	2	\
	semigroupoids	6.0.1	2	\
	semigroups	0.20	0	\
	serialise	0.2.6.1	5	\
	simple-sendfile	0.2.32	0	\
	singleton-bool	0.1.8	1	\
	skew-list	0.1	4	\
	some	1.0.6	2	\
	sop-core	0.5.0.2	6	\
	split	0.2.5	0	\
	splitmix	0.1.2	0	\
	streaming-commons	0.2.3.1	0	\
	strict	0.5.1	1	\
	syb	0.7.3	0	\
	tagged	0.8.9	0	\
	tar	0.7.0.0	2	\
	tasty	1.5.3	2	\
	tasty-golden	2.3.5	0	\
	tasty-hunit	0.10.2	0	\
	temporary	1.3	0	\
	text-iso8601	0.1.1	2	\
	text-short	0.1.6	3	\
	th-abstraction	0.7.1.0	1	\
	th-compat	0.1.6	0	\
	these	1.2.1	2	\
	time-compat	1.9.8	0	\
	time-manager	0.1.3	0	\
	topograph	1.0.1	1	\
	transformers-compat	0.7.2	0	\
	tree-diff	0.3.4	2	\
	typed-process	0.2.13.0	0	\
	unification-fd	0.11.2.2	0	\
	uniplate	1.6.13	1	\
	universe-base	1.1.4	1	\
	universe-reverse-instances	1.1.2	1	\
	unix-time	0.4.17	0	\
	unliftio-core	0.2.1.0	4	\
	unordered-containers	0.2.21	2	\
	utf8-string	1.0.2	0	\
	uuid-types	1.0.6	3	\
	vault	0.3.1.6	0	\
	vector	0.13.2.0	2	\
	vector-algorithms	0.9.1.0	0	\
	vector-binary-instances	0.2.5.2	5	\
	vector-stream	0.1.0.1	4	\
	wai	3.2.4	0	\
	warp	3.4.6	0	\
	witherable	0.5	2	\
	word8	0.1.3	0	\
	zinza	0.2.1	1	\
	zlib	0.7.1.1	0	\
