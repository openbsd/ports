# run: make modcargo-gen-crates-licenses
MODCARGO_CRATES +=	Inflector	0.11.4
MODCARGO_CRATES +=	actix-codec	0.5.2
MODCARGO_CRATES +=	actix-http	3.11.2
MODCARGO_CRATES +=	actix-router	0.5.3
MODCARGO_CRATES +=	actix-rt	2.11.0
MODCARGO_CRATES +=	actix-server	2.6.0
MODCARGO_CRATES +=	actix-service	2.0.3
MODCARGO_CRATES +=	actix-utils	3.0.1
MODCARGO_CRATES +=	actix-web	4.12.1
MODCARGO_CRATES +=	addr2line	0.25.1
MODCARGO_CRATES +=	adler2	2.0.1
MODCARGO_CRATES +=	aead	0.5.2
MODCARGO_CRATES +=	aes	0.8.4
MODCARGO_CRATES +=	age	0.11.2
MODCARGO_CRATES +=	age-core	0.11.0
MODCARGO_CRATES +=	ahash	0.8.12
MODCARGO_CRATES +=	aho-corasick	1.1.4
MODCARGO_CRATES +=	allocative	0.3.4
MODCARGO_CRATES +=	allocative_derive	0.3.3
MODCARGO_CRATES +=	allocator-api2	0.2.21
MODCARGO_CRATES +=	android_system_properties	0.1.5
MODCARGO_CRATES +=	annotate-snippets	0.9.2
MODCARGO_CRATES +=	ansi-to-tui	7.0.0
MODCARGO_CRATES +=	anstream	0.6.21
MODCARGO_CRATES +=	anstyle	1.0.13
MODCARGO_CRATES +=	anstyle-parse	0.2.7
MODCARGO_CRATES +=	anstyle-query	1.1.5
MODCARGO_CRATES +=	anstyle-wincon	3.0.11
MODCARGO_CRATES +=	anyhow	1.0.100
MODCARGO_CRATES +=	arbitrary	1.4.2
MODCARGO_CRATES +=	arboard	3.6.1
MODCARGO_CRATES +=	arc-swap	1.8.0
MODCARGO_CRATES +=	arrayvec	0.7.6
MODCARGO_CRATES +=	ascii	1.1.0
MODCARGO_CRATES +=	ascii-canvas	3.0.0
MODCARGO_CRATES +=	assert-json-diff	2.0.2
MODCARGO_CRATES +=	assert_cmd	2.1.2
MODCARGO_CRATES +=	assert_matches	1.5.0
MODCARGO_CRATES +=	async-broadcast	0.7.2
MODCARGO_CRATES +=	async-channel	2.5.0
MODCARGO_CRATES +=	async-executor	1.13.3
MODCARGO_CRATES +=	async-fs	2.2.0
MODCARGO_CRATES +=	async-io	2.6.0
MODCARGO_CRATES +=	async-lock	3.4.2
MODCARGO_CRATES +=	async-process	2.5.0
MODCARGO_CRATES +=	async-recursion	1.1.1
MODCARGO_CRATES +=	async-signal	0.2.13
MODCARGO_CRATES +=	async-stream	0.3.6
MODCARGO_CRATES +=	async-stream-impl	0.3.6
MODCARGO_CRATES +=	async-task	4.7.1
MODCARGO_CRATES +=	async-trait	0.1.89
MODCARGO_CRATES +=	asynk-strim	0.1.5
MODCARGO_CRATES +=	atoi	2.0.0
MODCARGO_CRATES +=	atomic-waker	1.1.2
MODCARGO_CRATES +=	autocfg	1.5.0
MODCARGO_CRATES +=	axum	0.8.8
MODCARGO_CRATES +=	axum-core	0.5.6
MODCARGO_CRATES +=	backtrace	0.3.76
MODCARGO_CRATES +=	base64	0.21.7
MODCARGO_CRATES +=	base64	0.22.1
MODCARGO_CRATES +=	base64ct	1.8.3
MODCARGO_CRATES +=	basic-toml	0.1.10
MODCARGO_CRATES +=	bech32	0.9.1
MODCARGO_CRATES +=	beef	0.5.2
MODCARGO_CRATES +=	bindgen	0.72.1
MODCARGO_CRATES +=	bit-set	0.5.3
MODCARGO_CRATES +=	bit-vec	0.6.3
MODCARGO_CRATES +=	bitflags	1.3.2
MODCARGO_CRATES +=	bitflags	2.10.0
MODCARGO_CRATES +=	block-buffer	0.10.4
MODCARGO_CRATES +=	block-padding	0.3.3
MODCARGO_CRATES +=	block2	0.6.2
MODCARGO_CRATES +=	blocking	1.6.2
MODCARGO_CRATES +=	borsh	1.6.0
MODCARGO_CRATES +=	bstr	1.12.1
MODCARGO_CRATES +=	bumpalo	3.19.1
MODCARGO_CRATES +=	bytemuck	1.25.0
MODCARGO_CRATES +=	byteorder	1.5.0
MODCARGO_CRATES +=	byteorder-lite	0.1.0
MODCARGO_CRATES +=	bytes	1.11.1
MODCARGO_CRATES +=	bytestring	1.5.0
MODCARGO_CRATES +=	bzip2	0.5.2
MODCARGO_CRATES +=	bzip2-sys	0.1.13+1.0.8
MODCARGO_CRATES +=	cassowary	0.3.0
MODCARGO_CRATES +=	castaway	0.2.4
MODCARGO_CRATES +=	cbc	0.1.2
MODCARGO_CRATES +=	cc	1.2.55
MODCARGO_CRATES +=	cesu8	1.1.0
MODCARGO_CRATES +=	cexpr	0.6.0
MODCARGO_CRATES +=	cfg-if	1.0.4
MODCARGO_CRATES +=	cfg_aliases	0.1.1
MODCARGO_CRATES +=	cfg_aliases	0.2.1
MODCARGO_CRATES +=	chacha20	0.9.1
MODCARGO_CRATES +=	chacha20poly1305	0.10.1
MODCARGO_CRATES +=	chardetng	0.1.17
MODCARGO_CRATES +=	chrono	0.4.43
MODCARGO_CRATES +=	chunked_transfer	1.5.0
MODCARGO_CRATES +=	cipher	0.4.4
MODCARGO_CRATES +=	clang-sys	1.8.1
MODCARGO_CRATES +=	clap	4.5.56
MODCARGO_CRATES +=	clap_builder	4.5.56
MODCARGO_CRATES +=	clap_complete	4.5.65
MODCARGO_CRATES +=	clap_derive	4.5.55
MODCARGO_CRATES +=	clap_lex	0.7.7
MODCARGO_CRATES +=	clipboard-win	5.4.1
MODCARGO_CRATES +=	cmake	0.1.57
MODCARGO_CRATES +=	cmp_any	0.8.1
MODCARGO_CRATES +=	color-eyre	0.6.5
MODCARGO_CRATES +=	color-spantrace	0.3.0
MODCARGO_CRATES +=	colorchoice	1.0.4
MODCARGO_CRATES +=	combine	4.6.7
MODCARGO_CRATES +=	compact_str	0.8.1
MODCARGO_CRATES +=	concurrent-queue	2.5.0
MODCARGO_CRATES +=	console	0.15.11
MODCARGO_CRATES +=	const-hex	1.17.0
MODCARGO_CRATES +=	const-oid	0.9.6
MODCARGO_CRATES +=	const_format	0.2.35
MODCARGO_CRATES +=	const_format_proc_macros	0.2.34
MODCARGO_CRATES +=	constant_time_eq	0.3.1
MODCARGO_CRATES +=	convert_case	0.6.0
MODCARGO_CRATES +=	convert_case	0.10.0
MODCARGO_CRATES +=	cookie-factory	0.3.3
MODCARGO_CRATES +=	core-foundation	0.9.4
MODCARGO_CRATES +=	core-foundation	0.10.1
MODCARGO_CRATES +=	core-foundation-sys	0.8.7
MODCARGO_CRATES +=	cpufeatures	0.2.17
MODCARGO_CRATES +=	crc	3.4.0
MODCARGO_CRATES +=	crc-catalog	2.4.0
MODCARGO_CRATES +=	crc32fast	1.5.0
MODCARGO_CRATES +=	critical-section	1.2.0
MODCARGO_CRATES +=	crossbeam-channel	0.5.15
MODCARGO_CRATES +=	crossbeam-deque	0.8.6
MODCARGO_CRATES +=	crossbeam-epoch	0.9.18
MODCARGO_CRATES +=	crossbeam-queue	0.3.12
MODCARGO_CRATES +=	crossbeam-utils	0.8.21
MODCARGO_CRATES +=	crossterm_winapi	0.9.1
MODCARGO_CRATES +=	crunchy	0.2.4
MODCARGO_CRATES +=	crypto-common	0.1.7
MODCARGO_CRATES +=	csv	1.4.0
MODCARGO_CRATES +=	csv-core	0.1.13
MODCARGO_CRATES +=	ctor	0.1.26
MODCARGO_CRATES +=	ctor	0.6.3
MODCARGO_CRATES +=	ctor-proc-macro	0.0.7
MODCARGO_CRATES +=	curve25519-dalek	4.1.3
MODCARGO_CRATES +=	curve25519-dalek-derive	0.1.1
MODCARGO_CRATES +=	darling	0.21.3
MODCARGO_CRATES +=	darling	0.23.0
MODCARGO_CRATES +=	darling_core	0.21.3
MODCARGO_CRATES +=	darling_core	0.23.0
MODCARGO_CRATES +=	darling_macro	0.21.3
MODCARGO_CRATES +=	darling_macro	0.23.0
MODCARGO_CRATES +=	data-encoding	2.10.0
MODCARGO_CRATES +=	dbus	0.9.10
MODCARGO_CRATES +=	dbus-secret-service	4.1.0
MODCARGO_CRATES +=	deadpool	0.12.3
MODCARGO_CRATES +=	deadpool-runtime	0.1.4
MODCARGO_CRATES +=	debugid	0.8.0
MODCARGO_CRATES +=	debugserver-types	0.5.0
MODCARGO_CRATES +=	deflate64	0.1.10
MODCARGO_CRATES +=	der	0.7.10
MODCARGO_CRATES +=	deranged	0.5.5
MODCARGO_CRATES +=	derivative	2.2.0
MODCARGO_CRATES +=	derive_arbitrary	1.4.2
MODCARGO_CRATES +=	derive_more	1.0.0
MODCARGO_CRATES +=	derive_more	2.1.1
MODCARGO_CRATES +=	derive_more-impl	1.0.0
MODCARGO_CRATES +=	derive_more-impl	2.1.1
MODCARGO_CRATES +=	diff	0.1.13
MODCARGO_CRATES +=	difflib	0.4.0
MODCARGO_CRATES +=	diffy	0.4.2
MODCARGO_CRATES +=	digest	0.10.7
MODCARGO_CRATES +=	dirs	6.0.0
MODCARGO_CRATES +=	dirs-next	2.0.0
MODCARGO_CRATES +=	dirs-sys	0.5.0
MODCARGO_CRATES +=	dirs-sys-next	0.1.2
MODCARGO_CRATES +=	dispatch2	0.3.0
MODCARGO_CRATES +=	display_container	0.9.0
MODCARGO_CRATES +=	displaydoc	0.2.5
MODCARGO_CRATES +=	dotenvy	0.15.7
MODCARGO_CRATES +=	downcast-rs	1.2.1
MODCARGO_CRATES +=	dtor	0.1.1
MODCARGO_CRATES +=	dtor-proc-macro	0.0.6
MODCARGO_CRATES +=	dunce	1.0.5
MODCARGO_CRATES +=	dupe	0.9.1
MODCARGO_CRATES +=	dupe_derive	0.9.1
MODCARGO_CRATES +=	dyn-clone	1.0.20
MODCARGO_CRATES +=	either	1.15.0
MODCARGO_CRATES +=	ena	0.14.3
MODCARGO_CRATES +=	encode_unicode	1.0.0
MODCARGO_CRATES +=	encoding_rs	0.8.35
MODCARGO_CRATES +=	endi	1.1.1
MODCARGO_CRATES +=	endian-type	0.1.2
MODCARGO_CRATES +=	endian-type	0.2.0
MODCARGO_CRATES +=	enum-as-inner	0.6.1
MODCARGO_CRATES +=	enumflags2	0.7.12
MODCARGO_CRATES +=	enumflags2_derive	0.7.12
MODCARGO_CRATES +=	env-flags	0.1.1
MODCARGO_CRATES +=	env_filter	0.1.4
MODCARGO_CRATES +=	env_home	0.1.0
MODCARGO_CRATES +=	env_logger	0.11.8
MODCARGO_CRATES +=	equivalent	1.0.2
MODCARGO_CRATES +=	erased-serde	0.3.31
MODCARGO_CRATES +=	errno	0.3.14
MODCARGO_CRATES +=	error-code	3.3.2
MODCARGO_CRATES +=	etcetera	0.8.0
MODCARGO_CRATES +=	event-listener	5.4.1
MODCARGO_CRATES +=	event-listener-strategy	0.5.4
MODCARGO_CRATES +=	eventsource-stream	0.2.3
MODCARGO_CRATES +=	eyre	0.6.12
MODCARGO_CRATES +=	fastrand	2.3.0
MODCARGO_CRATES +=	fax	0.2.6
MODCARGO_CRATES +=	fax_derive	0.2.0
MODCARGO_CRATES +=	fd-lock	4.0.4
MODCARGO_CRATES +=	fdeflate	0.3.7
MODCARGO_CRATES +=	fiat-crypto	0.2.9
MODCARGO_CRATES +=	filedescriptor	0.8.3
MODCARGO_CRATES +=	find-crate	0.6.3
MODCARGO_CRATES +=	find-msvc-tools	0.1.9
MODCARGO_CRATES +=	findshlibs	0.10.2
MODCARGO_CRATES +=	fixed_decimal	0.7.1
MODCARGO_CRATES +=	fixedbitset	0.4.2
MODCARGO_CRATES +=	fixedbitset	0.5.7
MODCARGO_CRATES +=	flate2	1.1.8
MODCARGO_CRATES +=	float-cmp	0.10.0
MODCARGO_CRATES +=	fluent	0.16.1
MODCARGO_CRATES +=	fluent-bundle	0.15.3
MODCARGO_CRATES +=	fluent-langneg	0.13.1
MODCARGO_CRATES +=	fluent-syntax	0.11.1
MODCARGO_CRATES +=	flume	0.11.1
MODCARGO_CRATES +=	flume	0.12.0
MODCARGO_CRATES +=	fnv	1.0.7
MODCARGO_CRATES +=	foldhash	0.1.5
MODCARGO_CRATES +=	foldhash	0.2.0
MODCARGO_CRATES +=	foreign-types	0.3.2
MODCARGO_CRATES +=	foreign-types	0.5.0
MODCARGO_CRATES +=	foreign-types-macros	0.2.3
MODCARGO_CRATES +=	foreign-types-shared	0.1.1
MODCARGO_CRATES +=	foreign-types-shared	0.3.1
MODCARGO_CRATES +=	form_urlencoded	1.2.2
MODCARGO_CRATES +=	fs_extra	1.3.0
MODCARGO_CRATES +=	fsevent-sys	4.1.0
MODCARGO_CRATES +=	fslock	0.2.1
MODCARGO_CRATES +=	futures	0.3.31
MODCARGO_CRATES +=	futures-channel	0.3.31
MODCARGO_CRATES +=	futures-core	0.3.31
MODCARGO_CRATES +=	futures-executor	0.3.31
MODCARGO_CRATES +=	futures-intrusive	0.5.0
MODCARGO_CRATES +=	futures-io	0.3.31
MODCARGO_CRATES +=	futures-lite	2.6.1
MODCARGO_CRATES +=	futures-macro	0.3.31
MODCARGO_CRATES +=	futures-sink	0.3.31
MODCARGO_CRATES +=	futures-task	0.3.31
MODCARGO_CRATES +=	futures-util	0.3.31
MODCARGO_CRATES +=	fxhash	0.2.1
MODCARGO_CRATES +=	generator	0.8.8
MODCARGO_CRATES +=	generic-array	0.14.7
MODCARGO_CRATES +=	gethostname	1.1.0
MODCARGO_CRATES +=	getopts	0.2.24
MODCARGO_CRATES +=	getrandom	0.2.17
MODCARGO_CRATES +=	getrandom	0.3.4
MODCARGO_CRATES +=	gimli	0.32.3
MODCARGO_CRATES +=	glob	0.3.3
MODCARGO_CRATES +=	globset	0.4.18
MODCARGO_CRATES +=	h2	0.4.13
MODCARGO_CRATES +=	half	2.7.1
MODCARGO_CRATES +=	hashbrown	0.12.3
MODCARGO_CRATES +=	hashbrown	0.14.5
MODCARGO_CRATES +=	hashbrown	0.15.5
MODCARGO_CRATES +=	hashbrown	0.16.1
MODCARGO_CRATES +=	hashlink	0.10.0
MODCARGO_CRATES +=	heck	0.5.0
MODCARGO_CRATES +=	hermit-abi	0.5.2
MODCARGO_CRATES +=	hex	0.4.3
MODCARGO_CRATES +=	hickory-proto	0.25.2
MODCARGO_CRATES +=	hickory-resolver	0.25.2
MODCARGO_CRATES +=	hkdf	0.12.4
MODCARGO_CRATES +=	hmac	0.12.1
MODCARGO_CRATES +=	home	0.5.12
MODCARGO_CRATES +=	hostname	0.4.2
MODCARGO_CRATES +=	http	0.2.12
MODCARGO_CRATES +=	http	1.4.0
MODCARGO_CRATES +=	http-body	1.0.1
MODCARGO_CRATES +=	http-body-util	0.1.3
MODCARGO_CRATES +=	http-range-header	0.4.2
MODCARGO_CRATES +=	httparse	1.10.1
MODCARGO_CRATES +=	httpdate	1.0.3
MODCARGO_CRATES +=	hyper	1.8.1
MODCARGO_CRATES +=	hyper-rustls	0.27.7
MODCARGO_CRATES +=	hyper-timeout	0.5.2
MODCARGO_CRATES +=	hyper-tls	0.6.0
MODCARGO_CRATES +=	hyper-util	0.1.19
MODCARGO_CRATES +=	i18n-config	0.4.8
MODCARGO_CRATES +=	i18n-embed	0.15.4
MODCARGO_CRATES +=	i18n-embed-fl	0.9.4
MODCARGO_CRATES +=	i18n-embed-impl	0.8.4
MODCARGO_CRATES +=	iana-time-zone	0.1.65
MODCARGO_CRATES +=	iana-time-zone-haiku	0.1.2
MODCARGO_CRATES +=	icu_collections	2.1.1
MODCARGO_CRATES +=	icu_decimal	2.1.1
MODCARGO_CRATES +=	icu_decimal_data	2.1.1
MODCARGO_CRATES +=	icu_locale	2.1.1
MODCARGO_CRATES +=	icu_locale_core	2.1.1
MODCARGO_CRATES +=	icu_locale_data	2.1.2
MODCARGO_CRATES +=	icu_normalizer	2.1.1
MODCARGO_CRATES +=	icu_normalizer_data	2.1.1
MODCARGO_CRATES +=	icu_properties	2.1.2
MODCARGO_CRATES +=	icu_properties_data	2.1.2
MODCARGO_CRATES +=	icu_provider	2.1.1
MODCARGO_CRATES +=	ident_case	1.0.1
MODCARGO_CRATES +=	idna	1.1.0
MODCARGO_CRATES +=	idna_adapter	1.2.1
MODCARGO_CRATES +=	ignore	0.4.25
MODCARGO_CRATES +=	image	0.25.9
MODCARGO_CRATES +=	impl-more	0.1.9
MODCARGO_CRATES +=	include_dir	0.7.4
MODCARGO_CRATES +=	include_dir_macros	0.7.4
MODCARGO_CRATES +=	indenter	0.3.4
MODCARGO_CRATES +=	indexmap	1.9.3
MODCARGO_CRATES +=	indexmap	2.13.0
MODCARGO_CRATES +=	indoc	2.0.7
MODCARGO_CRATES +=	inotify	0.11.0
MODCARGO_CRATES +=	inotify-sys	0.1.5
MODCARGO_CRATES +=	inout	0.1.4
MODCARGO_CRATES +=	insta	1.46.2
MODCARGO_CRATES +=	instability	0.3.11
MODCARGO_CRATES +=	intl-memoizer	0.5.3
MODCARGO_CRATES +=	intl_pluralrules	7.0.2
MODCARGO_CRATES +=	inventory	0.3.21
MODCARGO_CRATES +=	io_tee	0.1.1
MODCARGO_CRATES +=	ipconfig	0.3.2
MODCARGO_CRATES +=	ipnet	2.11.0
MODCARGO_CRATES +=	iri-string	0.7.10
MODCARGO_CRATES +=	is-terminal	0.4.17
MODCARGO_CRATES +=	is_ci	1.2.0
MODCARGO_CRATES +=	is_terminal_polyfill	1.70.2
MODCARGO_CRATES +=	itertools	0.10.5
MODCARGO_CRATES +=	itertools	0.13.0
MODCARGO_CRATES +=	itertools	0.14.0
MODCARGO_CRATES +=	itoa	1.0.17
MODCARGO_CRATES +=	jiff	0.2.18
MODCARGO_CRATES +=	jiff-static	0.2.18
MODCARGO_CRATES +=	jni	0.21.1
MODCARGO_CRATES +=	jni-sys	0.3.0
MODCARGO_CRATES +=	jobserver	0.1.34
MODCARGO_CRATES +=	js-sys	0.3.85
MODCARGO_CRATES +=	keyring	3.6.3
MODCARGO_CRATES +=	kqueue	1.1.1
MODCARGO_CRATES +=	kqueue-sys	1.0.4
MODCARGO_CRATES +=	lalrpop	0.19.12
MODCARGO_CRATES +=	lalrpop-util	0.19.12
MODCARGO_CRATES +=	landlock	0.4.4
MODCARGO_CRATES +=	language-tags	0.3.2
MODCARGO_CRATES +=	lazy_static	1.5.0
MODCARGO_CRATES +=	libc	0.2.180
MODCARGO_CRATES +=	libdbus-sys	0.2.7
MODCARGO_CRATES +=	libloading	0.8.9
MODCARGO_CRATES +=	libm	0.2.16
MODCARGO_CRATES +=	libredox	0.1.12
MODCARGO_CRATES +=	libsqlite3-sys	0.30.1
MODCARGO_CRATES +=	linux-keyutils	0.2.4
MODCARGO_CRATES +=	linux-raw-sys	0.4.15
MODCARGO_CRATES +=	linux-raw-sys	0.11.0
MODCARGO_CRATES +=	litemap	0.8.1
MODCARGO_CRATES +=	local-waker	0.1.4
MODCARGO_CRATES +=	lock_api	0.4.14
MODCARGO_CRATES +=	log	0.4.29
MODCARGO_CRATES +=	logos	0.12.1
MODCARGO_CRATES +=	logos-derive	0.12.1
MODCARGO_CRATES +=	loom	0.7.2
MODCARGO_CRATES +=	lru	0.12.5
MODCARGO_CRATES +=	lru	0.16.3
MODCARGO_CRATES +=	lru-slab	0.1.2
MODCARGO_CRATES +=	lsp-types	0.94.1
MODCARGO_CRATES +=	lzma-rs	0.3.0
MODCARGO_CRATES +=	lzma-sys	0.1.20
MODCARGO_CRATES +=	maplit	1.0.2
MODCARGO_CRATES +=	matchers	0.2.0
MODCARGO_CRATES +=	matchit	0.8.4
MODCARGO_CRATES +=	matchit	0.9.1
MODCARGO_CRATES +=	md-5	0.10.6
MODCARGO_CRATES +=	md5	0.8.0
MODCARGO_CRATES +=	memchr	2.7.6
MODCARGO_CRATES +=	memoffset	0.6.5
MODCARGO_CRATES +=	memoffset	0.9.1
MODCARGO_CRATES +=	mime	0.3.17
MODCARGO_CRATES +=	mime_guess	2.0.5
MODCARGO_CRATES +=	minimal-lexical	0.2.1
MODCARGO_CRATES +=	miniz_oxide	0.8.9
MODCARGO_CRATES +=	mio	1.1.1
MODCARGO_CRATES +=	moka	0.12.13
MODCARGO_CRATES +=	moxcms	0.7.11
MODCARGO_CRATES +=	multimap	0.10.1
MODCARGO_CRATES +=	native-tls	0.2.14
MODCARGO_CRATES +=	ndk-context	0.1.1
MODCARGO_CRATES +=	new_debug_unreachable	1.0.6
MODCARGO_CRATES +=	nibble_vec	0.1.0
MODCARGO_CRATES +=	nix	0.28.0
MODCARGO_CRATES +=	nix	0.29.0
MODCARGO_CRATES +=	nix	0.30.1
MODCARGO_CRATES +=	nom	7.1.3
MODCARGO_CRATES +=	nom	8.0.0
MODCARGO_CRATES +=	normalize-line-endings	0.3.0
MODCARGO_CRATES +=	notify	8.2.0
MODCARGO_CRATES +=	notify-types	2.1.0
MODCARGO_CRATES +=	nu-ansi-term	0.50.3
MODCARGO_CRATES +=	num	0.4.3
MODCARGO_CRATES +=	num-bigint	0.4.6
MODCARGO_CRATES +=	num-bigint-dig	0.8.6
MODCARGO_CRATES +=	num-complex	0.4.6
MODCARGO_CRATES +=	num-conv	0.2.0
MODCARGO_CRATES +=	num-integer	0.1.46
MODCARGO_CRATES +=	num-iter	0.1.45
MODCARGO_CRATES +=	num-rational	0.4.2
MODCARGO_CRATES +=	num-traits	0.2.19
MODCARGO_CRATES +=	num_cpus	1.17.0
MODCARGO_CRATES +=	num_threads	0.1.7
MODCARGO_CRATES +=	oauth2	5.0.0
MODCARGO_CRATES +=	objc2	0.6.3
MODCARGO_CRATES +=	objc2-app-kit	0.3.2
MODCARGO_CRATES +=	objc2-cloud-kit	0.3.2
MODCARGO_CRATES +=	objc2-core-data	0.3.2
MODCARGO_CRATES +=	objc2-core-foundation	0.3.2
MODCARGO_CRATES +=	objc2-core-graphics	0.3.2
MODCARGO_CRATES +=	objc2-core-image	0.3.2
MODCARGO_CRATES +=	objc2-core-location	0.3.2
MODCARGO_CRATES +=	objc2-core-text	0.3.2
MODCARGO_CRATES +=	objc2-encode	4.1.0
MODCARGO_CRATES +=	objc2-foundation	0.3.2
MODCARGO_CRATES +=	objc2-io-surface	0.3.2
MODCARGO_CRATES +=	objc2-quartz-core	0.3.2
MODCARGO_CRATES +=	objc2-ui-kit	0.3.2
MODCARGO_CRATES +=	objc2-user-notifications	0.3.2
MODCARGO_CRATES +=	object	0.37.3
MODCARGO_CRATES +=	once_cell	1.21.3
MODCARGO_CRATES +=	once_cell_polyfill	1.70.2
MODCARGO_CRATES +=	opaque-debug	0.3.1
MODCARGO_CRATES +=	openssl	0.10.75
MODCARGO_CRATES +=	openssl-macros	0.1.1
MODCARGO_CRATES +=	openssl-probe	0.1.6
MODCARGO_CRATES +=	openssl-probe	0.2.1
MODCARGO_CRATES +=	openssl-src	300.5.5+3.5.5
MODCARGO_CRATES +=	openssl-sys	0.9.111
MODCARGO_CRATES +=	opentelemetry	0.31.0
MODCARGO_CRATES +=	opentelemetry-appender-tracing	0.31.1
MODCARGO_CRATES +=	opentelemetry-http	0.31.0
MODCARGO_CRATES +=	opentelemetry-otlp	0.31.0
MODCARGO_CRATES +=	opentelemetry-proto	0.31.0
MODCARGO_CRATES +=	opentelemetry-semantic-conventions	0.31.0
MODCARGO_CRATES +=	opentelemetry_sdk	0.31.0
MODCARGO_CRATES +=	option-ext	0.2.0
MODCARGO_CRATES +=	ordered-stream	0.2.0
MODCARGO_CRATES +=	os_info	3.14.0
MODCARGO_CRATES +=	os_pipe	1.2.3
MODCARGO_CRATES +=	owo-colors	4.2.3
MODCARGO_CRATES +=	parking	2.2.1
MODCARGO_CRATES +=	parking_lot	0.12.5
MODCARGO_CRATES +=	parking_lot_core	0.9.12
MODCARGO_CRATES +=	paste	1.0.15
MODCARGO_CRATES +=	pastey	0.2.1
MODCARGO_CRATES +=	path-absolutize	3.1.1
MODCARGO_CRATES +=	path-dedot	3.1.1
MODCARGO_CRATES +=	pathdiff	0.2.3
MODCARGO_CRATES +=	pbkdf2	0.12.2
MODCARGO_CRATES +=	pem-rfc7468	0.7.0
MODCARGO_CRATES +=	percent-encoding	2.3.2
MODCARGO_CRATES +=	petgraph	0.6.5
MODCARGO_CRATES +=	petgraph	0.8.3
MODCARGO_CRATES +=	phf_shared	0.11.3
MODCARGO_CRATES +=	pin-project	1.1.10
MODCARGO_CRATES +=	pin-project-internal	1.1.10
MODCARGO_CRATES +=	pin-project-lite	0.2.16
MODCARGO_CRATES +=	pin-utils	0.1.0
MODCARGO_CRATES +=	piper	0.2.4
MODCARGO_CRATES +=	pkcs1	0.7.5
MODCARGO_CRATES +=	pkcs8	0.10.2
MODCARGO_CRATES +=	pkg-config	0.3.32
MODCARGO_CRATES +=	png	0.18.0
MODCARGO_CRATES +=	polling	3.11.0
MODCARGO_CRATES +=	poly1305	0.8.0
MODCARGO_CRATES +=	portable-atomic	1.13.1
MODCARGO_CRATES +=	portable-atomic-util	0.2.5
MODCARGO_CRATES +=	portable-pty	0.9.0
MODCARGO_CRATES +=	potential_utf	0.1.4
MODCARGO_CRATES +=	powerfmt	0.2.0
MODCARGO_CRATES +=	ppv-lite86	0.2.21
MODCARGO_CRATES +=	precomputed-hash	0.1.1
MODCARGO_CRATES +=	predicates	3.1.3
MODCARGO_CRATES +=	predicates-core	1.0.9
MODCARGO_CRATES +=	predicates-tree	1.0.12
MODCARGO_CRATES +=	pretty_assertions	1.4.1
MODCARGO_CRATES +=	proc-macro-crate	3.4.0
MODCARGO_CRATES +=	proc-macro-error-attr2	2.0.0
MODCARGO_CRATES +=	proc-macro-error2	2.0.1
MODCARGO_CRATES +=	proc-macro2	1.0.106
MODCARGO_CRATES +=	process-wrap	9.0.1
MODCARGO_CRATES +=	proptest	1.9.0
MODCARGO_CRATES +=	prost	0.14.3
MODCARGO_CRATES +=	prost-derive	0.14.3
MODCARGO_CRATES +=	psl	2.1.184
MODCARGO_CRATES +=	psl-types	2.0.11
MODCARGO_CRATES +=	pulldown-cmark	0.10.3
MODCARGO_CRATES +=	pulldown-cmark-escape	0.10.1
MODCARGO_CRATES +=	pxfm	0.1.27
MODCARGO_CRATES +=	quick-error	2.0.1
MODCARGO_CRATES +=	quick-xml	0.38.4
MODCARGO_CRATES +=	quinn	0.11.9
MODCARGO_CRATES +=	quinn-proto	0.11.13
MODCARGO_CRATES +=	quinn-udp	0.5.14
MODCARGO_CRATES +=	quote	1.0.44
MODCARGO_CRATES +=	r-efi	5.3.0
MODCARGO_CRATES +=	radix_trie	0.2.1
MODCARGO_CRATES +=	radix_trie	0.3.0
MODCARGO_CRATES +=	rama-boring	0.5.10
MODCARGO_CRATES +=	rama-boring-sys	0.5.10
MODCARGO_CRATES +=	rama-boring-tokio	0.5.10
MODCARGO_CRATES +=	rama-core	0.3.0-alpha.4
MODCARGO_CRATES +=	rama-dns	0.3.0-alpha.4
MODCARGO_CRATES +=	rama-error	0.3.0-alpha.4
MODCARGO_CRATES +=	rama-http	0.3.0-alpha.4
MODCARGO_CRATES +=	rama-http-backend	0.3.0-alpha.4
MODCARGO_CRATES +=	rama-http-core	0.3.0-alpha.4
MODCARGO_CRATES +=	rama-http-headers	0.3.0-alpha.4
MODCARGO_CRATES +=	rama-http-types	0.3.0-alpha.4
MODCARGO_CRATES +=	rama-macros	0.3.0-alpha.4
MODCARGO_CRATES +=	rama-net	0.3.0-alpha.4
MODCARGO_CRATES +=	rama-socks5	0.3.0-alpha.4
MODCARGO_CRATES +=	rama-tcp	0.3.0-alpha.4
MODCARGO_CRATES +=	rama-tls-boring	0.3.0-alpha.4
MODCARGO_CRATES +=	rama-udp	0.3.0-alpha.4
MODCARGO_CRATES +=	rama-unix	0.3.0-alpha.4
MODCARGO_CRATES +=	rama-utils	0.3.0-alpha.4
MODCARGO_CRATES +=	rand	0.8.5
MODCARGO_CRATES +=	rand	0.9.2
MODCARGO_CRATES +=	rand_chacha	0.3.1
MODCARGO_CRATES +=	rand_chacha	0.9.0
MODCARGO_CRATES +=	rand_core	0.6.4
MODCARGO_CRATES +=	rand_core	0.9.5
MODCARGO_CRATES +=	rand_xorshift	0.4.0
MODCARGO_CRATES +=	ratatui-macros	0.6.0
MODCARGO_CRATES +=	rayon	1.11.0
MODCARGO_CRATES +=	rayon-core	1.13.0
MODCARGO_CRATES +=	redox_syscall	0.5.18
MODCARGO_CRATES +=	redox_syscall	0.7.0
MODCARGO_CRATES +=	redox_users	0.4.6
MODCARGO_CRATES +=	redox_users	0.5.2
MODCARGO_CRATES +=	ref-cast	1.0.25
MODCARGO_CRATES +=	ref-cast-impl	1.0.25
MODCARGO_CRATES +=	regex	1.12.2
MODCARGO_CRATES +=	regex-automata	0.4.13
MODCARGO_CRATES +=	regex-lite	0.1.8
MODCARGO_CRATES +=	regex-syntax	0.6.29
MODCARGO_CRATES +=	regex-syntax	0.8.8
MODCARGO_CRATES +=	reqwest	0.12.28
MODCARGO_CRATES +=	resolv-conf	0.7.6
MODCARGO_CRATES +=	ring	0.17.14
MODCARGO_CRATES +=	rmcp	0.12.0
MODCARGO_CRATES +=	rmcp-macros	0.12.0
MODCARGO_CRATES +=	rsa	0.9.10
MODCARGO_CRATES +=	rust-embed	8.11.0
MODCARGO_CRATES +=	rust-embed-impl	8.11.0
MODCARGO_CRATES +=	rust-embed-utils	8.11.0
MODCARGO_CRATES +=	rustc-demangle	0.1.27
MODCARGO_CRATES +=	rustc-hash	1.1.0
MODCARGO_CRATES +=	rustc-hash	2.1.1
MODCARGO_CRATES +=	rustc_version	0.4.1
MODCARGO_CRATES +=	rustix	0.38.44
MODCARGO_CRATES +=	rustix	1.1.3
MODCARGO_CRATES +=	rustls	0.23.36
MODCARGO_CRATES +=	rustls-native-certs	0.8.3
MODCARGO_CRATES +=	rustls-pki-types	1.14.0
MODCARGO_CRATES +=	rustls-webpki	0.103.9
MODCARGO_CRATES +=	rustversion	1.0.22
MODCARGO_CRATES +=	rustyline	14.0.0
MODCARGO_CRATES +=	ryu	1.0.22
MODCARGO_CRATES +=	salsa20	0.10.2
MODCARGO_CRATES +=	same-file	1.0.6
MODCARGO_CRATES +=	scc	2.4.0
MODCARGO_CRATES +=	schannel	0.1.28
MODCARGO_CRATES +=	schemafy	0.5.2
MODCARGO_CRATES +=	schemafy_core	0.5.2
MODCARGO_CRATES +=	schemafy_lib	0.5.2
MODCARGO_CRATES +=	schemars	0.8.22
MODCARGO_CRATES +=	schemars	0.9.0
MODCARGO_CRATES +=	schemars	1.2.1
MODCARGO_CRATES +=	schemars_derive	0.8.22
MODCARGO_CRATES +=	schemars_derive	1.2.1
MODCARGO_CRATES +=	scoped-tls	1.0.1
MODCARGO_CRATES +=	scopeguard	1.2.0
MODCARGO_CRATES +=	scrypt	0.11.0
MODCARGO_CRATES +=	sdd	3.0.10
MODCARGO_CRATES +=	seccompiler	0.5.0
MODCARGO_CRATES +=	secrecy	0.10.3
MODCARGO_CRATES +=	secret-service	4.0.0
MODCARGO_CRATES +=	security-framework	2.11.1
MODCARGO_CRATES +=	security-framework	3.5.1
MODCARGO_CRATES +=	security-framework-sys	2.15.0
MODCARGO_CRATES +=	self_cell	0.10.3
MODCARGO_CRATES +=	self_cell	1.2.2
MODCARGO_CRATES +=	semver	1.0.27
MODCARGO_CRATES +=	sentry	0.46.1
MODCARGO_CRATES +=	sentry-actix	0.46.1
MODCARGO_CRATES +=	sentry-backtrace	0.46.1
MODCARGO_CRATES +=	sentry-contexts	0.46.1
MODCARGO_CRATES +=	sentry-core	0.46.1
MODCARGO_CRATES +=	sentry-debug-images	0.46.1
MODCARGO_CRATES +=	sentry-panic	0.46.1
MODCARGO_CRATES +=	sentry-tracing	0.46.1
MODCARGO_CRATES +=	sentry-types	0.46.1
MODCARGO_CRATES +=	serde	1.0.228
MODCARGO_CRATES +=	serde_core	1.0.228
MODCARGO_CRATES +=	serde_derive	1.0.228
MODCARGO_CRATES +=	serde_derive_internals	0.29.1
MODCARGO_CRATES +=	serde_html_form	0.3.2
MODCARGO_CRATES +=	serde_json	1.0.149
MODCARGO_CRATES +=	serde_path_to_error	0.1.20
MODCARGO_CRATES +=	serde_repr	0.1.20
MODCARGO_CRATES +=	serde_spanned	1.0.4
MODCARGO_CRATES +=	serde_urlencoded	0.7.1
MODCARGO_CRATES +=	serde_with	3.16.1
MODCARGO_CRATES +=	serde_with_macros	3.16.1
MODCARGO_CRATES +=	serde_yaml	0.9.34+deprecated
MODCARGO_CRATES +=	serial2	0.2.33
MODCARGO_CRATES +=	serial_test	3.3.1
MODCARGO_CRATES +=	serial_test_derive	3.3.1
MODCARGO_CRATES +=	sha1	0.10.6
MODCARGO_CRATES +=	sha1_smol	1.0.1
MODCARGO_CRATES +=	sha2	0.10.9
MODCARGO_CRATES +=	sharded-slab	0.1.7
MODCARGO_CRATES +=	shared_library	0.1.9
MODCARGO_CRATES +=	shell-words	1.1.1
MODCARGO_CRATES +=	shlex	1.3.0
MODCARGO_CRATES +=	signal-hook	0.3.18
MODCARGO_CRATES +=	signal-hook-mio	0.2.5
MODCARGO_CRATES +=	signal-hook-registry	1.4.8
MODCARGO_CRATES +=	signature	2.2.0
MODCARGO_CRATES +=	simd-adler32	0.3.8
MODCARGO_CRATES +=	simdutf8	0.1.5
MODCARGO_CRATES +=	similar	2.7.0
MODCARGO_CRATES +=	siphasher	1.0.2
MODCARGO_CRATES +=	slab	0.4.12
MODCARGO_CRATES +=	smallvec	1.15.1
MODCARGO_CRATES +=	smawk	0.3.2
MODCARGO_CRATES +=	smol_str	0.3.5
MODCARGO_CRATES +=	socket2	0.5.10
MODCARGO_CRATES +=	socket2	0.6.2
MODCARGO_CRATES +=	spin	0.9.8
MODCARGO_CRATES +=	spki	0.7.3
MODCARGO_CRATES +=	sqlx	0.8.6
MODCARGO_CRATES +=	sqlx-core	0.8.6
MODCARGO_CRATES +=	sqlx-macros	0.8.6
MODCARGO_CRATES +=	sqlx-macros-core	0.8.6
MODCARGO_CRATES +=	sqlx-mysql	0.8.6
MODCARGO_CRATES +=	sqlx-postgres	0.8.6
MODCARGO_CRATES +=	sqlx-sqlite	0.8.6
MODCARGO_CRATES +=	sse-stream	0.2.1
MODCARGO_CRATES +=	stable_deref_trait	1.2.1
MODCARGO_CRATES +=	starlark	0.13.0
MODCARGO_CRATES +=	starlark_derive	0.13.0
MODCARGO_CRATES +=	starlark_map	0.13.0
MODCARGO_CRATES +=	starlark_syntax	0.13.0
MODCARGO_CRATES +=	static_assertions	1.1.0
MODCARGO_CRATES +=	streaming-iterator	0.1.9
MODCARGO_CRATES +=	string_cache	0.8.9
MODCARGO_CRATES +=	stringprep	0.1.5
MODCARGO_CRATES +=	strsim	0.10.0
MODCARGO_CRATES +=	strsim	0.11.1
MODCARGO_CRATES +=	strum	0.26.3
MODCARGO_CRATES +=	strum	0.27.2
MODCARGO_CRATES +=	strum_macros	0.26.4
MODCARGO_CRATES +=	strum_macros	0.27.2
MODCARGO_CRATES +=	subtle	2.6.1
MODCARGO_CRATES +=	supports-color	2.1.0
MODCARGO_CRATES +=	supports-color	3.0.2
MODCARGO_CRATES +=	syn	1.0.109
MODCARGO_CRATES +=	syn	2.0.114
MODCARGO_CRATES +=	sync_wrapper	1.0.2
MODCARGO_CRATES +=	synstructure	0.13.2
MODCARGO_CRATES +=	sys-locale	0.3.2
MODCARGO_CRATES +=	system-configuration	0.6.1
MODCARGO_CRATES +=	system-configuration-sys	0.6.0
MODCARGO_CRATES +=	tagptr	0.2.0
MODCARGO_CRATES +=	tempfile	3.24.0
MODCARGO_CRATES +=	term	0.7.0
MODCARGO_CRATES +=	termcolor	1.4.1
MODCARGO_CRATES +=	terminal_size	0.4.3
MODCARGO_CRATES +=	termtree	0.5.1
MODCARGO_CRATES +=	test-case	3.3.1
MODCARGO_CRATES +=	test-case-core	3.3.1
MODCARGO_CRATES +=	test-case-macros	3.3.1
MODCARGO_CRATES +=	test-log	0.2.19
MODCARGO_CRATES +=	test-log-macros	0.2.19
MODCARGO_CRATES +=	textwrap	0.11.0
MODCARGO_CRATES +=	textwrap	0.16.2
MODCARGO_CRATES +=	thiserror	1.0.69
MODCARGO_CRATES +=	thiserror	2.0.18
MODCARGO_CRATES +=	thiserror-impl	1.0.69
MODCARGO_CRATES +=	thiserror-impl	2.0.18
MODCARGO_CRATES +=	thread_local	1.1.9
MODCARGO_CRATES +=	tiff	0.10.3
MODCARGO_CRATES +=	time	0.3.46
MODCARGO_CRATES +=	time-core	0.1.8
MODCARGO_CRATES +=	time-macros	0.2.26
MODCARGO_CRATES +=	tiny-keccak	2.0.2
MODCARGO_CRATES +=	tiny_http	0.12.0
MODCARGO_CRATES +=	tinystr	0.8.2
MODCARGO_CRATES +=	tinyvec	1.10.0
MODCARGO_CRATES +=	tinyvec_macros	0.1.1
MODCARGO_CRATES +=	tokio	1.49.0
MODCARGO_CRATES +=	tokio-graceful	0.2.2
MODCARGO_CRATES +=	tokio-macros	2.6.0
MODCARGO_CRATES +=	tokio-native-tls	0.3.1
MODCARGO_CRATES +=	tokio-rustls	0.26.4
MODCARGO_CRATES +=	tokio-stream	0.1.18
MODCARGO_CRATES +=	tokio-test	0.4.5
MODCARGO_CRATES +=	tokio-util	0.7.18
MODCARGO_CRATES +=	toml	0.5.11
MODCARGO_CRATES +=	toml	0.9.11+spec-1.1.0
MODCARGO_CRATES +=	toml_datetime	0.7.5+spec-1.1.0
MODCARGO_CRATES +=	toml_edit	0.23.10+spec-1.0.0
MODCARGO_CRATES +=	toml_edit	0.24.0+spec-1.1.0
MODCARGO_CRATES +=	toml_parser	1.0.6+spec-1.1.0
MODCARGO_CRATES +=	toml_writer	1.0.6+spec-1.1.0
MODCARGO_CRATES +=	tonic	0.14.3
MODCARGO_CRATES +=	tonic-prost	0.14.3
MODCARGO_CRATES +=	tower	0.5.3
MODCARGO_CRATES +=	tower-http	0.6.8
MODCARGO_CRATES +=	tower-layer	0.3.3
MODCARGO_CRATES +=	tower-service	0.3.3
MODCARGO_CRATES +=	tracing	0.1.44
MODCARGO_CRATES +=	tracing-appender	0.2.4
MODCARGO_CRATES +=	tracing-attributes	0.1.31
MODCARGO_CRATES +=	tracing-core	0.1.36
MODCARGO_CRATES +=	tracing-error	0.2.1
MODCARGO_CRATES +=	tracing-log	0.2.0
MODCARGO_CRATES +=	tracing-opentelemetry	0.32.1
MODCARGO_CRATES +=	tracing-subscriber	0.3.22
MODCARGO_CRATES +=	tracing-test	0.2.5
MODCARGO_CRATES +=	tracing-test-macro	0.2.5
MODCARGO_CRATES +=	tree-sitter	0.25.10
MODCARGO_CRATES +=	tree-sitter-bash	0.25.1
MODCARGO_CRATES +=	tree-sitter-highlight	0.25.10
MODCARGO_CRATES +=	tree-sitter-language	0.1.7
MODCARGO_CRATES +=	tree_magic_mini	3.2.2
MODCARGO_CRATES +=	try-lock	0.2.5
MODCARGO_CRATES +=	ts-rs	11.1.0
MODCARGO_CRATES +=	ts-rs-macros	11.1.0
MODCARGO_CRATES +=	type-map	0.5.1
MODCARGO_CRATES +=	typenum	1.19.0
MODCARGO_CRATES +=	uds_windows	1.1.0
MODCARGO_CRATES +=	uname	0.1.1
MODCARGO_CRATES +=	unarray	0.1.4
MODCARGO_CRATES +=	unic-langid	0.9.6
MODCARGO_CRATES +=	unic-langid-impl	0.9.6
MODCARGO_CRATES +=	unicase	2.9.0
MODCARGO_CRATES +=	unicode-bidi	0.3.18
MODCARGO_CRATES +=	unicode-ident	1.0.22
MODCARGO_CRATES +=	unicode-linebreak	0.1.5
MODCARGO_CRATES +=	unicode-normalization	0.1.25
MODCARGO_CRATES +=	unicode-properties	0.1.4
MODCARGO_CRATES +=	unicode-segmentation	1.12.0
MODCARGO_CRATES +=	unicode-truncate	1.1.0
MODCARGO_CRATES +=	unicode-width	0.1.14
MODCARGO_CRATES +=	unicode-width	0.2.1
MODCARGO_CRATES +=	unicode-xid	0.2.6
MODCARGO_CRATES +=	universal-hash	0.5.1
MODCARGO_CRATES +=	unsafe-libyaml	0.2.11
MODCARGO_CRATES +=	untrusted	0.9.0
MODCARGO_CRATES +=	ureq	3.1.4
MODCARGO_CRATES +=	ureq-proto	0.5.3
MODCARGO_CRATES +=	url	2.5.8
MODCARGO_CRATES +=	urlencoding	2.1.3
MODCARGO_CRATES +=	utf-8	0.7.6
MODCARGO_CRATES +=	utf8_iter	1.0.4
MODCARGO_CRATES +=	utf8parse	0.2.2
MODCARGO_CRATES +=	uuid	1.20.0
MODCARGO_CRATES +=	valuable	0.1.1
MODCARGO_CRATES +=	vcpkg	0.2.15
MODCARGO_CRATES +=	version_check	0.9.5
MODCARGO_CRATES +=	vt100	0.16.2
MODCARGO_CRATES +=	vte	0.15.0
MODCARGO_CRATES +=	wait-timeout	0.2.1
MODCARGO_CRATES +=	walkdir	2.5.0
MODCARGO_CRATES +=	want	0.3.1
MODCARGO_CRATES +=	wasi	0.11.1+wasi-snapshot-preview1
MODCARGO_CRATES +=	wasip2	1.0.2+wasi-0.2.9
MODCARGO_CRATES +=	wasite	0.1.0
MODCARGO_CRATES +=	wasm-bindgen	0.2.108
MODCARGO_CRATES +=	wasm-bindgen-futures	0.4.58
MODCARGO_CRATES +=	wasm-bindgen-macro	0.2.108
MODCARGO_CRATES +=	wasm-bindgen-macro-support	0.2.108
MODCARGO_CRATES +=	wasm-bindgen-shared	0.2.108
MODCARGO_CRATES +=	wasm-streams	0.4.2
MODCARGO_CRATES +=	wayland-backend	0.3.12
MODCARGO_CRATES +=	wayland-client	0.31.12
MODCARGO_CRATES +=	wayland-protocols	0.32.10
MODCARGO_CRATES +=	wayland-protocols-wlr	0.3.10
MODCARGO_CRATES +=	wayland-scanner	0.31.8
MODCARGO_CRATES +=	wayland-sys	0.31.8
MODCARGO_CRATES +=	web-sys	0.3.85
MODCARGO_CRATES +=	web-time	1.1.0
MODCARGO_CRATES +=	webbrowser	1.0.6
MODCARGO_CRATES +=	webpki-root-certs	1.0.5
MODCARGO_CRATES +=	webpki-roots	0.26.11
MODCARGO_CRATES +=	webpki-roots	1.0.5
MODCARGO_CRATES +=	weezl	0.1.12
MODCARGO_CRATES +=	which	8.0.0
MODCARGO_CRATES +=	whoami	1.6.1
MODCARGO_CRATES +=	widestring	1.2.1
MODCARGO_CRATES +=	wildcard	0.3.0
MODCARGO_CRATES +=	wildmatch	2.6.1
MODCARGO_CRATES +=	winapi	0.3.9
MODCARGO_CRATES +=	winapi-i686-pc-windows-gnu	0.4.0
MODCARGO_CRATES +=	winapi-util	0.1.11
MODCARGO_CRATES +=	winapi-x86_64-pc-windows-gnu	0.4.0
MODCARGO_CRATES +=	windows	0.58.0
MODCARGO_CRATES +=	windows	0.62.2
MODCARGO_CRATES +=	windows-collections	0.3.2
MODCARGO_CRATES +=	windows-core	0.58.0
MODCARGO_CRATES +=	windows-core	0.62.2
MODCARGO_CRATES +=	windows-future	0.3.2
MODCARGO_CRATES +=	windows-implement	0.58.0
MODCARGO_CRATES +=	windows-implement	0.60.2
MODCARGO_CRATES +=	windows-interface	0.58.0
MODCARGO_CRATES +=	windows-interface	0.59.3
MODCARGO_CRATES +=	windows-link	0.2.1
MODCARGO_CRATES +=	windows-numerics	0.3.1
MODCARGO_CRATES +=	windows-registry	0.6.1
MODCARGO_CRATES +=	windows-result	0.2.0
MODCARGO_CRATES +=	windows-result	0.4.1
MODCARGO_CRATES +=	windows-strings	0.1.0
MODCARGO_CRATES +=	windows-strings	0.5.1
MODCARGO_CRATES +=	windows-sys	0.45.0
MODCARGO_CRATES +=	windows-sys	0.48.0
MODCARGO_CRATES +=	windows-sys	0.52.0
MODCARGO_CRATES +=	windows-sys	0.59.0
MODCARGO_CRATES +=	windows-sys	0.60.2
MODCARGO_CRATES +=	windows-sys	0.61.2
MODCARGO_CRATES +=	windows-targets	0.42.2
MODCARGO_CRATES +=	windows-targets	0.48.5
MODCARGO_CRATES +=	windows-targets	0.52.6
MODCARGO_CRATES +=	windows-targets	0.53.5
MODCARGO_CRATES +=	windows-threading	0.2.1
MODCARGO_CRATES +=	windows_aarch64_gnullvm	0.42.2
MODCARGO_CRATES +=	windows_aarch64_gnullvm	0.48.5
MODCARGO_CRATES +=	windows_aarch64_gnullvm	0.52.6
MODCARGO_CRATES +=	windows_aarch64_gnullvm	0.53.1
MODCARGO_CRATES +=	windows_aarch64_msvc	0.42.2
MODCARGO_CRATES +=	windows_aarch64_msvc	0.48.5
MODCARGO_CRATES +=	windows_aarch64_msvc	0.52.6
MODCARGO_CRATES +=	windows_aarch64_msvc	0.53.1
MODCARGO_CRATES +=	windows_i686_gnu	0.42.2
MODCARGO_CRATES +=	windows_i686_gnu	0.48.5
MODCARGO_CRATES +=	windows_i686_gnu	0.52.6
MODCARGO_CRATES +=	windows_i686_gnu	0.53.1
MODCARGO_CRATES +=	windows_i686_gnullvm	0.52.6
MODCARGO_CRATES +=	windows_i686_gnullvm	0.53.1
MODCARGO_CRATES +=	windows_i686_msvc	0.42.2
MODCARGO_CRATES +=	windows_i686_msvc	0.48.5
MODCARGO_CRATES +=	windows_i686_msvc	0.52.6
MODCARGO_CRATES +=	windows_i686_msvc	0.53.1
MODCARGO_CRATES +=	windows_x86_64_gnu	0.42.2
MODCARGO_CRATES +=	windows_x86_64_gnu	0.48.5
MODCARGO_CRATES +=	windows_x86_64_gnu	0.52.6
MODCARGO_CRATES +=	windows_x86_64_gnu	0.53.1
MODCARGO_CRATES +=	windows_x86_64_gnullvm	0.42.2
MODCARGO_CRATES +=	windows_x86_64_gnullvm	0.48.5
MODCARGO_CRATES +=	windows_x86_64_gnullvm	0.52.6
MODCARGO_CRATES +=	windows_x86_64_gnullvm	0.53.1
MODCARGO_CRATES +=	windows_x86_64_msvc	0.42.2
MODCARGO_CRATES +=	windows_x86_64_msvc	0.48.5
MODCARGO_CRATES +=	windows_x86_64_msvc	0.52.6
MODCARGO_CRATES +=	windows_x86_64_msvc	0.53.1
MODCARGO_CRATES +=	winnow	0.7.14
MODCARGO_CRATES +=	winreg	0.10.1
MODCARGO_CRATES +=	winreg	0.50.0
MODCARGO_CRATES +=	winres	0.1.12
MODCARGO_CRATES +=	winsafe	0.0.19
MODCARGO_CRATES +=	winsplit	0.1.0
MODCARGO_CRATES +=	wiremock	0.6.5
MODCARGO_CRATES +=	wit-bindgen	0.51.0
MODCARGO_CRATES +=	wl-clipboard-rs	0.9.3
MODCARGO_CRATES +=	writeable	0.6.2
MODCARGO_CRATES +=	x11rb	0.13.2
MODCARGO_CRATES +=	x11rb-protocol	0.13.2
MODCARGO_CRATES +=	x25519-dalek	2.0.1
MODCARGO_CRATES +=	xdg-home	1.3.0
MODCARGO_CRATES +=	xz2	0.1.7
MODCARGO_CRATES +=	yansi	1.0.1
MODCARGO_CRATES +=	yoke	0.8.1
MODCARGO_CRATES +=	yoke-derive	0.8.1
MODCARGO_CRATES +=	zbus	4.4.0
MODCARGO_CRATES +=	zbus_macros	4.4.0
MODCARGO_CRATES +=	zbus_names	3.0.0
MODCARGO_CRATES +=	zerocopy	0.8.37
MODCARGO_CRATES +=	zerocopy-derive	0.8.37
MODCARGO_CRATES +=	zerofrom	0.1.6
MODCARGO_CRATES +=	zerofrom-derive	0.1.6
MODCARGO_CRATES +=	zeroize	1.8.2
MODCARGO_CRATES +=	zeroize_derive	1.4.3
MODCARGO_CRATES +=	zerotrie	0.2.3
MODCARGO_CRATES +=	zerovec	0.11.5
MODCARGO_CRATES +=	zerovec-derive	0.11.2
MODCARGO_CRATES +=	zip	2.4.2
MODCARGO_CRATES +=	zmij	1.0.19
MODCARGO_CRATES +=	zopfli	0.8.3
MODCARGO_CRATES +=	zstd	0.13.3
MODCARGO_CRATES +=	zstd-safe	7.2.4
MODCARGO_CRATES +=	zstd-sys	2.0.16+zstd.1.5.7
MODCARGO_CRATES +=	zune-core	0.4.12
MODCARGO_CRATES +=	zune-core	0.5.1
MODCARGO_CRATES +=	zune-jpeg	0.4.21
MODCARGO_CRATES +=	zune-jpeg	0.5.12
MODCARGO_CRATES +=	zvariant	4.2.0
MODCARGO_CRATES +=	zvariant_derive	4.2.0
MODCARGO_CRATES +=	zvariant_utils	2.1.0
