MODGO_MODULES =	\
	al.essio.dev/pkg/shellescape								 v1.6.0 \
	bitbucket.org/creachadair/shell								 v0.0.8 \
	cel.dev/expr										 v0.24.0 \
	cloud.google.com/go									 v0.121.6 \
	cloud.google.com/go/auth								 v0.17.0 \
	cloud.google.com/go/auth/oauth2adapt							 v0.2.8 \
	cloud.google.com/go/compute/metadata							 v0.9.0 \
	cloud.google.com/go/iam									 v1.5.3 \
	cloud.google.com/go/kms									 v1.23.2 \
	cloud.google.com/go/longrunning								 v0.6.7 \
	cloud.google.com/go/monitoring								 v1.24.2 \
	cloud.google.com/go/profiler								 v0.4.3 \
	cloud.google.com/go/pubsub								 v1.50.1 \
	cloud.google.com/go/pubsub/v2								 v2.3.0 \
	cloud.google.com/go/security								 v1.19.2 \
	cloud.google.com/go/spanner								 v1.86.1 \
	cloud.google.com/go/storage								 v1.57.1 \
	cloud.google.com/go/trace								 v1.11.3 \
	contrib.go.opencensus.io/exporter/stackdriver						 v0.13.14 \
	dario.cat/mergo										 v1.0.2 \
	filippo.io/edwards25519									 v1.1.0 \
	github.com/!adam!korcz/go-fuzz-headers-1						 v0.0.0-20230919221257-8b5d3ce2d11d \
	github.com/!alec!aivazis/survey/v2							 v2.3.7 \
	github.com/!azure!a!d/microsoft-authentication-library-for-go				 v1.6.0 \
	github.com/!azure/azure-sdk-for-go/sdk/azcore						 v1.20.0 \
	github.com/!azure/azure-sdk-for-go/sdk/azidentity					 v1.13.1 \
	github.com/!azure/azure-sdk-for-go/sdk/internal						 v1.11.2 \
	github.com/!azure/azure-sdk-for-go/sdk/security/keyvault/azkeys				 v1.4.0 \
	github.com/!azure/azure-sdk-for-go/sdk/security/keyvault/internal			 v1.2.0 \
	github.com/!d!a!t!a-!d!o!g/go-sqlmock							 v1.5.2 \
	github.com/!google!cloud!platform/grpc-gcp-go/grpcgcp					 v1.5.3 \
	github.com/!google!cloud!platform/opentelemetry-operations-go/detectors/gcp		 v1.30.0 \
	github.com/!google!cloud!platform/opentelemetry-operations-go/exporter/metric		 v0.54.0 \
	github.com/!google!cloud!platform/opentelemetry-operations-go/internal/resourcemapping	 v0.54.0 \
	github.com/!make!now!just/heredoc							 v1.0.0 \
	github.com/!masterminds/goutils								 v1.1.1 \
	github.com/!masterminds/semver/v3							 v3.4.0 \
	github.com/!masterminds/sprig/v3							 v3.3.0 \
	github.com/!microsoft/go-winio								 v0.6.2 \
	github.com/!netflix/go-expect								 v0.0.0-20220104043353-73e0943537d2 \
	github.com/!vivid!cortex/ewma								 v1.2.0 \
	github.com/alecthomas/assert/v2								 v2.11.0 \
	github.com/alecthomas/chroma/v2								 v2.19.0 \
	github.com/alecthomas/repr								 v0.4.0 \
	github.com/alessio/shellescape								 v1.4.1 \
	github.com/antihax/optional								 v1.0.0 \
	github.com/asaskevich/govalidator							 v0.0.0-20230301143203-a9d515a09cc2 \
	github.com/atotto/clipboard								 v0.1.4 \
	github.com/aws/aws-sdk-go								 v1.55.7 \
	github.com/aws/aws-sdk-go-v2								 v1.39.6 \
	github.com/aws/aws-sdk-go-v2/aws/protocol/eventstream					 v1.6.3 \
	github.com/aws/aws-sdk-go-v2/config							 v1.31.20 \
	github.com/aws/aws-sdk-go-v2/credentials						 v1.18.24 \
	github.com/aws/aws-sdk-go-v2/feature/ec2/imds						 v1.18.13 \
	github.com/aws/aws-sdk-go-v2/feature/s3/manager						 v1.17.10 \
	github.com/aws/aws-sdk-go-v2/internal/configsources					 v1.4.13 \
	github.com/aws/aws-sdk-go-v2/internal/endpoints/v2					 v2.7.13 \
	github.com/aws/aws-sdk-go-v2/internal/ini						 v1.8.4 \
	github.com/aws/aws-sdk-go-v2/internal/v4a						 v1.3.15 \
	github.com/aws/aws-sdk-go-v2/service/internal/accept-encoding				 v1.13.3 \
	github.com/aws/aws-sdk-go-v2/service/internal/checksum					 v1.3.17 \
	github.com/aws/aws-sdk-go-v2/service/internal/presigned-url				 v1.13.13 \
	github.com/aws/aws-sdk-go-v2/service/internal/s3shared					 v1.17.15 \
	github.com/aws/aws-sdk-go-v2/service/kms						 v1.48.2 \
	github.com/aws/aws-sdk-go-v2/service/s3							 v1.58.3 \
	github.com/aws/aws-sdk-go-v2/service/sso						 v1.30.3 \
	github.com/aws/aws-sdk-go-v2/service/ssooidc						 v1.35.7 \
	github.com/aws/aws-sdk-go-v2/service/sts						 v1.40.2 \
	github.com/aws/smithy-go								 v1.23.2 \
	github.com/aymanbagabas/go-osc52/v2							 v2.0.1 \
	github.com/aymanbagabas/go-udiff							 v0.3.1 \
	github.com/aymerick/douceur								 v0.2.0 \
	github.com/beevik/ntp									 v1.5.0 \
	github.com/beorn7/perks									 v1.0.1 \
	github.com/bgentry/speakeasy								 v0.2.0 \
	github.com/bits-and-blooms/bitset							 v1.24.0 \
	github.com/blang/semver									 v3.5.1+incompatible \
	github.com/bmatcuk/doublestar/v4							 v4.0.2 \
	github.com/briandowns/spinner								 v1.23.2 \
	github.com/bufbuild/protocompile							 v0.14.1 \
	github.com/catppuccin/go								 v0.3.0 \
	github.com/cavaliercoder/badio								 v0.0.0-20160213150051-ce5280129e9e \
	github.com/cavaliercoder/go-rpm								 v0.0.0-20200122174316-8cb9fd9c31a8 \
	github.com/cavaliergopher/cpio								 v1.0.1 \
	github.com/cenkalti/backoff/v4								 v4.3.0 \
	github.com/cenkalti/backoff/v5								 v5.0.3 \
	github.com/census-instrumentation/opencensus-proto					 v0.4.1 \
	github.com/cespare/xxhash/v2								 v2.3.0 \
	github.com/chainguard-dev/clog								 v1.7.0 \
	github.com/charmbracelet/bubbles							 v0.21.1-0.20250623103423-23b8fd6302d7 \
	github.com/charmbracelet/bubbletea							 v1.3.10 \
	github.com/charmbracelet/colorprofile							 v0.3.1 \
	github.com/charmbracelet/glamour							 v0.10.0 \
	github.com/charmbracelet/harmonica							 v0.2.0 \
	github.com/charmbracelet/huh								 v0.8.0 \
	github.com/charmbracelet/lipgloss							 v1.1.1-0.20250404203927-76690c660834 \
	github.com/charmbracelet/x/ansi								 v0.10.2 \
	github.com/charmbracelet/x/cellbuf							 v0.0.13 \
	github.com/charmbracelet/x/conpty							 v0.1.0 \
	github.com/charmbracelet/x/errors							 v0.0.0-20240508181413-e8d8b6e2de86 \
	github.com/charmbracelet/x/exp/golden							 v0.0.0-20241011142426-46044092ad91 \
	github.com/charmbracelet/x/exp/slice							 v0.0.0-20250630141444-821143405392 \
	github.com/charmbracelet/x/exp/strings							 v0.0.0-20250630141444-821143405392 \
	github.com/charmbracelet/x/term								 v0.2.1 \
	github.com/charmbracelet/x/termios							 v0.1.1 \
	github.com/charmbracelet/x/xpty								 v0.1.2 \
	github.com/cheggaaa/pb/v3								 v3.1.6 \
	github.com/cli/browser									 v1.3.0 \
	github.com/cli/go-gh/v2									 v2.13.0 \
	github.com/cli/go-internal								 v0.0.0-20241025142207-6c48bcd5ce24 \
	github.com/cli/oauth									 v1.2.1 \
	github.com/cli/safeexec									 v1.0.1 \
	github.com/cli/shurcoo!l-graphql							 v0.0.4 \
	github.com/cncf/xds/go									 v0.0.0-20251022180443-0feb69152e9f \
	github.com/codahale/rfc6979								 v0.0.0-20141003034818-6a90f24967eb \
	github.com/common-nighthawk/go-figure							 v0.0.0-20210622060536-734e95fb86be \
	github.com/containerd/errdefs								 v1.0.0 \
	github.com/containerd/errdefs/pkg							 v0.3.0 \
	github.com/containerd/log								 v0.1.0 \
	github.com/containerd/stargz-snapshotter/estargz					 v0.18.1 \
	github.com/coreos/go-oidc/v3								 v3.16.0 \
	github.com/coreos/go-semver								 v0.3.1 \
	github.com/coreos/go-systemd/v22							 v22.5.0 \
	github.com/cpuguy83/go-md2man/v2							 v2.0.7 \
	github.com/creack/pty									 v1.1.24 \
	github.com/cyberphone/json-canonicalization						 v0.0.0-20241213102144-19d51d7fe467 \
	github.com/danieljoos/wincred								 v1.2.2 \
	github.com/davecgh/go-spew								 v1.1.2-0.20180830191138-d8f796af33cc \
	github.com/dgryski/go-rendezvous							 v0.0.0-20200823014737-9f7001d12a5f \
	github.com/digitorus/pkcs7								 v0.0.0-20230818184609-3a137a874352 \
	github.com/digitorus/timestamp								 v0.0.0-20250524132541-c45532741eea \
	github.com/distribution/reference							 v0.6.0 \
	github.com/dlclark/regexp2								 v1.11.5 \
	github.com/docker/cli									 v29.0.3+incompatible \
	github.com/docker/distribution								 v2.8.3+incompatible \
	github.com/docker/docker								 v28.5.2+incompatible \
	github.com/docker/docker-credential-helpers						 v0.9.3 \
	github.com/docker/go-connections							 v0.5.0 \
	github.com/docker/go-units								 v0.5.0 \
	github.com/dustin/go-humanize								 v1.0.1 \
	github.com/envoyproxy/go-control-plane							 v0.13.5-0.20251024222203-75eaa193e329 \
	github.com/envoyproxy/go-control-plane/envoy						 v1.35.0 \
	github.com/envoyproxy/go-control-plane/ratelimit					 v0.1.0 \
	github.com/envoyproxy/protoc-gen-validate						 v1.2.1 \
	github.com/erikgeiser/coninput								 v0.0.0-20211004153227-1c3628e74d0f \
	github.com/fatih/color									 v1.18.0 \
	github.com/felixge/httpsnoop								 v1.0.4 \
	github.com/frankban/quicktest								 v1.14.6 \
	github.com/fsnotify/fsnotify								 v1.9.0 \
	github.com/fullstorydev/grpcurl								 v1.9.3 \
	github.com/fxamacker/cbor/v2								 v2.7.0 \
	github.com/gabriel-vasile/mimetype							 v1.4.11 \
	github.com/gdamore/encoding								 v1.0.1 \
	github.com/gdamore/tcell/v2								 v2.13.4 \
	github.com/go-chi/chi									 v4.1.2+incompatible \
	github.com/go-chi/chi/v5								 v5.2.3 \
	github.com/go-jose/go-jose/v3								 v3.0.0 \
	github.com/go-jose/go-jose/v4								 v4.1.3 \
	github.com/go-logr/logr									 v1.4.3 \
	github.com/go-logr/stdr									 v1.2.2 \
	github.com/go-openapi/analysis								 v0.24.1 \
	github.com/go-openapi/errors								 v0.22.4 \
	github.com/go-openapi/jsonpointer							 v0.22.1 \
	github.com/go-openapi/jsonreference							 v0.21.3 \
	github.com/go-openapi/loads								 v0.23.2 \
	github.com/go-openapi/runtime								 v0.29.2 \
	github.com/go-openapi/spec								 v0.22.1 \
	github.com/go-openapi/strfmt								 v0.25.0 \
	github.com/go-openapi/swag								 v0.25.4 \
	github.com/go-openapi/swag/cmdutils							 v0.25.4 \
	github.com/go-openapi/swag/conv								 v0.25.4 \
	github.com/go-openapi/swag/fileutils							 v0.25.4 \
	github.com/go-openapi/swag/jsonname							 v0.25.4 \
	github.com/go-openapi/swag/jsonutils							 v0.25.4 \
	github.com/go-openapi/swag/jsonutils/fixtures_test					 v0.25.4 \
	github.com/go-openapi/swag/loading							 v0.25.4 \
	github.com/go-openapi/swag/mangling							 v0.25.4 \
	github.com/go-openapi/swag/netutils							 v0.25.4 \
	github.com/go-openapi/swag/stringutils							 v0.25.4 \
	github.com/go-openapi/swag/typeutils							 v0.25.4 \
	github.com/go-openapi/swag/yamlutils							 v0.25.4 \
	github.com/go-openapi/testify/enable/yaml/v2						 v2.0.2 \
	github.com/go-openapi/testify/v2							 v2.0.2 \
	github.com/go-openapi/validate								 v0.25.1 \
	github.com/go-playground/locales							 v0.14.1 \
	github.com/go-playground/universal-translator						 v0.18.1 \
	github.com/go-playground/validator/v10							 v10.28.0 \
	github.com/go-redis/redismock/v9							 v9.2.0 \
	github.com/go-rod/rod									 v0.116.2 \
	github.com/go-sql-driver/mysql								 v1.9.3 \
	github.com/go-test/deep									 v1.1.1 \
	github.com/go-viper/mapstructure/v2							 v2.4.0 \
	github.com/godbus/dbus/v5								 v5.1.0 \
	github.com/gogo/protobuf								 v1.3.2 \
	github.com/golang-jwt/jwt/v5								 v5.3.0 \
	github.com/golang/glog									 v1.2.5 \
	github.com/golang/groupcache								 v0.0.0-20241129210726-2c02b8208cf8 \
	github.com/golang/mock									 v1.7.0-rc.1 \
	github.com/golang/protobuf								 v1.5.4 \
	github.com/golang/snappy								 v1.0.0 \
	github.com/google/addlicense								 v1.1.1 \
	github.com/google/btree									 v1.1.3 \
	github.com/google/certificate-transparency-go						 v1.3.2 \
	github.com/google/go-cmp								 v0.7.0 \
	github.com/google/go-containerregistry							 v0.20.7 \
	github.com/google/pprof									 v0.0.0-20250602020802-c6617b811d0e \
	github.com/google/rpmpack								 v0.7.1 \
	github.com/google/s2a-go								 v0.1.9 \
	github.com/google/shlex									 v0.0.0-20191202100458-e7afc7fbc510 \
	github.com/google/trillian								 v1.7.2 \
	github.com/google/uuid									 v1.6.0 \
	github.com/google/wire									 v0.6.0 \
	github.com/googleapis/enterprise-certificate-proxy					 v0.3.7 \
	github.com/googleapis/gax-go/v2								 v2.15.0 \
	github.com/gorilla/css									 v1.0.1 \
	github.com/gorilla/mux									 v1.8.1 \
	github.com/gorilla/websocket								 v1.5.3 \
	github.com/grafana/regexp								 v0.0.0-20240518133315-a468a5bfb3bc \
	github.com/grpc-ecosystem/go-grpc-middleware						 v1.4.0 \
	github.com/grpc-ecosystem/go-grpc-middleware/providers/prometheus			 v1.1.0 \
	github.com/grpc-ecosystem/go-grpc-middleware/v2						 v2.3.3 \
	github.com/grpc-ecosystem/grpc-gateway/v2						 v2.27.3 \
	github.com/h2non/parth									 v0.0.0-20190131123155-b4df798d6542 \
	github.com/hashicorp/errwrap								 v1.1.0 \
	github.com/hashicorp/go-cleanhttp							 v0.5.2 \
	github.com/hashicorp/go-multierror							 v1.1.1 \
	github.com/hashicorp/go-retryablehttp							 v0.7.8 \
	github.com/hashicorp/go-rootcerts							 v1.0.2 \
	github.com/hashicorp/go-secure-stdlib/parseutil						 v0.2.0 \
	github.com/hashicorp/go-secure-stdlib/strutil						 v0.1.2 \
	github.com/hashicorp/go-sockaddr							 v1.0.7 \
	github.com/hashicorp/go-version								 v1.8.0 \
	github.com/hashicorp/golang-lru/v2							 v2.0.7 \
	github.com/hashicorp/hcl								 v1.0.1-vault-7 \
	github.com/hashicorp/vault/api								 v1.22.0 \
	github.com/henvic/httpretty								 v0.1.4 \
	github.com/hexops/gotextdiff								 v1.0.3 \
	github.com/hinshun/vt10x								 v0.0.0-20220119200601-820417d04eec \
	github.com/howeyc/gopass								 v0.0.0-20210920133722-c8aef6fb66ef \
	github.com/huandu/xstrings								 v1.5.0 \
	github.com/in-toto/attestation								 v1.1.2 \
	github.com/in-toto/in-toto-golang							 v0.9.0 \
	github.com/inconshreveable/mousetrap							 v1.1.0 \
	github.com/itchyny/gojq									 v0.12.17 \
	github.com/itchyny/timefmt-go								 v0.1.6 \
	github.com/jackc/pgpassfile								 v1.0.0 \
	github.com/jackc/pgservicefile								 v0.0.0-20240606120523-5a60cdf6a761 \
	github.com/jackc/pgx/v5									 v5.7.5 \
	github.com/jackc/puddle/v2								 v2.2.2 \
	github.com/jedisct1/go-minisign								 v0.0.0-20241212093149-d2f9f49435c7 \
	github.com/jellydator/ttlcache/v3							 v3.4.0 \
	github.com/jhump/protoreflect								 v1.17.0 \
	github.com/jmespath/go-jmespath								 v0.4.1-0.20220621161143-b0104c826a24 \
	github.com/jmoiron/sqlx									 v1.4.0 \
	github.com/joho/godotenv								 v1.5.1 \
	github.com/jonboulle/clockwork								 v0.5.0 \
	github.com/josharian/intern								 v1.0.0 \
	github.com/kballard/go-shellquote							 v0.0.0-20180428030007-95032a82bc51 \
	github.com/keybase/go-keychain								 v0.0.1 \
	github.com/klauspost/compress								 v1.18.1 \
	github.com/klauspost/pgzip								 v1.2.6 \
	github.com/kr/pretty									 v0.3.1 \
	github.com/kr/text									 v0.2.0 \
	github.com/kylelemons/godebug								 v1.1.0 \
	github.com/leaanthony/go-ansi-parser							 v1.6.1 \
	github.com/leodido/go-urn								 v1.4.0 \
	github.com/letsencrypt/boulder								 v0.20251110.0 \
	github.com/letsencrypt/pkcs11key/v4							 v4.0.0 \
	github.com/lib/pq									 v1.10.9 \
	github.com/lucasb-eyer/go-colorful							 v1.3.0 \
	github.com/magefile/mage								 v1.14.0 \
	github.com/mailru/easyjson								 v0.9.0 \
	github.com/mattn/go-colorable								 v0.1.14 \
	github.com/mattn/go-isatty								 v0.0.20 \
	github.com/mattn/go-localereader							 v0.0.1 \
	github.com/mattn/go-runewidth								 v0.0.17 \
	github.com/mattn/go-sixel								 v0.0.5 \
	github.com/mattn/go-sqlite3								 v1.14.28 \
	github.com/mgutz/ansi									 v0.0.0-20200706080929-d51e80ef957d \
	github.com/microcosm-cc/bluemonday							 v1.0.27 \
	github.com/microsoft/dev-tunnels							 v0.1.19 \
	github.com/miekg/pkcs11									 v1.1.1 \
	github.com/mitchellh/copystructure							 v1.2.0 \
	github.com/mitchellh/go-homedir								 v1.1.0 \
	github.com/mitchellh/hashstructure/v2							 v2.0.2 \
	github.com/mitchellh/mapstructure							 v1.5.0 \
	github.com/mitchellh/reflectwalk							 v1.0.2 \
	github.com/moby/docker-image-spec							 v1.3.1 \
	github.com/moby/sys/atomicwriter							 v0.1.0 \
	github.com/moby/term									 v0.0.0-20221205130635-1aeaba878587 \
	github.com/montanaflynn/stats								 v0.7.1 \
	github.com/morikuni/aec									 v1.0.0 \
	github.com/muesli/ansi									 v0.0.0-20230316100256-276c6243b2f6 \
	github.com/muesli/cancelreader								 v0.2.2 \
	github.com/muesli/reflow								 v0.3.0 \
	github.com/muesli/termenv								 v0.16.0 \
	github.com/muhammadmuzzammil1998/jsonc							 v1.0.0 \
	github.com/munnerz/goautoneg								 v0.0.0-20191010083416-a7dc8b61c822 \
	github.com/natefinch/atomic								 v1.0.1 \
	github.com/nbio/st									 v0.0.0-20140626010706-e9e8d9816f32 \
	github.com/oklog/ulid									 v1.3.1 \
	github.com/olekukonko/tablewriter							 v0.0.5 \
	github.com/opencontainers/go-digest							 v1.0.0 \
	github.com/opencontainers/image-spec							 v1.1.1 \
	github.com/opentracing/opentracing-go							 v1.2.0 \
	github.com/pelletier/go-toml/v2								 v2.2.4 \
	github.com/pkg/browser									 v0.0.0-20240102092130-5ac0b6a4141c \
	github.com/pkg/errors									 v0.9.1 \
	github.com/planetscale/vtprotobuf							 v0.6.1-0.20240319094008-0393e58bdf10 \
	github.com/pmezard/go-difflib								 v1.0.1-0.20181226105442-5d4384ee4fb2 \
	github.com/prometheus/client_golang							 v1.23.2 \
	github.com/prometheus/client_model							 v0.6.2 \
	github.com/prometheus/common								 v0.66.1 \
	github.com/prometheus/otlptranslator							 v0.0.2 \
	github.com/prometheus/procfs								 v0.17.0 \
	github.com/prometheus/prometheus							 v0.51.0 \
	github.com/redis/go-redis/v9								 v9.14.1 \
	github.com/rivo/tview									 v0.42.0 \
	github.com/rivo/uniseg									 v0.4.7 \
	github.com/rodaine/table								 v1.3.0 \
	github.com/rogpeppe/fastuuid								 v1.2.0 \
	github.com/rogpeppe/go-internal								 v1.14.1 \
	github.com/rs/cors									 v1.11.1 \
	github.com/russross/blackfriday								 v1.6.0 \
	github.com/russross/blackfriday/v2							 v2.1.0 \
	github.com/ryanuber/go-glob								 v1.0.0 \
	github.com/sagikazarmark/locafero							 v0.11.0 \
	github.com/sahilm/fuzzy									 v0.1.1 \
	github.com/santhosh-tekuri/jsonschema/v5						 v5.3.1 \
	github.com/sassoftware/relic								 v7.2.1+incompatible \
	github.com/sassoftware/relic/v7								 v7.6.2 \
	github.com/secure-systems-lab/go-securesystemslib					 v0.9.1 \
	github.com/segmentio/ksuid								 v1.0.4 \
	github.com/sergi/go-diff								 v1.3.1 \
	github.com/shibumi/go-pathspec								 v1.3.0 \
	github.com/shopspring/decimal								 v1.4.0 \
	github.com/shurcoo!l/githubv4								 v0.0.0-20240727222349-48295856cce7 \
	github.com/shurcoo!l/graphql								 v0.0.0-20230722043721-ed46e5a46466 \
	github.com/sigstore/protobuf-specs							 v0.5.0 \
	github.com/sigstore/rekor								 v1.4.3 \
	github.com/sigstore/rekor-tiles								 v0.1.11 \
	github.com/sigstore/rekor-tiles/v2							 v2.0.1 \
	github.com/sigstore/sigstore								 v1.10.0 \
	github.com/sigstore/sigstore-go								 v1.1.4 \
	github.com/sigstore/sigstore/pkg/signature/kms/aws					 v1.10.0 \
	github.com/sigstore/sigstore/pkg/signature/kms/azure					 v1.10.0 \
	github.com/sigstore/sigstore/pkg/signature/kms/gcp					 v1.10.0 \
	github.com/sigstore/sigstore/pkg/signature/kms/hashivault				 v1.10.0 \
	github.com/sigstore/timestamp-authority							 v1.2.9 \
	github.com/sigstore/timestamp-authority/v2						 v2.0.3 \
	github.com/sirupsen/logrus								 v1.9.3 \
	github.com/skratchdot/open-golang							 v0.0.0-20200116055534-eef842397966 \
	github.com/soheilhy/cmux								 v0.1.5 \
	github.com/soniakeys/quant								 v1.0.0 \
	github.com/sourcegraph/conc								 v0.3.1-0.20240121214520-5f936abd7ae8 \
	github.com/spf13/afero									 v1.15.0 \
	github.com/spf13/cast									 v1.10.0 \
	github.com/spf13/cobra									 v1.10.2 \
	github.com/spf13/pflag									 v1.0.10 \
	github.com/spf13/viper									 v1.21.0 \
	github.com/spiffe/go-spiffe/v2								 v2.6.0 \
	github.com/stretchr/objx								 v0.5.2 \
	github.com/stretchr/testify								 v1.11.1 \
	github.com/subosito/gotenv								 v1.6.0 \
	github.com/syndtr/goleveldb								 v1.0.1-0.20220721030215-126854af5e6d \
	github.com/theupdateframework/go-tuf							 v0.7.0 \
	github.com/theupdateframework/go-tuf/v2							 v2.3.0 \
	github.com/thlib/go-timezone-local							 v0.0.6 \
	github.com/tink-crypto/tink-go-awskms/v2						 v2.1.0 \
	github.com/tink-crypto/tink-go-gcpkms/v2						 v2.2.0 \
	github.com/tink-crypto/tink-go-hcvault/v2						 v2.3.0 \
	github.com/tink-crypto/tink-go/v2							 v2.5.0 \
	github.com/titanous/rocacheck								 v0.0.0-20171023193734-afe73141d399 \
	github.com/tmc/grpc-websocket-proxy							 v0.0.0-20220101234140-673ab2c3ae75 \
	github.com/tomasen/realip								 v0.0.0-20180522021738-f0c99a92ddce \
	github.com/transparency-dev/formats							 v0.0.0-20251017110053-404c0d5b696c \
	github.com/transparency-dev/merkle							 v0.0.2 \
	github.com/transparency-dev/tessera							 v1.0.1-0.20251104110637-ba6c65c4ae73 \
	github.com/ulikunitz/xz									 v0.5.14 \
	github.com/urfave/cli									 v1.22.16 \
	github.com/urfave/negroni								 v1.0.0 \
	github.com/vbatts/tar-split								 v0.12.2 \
	github.com/veraison/go-cose								 v1.3.0 \
	github.com/vmihailenco/msgpack/v5							 v5.4.1 \
	github.com/vmihailenco/tagparser/v2							 v2.0.0 \
	github.com/x448/float16									 v0.8.4 \
	github.com/xdg-go/pbkdf2								 v1.0.0 \
	github.com/xdg-go/scram									 v1.1.2 \
	github.com/xdg-go/stringprep								 v1.0.4 \
	github.com/xiang90/probing								 v0.0.0-20221125231312-a49e3df8f510 \
	github.com/xo/terminfo									 v0.0.0-20220910002029-abceb7e1c41e \
	github.com/youmark/pkcs8								 v0.0.0-20240726163527-a2c0da244d78 \
	github.com/ysmood/fetchup								 v0.2.3 \
	github.com/ysmood/goob									 v0.4.0 \
	github.com/ysmood/got									 v0.40.0 \
	github.com/ysmood/gson									 v0.7.3 \
	github.com/ysmood/leakless								 v0.9.0 \
	github.com/yuin/goldmark								 v1.7.16 \
	github.com/yuin/goldmark-emoji								 v1.0.6 \
	github.com/zalando/go-keyring								 v0.2.6 \
	github.com/zeebo/errs									 v1.4.0 \
	go.etcd.io/bbolt									 v1.4.0 \
	go.etcd.io/etcd/api/v3									 v3.6.0 \
	go.etcd.io/etcd/client/pkg/v3								 v3.6.0 \
	go.etcd.io/etcd/client/v3								 v3.6.0 \
	go.etcd.io/etcd/etcdctl/v3								 v3.6.0 \
	go.etcd.io/etcd/etcdutl/v3								 v3.6.0 \
	go.etcd.io/etcd/pkg/v3									 v3.6.0 \
	go.etcd.io/etcd/server/v3								 v3.6.0 \
	go.etcd.io/etcd/tests/v3								 v3.6.0 \
	go.etcd.io/etcd/v3									 v3.6.0 \
	go.etcd.io/gofail									 v0.2.0 \
	go.etcd.io/raft/v3									 v3.6.0 \
	go.mongodb.org/mongo-driver								 v1.17.6 \
	go.opencensus.io									 v0.24.0 \
	go.opentelemetry.io/auto/sdk								 v1.2.1 \
	go.opentelemetry.io/contrib/detectors/gcp						 v1.38.0 \
	go.opentelemetry.io/contrib/instrumentation/google.golang.org/grpc/otelgrpc		 v0.63.0 \
	go.opentelemetry.io/contrib/instrumentation/net/http/otelhttp				 v0.63.0 \
	go.opentelemetry.io/otel								 v1.38.0 \
	go.opentelemetry.io/otel/exporters/otlp/otlptrace					 v1.34.0 \
	go.opentelemetry.io/otel/exporters/otlp/otlptrace/otlptracegrpc				 v1.34.0 \
	go.opentelemetry.io/otel/exporters/otlp/otlptrace/otlptracehttp				 v1.33.0 \
	go.opentelemetry.io/otel/exporters/prometheus						 v0.60.0 \
	go.opentelemetry.io/otel/metric								 v1.38.0 \
	go.opentelemetry.io/otel/sdk								 v1.38.0 \
	go.opentelemetry.io/otel/sdk/metric							 v1.38.0 \
	go.opentelemetry.io/otel/trace								 v1.38.0 \
	go.opentelemetry.io/proto/otlp								 v1.5.0 \
	go.step.sm/crypto									 v0.74.0 \
	go.uber.org/goleak									 v1.3.0 \
	go.uber.org/multierr									 v1.11.0 \
	go.uber.org/zap										 v1.27.1 \
	go.yaml.in/yaml/v2									 v2.4.2 \
	go.yaml.in/yaml/v3									 v3.0.4 \
	gocloud.dev										 v0.40.0 \
	golang.org/x/crypto									 v0.46.0 \
	golang.org/x/exp									 v0.0.0-20250620022241-b7579e27df2b \
	golang.org/x/mod									 v0.30.0 \
	golang.org/x/net									 v0.47.0 \
	golang.org/x/oauth2									 v0.33.0 \
	golang.org/x/sync									 v0.19.0 \
	golang.org/x/sys									 v0.39.0 \
	golang.org/x/telemetry									 v0.0.0-20251111182119-bc8e575c7b54 \
	golang.org/x/term									 v0.38.0 \
	golang.org/x/text									 v0.32.0 \
	golang.org/x/time									 v0.14.0 \
	golang.org/x/tools									 v0.39.0 \
	golang.org/x/xerrors									 v0.0.0-20240716161551-93cc26a95ae9 \
	gonum.org/v1/gonum									 v0.16.0 \
	google.golang.org/api									 v0.256.0 \
	google.golang.org/genproto								 v0.0.0-20250922171735-9219d122eba9 \
	google.golang.org/genproto/googleapis/api						 v0.0.0-20251022142026-3a174f9686a8 \
	google.golang.org/genproto/googleapis/rpc						 v0.0.0-20251103181224-f26f9409b101 \
	google.golang.org/grpc									 v1.77.0 \
	google.golang.org/protobuf								 v1.36.10 \
	gopkg.in/check.v1									 v1.0.0-20201130134442-10cb98267c6c \
	gopkg.in/h2non/gock.v1									 v1.1.2 \
	gopkg.in/ini.v1										 v1.67.0 \
	gopkg.in/natefinch/lumberjack.v2							 v2.2.1 \
	gopkg.in/yaml.v2									 v2.4.0 \
	gopkg.in/yaml.v3									 v3.0.1 \
	gotest.tools/v3										 v3.0.3 \
	k8s.io/klog/v2										 v2.130.1 \
	sigs.k8s.io/json									 v0.0.0-20241010143419-9aa6b5e7a4b3 \
	sigs.k8s.io/release-utils								 v0.12.2 \
	sigs.k8s.io/yaml									 v1.6.0 \
	software.sslmate.com/src/go-pkcs12							 v0.4.0

MODGO_MODFILES =	\
	al.essio.dev/pkg/shellescape								 v1.5.1 \
	cel.dev/expr										 v0.20.0 \
	cloud.google.com/go									 v0.120.0 \
	cloud.google.com/go/auth								 v0.15.0 \
	cloud.google.com/go/auth/oauth2adapt							 v0.2.7 \
	cloud.google.com/go/compute/metadata							 v0.6.0 \
	cloud.google.com/go/compute/metadata							 v0.7.0 \
	cloud.google.com/go/iam									 v1.5.2 \
	cloud.google.com/go/monitoring								 v1.24.0 \
	cloud.google.com/go/storage								 v1.56.0 \
	dario.cat/mergo										 v1.0.1 \
	github.com/!azure!a!d/microsoft-authentication-library-for-go				 v1.5.0 \
	github.com/!azure/azure-sdk-for-go/sdk/azcore						 v1.19.1 \
	github.com/!azure/azure-sdk-for-go/sdk/azidentity					 v1.13.0 \
	github.com/!google!cloud!platform/opentelemetry-operations-go/detectors/gcp		 v1.29.0 \
	github.com/!google!cloud!platform/opentelemetry-operations-go/exporter/metric		 v0.53.0 \
	github.com/!google!cloud!platform/opentelemetry-operations-go/internal/resourcemapping	 v0.53.0 \
	github.com/!masterminds/semver/v3							 v3.3.0 \
	github.com/!microsoft/go-winio								 v0.6.0 \
	github.com/alecthomas/chroma/v2								 v2.14.0 \
	github.com/aws/aws-sdk-go								 v1.55.5 \
	github.com/aws/aws-sdk-go-v2								 v1.39.5 \
	github.com/aws/aws-sdk-go-v2/config							 v1.31.16 \
	github.com/aws/aws-sdk-go-v2/credentials						 v1.18.20 \
	github.com/aws/aws-sdk-go-v2/feature/ec2/imds						 v1.18.12 \
	github.com/aws/aws-sdk-go-v2/internal/configsources					 v1.4.12 \
	github.com/aws/aws-sdk-go-v2/internal/endpoints/v2					 v2.7.12 \
	github.com/aws/aws-sdk-go-v2/service/internal/accept-encoding				 v1.13.2 \
	github.com/aws/aws-sdk-go-v2/service/internal/presigned-url				 v1.13.12 \
	github.com/aws/aws-sdk-go-v2/service/kms						 v1.46.2 \
	github.com/aws/aws-sdk-go-v2/service/kms						 v1.47.0 \
	github.com/aws/aws-sdk-go-v2/service/sso						 v1.30.0 \
	github.com/aws/aws-sdk-go-v2/service/ssooidc						 v1.35.4 \
	github.com/aws/aws-sdk-go-v2/service/sts						 v1.39.0 \
	github.com/aws/smithy-go								 v1.23.1 \
	github.com/aymanbagabas/go-udiff							 v0.2.0 \
	github.com/charmbracelet/bubbletea							 v1.3.5 \
	github.com/charmbracelet/bubbletea							 v1.3.6 \
	github.com/charmbracelet/colorprofile							 v0.2.3-0.20250311203215-f60798e515dc \
	github.com/charmbracelet/glamour							 v0.9.2-0.20250319212134-549f544650e3 \
	github.com/charmbracelet/lipgloss							 v1.1.0 \
	github.com/charmbracelet/lipgloss							 v1.1.1-0.20250319133953-166f707985bc \
	github.com/charmbracelet/x/ansi								 v0.10.1 \
	github.com/charmbracelet/x/ansi								 v0.8.0 \
	github.com/charmbracelet/x/ansi								 v0.9.3 \
	github.com/charmbracelet/x/cellbuf							 v0.0.13-0.20250311204145-2c3ea96c31dd \
	github.com/charmbracelet/x/exp/golden							 v0.0.0-20240806155701-69247e0abc2a \
	github.com/charmbracelet/x/exp/slice							 v0.0.0-20250327172914-2fdc97757edf \
	github.com/charmbracelet/x/exp/strings							 v0.0.0-20240722160745-212f7b056ed0 \
	github.com/cli/browser									 v1.0.0 \
	github.com/cli/safeexec									 v1.0.0 \
	github.com/cncf/xds/go									 v0.0.0-20250121191232-2f005788dc42 \
	github.com/cncf/xds/go									 v0.0.0-20250501225837-2ac532fd4443 \
	github.com/coreos/go-oidc/v3								 v3.14.1 \
	github.com/cpuguy83/go-md2man/v2							 v2.0.2 \
	github.com/cpuguy83/go-md2man/v2							 v2.0.5 \
	github.com/cpuguy83/go-md2man/v2							 v2.0.6 \
	github.com/creack/pty									 v1.1.17 \
	github.com/cyberphone/json-canonicalization						 v0.0.0-20220623050100-57a0ce2678a7 \
	github.com/danieljoos/wincred								 v1.2.0 \
	github.com/davecgh/go-spew								 v1.1.0 \
	github.com/davecgh/go-spew								 v1.1.1 \
	github.com/digitorus/pkcs7								 v0.0.0-20230713084857-e76b763bdc49 \
	github.com/digitorus/timestamp								 v0.0.0-20231217203849-220c5c2851b7 \
	github.com/dlclark/regexp2								 v1.11.0 \
	github.com/envoyproxy/go-control-plane/envoy						 v1.32.4 \
	github.com/fatih/color									 v1.15.0 \
	github.com/fatih/color									 v1.7.0 \
	github.com/gabriel-vasile/mimetype							 v1.4.10 \
	github.com/gdamore/tcell/v2								 v2.8.1 \
	github.com/go-jose/go-jose/v4								 v4.0.5 \
	github.com/go-jose/go-jose/v4								 v4.1.2 \
	github.com/go-logr/logr									 v1.2.2 \
	github.com/go-logr/logr									 v1.4.2 \
	github.com/go-openapi/analysis								 v0.23.0 \
	github.com/go-openapi/analysis								 v0.24.0 \
	github.com/go-openapi/errors								 v0.22.2 \
	github.com/go-openapi/jsonpointer							 v0.21.0 \
	github.com/go-openapi/jsonreference							 v0.21.0 \
	github.com/go-openapi/loads								 v0.22.0 \
	github.com/go-openapi/runtime								 v0.28.0 \
	github.com/go-openapi/spec								 v0.21.0 \
	github.com/go-openapi/strfmt								 v0.23.0 \
	github.com/go-openapi/swag								 v0.24.1 \
	github.com/go-openapi/swag								 v0.25.1 \
	github.com/go-openapi/swag/cmdutils							 v0.24.0 \
	github.com/go-openapi/swag/cmdutils							 v0.25.1 \
	github.com/go-openapi/swag/conv								 v0.24.0 \
	github.com/go-openapi/swag/conv								 v0.25.1 \
	github.com/go-openapi/swag/fileutils							 v0.24.0 \
	github.com/go-openapi/swag/fileutils							 v0.25.1 \
	github.com/go-openapi/swag/jsonname							 v0.24.0 \
	github.com/go-openapi/swag/jsonname							 v0.25.1 \
	github.com/go-openapi/swag/jsonutils							 v0.24.0 \
	github.com/go-openapi/swag/jsonutils							 v0.25.1 \
	github.com/go-openapi/swag/loading							 v0.24.0 \
	github.com/go-openapi/swag/loading							 v0.25.1 \
	github.com/go-openapi/swag/mangling							 v0.24.0 \
	github.com/go-openapi/swag/mangling							 v0.25.1 \
	github.com/go-openapi/swag/netutils							 v0.24.0 \
	github.com/go-openapi/swag/netutils							 v0.25.1 \
	github.com/go-openapi/swag/stringutils							 v0.24.0 \
	github.com/go-openapi/swag/stringutils							 v0.25.1 \
	github.com/go-openapi/swag/typeutils							 v0.24.0 \
	github.com/go-openapi/swag/typeutils							 v0.25.1 \
	github.com/go-openapi/swag/yamlutils							 v0.24.0 \
	github.com/go-openapi/swag/yamlutils							 v0.25.1 \
	github.com/go-openapi/validate								 v0.24.0 \
	github.com/go-sql-driver/mysql								 v1.9.2 \
	github.com/golang-jwt/jwt/v5								 v5.2.2 \
	github.com/golang/protobuf								 v1.5.0 \
	github.com/golang/protobuf								 v1.5.2 \
	github.com/golang/snappy								 v0.0.4 \
	github.com/google/go-cmp								 v0.5.4 \
	github.com/google/go-cmp								 v0.5.8 \
	github.com/google/go-cmp								 v0.5.9 \
	github.com/google/go-cmp								 v0.6.0 \
	github.com/google/go-containerregistry							 v0.20.3 \
	github.com/google/go-containerregistry							 v0.20.6 \
	github.com/googleapis/enterprise-certificate-proxy					 v0.3.5 \
	github.com/googleapis/enterprise-certificate-proxy					 v0.3.6 \
	github.com/googleapis/gax-go/v2								 v2.14.1 \
	github.com/gorilla/websocket								 v1.4.2 \
	github.com/gorilla/websocket								 v1.5.1 \
	github.com/grpc-ecosystem/go-grpc-middleware/providers/prometheus			 v1.0.1 \
	github.com/grpc-ecosystem/go-grpc-middleware/v2						 v2.1.0 \
	github.com/grpc-ecosystem/grpc-gateway/v2						 v2.26.3 \
	github.com/hashicorp/go-secure-stdlib/parseutil						 v0.1.7 \
	github.com/hashicorp/go-sockaddr							 v1.0.2 \
	github.com/hashicorp/hcl								 v1.0.0 \
	github.com/hashicorp/vault/api								 v1.16.0 \
	github.com/henvic/httpretty								 v0.0.6 \
	github.com/itchyny/gojq									 v0.12.15 \
	github.com/itchyny/timefmt-go								 v0.1.5 \
	github.com/jedisct1/go-minisign								 v0.0.0-20211028175153-1c139d1cc84b \
	github.com/klauspost/compress								 v1.16.7 \
	github.com/klauspost/compress								 v1.18.0 \
	github.com/letsencrypt/boulder								 v0.0.0-20240620165639-de9c06129bec \
	github.com/lucasb-eyer/go-colorful							 v1.2.0 \
	github.com/mattn/go-colorable								 v0.1.13 \
	github.com/mattn/go-colorable								 v0.1.2 \
	github.com/mattn/go-isatty								 v0.0.17 \
	github.com/mattn/go-isatty								 v0.0.8 \
	github.com/mattn/go-runewidth								 v0.0.12 \
	github.com/mattn/go-runewidth								 v0.0.14 \
	github.com/mattn/go-runewidth								 v0.0.15 \
	github.com/mattn/go-runewidth								 v0.0.16 \
	github.com/mattn/go-sqlite3								 v1.14.24 \
	github.com/mgutz/ansi									 v0.0.0-20170206155736-9520e82c474b \
	github.com/pkg/browser									 v0.0.0-20210911075715-681adbf594b8 \
	github.com/pmezard/go-difflib								 v1.0.0 \
	github.com/prometheus/client_golang							 v1.22.0 \
	github.com/prometheus/client_model							 v0.6.1 \
	github.com/prometheus/common								 v0.62.0 \
	github.com/prometheus/procfs								 v0.15.1 \
	github.com/prometheus/procfs								 v0.16.1 \
	github.com/rivo/uniseg									 v0.1.0 \
	github.com/rivo/uniseg									 v0.2.0 \
	github.com/rodaine/table								 v1.0.1 \
	github.com/rogpeppe/go-internal								 v1.9.0 \
	github.com/secure-systems-lab/go-securesystemslib					 v0.6.0 \
	github.com/sigstore/protobuf-specs							 v0.4.1 \
	github.com/sigstore/rekor								 v1.4.2 \
	github.com/sigstore/sigstore								 v1.9.5 \
	github.com/sigstore/sigstore								 v1.9.6-0.20250729224751-181c5d3339b3 \
	github.com/sigstore/sigstore-go								 v1.1.3 \
	github.com/sigstore/sigstore/pkg/signature/kms/aws					 v1.9.5 \
	github.com/sigstore/sigstore/pkg/signature/kms/azure					 v1.9.5 \
	github.com/sigstore/sigstore/pkg/signature/kms/gcp					 v1.9.6-0.20250729224751-181c5d3339b3 \
	github.com/sigstore/sigstore/pkg/signature/kms/hashivault				 v1.9.5 \
	github.com/spf13/cast									 v1.7.0 \
	github.com/spf13/cobra									 v1.10.1 \
	github.com/spf13/cobra									 v1.7.0 \
	github.com/spf13/cobra									 v1.9.1 \
	github.com/spf13/pflag									 v1.0.5 \
	github.com/spf13/pflag									 v1.0.6 \
	github.com/spf13/pflag									 v1.0.9 \
	github.com/spiffe/go-spiffe/v2								 v2.1.3 \
	github.com/spiffe/go-spiffe/v2								 v2.5.0 \
	github.com/stretchr/objx								 v0.1.0 \
	github.com/stretchr/objx								 v0.4.0 \
	github.com/stretchr/objx								 v0.5.0 \
	github.com/stretchr/testify								 v1.10.0 \
	github.com/stretchr/testify								 v1.3.0 \
	github.com/stretchr/testify								 v1.5.1 \
	github.com/stretchr/testify								 v1.6.1 \
	github.com/stretchr/testify								 v1.7.0 \
	github.com/stretchr/testify								 v1.7.1 \
	github.com/stretchr/testify								 v1.8.0 \
	github.com/stretchr/testify								 v1.8.2 \
	github.com/stretchr/testify								 v1.8.4 \
	github.com/stretchr/testify								 v1.9.0 \
	github.com/theupdateframework/go-tuf/v2							 v2.2.0 \
	github.com/thlib/go-timezone-local							 v0.0.0-20210907160436-ef149e42d28e \
	github.com/yuin/goldmark								 v1.4.13 \
	github.com/yuin/goldmark								 v1.7.10 \
	github.com/yuin/goldmark								 v1.7.8 \
	github.com/yuin/goldmark-emoji								 v1.0.5 \
	github.com/zalando/go-keyring								 v0.2.3 \
	github.com/zeebo/errs									 v1.3.0 \
	go.mongodb.org/mongo-driver								 v1.14.0 \
	go.opentelemetry.io/auto/sdk								 v1.1.0 \
	go.opentelemetry.io/contrib/detectors/gcp						 v1.36.0 \
	go.opentelemetry.io/contrib/instrumentation/google.golang.org/grpc/otelgrpc		 v0.59.0 \
	go.opentelemetry.io/contrib/instrumentation/google.golang.org/grpc/otelgrpc		 v0.61.0 \
	go.opentelemetry.io/contrib/instrumentation/net/http/otelhttp				 v0.59.0 \
	go.opentelemetry.io/contrib/instrumentation/net/http/otelhttp				 v0.61.0 \
	go.opentelemetry.io/otel								 v1.34.0 \
	go.opentelemetry.io/otel								 v1.36.0 \
	go.opentelemetry.io/otel/metric								 v1.34.0 \
	go.opentelemetry.io/otel/metric								 v1.36.0 \
	go.opentelemetry.io/otel/sdk								 v1.34.0 \
	go.opentelemetry.io/otel/trace								 v1.34.0 \
	go.opentelemetry.io/otel/trace								 v1.36.0 \
	go.step.sm/crypto									 v0.73.0 \
	go.uber.org/zap										 v1.27.0 \
	golang.org/x/crypto									 v0.0.0-20190308221718-c2843e01d9a2 \
	golang.org/x/crypto									 v0.0.0-20210921155107-089bfa567519 \
	golang.org/x/crypto									 v0.23.0 \
	golang.org/x/crypto									 v0.26.0 \
	golang.org/x/crypto									 v0.31.0 \
	golang.org/x/crypto									 v0.36.0 \
	golang.org/x/crypto									 v0.38.0 \
	golang.org/x/crypto									 v0.40.0 \
	golang.org/x/crypto									 v0.43.0 \
	golang.org/x/crypto									 v0.44.0 \
	golang.org/x/crypto									 v0.45.0 \
	golang.org/x/crypto									 v0.8.0 \
	golang.org/x/exp									 v0.0.0-20220909182711-5c715a9e8561 \
	golang.org/x/exp									 v0.0.0-20231006140011-7918f672742d \
	golang.org/x/mod									 v0.21.0 \
	golang.org/x/mod									 v0.24.0 \
	golang.org/x/mod									 v0.29.0 \
	golang.org/x/mod									 v0.6.0-dev.0.20220419223038-86c51ed26bb4 \
	golang.org/x/mod									 v0.8.0 \
	golang.org/x/net									 v0.0.0-20190620200207-3b0461eec859 \
	golang.org/x/net									 v0.0.0-20210226172049-e18ecbb05110 \
	golang.org/x/net									 v0.0.0-20220722155237-a158d28d115b \
	golang.org/x/net									 v0.26.0 \
	golang.org/x/net									 v0.33.0 \
	golang.org/x/net									 v0.38.0 \
	golang.org/x/net									 v0.40.0 \
	golang.org/x/net									 v0.41.0 \
	golang.org/x/net									 v0.46.0 \
	golang.org/x/net									 v0.46.1-0.20251013234738-63d1a5100f82 \
	golang.org/x/net									 v0.6.0 \
	golang.org/x/net									 v0.9.0 \
	golang.org/x/oauth2									 v0.28.0 \
	golang.org/x/oauth2									 v0.30.0 \
	golang.org/x/oauth2									 v0.32.0 \
	golang.org/x/sync									 v0.0.0-20190423024810-112230192c58 \
	golang.org/x/sync									 v0.0.0-20220722155255-886fb9371eb4 \
	golang.org/x/sync									 v0.1.0 \
	golang.org/x/sync									 v0.13.0 \
	golang.org/x/sync									 v0.14.0 \
	golang.org/x/sync									 v0.15.0 \
	golang.org/x/sync									 v0.17.0 \
	golang.org/x/sync									 v0.18.0 \
	golang.org/x/sync									 v0.8.0 \
	golang.org/x/sys									 v0.0.0-20190215142949-d0b11bdaac8a \
	golang.org/x/sys									 v0.0.0-20190222072716-a9d3bda3a223 \
	golang.org/x/sys									 v0.0.0-20201119102817-f84b799fce68 \
	golang.org/x/sys									 v0.0.0-20210615035016-665e8c7367d1 \
	golang.org/x/sys									 v0.0.0-20210809222454-d867a43fc93e \
	golang.org/x/sys									 v0.0.0-20210831042530-f4d43177bf5e \
	golang.org/x/sys									 v0.0.0-20220204135822-1c1b9b1eba6a \
	golang.org/x/sys									 v0.0.0-20220412211240-33da011f77ad \
	golang.org/x/sys									 v0.0.0-20220520151302-bc2c85ada10a \
	golang.org/x/sys									 v0.0.0-20220715151400-c0bba94af5f8 \
	golang.org/x/sys									 v0.0.0-20220722155257-8c9f86f7a55f \
	golang.org/x/sys									 v0.13.0 \
	golang.org/x/sys									 v0.20.0 \
	golang.org/x/sys									 v0.25.0 \
	golang.org/x/sys									 v0.26.0 \
	golang.org/x/sys									 v0.28.0 \
	golang.org/x/sys									 v0.29.0 \
	golang.org/x/sys									 v0.30.0 \
	golang.org/x/sys									 v0.31.0 \
	golang.org/x/sys									 v0.32.0 \
	golang.org/x/sys									 v0.33.0 \
	golang.org/x/sys									 v0.34.0 \
	golang.org/x/sys									 v0.36.0 \
	golang.org/x/sys									 v0.37.0 \
	golang.org/x/sys									 v0.38.0 \
	golang.org/x/sys									 v0.5.0 \
	golang.org/x/sys									 v0.6.0 \
	golang.org/x/sys									 v0.8.0 \
	golang.org/x/telemetry									 v0.0.0-20250908211612-aef8a434d053 \
	golang.org/x/term									 v0.0.0-20201126162022-7de9c90e9dd1 \
	golang.org/x/term									 v0.0.0-20210927222741-03fcf44c2211 \
	golang.org/x/term									 v0.1.0 \
	golang.org/x/term									 v0.28.0 \
	golang.org/x/term									 v0.30.0 \
	golang.org/x/term									 v0.31.0 \
	golang.org/x/term									 v0.33.0 \
	golang.org/x/term									 v0.36.0 \
	golang.org/x/term									 v0.37.0 \
	golang.org/x/term									 v0.5.0 \
	golang.org/x/text									 v0.14.0 \
	golang.org/x/text									 v0.17.0 \
	golang.org/x/text									 v0.21.0 \
	golang.org/x/text									 v0.23.0 \
	golang.org/x/text									 v0.24.0 \
	golang.org/x/text									 v0.25.0 \
	golang.org/x/text									 v0.29.0 \
	golang.org/x/text									 v0.3.0 \
	golang.org/x/text									 v0.3.3 \
	golang.org/x/text									 v0.3.7 \
	golang.org/x/text									 v0.3.8 \
	golang.org/x/text									 v0.30.0 \
	golang.org/x/text									 v0.31.0 \
	golang.org/x/text									 v0.4.0 \
	golang.org/x/text									 v0.7.0 \
	golang.org/x/text									 v0.9.0 \
	golang.org/x/time									 v0.0.0-20210723032227-1f47c861a9ac \
	golang.org/x/time									 v0.11.0 \
	golang.org/x/tools									 v0.0.0-20180917221912-90fa682c2a6e \
	golang.org/x/tools									 v0.0.0-20191119224855-298f0cb1881e \
	golang.org/x/tools									 v0.1.12 \
	golang.org/x/tools									 v0.14.0 \
	golang.org/x/tools									 v0.26.0 \
	golang.org/x/tools									 v0.31.0 \
	golang.org/x/tools									 v0.37.0 \
	golang.org/x/tools									 v0.38.0 \
	golang.org/x/tools									 v0.6.0 \
	golang.org/x/xerrors									 v0.0.0-20190717185122-a985d3407aa7 \
	google.golang.org/api									 v0.226.0 \
	google.golang.org/api									 v0.254.0 \
	google.golang.org/genproto								 v0.0.0-20230223222841-637eb2293923 \
	google.golang.org/genproto								 v0.0.0-20230706204954-ccb25ca9f130 \
	google.golang.org/genproto								 v0.0.0-20250122153221-138b5a5a4fd4 \
	google.golang.org/genproto								 v0.0.0-20250603155806-513f23925822 \
	google.golang.org/genproto/googleapis/api						 v0.0.0-20230726155614-23370e0ffb3e \
	google.golang.org/genproto/googleapis/api						 v0.0.0-20240520151616-dc85e6b867a5 \
	google.golang.org/genproto/googleapis/api						 v0.0.0-20250303144028-a0af3efb3deb \
	google.golang.org/genproto/googleapis/api						 v0.0.0-20250818200422-3122310a409c \
	google.golang.org/genproto/googleapis/api						 v0.0.0-20250825161204-c5933d9347a5 \
	google.golang.org/genproto/googleapis/api						 v0.0.0-20250929231259-57b25ae835d4 \
	google.golang.org/genproto/googleapis/rpc						 v0.0.0-20250303144028-a0af3efb3deb \
	google.golang.org/genproto/googleapis/rpc						 v0.0.0-20250825161204-c5933d9347a5 \
	google.golang.org/genproto/googleapis/rpc						 v0.0.0-20250929231259-57b25ae835d4 \
	google.golang.org/genproto/googleapis/rpc						 v0.0.0-20251014184007-4626949a642f \
	google.golang.org/genproto/googleapis/rpc						 v0.0.0-20251022142026-3a174f9686a8 \
	google.golang.org/grpc									 v1.54.0 \
	google.golang.org/grpc									 v1.71.0 \
	google.golang.org/grpc									 v1.72.2 \
	google.golang.org/grpc									 v1.75.0 \
	google.golang.org/grpc									 v1.75.1 \
	google.golang.org/grpc									 v1.76.0 \
	google.golang.org/protobuf								 v1.28.1 \
	google.golang.org/protobuf								 v1.36.3 \
	google.golang.org/protobuf								 v1.36.6 \
	gopkg.in/check.v1									 v0.0.0-20161208181325-20d25e280405 \
	gopkg.in/check.v1									 v1.0.0-20180628173108-788fd7840127 \
	gopkg.in/yaml.v2									 v2.3.0 \
	gopkg.in/yaml.v3									 v3.0.0-20200313102051-9f266ea9e77c \
	sigs.k8s.io/yaml									 v1.4.0

