MODCARGO_CRATES +=	addr2line	0.21.0	# Apache-2.0 OR MIT
MODCARGO_CRATES +=	adler	1.0.2	# 0BSD OR MIT OR Apache-2.0
MODCARGO_CRATES +=	aho-corasick	1.1.2	# Unlicense OR MIT
MODCARGO_CRATES +=	android-tzdata	0.1.1	# MIT OR Apache-2.0
MODCARGO_CRATES +=	android_system_properties	0.1.5	# MIT/Apache-2.0
MODCARGO_CRATES +=	anstream	0.6.11	# MIT OR Apache-2.0
MODCARGO_CRATES +=	anstyle	1.0.2	# MIT OR Apache-2.0
MODCARGO_CRATES +=	anstyle-parse	0.2.1	# MIT OR Apache-2.0
MODCARGO_CRATES +=	anstyle-query	1.0.0	# MIT OR Apache-2.0
MODCARGO_CRATES +=	anstyle-wincon	3.0.2	# MIT OR Apache-2.0
MODCARGO_CRATES +=	anyhow	1.0.81	# MIT OR Apache-2.0
MODCARGO_CRATES +=	ar	0.9.0	# MIT
MODCARGO_CRATES +=	arc-swap	1.6.0	# MIT OR Apache-2.0
MODCARGO_CRATES +=	arrayref	0.3.7	# BSD-2-Clause
MODCARGO_CRATES +=	arrayvec	0.7.4	# MIT OR Apache-2.0
MODCARGO_CRATES +=	ascii	1.1.0	# Apache-2.0 OR MIT
MODCARGO_CRATES +=	assert_cmd	2.0.13	# MIT OR Apache-2.0
MODCARGO_CRATES +=	async-trait	0.1.77	# MIT OR Apache-2.0
MODCARGO_CRATES +=	autocfg	1.1.0	# Apache-2.0 OR MIT
MODCARGO_CRATES +=	backon	0.4.1	# Apache-2.0
MODCARGO_CRATES +=	backtrace	0.3.69	# MIT OR Apache-2.0
MODCARGO_CRATES +=	base64	0.13.1	# MIT/Apache-2.0
MODCARGO_CRATES +=	base64	0.21.7	# MIT OR Apache-2.0
MODCARGO_CRATES +=	base64ct	1.6.0	# Apache-2.0 OR MIT
MODCARGO_CRATES +=	bb8	0.8.1	# MIT
MODCARGO_CRATES +=	bincode	1.3.3	# MIT
MODCARGO_CRATES +=	bitflags	1.3.2	# MIT/Apache-2.0
MODCARGO_CRATES +=	bitflags	2.4.1	# MIT OR Apache-2.0
MODCARGO_CRATES +=	blake3	1.5.0	# CC0-1.0 OR Apache-2.0
MODCARGO_CRATES +=	block-buffer	0.10.4	# MIT OR Apache-2.0
MODCARGO_CRATES +=	bstr	1.9.0	# MIT OR Apache-2.0
MODCARGO_CRATES +=	buf_redux	0.8.4	# MIT OR Apache-2.0
MODCARGO_CRATES +=	bumpalo	3.14.0	# MIT OR Apache-2.0
MODCARGO_CRATES +=	byteorder	1.5.0	# Unlicense OR MIT
MODCARGO_CRATES +=	bytes	1.5.0	# MIT
MODCARGO_CRATES +=	cc	1.0.83	# MIT OR Apache-2.0
MODCARGO_CRATES +=	cfg-if	0.1.10	# MIT/Apache-2.0
MODCARGO_CRATES +=	cfg-if	1.0.0	# MIT/Apache-2.0
MODCARGO_CRATES +=	chrono	0.4.33	# MIT OR Apache-2.0
MODCARGO_CRATES +=	chunked_transfer	1.5.0	# MIT OR Apache-2.0
MODCARGO_CRATES +=	clap	4.4.18	# MIT OR Apache-2.0
MODCARGO_CRATES +=	clap_builder	4.4.18	# MIT OR Apache-2.0
MODCARGO_CRATES +=	clap_derive	4.4.7	# MIT OR Apache-2.0
MODCARGO_CRATES +=	clap_lex	0.6.0	# MIT OR Apache-2.0
MODCARGO_CRATES +=	colorchoice	1.0.0	# MIT OR Apache-2.0
MODCARGO_CRATES +=	combine	4.6.6	# MIT
MODCARGO_CRATES +=	const-oid	0.9.6	# Apache-2.0 OR MIT
MODCARGO_CRATES +=	const-random	0.1.17	# MIT OR Apache-2.0
MODCARGO_CRATES +=	const-random-macro	0.1.16	# MIT OR Apache-2.0
MODCARGO_CRATES +=	constant_time_eq	0.3.0	# CC0-1.0 OR MIT-0 OR Apache-2.0
MODCARGO_CRATES +=	core-foundation	0.9.4	# MIT OR Apache-2.0
MODCARGO_CRATES +=	core-foundation-sys	0.8.6	# MIT OR Apache-2.0
MODCARGO_CRATES +=	core_affinity	0.8.1	# MIT/Apache-2.0
MODCARGO_CRATES +=	cpufeatures	0.2.12	# MIT OR Apache-2.0
MODCARGO_CRATES +=	crc16	0.4.0	# MIT
MODCARGO_CRATES +=	crc32fast	1.3.2	# MIT OR Apache-2.0
MODCARGO_CRATES +=	crossbeam-utils	0.8.18	# MIT OR Apache-2.0
MODCARGO_CRATES +=	crunchy	0.2.2	# MIT
MODCARGO_CRATES +=	crypto-common	0.1.6	# MIT OR Apache-2.0
MODCARGO_CRATES +=	daemonize	0.5.0	# MIT/Apache-2.0
MODCARGO_CRATES +=	dashmap	5.5.3	# MIT
MODCARGO_CRATES +=	data-encoding	2.5.0	# MIT
MODCARGO_CRATES +=	der	0.7.8	# Apache-2.0 OR MIT
MODCARGO_CRATES +=	deranged	0.3.11	# MIT OR Apache-2.0
MODCARGO_CRATES +=	derive_more	0.99.17	# MIT
MODCARGO_CRATES +=	difflib	0.4.0	# MIT
MODCARGO_CRATES +=	digest	0.10.7	# MIT OR Apache-2.0
MODCARGO_CRATES +=	directories	5.0.1	# MIT OR Apache-2.0
MODCARGO_CRATES +=	dirs-sys	0.4.1	# MIT OR Apache-2.0
MODCARGO_CRATES +=	displaydoc	0.1.7	# MIT OR Apache-2.0
MODCARGO_CRATES +=	dlv-list	0.5.2	# MIT OR Apache-2.0
MODCARGO_CRATES +=	doc-comment	0.3.3	# MIT
MODCARGO_CRATES +=	either	1.9.0	# MIT OR Apache-2.0
MODCARGO_CRATES +=	encoding_rs	0.8.33	# (Apache-2.0 OR MIT) AND BSD-3-Clause
MODCARGO_CRATES +=	enum-as-inner	0.6.0	# MIT/Apache-2.0
MODCARGO_CRATES +=	env_logger	0.10.2	# MIT OR Apache-2.0
MODCARGO_CRATES +=	equivalent	1.0.1	# Apache-2.0 OR MIT
MODCARGO_CRATES +=	errno	0.3.8	# MIT OR Apache-2.0
MODCARGO_CRATES +=	error-chain	0.12.4	# MIT/Apache-2.0
MODCARGO_CRATES +=	fastrand	1.9.0	# Apache-2.0 OR MIT
MODCARGO_CRATES +=	fastrand	2.0.1	# Apache-2.0 OR MIT
MODCARGO_CRATES +=	filetime	0.2.23	# MIT/Apache-2.0
MODCARGO_CRATES +=	flagset	0.4.4	# Apache-2.0
MODCARGO_CRATES +=	flate2	1.0.28	# MIT OR Apache-2.0
MODCARGO_CRATES +=	float-cmp	0.9.0	# MIT
MODCARGO_CRATES +=	flume	0.10.14	# Apache-2.0/MIT
MODCARGO_CRATES +=	fnv	1.0.7	# Apache-2.0 / MIT
MODCARGO_CRATES +=	foreign-types	0.3.2	# MIT/Apache-2.0
MODCARGO_CRATES +=	foreign-types-shared	0.1.1	# MIT/Apache-2.0
MODCARGO_CRATES +=	form_urlencoded	1.2.1	# MIT OR Apache-2.0
MODCARGO_CRATES +=	fs-err	2.11.0	# MIT/Apache-2.0
MODCARGO_CRATES +=	futures	0.3.30	# MIT OR Apache-2.0
MODCARGO_CRATES +=	futures-channel	0.3.30	# MIT OR Apache-2.0
MODCARGO_CRATES +=	futures-core	0.3.30	# MIT OR Apache-2.0
MODCARGO_CRATES +=	futures-executor	0.3.30	# MIT OR Apache-2.0
MODCARGO_CRATES +=	futures-io	0.3.30	# MIT OR Apache-2.0
MODCARGO_CRATES +=	futures-macro	0.3.30	# MIT OR Apache-2.0
MODCARGO_CRATES +=	futures-sink	0.3.30	# MIT OR Apache-2.0
MODCARGO_CRATES +=	futures-task	0.3.30	# MIT OR Apache-2.0
MODCARGO_CRATES +=	futures-util	0.3.30	# MIT OR Apache-2.0
MODCARGO_CRATES +=	generic-array	0.14.7	# MIT
MODCARGO_CRATES +=	getrandom	0.2.11	# MIT OR Apache-2.0
MODCARGO_CRATES +=	gimli	0.28.1	# MIT OR Apache-2.0
MODCARGO_CRATES +=	gzp	0.11.3	# Unlicense/MIT
MODCARGO_CRATES +=	h2	0.3.24	# MIT
MODCARGO_CRATES +=	hashbrown	0.14.3	# MIT OR Apache-2.0
MODCARGO_CRATES +=	heck	0.4.1	# MIT OR Apache-2.0
MODCARGO_CRATES +=	hermit-abi	0.3.3	# MIT OR Apache-2.0
MODCARGO_CRATES +=	hex	0.4.3	# MIT OR Apache-2.0
MODCARGO_CRATES +=	hmac	0.12.1	# MIT OR Apache-2.0
MODCARGO_CRATES +=	home	0.5.9	# MIT OR Apache-2.0
MODCARGO_CRATES +=	hostname	0.3.1	# MIT
MODCARGO_CRATES +=	http	0.2.11	# MIT OR Apache-2.0
MODCARGO_CRATES +=	http	1.0.0	# MIT OR Apache-2.0
MODCARGO_CRATES +=	http-body	0.4.6	# MIT
MODCARGO_CRATES +=	http-body	1.0.0	# MIT
MODCARGO_CRATES +=	http-body-util	0.1.0	# MIT
MODCARGO_CRATES +=	httparse	1.8.0	# MIT/Apache-2.0
MODCARGO_CRATES +=	httpdate	1.0.3	# MIT OR Apache-2.0
MODCARGO_CRATES +=	humantime	2.1.0	# MIT/Apache-2.0
MODCARGO_CRATES +=	hyper	0.14.28	# MIT
MODCARGO_CRATES +=	hyper	1.1.0	# MIT
MODCARGO_CRATES +=	hyper-rustls	0.24.2	# Apache-2.0 OR ISC OR MIT
MODCARGO_CRATES +=	hyper-tls	0.5.0	# MIT/Apache-2.0
MODCARGO_CRATES +=	hyper-util	0.1.3	# MIT
MODCARGO_CRATES +=	iana-time-zone	0.1.59	# MIT OR Apache-2.0
MODCARGO_CRATES +=	iana-time-zone-haiku	0.1.2	# MIT OR Apache-2.0
MODCARGO_CRATES +=	idna	0.4.0	# MIT OR Apache-2.0
MODCARGO_CRATES +=	idna	0.5.0	# MIT OR Apache-2.0
MODCARGO_CRATES +=	indexmap	2.2.5	# Apache-2.0 OR MIT
MODCARGO_CRATES +=	instant	0.1.12	# BSD-3-Clause
MODCARGO_CRATES +=	ipconfig	0.3.2	# MIT/Apache-2.0
MODCARGO_CRATES +=	ipnet	2.9.0	# MIT OR Apache-2.0
MODCARGO_CRATES +=	is-terminal	0.4.12	# MIT
MODCARGO_CRATES +=	itertools	0.12.0	# MIT OR Apache-2.0
MODCARGO_CRATES +=	itoa	1.0.10	# MIT OR Apache-2.0
MODCARGO_CRATES +=	jobserver	0.1.28	# MIT OR Apache-2.0
MODCARGO_CRATES +=	js-sys	0.3.66	# MIT OR Apache-2.0
MODCARGO_CRATES +=	jsonwebtoken	9.2.0	# MIT
MODCARGO_CRATES +=	lazy_static	1.4.0	# MIT/Apache-2.0
MODCARGO_CRATES +=	libc	0.2.153	# MIT OR Apache-2.0
MODCARGO_CRATES +=	libm	0.2.8	# MIT OR Apache-2.0
MODCARGO_CRATES +=	libmount	0.1.15	# MIT/Apache-2.0
MODCARGO_CRATES +=	libredox	0.0.1	# MIT
MODCARGO_CRATES +=	linked-hash-map	0.5.6	# MIT/Apache-2.0
MODCARGO_CRATES +=	linux-raw-sys	0.4.12	# Apache-2.0 WITH LLVM-exception OR Apache-2.0 OR MIT
MODCARGO_CRATES +=	lock_api	0.4.11	# MIT OR Apache-2.0
MODCARGO_CRATES +=	log	0.4.20	# MIT OR Apache-2.0
MODCARGO_CRATES +=	lru-cache	0.1.2	# MIT/Apache-2.0
MODCARGO_CRATES +=	match_cfg	0.1.0	# MIT/Apache-2.0
MODCARGO_CRATES +=	md-5	0.10.6	# MIT OR Apache-2.0
MODCARGO_CRATES +=	memchr	2.7.1	# Unlicense OR MIT
MODCARGO_CRATES +=	memmap2	0.9.4	# MIT OR Apache-2.0
MODCARGO_CRATES +=	mime	0.3.17	# MIT OR Apache-2.0
MODCARGO_CRATES +=	mime_guess	2.0.4	# MIT
MODCARGO_CRATES +=	miniz_oxide	0.7.1	# MIT OR Zlib OR Apache-2.0
MODCARGO_CRATES +=	mio	0.8.10	# MIT
MODCARGO_CRATES +=	multipart	0.18.0	# MIT OR Apache-2.0
MODCARGO_CRATES +=	nanorand	0.7.0	# Zlib
MODCARGO_CRATES +=	native-tls	0.2.11	# MIT/Apache-2.0
MODCARGO_CRATES +=	nix	0.14.1	# MIT
MODCARGO_CRATES +=	nix	0.27.1	# MIT
MODCARGO_CRATES +=	normalize-line-endings	0.3.0	# Apache-2.0
MODCARGO_CRATES +=	num-bigint	0.4.4	# MIT OR Apache-2.0
MODCARGO_CRATES +=	num-bigint-dig	0.8.4	# MIT/Apache-2.0
MODCARGO_CRATES +=	num-integer	0.1.45	# MIT OR Apache-2.0
MODCARGO_CRATES +=	num-iter	0.1.43	# MIT OR Apache-2.0
MODCARGO_CRATES +=	num-traits	0.2.17	# MIT OR Apache-2.0
MODCARGO_CRATES +=	num_cpus	1.16.0	# MIT OR Apache-2.0
MODCARGO_CRATES +=	num_threads	0.1.6	# MIT OR Apache-2.0
MODCARGO_CRATES +=	number_prefix	0.4.0	# MIT
MODCARGO_CRATES +=	object	0.32.2	# Apache-2.0 OR MIT
MODCARGO_CRATES +=	once_cell	1.19.0	# MIT OR Apache-2.0
MODCARGO_CRATES +=	opendal	0.45.1	# Apache-2.0
MODCARGO_CRATES +=	openssl	0.10.64	# Apache-2.0
MODCARGO_CRATES +=	openssl-macros	0.1.1	# MIT/Apache-2.0
MODCARGO_CRATES +=	openssl-probe	0.1.5	# MIT/Apache-2.0
MODCARGO_CRATES +=	openssl-src	300.2.1+3.2.0	# MIT/Apache-2.0
MODCARGO_CRATES +=	openssl-sys	0.9.101	# MIT
MODCARGO_CRATES +=	option-ext	0.2.0	# MPL-2.0
MODCARGO_CRATES +=	ordered-multimap	0.7.0	# MIT
MODCARGO_CRATES +=	parking_lot	0.12.1	# MIT OR Apache-2.0
MODCARGO_CRATES +=	parking_lot_core	0.9.9	# MIT OR Apache-2.0
MODCARGO_CRATES +=	pem	3.0.3	# MIT
MODCARGO_CRATES +=	pem-rfc7468	0.7.0	# Apache-2.0 OR MIT
MODCARGO_CRATES +=	percent-encoding	2.3.1	# MIT OR Apache-2.0
MODCARGO_CRATES +=	pin-project	1.1.3	# Apache-2.0 OR MIT
MODCARGO_CRATES +=	pin-project-internal	1.1.3	# Apache-2.0 OR MIT
MODCARGO_CRATES +=	pin-project-lite	0.2.13	# Apache-2.0 OR MIT
MODCARGO_CRATES +=	pin-utils	0.1.0	# MIT OR Apache-2.0
MODCARGO_CRATES +=	pkcs1	0.7.5	# Apache-2.0 OR MIT
MODCARGO_CRATES +=	pkcs8	0.10.2	# Apache-2.0 OR MIT
MODCARGO_CRATES +=	pkg-config	0.3.28	# MIT OR Apache-2.0
MODCARGO_CRATES +=	powerfmt	0.2.0	# MIT OR Apache-2.0
MODCARGO_CRATES +=	ppv-lite86	0.2.17	# MIT/Apache-2.0
MODCARGO_CRATES +=	predicates	3.1.0	# MIT OR Apache-2.0
MODCARGO_CRATES +=	predicates-core	1.0.6	# MIT OR Apache-2.0
MODCARGO_CRATES +=	predicates-tree	1.0.9	# MIT OR Apache-2.0
MODCARGO_CRATES +=	proc-macro2	1.0.75	# MIT OR Apache-2.0
MODCARGO_CRATES +=	quick-error	1.2.3	# MIT/Apache-2.0
MODCARGO_CRATES +=	quick-xml	0.31.0	# MIT
MODCARGO_CRATES +=	quote	1.0.35	# MIT OR Apache-2.0
MODCARGO_CRATES +=	rand	0.8.5	# MIT OR Apache-2.0
MODCARGO_CRATES +=	rand_chacha	0.3.1	# MIT OR Apache-2.0
MODCARGO_CRATES +=	rand_core	0.6.4	# MIT OR Apache-2.0
MODCARGO_CRATES +=	redis	0.23.3	# BSD-3-Clause
MODCARGO_CRATES +=	redox_syscall	0.4.1	# MIT
MODCARGO_CRATES +=	redox_users	0.4.4	# MIT
MODCARGO_CRATES +=	regex	1.10.3	# MIT OR Apache-2.0
MODCARGO_CRATES +=	regex-automata	0.4.5	# MIT OR Apache-2.0
MODCARGO_CRATES +=	regex-syntax	0.8.2	# MIT OR Apache-2.0
MODCARGO_CRATES +=	reqsign	0.14.7	# Apache-2.0
MODCARGO_CRATES +=	reqwest	0.11.23	# MIT OR Apache-2.0
MODCARGO_CRATES +=	resolv-conf	0.7.0	# MIT/Apache-2.0
MODCARGO_CRATES +=	retry	2.0.0	# MIT
MODCARGO_CRATES +=	ring	0.17.7	# LICENSE
MODCARGO_CRATES +=	rouille	3.6.2	# MIT/Apache-2.0
MODCARGO_CRATES +=	rsa	0.9.6	# MIT OR Apache-2.0
MODCARGO_CRATES +=	rust-ini	0.20.0	# MIT
MODCARGO_CRATES +=	rustc-demangle	0.1.23	# MIT/Apache-2.0
MODCARGO_CRATES +=	rustix	0.38.30	# Apache-2.0 WITH LLVM-exception OR Apache-2.0 OR MIT
MODCARGO_CRATES +=	rustls	0.21.10	# Apache-2.0 OR ISC OR MIT
MODCARGO_CRATES +=	rustls-native-certs	0.6.3	# Apache-2.0 OR ISC OR MIT
MODCARGO_CRATES +=	rustls-pemfile	1.0.4	# Apache-2.0 OR ISC OR MIT
MODCARGO_CRATES +=	rustls-webpki	0.101.7	# ISC
MODCARGO_CRATES +=	ruzstd	0.5.0	# MIT
MODCARGO_CRATES +=	ryu	1.0.16	# Apache-2.0 OR BSL-1.0
MODCARGO_CRATES +=	safemem	0.3.3	# MIT/Apache-2.0
MODCARGO_CRATES +=	same-file	1.0.6	# Unlicense/MIT
MODCARGO_CRATES +=	schannel	0.1.23	# MIT
MODCARGO_CRATES +=	scopeguard	1.2.0	# MIT OR Apache-2.0
MODCARGO_CRATES +=	sct	0.7.1	# Apache-2.0 OR ISC OR MIT
MODCARGO_CRATES +=	security-framework	2.9.2	# MIT OR Apache-2.0
MODCARGO_CRATES +=	security-framework-sys	2.9.1	# MIT OR Apache-2.0
MODCARGO_CRATES +=	semver	1.0.21	# MIT OR Apache-2.0
MODCARGO_CRATES +=	serde	1.0.195	# MIT OR Apache-2.0
MODCARGO_CRATES +=	serde_derive	1.0.195	# MIT OR Apache-2.0
MODCARGO_CRATES +=	serde_json	1.0.114	# MIT OR Apache-2.0
MODCARGO_CRATES +=	serde_repr	0.1.18	# MIT OR Apache-2.0
MODCARGO_CRATES +=	serde_spanned	0.6.5	# MIT OR Apache-2.0
MODCARGO_CRATES +=	serde_urlencoded	0.7.1	# MIT/Apache-2.0
MODCARGO_CRATES +=	serial_test	2.0.0	# MIT
MODCARGO_CRATES +=	serial_test_derive	2.0.0	# MIT
MODCARGO_CRATES +=	sha1	0.10.6	# MIT OR Apache-2.0
MODCARGO_CRATES +=	sha1_smol	1.0.0	# BSD-3-Clause
MODCARGO_CRATES +=	sha2	0.10.8	# MIT OR Apache-2.0
MODCARGO_CRATES +=	signal-hook-registry	1.4.1	# Apache-2.0/MIT
MODCARGO_CRATES +=	signature	2.2.0	# Apache-2.0 OR MIT
MODCARGO_CRATES +=	simple_asn1	0.6.2	# ISC
MODCARGO_CRATES +=	slab	0.4.9	# MIT
MODCARGO_CRATES +=	smallvec	1.11.2	# MIT OR Apache-2.0
MODCARGO_CRATES +=	socket2	0.4.10	# MIT OR Apache-2.0
MODCARGO_CRATES +=	socket2	0.5.5	# MIT OR Apache-2.0
MODCARGO_CRATES +=	spin	0.5.2	# MIT
MODCARGO_CRATES +=	spin	0.9.8	# MIT
MODCARGO_CRATES +=	spki	0.7.3	# Apache-2.0 OR MIT
MODCARGO_CRATES +=	static_assertions	1.1.0	# MIT OR Apache-2.0
MODCARGO_CRATES +=	stringmatch	0.3.3	# MIT
MODCARGO_CRATES +=	strip-ansi-escapes	0.2.0	# Apache-2.0/MIT
MODCARGO_CRATES +=	strsim	0.10.0	# MIT
MODCARGO_CRATES +=	subtle	2.5.0	# BSD-3-Clause
MODCARGO_CRATES +=	syn	1.0.109	# MIT OR Apache-2.0
MODCARGO_CRATES +=	syn	2.0.48	# MIT OR Apache-2.0
MODCARGO_CRATES +=	syslog	6.1.0	# MIT
MODCARGO_CRATES +=	system-configuration	0.5.1	# MIT OR Apache-2.0
MODCARGO_CRATES +=	system-configuration-sys	0.5.0	# MIT OR Apache-2.0
MODCARGO_CRATES +=	tar	0.4.40	# MIT/Apache-2.0
MODCARGO_CRATES +=	temp-env	0.3.6	# MIT OR Apache-2.0
MODCARGO_CRATES +=	tempfile	3.9.0	# MIT OR Apache-2.0
MODCARGO_CRATES +=	termcolor	1.4.0	# Unlicense OR MIT
MODCARGO_CRATES +=	terminal_size	0.3.0	# MIT OR Apache-2.0
MODCARGO_CRATES +=	termtree	0.4.1	# MIT
MODCARGO_CRATES +=	test-case	3.3.1	# MIT
MODCARGO_CRATES +=	test-case-core	3.3.1	# MIT
MODCARGO_CRATES +=	test-case-macros	3.3.1	# MIT
MODCARGO_CRATES +=	thirtyfour	0.27.3	# MIT OR Apache-2.0
MODCARGO_CRATES +=	thirtyfour_sync	0.27.1	# MIT OR Apache-2.0
MODCARGO_CRATES +=	thiserror	1.0.56	# MIT OR Apache-2.0
MODCARGO_CRATES +=	thiserror-impl	1.0.56	# MIT OR Apache-2.0
MODCARGO_CRATES +=	threadpool	1.8.1	# MIT/Apache-2.0
MODCARGO_CRATES +=	time	0.3.31	# MIT OR Apache-2.0
MODCARGO_CRATES +=	time-core	0.1.2	# MIT OR Apache-2.0
MODCARGO_CRATES +=	time-macros	0.2.16	# MIT OR Apache-2.0
MODCARGO_CRATES +=	tiny-keccak	2.0.2	# CC0-1.0
MODCARGO_CRATES +=	tiny_http	0.12.0	# MIT OR Apache-2.0
MODCARGO_CRATES +=	tinyvec	1.6.0	# Zlib OR Apache-2.0 OR MIT
MODCARGO_CRATES +=	tinyvec_macros	0.1.1	# MIT OR Apache-2.0 OR Zlib
MODCARGO_CRATES +=	tokio	1.35.1	# MIT
MODCARGO_CRATES +=	tokio-macros	2.2.0	# MIT
MODCARGO_CRATES +=	tokio-native-tls	0.3.1	# MIT
MODCARGO_CRATES +=	tokio-retry	0.3.0	# MIT
MODCARGO_CRATES +=	tokio-rustls	0.24.1	# MIT/Apache-2.0
MODCARGO_CRATES +=	tokio-serde	0.8.0	# MIT OR Apache-2.0
MODCARGO_CRATES +=	tokio-util	0.7.10	# MIT
MODCARGO_CRATES +=	toml	0.8.10	# MIT OR Apache-2.0
MODCARGO_CRATES +=	toml_datetime	0.6.5	# MIT OR Apache-2.0
MODCARGO_CRATES +=	toml_edit	0.22.6	# MIT OR Apache-2.0
MODCARGO_CRATES +=	tower	0.4.13	# MIT
MODCARGO_CRATES +=	tower-layer	0.3.2	# MIT
MODCARGO_CRATES +=	tower-service	0.3.2	# MIT
MODCARGO_CRATES +=	tracing	0.1.40	# MIT
MODCARGO_CRATES +=	tracing-attributes	0.1.27	# MIT
MODCARGO_CRATES +=	tracing-core	0.1.32	# MIT
MODCARGO_CRATES +=	trust-dns-proto	0.23.2	# MIT OR Apache-2.0
MODCARGO_CRATES +=	trust-dns-resolver	0.23.2	# MIT OR Apache-2.0
MODCARGO_CRATES +=	try-lock	0.2.5	# MIT
MODCARGO_CRATES +=	twoway	0.1.8	# MIT/Apache-2.0
MODCARGO_CRATES +=	twox-hash	1.6.3	# MIT
MODCARGO_CRATES +=	typenum	1.17.0	# MIT OR Apache-2.0
MODCARGO_CRATES +=	unicase	2.7.0	# MIT/Apache-2.0
MODCARGO_CRATES +=	unicode-bidi	0.3.14	# MIT OR Apache-2.0
MODCARGO_CRATES +=	unicode-ident	1.0.12	# (MIT OR Apache-2.0) AND Unicode-DFS-2016
MODCARGO_CRATES +=	unicode-normalization	0.1.22	# MIT/Apache-2.0
MODCARGO_CRATES +=	untrusted	0.9.0	# ISC
MODCARGO_CRATES +=	url	2.5.0	# MIT OR Apache-2.0
MODCARGO_CRATES +=	urlparse	0.7.3	# MIT
MODCARGO_CRATES +=	utf8parse	0.2.1	# Apache-2.0 OR MIT
MODCARGO_CRATES +=	uuid	1.7.0	# Apache-2.0 OR MIT
MODCARGO_CRATES +=	vcpkg	0.2.15	# MIT/Apache-2.0
MODCARGO_CRATES +=	version-compare	0.1.1	# MIT
MODCARGO_CRATES +=	version_check	0.9.4	# MIT/Apache-2.0
MODCARGO_CRATES +=	void	1.0.2	# MIT
MODCARGO_CRATES +=	vte	0.11.1	# Apache-2.0 OR MIT
MODCARGO_CRATES +=	vte_generate_state_changes	0.1.1	# Apache-2.0 OR MIT
MODCARGO_CRATES +=	wait-timeout	0.2.0	# MIT/Apache-2.0
MODCARGO_CRATES +=	walkdir	2.5.0	# Unlicense/MIT
MODCARGO_CRATES +=	want	0.3.1	# MIT
MODCARGO_CRATES +=	wasi	0.11.0+wasi-snapshot-preview1	# Apache-2.0 WITH LLVM-exception OR Apache-2.0 OR MIT
MODCARGO_CRATES +=	wasm-bindgen	0.2.89	# MIT OR Apache-2.0
MODCARGO_CRATES +=	wasm-bindgen-backend	0.2.89	# MIT OR Apache-2.0
MODCARGO_CRATES +=	wasm-bindgen-futures	0.4.39	# MIT OR Apache-2.0
MODCARGO_CRATES +=	wasm-bindgen-macro	0.2.89	# MIT OR Apache-2.0
MODCARGO_CRATES +=	wasm-bindgen-macro-support	0.2.89	# MIT OR Apache-2.0
MODCARGO_CRATES +=	wasm-bindgen-shared	0.2.89	# MIT OR Apache-2.0
MODCARGO_CRATES +=	wasm-streams	0.3.0	# MIT OR Apache-2.0
MODCARGO_CRATES +=	web-sys	0.3.66	# MIT OR Apache-2.0
MODCARGO_CRATES +=	webpki-roots	0.25.3	# MPL-2.0
MODCARGO_CRATES +=	which	6.0.0	# MIT
MODCARGO_CRATES +=	widestring	1.0.2	# MIT OR Apache-2.0
MODCARGO_CRATES +=	winapi	0.3.9	# MIT/Apache-2.0
MODCARGO_CRATES +=	winapi-i686-pc-windows-gnu	0.4.0	# MIT/Apache-2.0
MODCARGO_CRATES +=	winapi-util	0.1.6	# Unlicense/MIT
MODCARGO_CRATES +=	winapi-x86_64-pc-windows-gnu	0.4.0	# MIT/Apache-2.0
MODCARGO_CRATES +=	windows-core	0.52.0	# MIT OR Apache-2.0
MODCARGO_CRATES +=	windows-sys	0.48.0	# MIT OR Apache-2.0
MODCARGO_CRATES +=	windows-sys	0.52.0	# MIT OR Apache-2.0
MODCARGO_CRATES +=	windows-targets	0.48.5	# MIT OR Apache-2.0
MODCARGO_CRATES +=	windows-targets	0.52.0	# MIT OR Apache-2.0
MODCARGO_CRATES +=	windows_aarch64_gnullvm	0.48.5	# MIT OR Apache-2.0
MODCARGO_CRATES +=	windows_aarch64_gnullvm	0.52.0	# MIT OR Apache-2.0
MODCARGO_CRATES +=	windows_aarch64_msvc	0.48.5	# MIT OR Apache-2.0
MODCARGO_CRATES +=	windows_aarch64_msvc	0.52.0	# MIT OR Apache-2.0
MODCARGO_CRATES +=	windows_i686_gnu	0.48.5	# MIT OR Apache-2.0
MODCARGO_CRATES +=	windows_i686_gnu	0.52.0	# MIT OR Apache-2.0
MODCARGO_CRATES +=	windows_i686_msvc	0.48.5	# MIT OR Apache-2.0
MODCARGO_CRATES +=	windows_i686_msvc	0.52.0	# MIT OR Apache-2.0
MODCARGO_CRATES +=	windows_x86_64_gnu	0.48.5	# MIT OR Apache-2.0
MODCARGO_CRATES +=	windows_x86_64_gnu	0.52.0	# MIT OR Apache-2.0
MODCARGO_CRATES +=	windows_x86_64_gnullvm	0.48.5	# MIT OR Apache-2.0
MODCARGO_CRATES +=	windows_x86_64_gnullvm	0.52.0	# MIT OR Apache-2.0
MODCARGO_CRATES +=	windows_x86_64_msvc	0.48.5	# MIT OR Apache-2.0
MODCARGO_CRATES +=	windows_x86_64_msvc	0.52.0	# MIT OR Apache-2.0
MODCARGO_CRATES +=	winnow	0.6.1	# MIT
MODCARGO_CRATES +=	winreg	0.50.0	# MIT
MODCARGO_CRATES +=	xattr	1.2.0	# MIT/Apache-2.0
MODCARGO_CRATES +=	zeroize	1.7.0	# Apache-2.0 OR MIT
MODCARGO_CRATES +=	zip	0.6.6	# MIT
MODCARGO_CRATES +=	zstd	0.13.0	# MIT
MODCARGO_CRATES +=	zstd-safe	7.0.0	# MIT/Apache-2.0
MODCARGO_CRATES +=	zstd-sys	2.0.9+zstd.1.5.5	# MIT/Apache-2.0
