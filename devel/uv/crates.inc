MODCARGO_CRATES +=	addr2line	0.24.2	# Apache-2.0 OR MIT
MODCARGO_CRATES +=	adler2	2.0.1	# 0BSD OR MIT OR Apache-2.0
MODCARGO_CRATES +=	aes	0.8.4	# MIT OR Apache-2.0
MODCARGO_CRATES +=	aho-corasick	1.1.3	# Unlicense OR MIT
MODCARGO_CRATES +=	allocator-api2	0.2.21	# MIT OR Apache-2.0
MODCARGO_CRATES +=	anes	0.1.6	# MIT OR Apache-2.0
MODCARGO_CRATES +=	anstream	0.6.20	# MIT OR Apache-2.0
MODCARGO_CRATES +=	anstyle	1.0.11	# MIT OR Apache-2.0
MODCARGO_CRATES +=	anstyle-parse	0.2.7	# MIT OR Apache-2.0
MODCARGO_CRATES +=	anstyle-query	1.1.3	# MIT OR Apache-2.0
MODCARGO_CRATES +=	anstyle-wincon	3.0.9	# MIT OR Apache-2.0
MODCARGO_CRATES +=	anyhow	1.0.99	# MIT OR Apache-2.0
MODCARGO_CRATES +=	approx	0.5.1	# Apache-2.0
MODCARGO_CRATES +=	arbitrary	1.4.1	# MIT OR Apache-2.0
MODCARGO_CRATES +=	arcstr	1.2.0	# Apache-2.0 OR MIT OR Zlib
MODCARGO_CRATES +=	arrayref	0.3.9	# BSD-2-Clause
MODCARGO_CRATES +=	arrayvec	0.7.6	# MIT OR Apache-2.0
MODCARGO_CRATES +=	assert-json-diff	2.0.2	# MIT
MODCARGO_CRATES +=	assert_cmd	2.0.17	# MIT OR Apache-2.0
MODCARGO_CRATES +=	assert_fs	1.1.3	# MIT OR Apache-2.0
MODCARGO_CRATES +=	astral-tokio-tar	0.5.3	# MIT OR Apache-2.0
MODCARGO_CRATES +=	async-broadcast	0.7.2	# MIT OR Apache-2.0
MODCARGO_CRATES +=	async-channel	2.5.0	# Apache-2.0 OR MIT
MODCARGO_CRATES +=	async-compression	0.4.19	# MIT OR Apache-2.0
MODCARGO_CRATES +=	async-recursion	1.1.1	# MIT OR Apache-2.0
MODCARGO_CRATES +=	async-trait	0.1.89	# MIT OR Apache-2.0
MODCARGO_CRATES +=	async_http_range_reader	0.9.1	# MIT
MODCARGO_CRATES +=	atomic-waker	1.1.2	# Apache-2.0 OR MIT
MODCARGO_CRATES +=	autocfg	1.5.0	# Apache-2.0 OR MIT
MODCARGO_CRATES +=	axoasset	1.3.0	# MIT OR Apache-2.0
MODCARGO_CRATES +=	axoprocess	0.2.1	# MIT OR Apache-2.0
MODCARGO_CRATES +=	axotag	0.3.0	# MIT OR Apache-2.0
MODCARGO_CRATES +=	axoupdater	0.9.1	# MIT OR Apache-2.0
MODCARGO_CRATES +=	backon	1.5.2	# Apache-2.0
MODCARGO_CRATES +=	backtrace	0.3.75	# MIT OR Apache-2.0
MODCARGO_CRATES +=	base64	0.21.7	# MIT OR Apache-2.0
MODCARGO_CRATES +=	base64	0.22.1	# MIT OR Apache-2.0
MODCARGO_CRATES +=	bincode	1.3.3	# MIT
MODCARGO_CRATES +=	bisection	0.1.0	# MIT
MODCARGO_CRATES +=	bitflags	1.3.2	# MIT/Apache-2.0
MODCARGO_CRATES +=	bitflags	2.9.3	# MIT OR Apache-2.0
MODCARGO_CRATES +=	blake2	0.10.6	# MIT OR Apache-2.0
MODCARGO_CRATES +=	block-buffer	0.10.4	# MIT OR Apache-2.0
MODCARGO_CRATES +=	block-padding	0.3.3	# MIT OR Apache-2.0
MODCARGO_CRATES +=	boxcar	0.2.14	# MIT
MODCARGO_CRATES +=	bstr	1.12.0	# MIT OR Apache-2.0
MODCARGO_CRATES +=	bumpalo	3.19.0	# MIT OR Apache-2.0
MODCARGO_CRATES +=	bytecheck	0.8.1	# MIT
MODCARGO_CRATES +=	bytecheck_derive	0.8.1	# MIT
MODCARGO_CRATES +=	bytemuck	1.23.1	# Zlib OR Apache-2.0 OR MIT
MODCARGO_CRATES +=	byteorder	1.5.0	# Unlicense OR MIT
MODCARGO_CRATES +=	byteorder-lite	0.1.0	# Unlicense OR MIT
MODCARGO_CRATES +=	bytes	1.10.1	# MIT
MODCARGO_CRATES +=	bzip2	0.5.2	# MIT OR Apache-2.0
MODCARGO_CRATES +=	bzip2-sys	0.1.13+1.0.8	# MIT/Apache-2.0
MODCARGO_CRATES +=	camino	1.1.10	# MIT OR Apache-2.0
MODCARGO_CRATES +=	cargo-util	0.2.22	# MIT OR Apache-2.0
MODCARGO_CRATES +=	cast	0.3.0	# MIT OR Apache-2.0
MODCARGO_CRATES +=	cbc	0.1.2	# MIT OR Apache-2.0
MODCARGO_CRATES +=	cc	1.2.30	# MIT OR Apache-2.0
MODCARGO_CRATES +=	cfg-if	1.0.1	# MIT OR Apache-2.0
MODCARGO_CRATES +=	cfg_aliases	0.2.1	# MIT
MODCARGO_CRATES +=	charset	0.1.5	# Apache-2.0 OR MIT
MODCARGO_CRATES +=	ciborium	0.2.2	# Apache-2.0
MODCARGO_CRATES +=	ciborium-io	0.2.2	# Apache-2.0
MODCARGO_CRATES +=	ciborium-ll	0.2.2	# Apache-2.0
MODCARGO_CRATES +=	cipher	0.4.4	# MIT OR Apache-2.0
MODCARGO_CRATES +=	clap	4.5.45	# MIT OR Apache-2.0
MODCARGO_CRATES +=	clap_builder	4.5.44	# MIT OR Apache-2.0
MODCARGO_CRATES +=	clap_complete	4.5.55	# MIT OR Apache-2.0
MODCARGO_CRATES +=	clap_complete_command	0.6.1	# MIT
MODCARGO_CRATES +=	clap_complete_nushell	4.5.8	# MIT OR Apache-2.0
MODCARGO_CRATES +=	clap_derive	4.5.45	# MIT OR Apache-2.0
MODCARGO_CRATES +=	clap_lex	0.7.5	# MIT OR Apache-2.0
MODCARGO_CRATES +=	codspeed	3.0.5	# MIT OR Apache-2.0
MODCARGO_CRATES +=	codspeed-criterion-compat	3.0.5	# MIT OR Apache-2.0
MODCARGO_CRATES +=	codspeed-criterion-compat-walltime	3.0.5	# Apache-2.0 OR MIT
MODCARGO_CRATES +=	color_quant	1.1.0	# MIT
MODCARGO_CRATES +=	colorchoice	1.0.4	# MIT OR Apache-2.0
MODCARGO_CRATES +=	colored	2.2.0	# MPL-2.0
MODCARGO_CRATES +=	concurrent-queue	2.5.0	# Apache-2.0 OR MIT
MODCARGO_CRATES +=	configparser	3.1.0	# MIT OR LGPL-3.0-or-later
MODCARGO_CRATES +=	console	0.15.11	# MIT
MODCARGO_CRATES +=	console	0.16.0	# MIT
MODCARGO_CRATES +=	core-foundation	0.9.4	# MIT OR Apache-2.0
MODCARGO_CRATES +=	core-foundation	0.10.1	# MIT OR Apache-2.0
MODCARGO_CRATES +=	core-foundation-sys	0.8.7	# MIT OR Apache-2.0
MODCARGO_CRATES +=	cpufeatures	0.2.17	# MIT OR Apache-2.0
MODCARGO_CRATES +=	crc	3.3.0	# MIT OR Apache-2.0
MODCARGO_CRATES +=	crc-catalog	2.4.0	# MIT OR Apache-2.0
MODCARGO_CRATES +=	crc32fast	1.5.0	# MIT OR Apache-2.0
MODCARGO_CRATES +=	criterion	0.7.0	# Apache-2.0 OR MIT
MODCARGO_CRATES +=	criterion-plot	0.5.0	# MIT/Apache-2.0
MODCARGO_CRATES +=	criterion-plot	0.6.0	# MIT OR Apache-2.0
MODCARGO_CRATES +=	crossbeam-deque	0.8.6	# MIT OR Apache-2.0
MODCARGO_CRATES +=	crossbeam-epoch	0.9.18	# MIT OR Apache-2.0
MODCARGO_CRATES +=	crossbeam-utils	0.8.21	# MIT OR Apache-2.0
MODCARGO_CRATES +=	crunchy	0.2.4	# MIT
MODCARGO_CRATES +=	crypto-common	0.1.6	# MIT OR Apache-2.0
MODCARGO_CRATES +=	csv	1.3.1	# Unlicense/MIT
MODCARGO_CRATES +=	csv-core	0.1.12	# Unlicense/MIT
MODCARGO_CRATES +=	ctrlc	3.4.7	# MIT/Apache-2.0
MODCARGO_CRATES +=	dashmap	6.1.0	# MIT
MODCARGO_CRATES +=	data-encoding	2.9.0	# MIT
MODCARGO_CRATES +=	data-url	0.2.0	# MIT OR Apache-2.0
MODCARGO_CRATES +=	deadpool	0.10.0	# MIT OR Apache-2.0
MODCARGO_CRATES +=	deadpool-runtime	0.1.4	# MIT OR Apache-2.0
MODCARGO_CRATES +=	derive_arbitrary	1.4.1	# MIT/Apache-2.0
MODCARGO_CRATES +=	diff	0.1.13	# MIT OR Apache-2.0
MODCARGO_CRATES +=	difflib	0.4.0	# MIT
MODCARGO_CRATES +=	digest	0.10.7	# MIT OR Apache-2.0
MODCARGO_CRATES +=	dirs	6.0.0	# MIT OR Apache-2.0
MODCARGO_CRATES +=	dirs-sys	0.5.0	# MIT OR Apache-2.0
MODCARGO_CRATES +=	displaydoc	0.2.5	# MIT OR Apache-2.0
MODCARGO_CRATES +=	doc-comment	0.3.3	# MIT
MODCARGO_CRATES +=	dotenvy	0.15.7	# MIT
MODCARGO_CRATES +=	dunce	1.0.5	# CC0-1.0 OR MIT-0 OR Apache-2.0
MODCARGO_CRATES +=	dyn-clone	1.0.19	# MIT OR Apache-2.0
MODCARGO_CRATES +=	either	1.15.0	# MIT OR Apache-2.0
MODCARGO_CRATES +=	encode_unicode	1.0.0	# Apache-2.0 OR MIT
MODCARGO_CRATES +=	encoding_rs	0.8.35	# (Apache-2.0 OR MIT) AND BSD-3-Clause
MODCARGO_CRATES +=	encoding_rs_io	0.1.7	# MIT OR Apache-2.0
MODCARGO_CRATES +=	endi	1.1.0	# MIT
MODCARGO_CRATES +=	enumflags2	0.7.12	# MIT OR Apache-2.0
MODCARGO_CRATES +=	enumflags2_derive	0.7.12	# MIT OR Apache-2.0
MODCARGO_CRATES +=	env_filter	0.1.3	# MIT OR Apache-2.0
MODCARGO_CRATES +=	env_home	0.1.0	# MIT OR Apache-2.0
MODCARGO_CRATES +=	env_logger	0.11.8	# MIT OR Apache-2.0
MODCARGO_CRATES +=	equivalent	1.0.2	# Apache-2.0 OR MIT
MODCARGO_CRATES +=	erased-serde	0.4.6	# MIT OR Apache-2.0
MODCARGO_CRATES +=	errno	0.3.13	# MIT OR Apache-2.0
MODCARGO_CRATES +=	etcetera	0.10.0	# MIT OR Apache-2.0
MODCARGO_CRATES +=	event-listener	5.4.0	# Apache-2.0 OR MIT
MODCARGO_CRATES +=	event-listener-strategy	0.5.4	# Apache-2.0 OR MIT
MODCARGO_CRATES +=	fastrand	2.3.0	# Apache-2.0 OR MIT
MODCARGO_CRATES +=	fdeflate	0.3.7	# MIT OR Apache-2.0
MODCARGO_CRATES +=	filetime	0.2.26	# MIT/Apache-2.0
MODCARGO_CRATES +=	fixedbitset	0.5.7	# MIT OR Apache-2.0
MODCARGO_CRATES +=	flate2	1.1.2	# MIT OR Apache-2.0
MODCARGO_CRATES +=	float-cmp	0.9.0	# MIT
MODCARGO_CRATES +=	float-cmp	0.10.0	# MIT
MODCARGO_CRATES +=	fnv	1.0.7	# Apache-2.0 / MIT
MODCARGO_CRATES +=	foldhash	0.1.5	# Zlib
MODCARGO_CRATES +=	fontconfig-parser	0.5.8	# MIT
MODCARGO_CRATES +=	fontdb	0.12.0	# MIT
MODCARGO_CRATES +=	form_urlencoded	1.2.1	# MIT OR Apache-2.0
MODCARGO_CRATES +=	fs-err	3.1.1	# MIT/Apache-2.0
MODCARGO_CRATES +=	fs2	0.4.3	# MIT/Apache-2.0
MODCARGO_CRATES +=	futures	0.3.31	# MIT OR Apache-2.0
MODCARGO_CRATES +=	futures-channel	0.3.31	# MIT OR Apache-2.0
MODCARGO_CRATES +=	futures-core	0.3.31	# MIT OR Apache-2.0
MODCARGO_CRATES +=	futures-executor	0.3.31	# MIT OR Apache-2.0
MODCARGO_CRATES +=	futures-io	0.3.31	# MIT OR Apache-2.0
MODCARGO_CRATES +=	futures-lite	2.6.0	# Apache-2.0 OR MIT
MODCARGO_CRATES +=	futures-macro	0.3.31	# MIT OR Apache-2.0
MODCARGO_CRATES +=	futures-sink	0.3.31	# MIT OR Apache-2.0
MODCARGO_CRATES +=	futures-task	0.3.31	# MIT OR Apache-2.0
MODCARGO_CRATES +=	futures-util	0.3.31	# MIT OR Apache-2.0
MODCARGO_CRATES +=	generic-array	0.14.7	# MIT
MODCARGO_CRATES +=	getrandom	0.2.16	# MIT OR Apache-2.0
MODCARGO_CRATES +=	getrandom	0.3.3	# MIT OR Apache-2.0
MODCARGO_CRATES +=	gif	0.12.0	# MIT/Apache-2.0
MODCARGO_CRATES +=	gimli	0.31.1	# MIT OR Apache-2.0
MODCARGO_CRATES +=	glob	0.3.3	# MIT OR Apache-2.0
MODCARGO_CRATES +=	globset	0.4.16	# Unlicense OR MIT
MODCARGO_CRATES +=	globwalk	0.9.1	# MIT
MODCARGO_CRATES +=	gloo-timers	0.3.0	# MIT OR Apache-2.0
MODCARGO_CRATES +=	goblin	0.10.1	# MIT
MODCARGO_CRATES +=	h2	0.4.12	# MIT
MODCARGO_CRATES +=	half	2.6.0	# MIT OR Apache-2.0
MODCARGO_CRATES +=	hashbrown	0.14.5	# MIT OR Apache-2.0
MODCARGO_CRATES +=	hashbrown	0.15.5	# MIT OR Apache-2.0
MODCARGO_CRATES +=	heck	0.5.0	# MIT OR Apache-2.0
MODCARGO_CRATES +=	hermit-abi	0.5.2	# MIT OR Apache-2.0
MODCARGO_CRATES +=	hex	0.4.3	# MIT OR Apache-2.0
MODCARGO_CRATES +=	hkdf	0.12.4	# MIT OR Apache-2.0
MODCARGO_CRATES +=	hmac	0.12.1	# MIT OR Apache-2.0
MODCARGO_CRATES +=	home	0.5.11	# MIT OR Apache-2.0
MODCARGO_CRATES +=	homedir	0.3.6	# MIT OR Apache-2.0
MODCARGO_CRATES +=	html-escape	0.2.13	# MIT
MODCARGO_CRATES +=	http	1.3.1	# MIT OR Apache-2.0
MODCARGO_CRATES +=	http-body	1.0.1	# MIT
MODCARGO_CRATES +=	http-body-util	0.1.3	# MIT
MODCARGO_CRATES +=	http-content-range	0.2.3	# MIT OR Apache-2.0
MODCARGO_CRATES +=	httparse	1.10.1	# MIT OR Apache-2.0
MODCARGO_CRATES +=	httpdate	1.0.3	# MIT OR Apache-2.0
MODCARGO_CRATES +=	hyper	1.6.0	# MIT
MODCARGO_CRATES +=	hyper-rustls	0.27.7	# Apache-2.0 OR ISC OR MIT
MODCARGO_CRATES +=	hyper-util	0.1.16	# MIT
MODCARGO_CRATES +=	icu_collections	2.0.0	# Unicode-3.0
MODCARGO_CRATES +=	icu_locale_core	2.0.0	# Unicode-3.0
MODCARGO_CRATES +=	icu_normalizer	2.0.0	# Unicode-3.0
MODCARGO_CRATES +=	icu_normalizer_data	2.0.0	# Unicode-3.0
MODCARGO_CRATES +=	icu_properties	2.0.1	# Unicode-3.0
MODCARGO_CRATES +=	icu_properties_data	2.0.1	# Unicode-3.0
MODCARGO_CRATES +=	icu_provider	2.0.0	# Unicode-3.0
MODCARGO_CRATES +=	idna	1.0.3	# MIT OR Apache-2.0
MODCARGO_CRATES +=	idna_adapter	1.2.1	# Apache-2.0 OR MIT
MODCARGO_CRATES +=	ignore	0.4.23	# Unlicense OR MIT
MODCARGO_CRATES +=	image	0.25.6	# MIT OR Apache-2.0
MODCARGO_CRATES +=	imagesize	0.11.0	# MIT
MODCARGO_CRATES +=	indexmap	2.10.0	# Apache-2.0 OR MIT
MODCARGO_CRATES +=	indicatif	0.18.0	# MIT
MODCARGO_CRATES +=	indoc	2.0.6	# MIT OR Apache-2.0
MODCARGO_CRATES +=	inout	0.1.4	# MIT OR Apache-2.0
MODCARGO_CRATES +=	insta	1.43.1	# Apache-2.0
MODCARGO_CRATES +=	io-uring	0.7.9	# MIT OR Apache-2.0
MODCARGO_CRATES +=	ipnet	2.11.0	# MIT OR Apache-2.0
MODCARGO_CRATES +=	iri-string	0.7.8	# MIT OR Apache-2.0
MODCARGO_CRATES +=	is-docker	0.2.0	# MIT
MODCARGO_CRATES +=	is-terminal	0.4.16	# MIT
MODCARGO_CRATES +=	is-wsl	0.4.0	# MIT
MODCARGO_CRATES +=	is_ci	1.2.0	# ISC
MODCARGO_CRATES +=	is_terminal_polyfill	1.70.1	# MIT OR Apache-2.0
MODCARGO_CRATES +=	itertools	0.10.5	# MIT/Apache-2.0
MODCARGO_CRATES +=	itertools	0.13.0	# MIT OR Apache-2.0
MODCARGO_CRATES +=	itertools	0.14.0	# MIT OR Apache-2.0
MODCARGO_CRATES +=	itoa	1.0.15	# MIT OR Apache-2.0
MODCARGO_CRATES +=	jiff	0.2.15	# Unlicense OR MIT
MODCARGO_CRATES +=	jiff-static	0.2.15	# Unlicense OR MIT
MODCARGO_CRATES +=	jiff-tzdb	0.1.4	# Unlicense OR MIT
MODCARGO_CRATES +=	jiff-tzdb-platform	0.1.3	# Unlicense OR MIT
MODCARGO_CRATES +=	jobserver	0.1.33	# MIT OR Apache-2.0
MODCARGO_CRATES +=	jpeg-decoder	0.3.2	# MIT OR Apache-2.0
MODCARGO_CRATES +=	js-sys	0.3.77	# MIT OR Apache-2.0
MODCARGO_CRATES +=	junction	1.2.0	# MIT
MODCARGO_CRATES +=	kurbo	0.8.3	# MIT/Apache-2.0
MODCARGO_CRATES +=	kurbo	0.9.5	# MIT/Apache-2.0
MODCARGO_CRATES +=	lazy_static	1.5.0	# MIT OR Apache-2.0
MODCARGO_CRATES +=	libc	0.2.175	# MIT OR Apache-2.0
MODCARGO_CRATES +=	libmimalloc-sys	0.1.43	# MIT
MODCARGO_CRATES +=	libredox	0.1.6	# MIT
MODCARGO_CRATES +=	libz-rs-sys	0.5.1	# Zlib
MODCARGO_CRATES +=	linux-raw-sys	0.4.15	# Apache-2.0 WITH LLVM-exception OR Apache-2.0 OR MIT
MODCARGO_CRATES +=	linux-raw-sys	0.9.4	# Apache-2.0 WITH LLVM-exception OR Apache-2.0 OR MIT
MODCARGO_CRATES +=	litemap	0.8.0	# Unicode-3.0
MODCARGO_CRATES +=	lock_api	0.4.13	# MIT OR Apache-2.0
MODCARGO_CRATES +=	log	0.4.27	# MIT OR Apache-2.0
MODCARGO_CRATES +=	lru-slab	0.1.2	# MIT OR Apache-2.0 OR Zlib
MODCARGO_CRATES +=	lzma-rs	0.3.0	# MIT
MODCARGO_CRATES +=	lzma-sys	0.1.20	# MIT/Apache-2.0
MODCARGO_CRATES +=	mailparse	0.16.1	# 0BSD
MODCARGO_CRATES +=	markdown	1.0.0	# MIT
MODCARGO_CRATES +=	matchers	0.2.0	# MIT
MODCARGO_CRATES +=	md-5	0.10.6	# MIT OR Apache-2.0
MODCARGO_CRATES +=	memchr	2.7.5	# Unlicense OR MIT
MODCARGO_CRATES +=	memmap2	0.5.10	# MIT OR Apache-2.0
MODCARGO_CRATES +=	memmap2	0.9.7	# MIT OR Apache-2.0
MODCARGO_CRATES +=	memoffset	0.9.1	# MIT
MODCARGO_CRATES +=	miette	7.6.0	# Apache-2.0
MODCARGO_CRATES +=	miette-derive	7.6.0	# Apache-2.0
MODCARGO_CRATES +=	mimalloc	0.1.47	# MIT
MODCARGO_CRATES +=	mime	0.3.17	# MIT OR Apache-2.0
MODCARGO_CRATES +=	mime_guess	2.0.5	# MIT
MODCARGO_CRATES +=	miniz_oxide	0.8.9	# MIT OR Zlib OR Apache-2.0
MODCARGO_CRATES +=	mio	1.0.4	# MIT
MODCARGO_CRATES +=	miow	0.6.0	# MIT OR Apache-2.0
MODCARGO_CRATES +=	munge	0.4.5	# MIT
MODCARGO_CRATES +=	munge_macro	0.4.5	# MIT
MODCARGO_CRATES +=	nanoid	0.4.0	# MIT
MODCARGO_CRATES +=	nix	0.29.0	# MIT
MODCARGO_CRATES +=	nix	0.30.1	# MIT
MODCARGO_CRATES +=	normalize-line-endings	0.3.0	# Apache-2.0
MODCARGO_CRATES +=	nu-ansi-term	0.50.1	# MIT
MODCARGO_CRATES +=	num	0.4.3	# MIT OR Apache-2.0
MODCARGO_CRATES +=	num-bigint	0.4.6	# MIT OR Apache-2.0
MODCARGO_CRATES +=	num-complex	0.4.6	# MIT OR Apache-2.0
MODCARGO_CRATES +=	num-integer	0.1.46	# MIT OR Apache-2.0
MODCARGO_CRATES +=	num-iter	0.1.45	# MIT OR Apache-2.0
MODCARGO_CRATES +=	num-rational	0.4.2	# MIT OR Apache-2.0
MODCARGO_CRATES +=	num-traits	0.2.19	# MIT OR Apache-2.0
MODCARGO_CRATES +=	num_cpus	1.17.0	# MIT OR Apache-2.0
MODCARGO_CRATES +=	object	0.36.7	# Apache-2.0 OR MIT
MODCARGO_CRATES +=	once_cell	1.21.3	# MIT OR Apache-2.0
MODCARGO_CRATES +=	once_cell_polyfill	1.70.1	# MIT OR Apache-2.0
MODCARGO_CRATES +=	oorandom	11.1.5	# MIT
MODCARGO_CRATES +=	open	5.3.2	# MIT
MODCARGO_CRATES +=	openssl-probe	0.1.6	# MIT/Apache-2.0
MODCARGO_CRATES +=	option-ext	0.2.0	# MPL-2.0
MODCARGO_CRATES +=	ordered-stream	0.2.0	# MIT OR Apache-2.0
MODCARGO_CRATES +=	os_str_bytes	6.6.1	# MIT OR Apache-2.0
MODCARGO_CRATES +=	owo-colors	4.2.2	# MIT
MODCARGO_CRATES +=	parking	2.2.1	# Apache-2.0 OR MIT
MODCARGO_CRATES +=	parking_lot	0.12.4	# MIT OR Apache-2.0
MODCARGO_CRATES +=	parking_lot_core	0.9.11	# MIT OR Apache-2.0
MODCARGO_CRATES +=	paste	1.0.15	# MIT OR Apache-2.0
MODCARGO_CRATES +=	path-slash	0.2.1	# MIT
MODCARGO_CRATES +=	pathdiff	0.2.3	# MIT/Apache-2.0
MODCARGO_CRATES +=	percent-encoding	2.3.2	# MIT OR Apache-2.0
MODCARGO_CRATES +=	pest	2.8.1	# MIT OR Apache-2.0
MODCARGO_CRATES +=	pest_derive	2.8.1	# MIT OR Apache-2.0
MODCARGO_CRATES +=	pest_generator	2.8.1	# MIT OR Apache-2.0
MODCARGO_CRATES +=	pest_meta	2.8.1	# MIT OR Apache-2.0
MODCARGO_CRATES +=	petgraph	0.8.2	# MIT OR Apache-2.0
MODCARGO_CRATES +=	pico-args	0.5.0	# MIT
MODCARGO_CRATES +=	pin-project	1.1.10	# Apache-2.0 OR MIT
MODCARGO_CRATES +=	pin-project-internal	1.1.10	# Apache-2.0 OR MIT
MODCARGO_CRATES +=	pin-project-lite	0.2.16	# Apache-2.0 OR MIT
MODCARGO_CRATES +=	pin-utils	0.1.0	# MIT OR Apache-2.0
MODCARGO_CRATES +=	pkg-config	0.3.32	# MIT OR Apache-2.0
MODCARGO_CRATES +=	plain	0.2.3	# MIT/Apache-2.0
MODCARGO_CRATES +=	png	0.17.16	# MIT OR Apache-2.0
MODCARGO_CRATES +=	poloto	19.1.2	# MIT
MODCARGO_CRATES +=	portable-atomic	1.11.1	# Apache-2.0 OR MIT
MODCARGO_CRATES +=	portable-atomic-util	0.2.4	# Apache-2.0 OR MIT
MODCARGO_CRATES +=	potential_utf	0.1.2	# Unicode-3.0
MODCARGO_CRATES +=	ppv-lite86	0.2.21	# MIT OR Apache-2.0
MODCARGO_CRATES +=	predicates	3.1.3	# MIT OR Apache-2.0
MODCARGO_CRATES +=	predicates-core	1.0.9	# MIT OR Apache-2.0
MODCARGO_CRATES +=	predicates-tree	1.0.12	# MIT OR Apache-2.0
MODCARGO_CRATES +=	pretty_assertions	1.4.1	# MIT OR Apache-2.0
MODCARGO_CRATES +=	priority-queue	2.5.0	# LGPL-3.0-or-later OR MPL-2.0
MODCARGO_CRATES +=	proc-macro-crate	3.3.0	# MIT OR Apache-2.0
MODCARGO_CRATES +=	proc-macro2	1.0.101	# MIT OR Apache-2.0
MODCARGO_CRATES +=	procfs	0.17.0	# MIT OR Apache-2.0
MODCARGO_CRATES +=	procfs-core	0.17.0	# MIT OR Apache-2.0
MODCARGO_CRATES +=	ptr_meta	0.3.0	# MIT
MODCARGO_CRATES +=	ptr_meta_derive	0.3.0	# MIT
MODCARGO_CRATES +=	quinn	0.11.8	# MIT OR Apache-2.0
MODCARGO_CRATES +=	quinn-proto	0.11.12	# MIT OR Apache-2.0
MODCARGO_CRATES +=	quinn-udp	0.5.13	# MIT OR Apache-2.0
MODCARGO_CRATES +=	quote	1.0.40	# MIT OR Apache-2.0
MODCARGO_CRATES +=	quoted_printable	0.5.1	# 0BSD
MODCARGO_CRATES +=	r-efi	5.3.0	# MIT OR Apache-2.0 OR LGPL-2.1-or-later
MODCARGO_CRATES +=	rancor	0.1.0	# MIT
MODCARGO_CRATES +=	rand	0.8.5	# MIT OR Apache-2.0
MODCARGO_CRATES +=	rand	0.9.2	# MIT OR Apache-2.0
MODCARGO_CRATES +=	rand_chacha	0.3.1	# MIT OR Apache-2.0
MODCARGO_CRATES +=	rand_chacha	0.9.0	# MIT OR Apache-2.0
MODCARGO_CRATES +=	rand_core	0.6.4	# MIT OR Apache-2.0
MODCARGO_CRATES +=	rand_core	0.9.3	# MIT OR Apache-2.0
MODCARGO_CRATES +=	rayon	1.10.0	# MIT OR Apache-2.0
MODCARGO_CRATES +=	rayon-core	1.12.1	# MIT OR Apache-2.0
MODCARGO_CRATES +=	rctree	0.5.0	# MIT
MODCARGO_CRATES +=	redox_syscall	0.5.15	# MIT
MODCARGO_CRATES +=	redox_users	0.5.0	# MIT
MODCARGO_CRATES +=	ref-cast	1.0.24	# MIT OR Apache-2.0
MODCARGO_CRATES +=	ref-cast-impl	1.0.24	# MIT OR Apache-2.0
MODCARGO_CRATES +=	reflink-copy	0.1.26	# MIT/Apache-2.0
MODCARGO_CRATES +=	regex	1.11.2	# MIT OR Apache-2.0
MODCARGO_CRATES +=	regex-automata	0.4.10	# MIT OR Apache-2.0
MODCARGO_CRATES +=	regex-syntax	0.8.5	# MIT OR Apache-2.0
MODCARGO_CRATES +=	rend	0.5.2	# MIT
MODCARGO_CRATES +=	reqwest	0.12.22	# MIT OR Apache-2.0
MODCARGO_CRATES +=	resvg	0.29.0	# MPL-2.0
MODCARGO_CRATES +=	retry-policies	0.4.0	# MIT OR Apache-2.0
MODCARGO_CRATES +=	rgb	0.8.52	# MIT
MODCARGO_CRATES +=	ring	0.17.14	# Apache-2.0 AND ISC
MODCARGO_CRATES +=	rkyv	0.8.11	# MIT
MODCARGO_CRATES +=	rkyv_derive	0.8.11	# MIT
MODCARGO_CRATES +=	rmp	0.8.14	# MIT
MODCARGO_CRATES +=	rmp-serde	1.3.0	# MIT
MODCARGO_CRATES +=	rosvgtree	0.1.0	# MIT OR Apache-2.0
MODCARGO_CRATES +=	roxmltree	0.18.1	# MIT OR Apache-2.0
MODCARGO_CRATES +=	roxmltree	0.20.0	# MIT OR Apache-2.0
MODCARGO_CRATES +=	rust-netrc	0.1.2	# MIT
MODCARGO_CRATES +=	rustc-demangle	0.1.25	# MIT/Apache-2.0
MODCARGO_CRATES +=	rustc-hash	2.1.1	# Apache-2.0 OR MIT
MODCARGO_CRATES +=	rustix	0.38.44	# Apache-2.0 WITH LLVM-exception OR Apache-2.0 OR MIT
MODCARGO_CRATES +=	rustix	1.0.8	# Apache-2.0 WITH LLVM-exception OR Apache-2.0 OR MIT
MODCARGO_CRATES +=	rustls	0.23.29	# Apache-2.0 OR ISC OR MIT
MODCARGO_CRATES +=	rustls-native-certs	0.8.1	# Apache-2.0 OR ISC OR MIT
MODCARGO_CRATES +=	rustls-pki-types	1.12.0	# MIT OR Apache-2.0
MODCARGO_CRATES +=	rustls-webpki	0.103.4	# ISC
MODCARGO_CRATES +=	rustversion	1.0.21	# MIT OR Apache-2.0
MODCARGO_CRATES +=	rustybuzz	0.7.0	# MIT
MODCARGO_CRATES +=	ryu	1.0.20	# Apache-2.0 OR BSL-1.0
MODCARGO_CRATES +=	same-file	1.0.6	# Unlicense/MIT
MODCARGO_CRATES +=	schannel	0.1.27	# MIT
MODCARGO_CRATES +=	schemars	1.0.4	# MIT
MODCARGO_CRATES +=	schemars_derive	1.0.4	# MIT
MODCARGO_CRATES +=	scopeguard	1.2.0	# MIT OR Apache-2.0
MODCARGO_CRATES +=	scroll	0.13.0	# MIT
MODCARGO_CRATES +=	scroll_derive	0.13.0	# MIT
MODCARGO_CRATES +=	seahash	4.1.0	# MIT
MODCARGO_CRATES +=	secret-service	5.0.0	# MIT OR Apache-2.0
MODCARGO_CRATES +=	security-framework	3.2.0	# MIT OR Apache-2.0
MODCARGO_CRATES +=	security-framework-sys	2.14.0	# MIT OR Apache-2.0
MODCARGO_CRATES +=	self-replace	1.5.0	# Apache-2.0
MODCARGO_CRATES +=	semver	1.0.26	# MIT OR Apache-2.0
MODCARGO_CRATES +=	serde	1.0.219	# MIT OR Apache-2.0
MODCARGO_CRATES +=	serde-untagged	0.1.8	# MIT OR Apache-2.0
MODCARGO_CRATES +=	serde_derive	1.0.219	# MIT OR Apache-2.0
MODCARGO_CRATES +=	serde_derive_internals	0.29.1	# MIT OR Apache-2.0
MODCARGO_CRATES +=	serde_json	1.0.143	# MIT OR Apache-2.0
MODCARGO_CRATES +=	serde_repr	0.1.20	# MIT OR Apache-2.0
MODCARGO_CRATES +=	serde_spanned	1.0.0	# MIT OR Apache-2.0
MODCARGO_CRATES +=	serde_urlencoded	0.7.1	# MIT/Apache-2.0
MODCARGO_CRATES +=	serde_yaml	0.9.34+deprecated	# MIT OR Apache-2.0
MODCARGO_CRATES +=	sha2	0.10.9	# MIT OR Apache-2.0
MODCARGO_CRATES +=	sharded-slab	0.1.7	# MIT
MODCARGO_CRATES +=	shell-escape	0.1.5	# MIT/Apache-2.0
MODCARGO_CRATES +=	shellexpand	3.1.1	# MIT/Apache-2.0
MODCARGO_CRATES +=	shlex	1.3.0	# MIT OR Apache-2.0
MODCARGO_CRATES +=	signal-hook-registry	1.4.5	# Apache-2.0/MIT
MODCARGO_CRATES +=	simd-adler32	0.3.7	# MIT
MODCARGO_CRATES +=	simdutf8	0.1.5	# MIT OR Apache-2.0
MODCARGO_CRATES +=	similar	2.7.0	# Apache-2.0
MODCARGO_CRATES +=	simplecss	0.2.2	# Apache-2.0 OR MIT
MODCARGO_CRATES +=	siphasher	0.3.11	# MIT/Apache-2.0
MODCARGO_CRATES +=	slab	0.4.10	# MIT
MODCARGO_CRATES +=	smallvec	1.15.1	# MIT OR Apache-2.0
MODCARGO_CRATES +=	smawk	0.3.2	# MIT
MODCARGO_CRATES +=	socket2	0.5.10	# MIT OR Apache-2.0
MODCARGO_CRATES +=	socket2	0.6.0	# MIT OR Apache-2.0
MODCARGO_CRATES +=	spdx	0.10.9	# MIT OR Apache-2.0
MODCARGO_CRATES +=	stable_deref_trait	1.2.0	# MIT/Apache-2.0
MODCARGO_CRATES +=	static_assertions	1.1.0	# MIT OR Apache-2.0
MODCARGO_CRATES +=	statrs	0.18.0	# MIT
MODCARGO_CRATES +=	strict-num	0.1.1	# MIT
MODCARGO_CRATES +=	strsim	0.11.1	# MIT
MODCARGO_CRATES +=	subtle	2.6.1	# BSD-3-Clause
MODCARGO_CRATES +=	supports-color	3.0.2	# Apache-2.0
MODCARGO_CRATES +=	supports-hyperlinks	3.1.0	# Apache-2.0
MODCARGO_CRATES +=	supports-unicode	3.0.0	# Apache-2.0
MODCARGO_CRATES +=	svg	0.18.0	# Apache-2.0 OR MIT
MODCARGO_CRATES +=	svgfilters	0.4.0	# MPL-2.0
MODCARGO_CRATES +=	svgtypes	0.9.0	# MIT/Apache-2.0
MODCARGO_CRATES +=	svgtypes	0.10.0	# MIT/Apache-2.0
MODCARGO_CRATES +=	syn	2.0.106	# MIT OR Apache-2.0
MODCARGO_CRATES +=	sync_wrapper	1.0.2	# Apache-2.0
MODCARGO_CRATES +=	synstructure	0.13.2	# MIT
MODCARGO_CRATES +=	sys-info	0.9.1	# MIT
MODCARGO_CRATES +=	system-configuration	0.6.1	# MIT OR Apache-2.0
MODCARGO_CRATES +=	system-configuration-sys	0.6.0	# MIT OR Apache-2.0
MODCARGO_CRATES +=	tagu	0.1.6	# MIT
MODCARGO_CRATES +=	tar	0.4.44	# MIT OR Apache-2.0
MODCARGO_CRATES +=	target-lexicon	0.13.2	# Apache-2.0 WITH LLVM-exception
MODCARGO_CRATES +=	temp-env	0.3.6	# MIT OR Apache-2.0
MODCARGO_CRATES +=	tempfile	3.20.0	# MIT OR Apache-2.0
MODCARGO_CRATES +=	terminal_size	0.4.2	# MIT OR Apache-2.0
MODCARGO_CRATES +=	termtree	0.5.1	# MIT
MODCARGO_CRATES +=	test-case	3.3.1	# MIT
MODCARGO_CRATES +=	test-case-core	3.3.1	# MIT
MODCARGO_CRATES +=	test-case-macros	3.3.1	# MIT
MODCARGO_CRATES +=	test-log	0.2.18	# Apache-2.0 OR MIT
MODCARGO_CRATES +=	test-log-macros	0.2.18	# Apache-2.0 OR MIT
MODCARGO_CRATES +=	textwrap	0.16.2	# MIT
MODCARGO_CRATES +=	thiserror	1.0.69	# MIT OR Apache-2.0
MODCARGO_CRATES +=	thiserror	2.0.16	# MIT OR Apache-2.0
MODCARGO_CRATES +=	thiserror-impl	1.0.69	# MIT OR Apache-2.0
MODCARGO_CRATES +=	thiserror-impl	2.0.16	# MIT OR Apache-2.0
MODCARGO_CRATES +=	thread_local	1.1.9	# MIT OR Apache-2.0
MODCARGO_CRATES +=	tikv-jemalloc-sys	0.6.0+5.3.0-1-ge13ca993e8ccb9ba9847cc330696e02839f328f7	# MIT/Apache-2.0
MODCARGO_CRATES +=	tikv-jemallocator	0.6.0	# MIT/Apache-2.0
MODCARGO_CRATES +=	tiny-skia	0.8.4	# BSD-3-Clause
MODCARGO_CRATES +=	tiny-skia-path	0.8.4	# BSD-3-Clause
MODCARGO_CRATES +=	tinystr	0.8.1	# Unicode-3.0
MODCARGO_CRATES +=	tinytemplate	1.2.1	# Apache-2.0 OR MIT
MODCARGO_CRATES +=	tinyvec	1.9.0	# Zlib OR Apache-2.0 OR MIT
MODCARGO_CRATES +=	tinyvec_macros	0.1.1	# MIT OR Apache-2.0 OR Zlib
MODCARGO_CRATES +=	tokio	1.47.1	# MIT
MODCARGO_CRATES +=	tokio-macros	2.5.0	# MIT
MODCARGO_CRATES +=	tokio-rustls	0.26.2	# MIT OR Apache-2.0
MODCARGO_CRATES +=	tokio-stream	0.1.17	# MIT
MODCARGO_CRATES +=	tokio-util	0.7.15	# MIT
MODCARGO_CRATES +=	toml	0.9.2	# MIT OR Apache-2.0
MODCARGO_CRATES +=	toml_datetime	0.6.11	# MIT OR Apache-2.0
MODCARGO_CRATES +=	toml_datetime	0.7.0	# MIT OR Apache-2.0
MODCARGO_CRATES +=	toml_edit	0.22.27	# MIT OR Apache-2.0
MODCARGO_CRATES +=	toml_edit	0.23.2	# MIT OR Apache-2.0
MODCARGO_CRATES +=	toml_parser	1.0.1	# MIT OR Apache-2.0
MODCARGO_CRATES +=	toml_writer	1.0.2	# MIT OR Apache-2.0
MODCARGO_CRATES +=	tower	0.5.2	# MIT
MODCARGO_CRATES +=	tower-http	0.6.6	# MIT
MODCARGO_CRATES +=	tower-layer	0.3.3	# MIT
MODCARGO_CRATES +=	tower-service	0.3.3	# MIT
MODCARGO_CRATES +=	tracing	0.1.41	# MIT
MODCARGO_CRATES +=	tracing-attributes	0.1.30	# MIT
MODCARGO_CRATES +=	tracing-core	0.1.34	# MIT
MODCARGO_CRATES +=	tracing-durations-export	0.3.1	# MIT OR Apache-2.0
MODCARGO_CRATES +=	tracing-log	0.2.0	# MIT
MODCARGO_CRATES +=	tracing-serde	0.2.0	# MIT
MODCARGO_CRATES +=	tracing-subscriber	0.3.20	# MIT
MODCARGO_CRATES +=	tracing-test	0.2.5	# MIT
MODCARGO_CRATES +=	tracing-test-macro	0.2.5	# MIT
MODCARGO_CRATES +=	tracing-tree	0.4.0	# MIT OR Apache-2.0
MODCARGO_CRATES +=	try-lock	0.2.5	# MIT
MODCARGO_CRATES +=	ttf-parser	0.18.1	# MIT OR Apache-2.0
MODCARGO_CRATES +=	typeid	1.0.3	# MIT OR Apache-2.0
MODCARGO_CRATES +=	typenum	1.18.0	# MIT OR Apache-2.0
MODCARGO_CRATES +=	ucd-trie	0.1.7	# MIT OR Apache-2.0
MODCARGO_CRATES +=	uds_windows	1.1.0	# MIT
MODCARGO_CRATES +=	unicase	2.8.1	# MIT OR Apache-2.0
MODCARGO_CRATES +=	unicode-bidi	0.3.18	# MIT OR Apache-2.0
MODCARGO_CRATES +=	unicode-bidi-mirroring	0.1.0	# MIT/Apache-2.0
MODCARGO_CRATES +=	unicode-ccc	0.1.2	# MIT/Apache-2.0
MODCARGO_CRATES +=	unicode-general-category	0.6.0	# Apache-2.0
MODCARGO_CRATES +=	unicode-id	0.3.5	# MIT OR Apache-2.0
MODCARGO_CRATES +=	unicode-ident	1.0.18	# (MIT OR Apache-2.0) AND Unicode-3.0
MODCARGO_CRATES +=	unicode-linebreak	0.1.5	# Apache-2.0
MODCARGO_CRATES +=	unicode-script	0.5.7	# MIT OR Apache-2.0
MODCARGO_CRATES +=	unicode-vo	0.1.0	# MIT/Apache-2.0
MODCARGO_CRATES +=	unicode-width	0.1.14	# MIT OR Apache-2.0
MODCARGO_CRATES +=	unicode-width	0.2.1	# MIT OR Apache-2.0
MODCARGO_CRATES +=	unit-prefix	0.5.1	# MIT
MODCARGO_CRATES +=	unsafe-libyaml	0.2.11	# MIT
MODCARGO_CRATES +=	unscanny	0.1.0	# MIT OR Apache-2.0
MODCARGO_CRATES +=	untrusted	0.9.0	# ISC
MODCARGO_CRATES +=	url	2.5.4	# MIT OR Apache-2.0
MODCARGO_CRATES +=	usvg	0.29.0	# MPL-2.0
MODCARGO_CRATES +=	usvg-text-layout	0.29.0	# MPL-2.0
MODCARGO_CRATES +=	utf8-width	0.1.7	# MIT
MODCARGO_CRATES +=	utf8_iter	1.0.4	# Apache-2.0 OR MIT
MODCARGO_CRATES +=	utf8parse	0.2.2	# Apache-2.0 OR MIT
MODCARGO_CRATES +=	uuid	1.17.0	# Apache-2.0 OR MIT
MODCARGO_CRATES +=	valuable	0.1.1	# MIT
MODCARGO_CRATES +=	version_check	0.9.5	# MIT/Apache-2.0
MODCARGO_CRATES +=	wait-timeout	0.2.1	# MIT/Apache-2.0
MODCARGO_CRATES +=	walkdir	2.5.0	# Unlicense/MIT
MODCARGO_CRATES +=	want	0.3.1	# MIT
MODCARGO_CRATES +=	wasi	0.11.1+wasi-snapshot-preview1	# Apache-2.0 WITH LLVM-exception OR Apache-2.0 OR MIT
MODCARGO_CRATES +=	wasi	0.14.2+wasi-0.2.4	# Apache-2.0 WITH LLVM-exception OR Apache-2.0 OR MIT
MODCARGO_CRATES +=	wasite	0.1.0	# Apache-2.0 OR BSL-1.0 OR MIT
MODCARGO_CRATES +=	wasm-bindgen	0.2.100	# MIT OR Apache-2.0
MODCARGO_CRATES +=	wasm-bindgen-backend	0.2.100	# MIT OR Apache-2.0
MODCARGO_CRATES +=	wasm-bindgen-futures	0.4.50	# MIT OR Apache-2.0
MODCARGO_CRATES +=	wasm-bindgen-macro	0.2.100	# MIT OR Apache-2.0
MODCARGO_CRATES +=	wasm-bindgen-macro-support	0.2.100	# MIT OR Apache-2.0
MODCARGO_CRATES +=	wasm-bindgen-shared	0.2.100	# MIT OR Apache-2.0
MODCARGO_CRATES +=	wasm-streams	0.4.2	# MIT OR Apache-2.0
MODCARGO_CRATES +=	wasmtimer	0.4.2	# MIT
MODCARGO_CRATES +=	web-sys	0.3.77	# MIT OR Apache-2.0
MODCARGO_CRATES +=	web-time	1.1.0	# MIT OR Apache-2.0
MODCARGO_CRATES +=	webpki-roots	1.0.2	# CDLA-Permissive-2.0
MODCARGO_CRATES +=	weezl	0.1.10	# MIT OR Apache-2.0
MODCARGO_CRATES +=	which	8.0.0	# MIT
MODCARGO_CRATES +=	whoami	1.6.0	# Apache-2.0 OR BSL-1.0 OR MIT
MODCARGO_CRATES +=	widestring	1.2.0	# MIT OR Apache-2.0
MODCARGO_CRATES +=	winapi	0.3.9	# MIT/Apache-2.0
MODCARGO_CRATES +=	winapi-i686-pc-windows-gnu	0.4.0	# MIT/Apache-2.0
MODCARGO_CRATES +=	winapi-util	0.1.9	# Unlicense OR MIT
MODCARGO_CRATES +=	winapi-x86_64-pc-windows-gnu	0.4.0	# MIT/Apache-2.0
MODCARGO_CRATES +=	windows	0.59.0	# MIT OR Apache-2.0
MODCARGO_CRATES +=	windows	0.61.3	# MIT OR Apache-2.0
MODCARGO_CRATES +=	windows-collections	0.2.0	# MIT OR Apache-2.0
MODCARGO_CRATES +=	windows-core	0.59.0	# MIT OR Apache-2.0
MODCARGO_CRATES +=	windows-core	0.61.2	# MIT OR Apache-2.0
MODCARGO_CRATES +=	windows-future	0.2.1	# MIT OR Apache-2.0
MODCARGO_CRATES +=	windows-implement	0.59.0	# MIT OR Apache-2.0
MODCARGO_CRATES +=	windows-implement	0.60.0	# MIT OR Apache-2.0
MODCARGO_CRATES +=	windows-interface	0.59.1	# MIT OR Apache-2.0
MODCARGO_CRATES +=	windows-link	0.1.3	# MIT OR Apache-2.0
MODCARGO_CRATES +=	windows-numerics	0.2.0	# MIT OR Apache-2.0
MODCARGO_CRATES +=	windows-registry	0.5.3	# MIT OR Apache-2.0
MODCARGO_CRATES +=	windows-result	0.3.4	# MIT OR Apache-2.0
MODCARGO_CRATES +=	windows-strings	0.3.1	# MIT OR Apache-2.0
MODCARGO_CRATES +=	windows-strings	0.4.2	# MIT OR Apache-2.0
MODCARGO_CRATES +=	windows-sys	0.48.0	# MIT OR Apache-2.0
MODCARGO_CRATES +=	windows-sys	0.52.0	# MIT OR Apache-2.0
MODCARGO_CRATES +=	windows-sys	0.59.0	# MIT OR Apache-2.0
MODCARGO_CRATES +=	windows-sys	0.60.2	# MIT OR Apache-2.0
MODCARGO_CRATES +=	windows-targets	0.48.5	# MIT OR Apache-2.0
MODCARGO_CRATES +=	windows-targets	0.52.6	# MIT OR Apache-2.0
MODCARGO_CRATES +=	windows-targets	0.53.2	# MIT OR Apache-2.0
MODCARGO_CRATES +=	windows-threading	0.1.0	# MIT OR Apache-2.0
MODCARGO_CRATES +=	windows_aarch64_gnullvm	0.48.5	# MIT OR Apache-2.0
MODCARGO_CRATES +=	windows_aarch64_gnullvm	0.52.6	# MIT OR Apache-2.0
MODCARGO_CRATES +=	windows_aarch64_gnullvm	0.53.0	# MIT OR Apache-2.0
MODCARGO_CRATES +=	windows_aarch64_msvc	0.48.5	# MIT OR Apache-2.0
MODCARGO_CRATES +=	windows_aarch64_msvc	0.52.6	# MIT OR Apache-2.0
MODCARGO_CRATES +=	windows_aarch64_msvc	0.53.0	# MIT OR Apache-2.0
MODCARGO_CRATES +=	windows_i686_gnu	0.48.5	# MIT OR Apache-2.0
MODCARGO_CRATES +=	windows_i686_gnu	0.52.6	# MIT OR Apache-2.0
MODCARGO_CRATES +=	windows_i686_gnu	0.53.0	# MIT OR Apache-2.0
MODCARGO_CRATES +=	windows_i686_gnullvm	0.52.6	# MIT OR Apache-2.0
MODCARGO_CRATES +=	windows_i686_gnullvm	0.53.0	# MIT OR Apache-2.0
MODCARGO_CRATES +=	windows_i686_msvc	0.48.5	# MIT OR Apache-2.0
MODCARGO_CRATES +=	windows_i686_msvc	0.52.6	# MIT OR Apache-2.0
MODCARGO_CRATES +=	windows_i686_msvc	0.53.0	# MIT OR Apache-2.0
MODCARGO_CRATES +=	windows_x86_64_gnu	0.48.5	# MIT OR Apache-2.0
MODCARGO_CRATES +=	windows_x86_64_gnu	0.52.6	# MIT OR Apache-2.0
MODCARGO_CRATES +=	windows_x86_64_gnu	0.53.0	# MIT OR Apache-2.0
MODCARGO_CRATES +=	windows_x86_64_gnullvm	0.48.5	# MIT OR Apache-2.0
MODCARGO_CRATES +=	windows_x86_64_gnullvm	0.52.6	# MIT OR Apache-2.0
MODCARGO_CRATES +=	windows_x86_64_gnullvm	0.53.0	# MIT OR Apache-2.0
MODCARGO_CRATES +=	windows_x86_64_msvc	0.48.5	# MIT OR Apache-2.0
MODCARGO_CRATES +=	windows_x86_64_msvc	0.52.6	# MIT OR Apache-2.0
MODCARGO_CRATES +=	windows_x86_64_msvc	0.53.0	# MIT OR Apache-2.0
MODCARGO_CRATES +=	winnow	0.7.12	# MIT
MODCARGO_CRATES +=	winsafe	0.0.19	# MIT
MODCARGO_CRATES +=	wiremock	0.6.4	# MIT/Apache-2.0
MODCARGO_CRATES +=	wit-bindgen-rt	0.39.0	# Apache-2.0 WITH LLVM-exception OR Apache-2.0 OR MIT
MODCARGO_CRATES +=	writeable	0.6.1	# Unicode-3.0
MODCARGO_CRATES +=	xattr	1.5.1	# MIT OR Apache-2.0
MODCARGO_CRATES +=	xmlparser	0.13.6	# MIT/Apache-2.0
MODCARGO_CRATES +=	xz2	0.1.7	# MIT/Apache-2.0
MODCARGO_CRATES +=	yansi	1.0.1	# MIT OR Apache-2.0
MODCARGO_CRATES +=	yoke	0.8.0	# Unicode-3.0
MODCARGO_CRATES +=	yoke-derive	0.8.0	# Unicode-3.0
MODCARGO_CRATES +=	zbus	5.8.0	# MIT
MODCARGO_CRATES +=	zbus_macros	5.8.0	# MIT
MODCARGO_CRATES +=	zbus_names	4.2.0	# MIT
MODCARGO_CRATES +=	zerocopy	0.8.26	# BSD-2-Clause OR Apache-2.0 OR MIT
MODCARGO_CRATES +=	zerocopy-derive	0.8.26	# BSD-2-Clause OR Apache-2.0 OR MIT
MODCARGO_CRATES +=	zerofrom	0.1.6	# Unicode-3.0
MODCARGO_CRATES +=	zerofrom-derive	0.1.6	# Unicode-3.0
MODCARGO_CRATES +=	zeroize	1.8.1	# Apache-2.0 OR MIT
MODCARGO_CRATES +=	zerotrie	0.2.2	# Unicode-3.0
MODCARGO_CRATES +=	zerovec	0.11.2	# Unicode-3.0
MODCARGO_CRATES +=	zerovec-derive	0.11.1	# Unicode-3.0
MODCARGO_CRATES +=	zip	2.4.2	# MIT
MODCARGO_CRATES +=	zlib-rs	0.5.1	# Zlib
MODCARGO_CRATES +=	zopfli	0.8.2	# Apache-2.0
MODCARGO_CRATES +=	zstd	0.13.3	# MIT
MODCARGO_CRATES +=	zstd-safe	7.2.4	# MIT OR Apache-2.0
MODCARGO_CRATES +=	zstd-sys	2.0.15+zstd.1.5.7	# MIT/Apache-2.0
MODCARGO_CRATES +=	zvariant	5.6.0	# MIT
MODCARGO_CRATES +=	zvariant_derive	5.6.0	# MIT
MODCARGO_CRATES +=	zvariant_utils	3.2.0	# MIT
