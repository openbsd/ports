MODCABAL_MANIFEST	= \
	ansi-terminal	1.1.5	0	\
	ansi-terminal-types	1.1.3	0	\
	colour	2.3.6	0	\
	hashable	1.5.1.0	0	\
	json	0.11	0	\
	microlens	0.5.0.0	0	\
	microlens-ghc	0.4.15.2	0	\
	microlens-mtl	0.2.1.1	0	\
	microlens-platform	0.4.4.2	0	\
	microlens-th	0.4.3.18	0	\
	optparse-applicative	0.19.0.0	0	\
	prettyprinter	1.7.1	0	\
	prettyprinter-ansi-terminal	1.1.3	0	\
	primitive	0.9.1.0	1	\
	random	1.3.1	0	\
	splitmix	0.1.3.2	0	\
	syb	0.7.3	0	\
	tagged	0.8.10	1	\
	tasty	1.5.3	2	\
	th-abstraction	0.7.2.0	0	\
	transformers-compat	0.8	0	\
	unordered-containers	0.2.21	2	\
	utf8-string	1.0.2	0	\
	vector	0.13.2.0	2	\
	vector-stream	0.1.0.1	4
