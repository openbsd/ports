MODCARGO_CRATES +=	aho-corasick	1.0.4	# Unlicense OR MIT
MODCARGO_CRATES +=	anes	0.1.6	# MIT OR Apache-2.0
MODCARGO_CRATES +=	annotate-snippets	0.6.1	# Apache-2.0/MIT
MODCARGO_CRATES +=	anstyle	1.0.2	# MIT OR Apache-2.0
MODCARGO_CRATES +=	autocfg	1.1.0	# Apache-2.0 OR MIT
MODCARGO_CRATES +=	bitflags	2.4.0	# MIT OR Apache-2.0
MODCARGO_CRATES +=	bumpalo	3.12.0	# MIT/Apache-2.0
MODCARGO_CRATES +=	cast	0.3.0	# MIT OR Apache-2.0
MODCARGO_CRATES +=	cc	1.0.83	# MIT OR Apache-2.0
MODCARGO_CRATES +=	cfg-if	1.0.0	# MIT/Apache-2.0
MODCARGO_CRATES +=	chic	1.2.2	# MIT OR Apache-2.0
MODCARGO_CRATES +=	ciborium	0.2.0	# Apache-2.0
MODCARGO_CRATES +=	ciborium-io	0.2.0	# Apache-2.0
MODCARGO_CRATES +=	ciborium-ll	0.2.0	# Apache-2.0
MODCARGO_CRATES +=	clap	4.4.0	# MIT OR Apache-2.0
MODCARGO_CRATES +=	clap_builder	4.4.0	# MIT OR Apache-2.0
MODCARGO_CRATES +=	clap_lex	0.5.1	# MIT OR Apache-2.0
MODCARGO_CRATES +=	criterion	0.5.1	# Apache-2.0 OR MIT
MODCARGO_CRATES +=	criterion-plot	0.5.0	# MIT/Apache-2.0
MODCARGO_CRATES +=	crossbeam-deque	0.8.1	# MIT OR Apache-2.0
MODCARGO_CRATES +=	crossbeam-epoch	0.9.9	# MIT OR Apache-2.0
MODCARGO_CRATES +=	crossbeam-utils	0.8.10	# MIT OR Apache-2.0
MODCARGO_CRATES +=	difference	2.0.0	# MIT
MODCARGO_CRATES +=	either	1.6.1	# MIT/Apache-2.0
MODCARGO_CRATES +=	equivalent	1.0.1	# Apache-2.0 OR MIT
MODCARGO_CRATES +=	errno	0.3.2	# MIT OR Apache-2.0
MODCARGO_CRATES +=	errno-dragonfly	0.1.2	# MIT
MODCARGO_CRATES +=	glob	0.3.0	# MIT/Apache-2.0
MODCARGO_CRATES +=	half	1.8.2	# MIT OR Apache-2.0
MODCARGO_CRATES +=	hashbrown	0.14.5	# MIT OR Apache-2.0
MODCARGO_CRATES +=	heck	0.5.0	# MIT OR Apache-2.0
MODCARGO_CRATES +=	hermit-abi	0.3.2	# MIT OR Apache-2.0
MODCARGO_CRATES +=	indexmap	2.4.0	# Apache-2.0 OR MIT
MODCARGO_CRATES +=	indoc	2.0.4	# MIT OR Apache-2.0
MODCARGO_CRATES +=	is-terminal	0.4.9	# MIT
MODCARGO_CRATES +=	itertools	0.10.5	# MIT/Apache-2.0
MODCARGO_CRATES +=	itertools	0.13.0	# MIT OR Apache-2.0
MODCARGO_CRATES +=	itoa	1.0.2	# MIT OR Apache-2.0
MODCARGO_CRATES +=	js-sys	0.3.58	# MIT/Apache-2.0
MODCARGO_CRATES +=	lazy_static	1.4.0	# MIT/Apache-2.0
MODCARGO_CRATES +=	libc	0.2.149	# MIT OR Apache-2.0
MODCARGO_CRATES +=	linux-raw-sys	0.4.10	# Apache-2.0 WITH LLVM-exception OR Apache-2.0 OR MIT
MODCARGO_CRATES +=	log	0.4.17	# MIT OR Apache-2.0
MODCARGO_CRATES +=	memchr	2.7.4	# Unlicense OR MIT
MODCARGO_CRATES +=	memoffset	0.6.5	# MIT
MODCARGO_CRATES +=	memoffset	0.9.0	# MIT
MODCARGO_CRATES +=	num-traits	0.2.15	# MIT OR Apache-2.0
MODCARGO_CRATES +=	once_cell	1.16.0	# MIT OR Apache-2.0
MODCARGO_CRATES +=	oorandom	11.1.3	# MIT
MODCARGO_CRATES +=	paste	1.0.15	# MIT OR Apache-2.0
MODCARGO_CRATES +=	peg	0.8.4	# MIT
MODCARGO_CRATES +=	peg-macros	0.8.4	# MIT
MODCARGO_CRATES +=	peg-runtime	0.8.3	# MIT
MODCARGO_CRATES +=	plotters	0.3.1	# MIT
MODCARGO_CRATES +=	plotters-backend	0.3.2	# MIT
MODCARGO_CRATES +=	plotters-svg	0.3.1	# MIT
MODCARGO_CRATES +=	portable-atomic	1.4.3	# Apache-2.0 OR MIT
MODCARGO_CRATES +=	proc-macro2	1.0.86	# MIT OR Apache-2.0
MODCARGO_CRATES +=	pyo3	0.22.2	# MIT OR Apache-2.0
MODCARGO_CRATES +=	pyo3-build-config	0.22.2	# MIT OR Apache-2.0
MODCARGO_CRATES +=	pyo3-ffi	0.22.2	# MIT OR Apache-2.0
MODCARGO_CRATES +=	pyo3-macros	0.22.2	# MIT OR Apache-2.0
MODCARGO_CRATES +=	pyo3-macros-backend	0.22.2	# MIT OR Apache-2.0
MODCARGO_CRATES +=	quote	1.0.37	# MIT OR Apache-2.0
MODCARGO_CRATES +=	rayon	1.10.0	# MIT OR Apache-2.0
MODCARGO_CRATES +=	rayon-core	1.12.1	# MIT OR Apache-2.0
MODCARGO_CRATES +=	regex	1.10.6	# MIT OR Apache-2.0
MODCARGO_CRATES +=	regex-automata	0.4.7	# MIT OR Apache-2.0
MODCARGO_CRATES +=	regex-syntax	0.8.4	# MIT OR Apache-2.0
MODCARGO_CRATES +=	rustix	0.38.19	# Apache-2.0 WITH LLVM-exception OR Apache-2.0 OR MIT
MODCARGO_CRATES +=	ryu	1.0.10	# Apache-2.0 OR BSL-1.0
MODCARGO_CRATES +=	same-file	1.0.6	# Unlicense/MIT
MODCARGO_CRATES +=	scopeguard	1.1.0	# MIT/Apache-2.0
MODCARGO_CRATES +=	serde	1.0.208	# MIT OR Apache-2.0
MODCARGO_CRATES +=	serde_derive	1.0.208	# MIT OR Apache-2.0
MODCARGO_CRATES +=	serde_json	1.0.125	# MIT OR Apache-2.0
MODCARGO_CRATES +=	serde_spanned	0.6.7	# MIT OR Apache-2.0
MODCARGO_CRATES +=	syn	1.0.109	# MIT OR Apache-2.0
MODCARGO_CRATES +=	syn	2.0.75	# MIT OR Apache-2.0
MODCARGO_CRATES +=	target-lexicon	0.12.15	# Apache-2.0 WITH LLVM-exception
MODCARGO_CRATES +=	termcolor	1.1.3	# Unlicense OR MIT
MODCARGO_CRATES +=	thiserror	1.0.63	# MIT OR Apache-2.0
MODCARGO_CRATES +=	thiserror-impl	1.0.63	# MIT OR Apache-2.0
MODCARGO_CRATES +=	tinytemplate	1.2.1	# Apache-2.0 OR MIT
MODCARGO_CRATES +=	toml	0.8.19	# MIT OR Apache-2.0
MODCARGO_CRATES +=	toml_datetime	0.6.8	# MIT OR Apache-2.0
MODCARGO_CRATES +=	toml_edit	0.22.20	# MIT OR Apache-2.0
MODCARGO_CRATES +=	trybuild	1.0.99	# MIT OR Apache-2.0
MODCARGO_CRATES +=	unicode-ident	1.0.1	# MIT OR Apache-2.0
MODCARGO_CRATES +=	unindent	0.2.3	# MIT OR Apache-2.0
MODCARGO_CRATES +=	walkdir	2.3.2	# Unlicense/MIT
MODCARGO_CRATES +=	wasm-bindgen	0.2.81	# MIT/Apache-2.0
MODCARGO_CRATES +=	wasm-bindgen-backend	0.2.81	# MIT/Apache-2.0
MODCARGO_CRATES +=	wasm-bindgen-macro	0.2.81	# MIT/Apache-2.0
MODCARGO_CRATES +=	wasm-bindgen-macro-support	0.2.81	# MIT/Apache-2.0
MODCARGO_CRATES +=	wasm-bindgen-shared	0.2.81	# MIT/Apache-2.0
MODCARGO_CRATES +=	web-sys	0.3.58	# MIT/Apache-2.0
MODCARGO_CRATES +=	winapi	0.3.9	# MIT/Apache-2.0
MODCARGO_CRATES +=	winapi-i686-pc-windows-gnu	0.4.0	# MIT/Apache-2.0
MODCARGO_CRATES +=	winapi-util	0.1.5	# Unlicense/MIT
MODCARGO_CRATES +=	winapi-x86_64-pc-windows-gnu	0.4.0	# MIT/Apache-2.0
MODCARGO_CRATES +=	windows-sys	0.48.0	# MIT OR Apache-2.0
MODCARGO_CRATES +=	windows-targets	0.48.5	# MIT OR Apache-2.0
MODCARGO_CRATES +=	windows_aarch64_gnullvm	0.48.5	# MIT OR Apache-2.0
MODCARGO_CRATES +=	windows_aarch64_msvc	0.48.5	# MIT OR Apache-2.0
MODCARGO_CRATES +=	windows_i686_gnu	0.48.5	# MIT OR Apache-2.0
MODCARGO_CRATES +=	windows_i686_msvc	0.48.5	# MIT OR Apache-2.0
MODCARGO_CRATES +=	windows_x86_64_gnu	0.48.5	# MIT OR Apache-2.0
MODCARGO_CRATES +=	windows_x86_64_gnullvm	0.48.5	# MIT OR Apache-2.0
MODCARGO_CRATES +=	windows_x86_64_msvc	0.48.5	# MIT OR Apache-2.0
MODCARGO_CRATES +=	winnow	0.6.18	# MIT
