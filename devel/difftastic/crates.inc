MODCARGO_CRATES +=	ahash	0.8.11	# MIT OR Apache-2.0
MODCARGO_CRATES +=	aho-corasick	1.1.3	# Unlicense OR MIT
MODCARGO_CRATES +=	allocator-api2	0.2.16	# MIT OR Apache-2.0
MODCARGO_CRATES +=	anstream	0.6.15	# MIT OR Apache-2.0
MODCARGO_CRATES +=	anstyle	1.0.10	# MIT OR Apache-2.0
MODCARGO_CRATES +=	anstyle-parse	0.2.6	# MIT OR Apache-2.0
MODCARGO_CRATES +=	anstyle-query	1.1.1	# MIT OR Apache-2.0
MODCARGO_CRATES +=	anstyle-wincon	3.0.4	# MIT OR Apache-2.0
MODCARGO_CRATES +=	assert_cmd	2.0.17	# MIT OR Apache-2.0
MODCARGO_CRATES +=	autocfg	1.1.0	# Apache-2.0 OR MIT
MODCARGO_CRATES +=	bitflags	1.3.2	# MIT/Apache-2.0
MODCARGO_CRATES +=	bitflags	2.5.0	# MIT OR Apache-2.0
MODCARGO_CRATES +=	bstr	1.9.1	# MIT OR Apache-2.0
MODCARGO_CRATES +=	bumpalo	3.16.0	# MIT OR Apache-2.0
MODCARGO_CRATES +=	cc	1.2.39	# MIT OR Apache-2.0
MODCARGO_CRATES +=	cfg-if	1.0.0	# MIT/Apache-2.0
MODCARGO_CRATES +=	clap	4.5.23	# MIT OR Apache-2.0
MODCARGO_CRATES +=	clap_builder	4.5.23	# MIT OR Apache-2.0
MODCARGO_CRATES +=	clap_lex	0.7.4	# MIT OR Apache-2.0
MODCARGO_CRATES +=	colorchoice	1.0.3	# MIT OR Apache-2.0
MODCARGO_CRATES +=	crossbeam-deque	0.8.5	# MIT OR Apache-2.0
MODCARGO_CRATES +=	crossbeam-epoch	0.9.18	# MIT OR Apache-2.0
MODCARGO_CRATES +=	crossbeam-utils	0.8.19	# MIT OR Apache-2.0
MODCARGO_CRATES +=	crossterm	0.28.1	# MIT
MODCARGO_CRATES +=	crossterm_winapi	0.9.1	# MIT
MODCARGO_CRATES +=	diff	0.1.13	# MIT OR Apache-2.0
MODCARGO_CRATES +=	difflib	0.4.0	# MIT
MODCARGO_CRATES +=	doc-comment	0.3.3	# MIT
MODCARGO_CRATES +=	either	1.10.0	# MIT OR Apache-2.0
MODCARGO_CRATES +=	encoding_rs	0.8.35	# (Apache-2.0 OR MIT) AND BSD-3-Clause
MODCARGO_CRATES +=	env_logger	0.10.2	# MIT OR Apache-2.0
MODCARGO_CRATES +=	equivalent	1.0.1	# Apache-2.0 OR MIT
MODCARGO_CRATES +=	errno	0.3.8	# MIT OR Apache-2.0
MODCARGO_CRATES +=	find-msvc-tools	0.1.2	# MIT OR Apache-2.0
MODCARGO_CRATES +=	fixedbitset	0.4.2	# MIT/Apache-2.0
MODCARGO_CRATES +=	float-cmp	0.10.0	# MIT
MODCARGO_CRATES +=	fnv	1.0.7	# Apache-2.0 / MIT
MODCARGO_CRATES +=	glob	0.3.1	# MIT OR Apache-2.0
MODCARGO_CRATES +=	globset	0.4.15	# Unlicense OR MIT
MODCARGO_CRATES +=	hashbrown	0.14.3	# MIT OR Apache-2.0
MODCARGO_CRATES +=	heck	0.5.0	# MIT OR Apache-2.0
MODCARGO_CRATES +=	hermit-abi	0.3.9	# MIT OR Apache-2.0
MODCARGO_CRATES +=	humansize	2.1.3	# MIT/Apache-2.0
MODCARGO_CRATES +=	humantime	2.1.0	# MIT/Apache-2.0
MODCARGO_CRATES +=	ignore	0.4.23	# Unlicense OR MIT
MODCARGO_CRATES +=	indexmap	2.2.6	# Apache-2.0 OR MIT
MODCARGO_CRATES +=	is-terminal	0.4.12	# MIT
MODCARGO_CRATES +=	is_terminal_polyfill	1.70.1	# MIT OR Apache-2.0
MODCARGO_CRATES +=	itoa	1.0.10	# MIT OR Apache-2.0
MODCARGO_CRATES +=	lazy_static	1.4.0	# MIT/Apache-2.0
MODCARGO_CRATES +=	libc	0.2.169	# MIT OR Apache-2.0
MODCARGO_CRATES +=	libm	0.2.8	# MIT OR Apache-2.0
MODCARGO_CRATES +=	line-numbers	0.3.0	# MIT
MODCARGO_CRATES +=	linux-raw-sys	0.4.14	# Apache-2.0 WITH LLVM-exception OR Apache-2.0 OR MIT
MODCARGO_CRATES +=	lock_api	0.4.11	# MIT OR Apache-2.0
MODCARGO_CRATES +=	log	0.4.21	# MIT OR Apache-2.0
MODCARGO_CRATES +=	memchr	2.7.1	# Unlicense OR MIT
MODCARGO_CRATES +=	minimal-lexical	0.2.1	# MIT/Apache-2.0
MODCARGO_CRATES +=	mio	1.0.3	# MIT
MODCARGO_CRATES +=	nom	7.1.3	# MIT
MODCARGO_CRATES +=	normalize-line-endings	0.3.0	# Apache-2.0
MODCARGO_CRATES +=	num-traits	0.2.19	# MIT OR Apache-2.0
MODCARGO_CRATES +=	once_cell	1.19.0	# MIT OR Apache-2.0
MODCARGO_CRATES +=	owo-colors	4.2.3	# MIT
MODCARGO_CRATES +=	parking_lot	0.12.1	# MIT OR Apache-2.0
MODCARGO_CRATES +=	parking_lot_core	0.9.9	# MIT OR Apache-2.0
MODCARGO_CRATES +=	petgraph	0.6.4	# MIT OR Apache-2.0
MODCARGO_CRATES +=	predicates	3.1.3	# MIT OR Apache-2.0
MODCARGO_CRATES +=	predicates-core	1.0.6	# MIT OR Apache-2.0
MODCARGO_CRATES +=	predicates-tree	1.0.9	# MIT OR Apache-2.0
MODCARGO_CRATES +=	pretty_assertions	1.4.1	# MIT OR Apache-2.0
MODCARGO_CRATES +=	pretty_env_logger	0.5.0	# MIT/Apache-2.0
MODCARGO_CRATES +=	proc-macro2	1.0.101	# MIT OR Apache-2.0
MODCARGO_CRATES +=	quote	1.0.35	# MIT OR Apache-2.0
MODCARGO_CRATES +=	radix-heap	0.4.2	# MIT
MODCARGO_CRATES +=	rayon	1.10.0	# MIT OR Apache-2.0
MODCARGO_CRATES +=	rayon-core	1.12.1	# MIT OR Apache-2.0
MODCARGO_CRATES +=	redox_syscall	0.4.1	# MIT
MODCARGO_CRATES +=	regex	1.11.1	# MIT OR Apache-2.0
MODCARGO_CRATES +=	regex-automata	0.4.9	# MIT OR Apache-2.0
MODCARGO_CRATES +=	regex-syntax	0.8.5	# MIT OR Apache-2.0
MODCARGO_CRATES +=	rustc-hash	2.0.0	# Apache-2.0/MIT
MODCARGO_CRATES +=	rustix	0.38.34	# Apache-2.0 WITH LLVM-exception OR Apache-2.0 OR MIT
MODCARGO_CRATES +=	rustversion	1.0.14	# MIT OR Apache-2.0
MODCARGO_CRATES +=	ryu	1.0.17	# Apache-2.0 OR BSL-1.0
MODCARGO_CRATES +=	same-file	1.0.6	# Unlicense/MIT
MODCARGO_CRATES +=	scopeguard	1.2.0	# MIT OR Apache-2.0
MODCARGO_CRATES +=	serde	1.0.228	# MIT OR Apache-2.0
MODCARGO_CRATES +=	serde_core	1.0.228	# MIT OR Apache-2.0
MODCARGO_CRATES +=	serde_derive	1.0.228	# MIT OR Apache-2.0
MODCARGO_CRATES +=	serde_json	1.0.145	# MIT OR Apache-2.0
MODCARGO_CRATES +=	shlex	1.3.0	# MIT OR Apache-2.0
MODCARGO_CRATES +=	signal-hook	0.3.17	# Apache-2.0/MIT
MODCARGO_CRATES +=	signal-hook-mio	0.2.4	# Apache-2.0/MIT
MODCARGO_CRATES +=	signal-hook-registry	1.4.1	# Apache-2.0/MIT
MODCARGO_CRATES +=	smallvec	1.13.2	# MIT OR Apache-2.0
MODCARGO_CRATES +=	streaming-iterator	0.1.9	# MIT OR Apache-2.0
MODCARGO_CRATES +=	strsim	0.11.1	# MIT
MODCARGO_CRATES +=	strum	0.26.3	# MIT
MODCARGO_CRATES +=	strum_macros	0.26.4	# MIT
MODCARGO_CRATES +=	syn	2.0.106	# MIT OR Apache-2.0
MODCARGO_CRATES +=	termcolor	1.4.1	# Unlicense OR MIT
MODCARGO_CRATES +=	terminal_size	0.4.1	# MIT OR Apache-2.0
MODCARGO_CRATES +=	termtree	0.4.1	# MIT
MODCARGO_CRATES +=	tikv-jemalloc-sys	0.6.0+5.3.0-1-ge13ca993e8ccb9ba9847cc330696e02839f328f7	# MIT/Apache-2.0
MODCARGO_CRATES +=	tikv-jemallocator	0.6.0	# MIT/Apache-2.0
MODCARGO_CRATES +=	tree-sitter	0.25.10	# MIT
MODCARGO_CRATES +=	tree-sitter-ada	0.1.0	# MIT
MODCARGO_CRATES +=	tree-sitter-bash	0.23.3	# MIT
MODCARGO_CRATES +=	tree-sitter-c	0.23.4	# MIT
MODCARGO_CRATES +=	tree-sitter-c-sharp	0.23.1	# MIT
MODCARGO_CRATES +=	tree-sitter-clojure-orchard	0.2.0	# MIT
MODCARGO_CRATES +=	tree-sitter-cmake	0.7.1	# MIT
MODCARGO_CRATES +=	tree-sitter-cpp	0.23.4	# MIT
MODCARGO_CRATES +=	tree-sitter-css	0.23.1	# MIT
MODCARGO_CRATES +=	tree-sitter-dart-orchard	0.2.1	# MIT
MODCARGO_CRATES +=	tree-sitter-devicetree	0.14.1	# MIT
MODCARGO_CRATES +=	tree-sitter-elisp	1.6.1	# MIT
MODCARGO_CRATES +=	tree-sitter-elixir	0.3.4	# Apache-2.0
MODCARGO_CRATES +=	tree-sitter-elm	5.8.0	# MIT
MODCARGO_CRATES +=	tree-sitter-erlang	0.13.0	# MIT
MODCARGO_CRATES +=	tree-sitter-fsharp	0.1.0	# MIT
MODCARGO_CRATES +=	tree-sitter-gleam	1.0.0	# Apache-2.0
MODCARGO_CRATES +=	tree-sitter-go	0.23.4	# MIT
MODCARGO_CRATES +=	tree-sitter-haskell	0.23.1	# MIT
MODCARGO_CRATES +=	tree-sitter-hcl	1.1.0	# Apache-2.0
MODCARGO_CRATES +=	tree-sitter-html	0.23.2	# MIT
MODCARGO_CRATES +=	tree-sitter-java	0.23.4	# MIT
MODCARGO_CRATES +=	tree-sitter-javascript	0.23.1	# MIT
MODCARGO_CRATES +=	tree-sitter-json	0.24.8	# MIT
MODCARGO_CRATES +=	tree-sitter-julia	0.23.1	# MIT
MODCARGO_CRATES +=	tree-sitter-language	0.1.3	# MIT
MODCARGO_CRATES +=	tree-sitter-lua	0.2.0	# MIT
MODCARGO_CRATES +=	tree-sitter-make	1.1.1	# MIT
MODCARGO_CRATES +=	tree-sitter-newick	1.1.0	# LICENSE.txt
MODCARGO_CRATES +=	tree-sitter-nix	0.0.2	# MIT
MODCARGO_CRATES +=	tree-sitter-objc	3.0.2	# MIT
MODCARGO_CRATES +=	tree-sitter-ocaml	0.23.2	# MIT
MODCARGO_CRATES +=	tree-sitter-pascal	0.10.0	# MIT
MODCARGO_CRATES +=	tree-sitter-php	0.23.11	# MIT
MODCARGO_CRATES +=	tree-sitter-proto	0.2.0	# MIT
MODCARGO_CRATES +=	tree-sitter-python	0.23.5	# MIT
MODCARGO_CRATES +=	tree-sitter-qmljs	0.3.0	# MIT
MODCARGO_CRATES +=	tree-sitter-r	1.2.0	# MIT
MODCARGO_CRATES +=	tree-sitter-racket	0.24.7	# MIT
MODCARGO_CRATES +=	tree-sitter-ruby	0.23.1	# MIT
MODCARGO_CRATES +=	tree-sitter-rust-orchard	0.13.0	# MIT
MODCARGO_CRATES +=	tree-sitter-scala	0.23.3	# MIT
MODCARGO_CRATES +=	tree-sitter-scheme	0.24.7	# MIT
MODCARGO_CRATES +=	tree-sitter-sequel	0.3.11	# MIT
MODCARGO_CRATES +=	tree-sitter-sfapex	2.4.0	# MIT
MODCARGO_CRATES +=	tree-sitter-solidity	1.2.13	# MIT
MODCARGO_CRATES +=	tree-sitter-swift	0.7.0	# MIT
MODCARGO_CRATES +=	tree-sitter-toml-ng	0.7.0	# MIT
MODCARGO_CRATES +=	tree-sitter-typescript	0.23.2	# MIT
MODCARGO_CRATES +=	tree-sitter-verilog	1.0.3	# MIT
MODCARGO_CRATES +=	tree-sitter-xml	0.7.0	# MIT
MODCARGO_CRATES +=	tree-sitter-yaml	0.7.0	# MIT
MODCARGO_CRATES +=	tree-sitter-zig	1.1.2	# MIT
MODCARGO_CRATES +=	tree_magic_mini	3.1.6	# MIT
MODCARGO_CRATES +=	typed-arena	2.0.2	# MIT
MODCARGO_CRATES +=	unicode-ident	1.0.12	# (MIT OR Apache-2.0) AND Unicode-DFS-2016
MODCARGO_CRATES +=	unicode-width	0.1.11	# MIT/Apache-2.0
MODCARGO_CRATES +=	utf8parse	0.2.2	# Apache-2.0 OR MIT
MODCARGO_CRATES +=	version_check	0.9.4	# MIT/Apache-2.0
MODCARGO_CRATES +=	wait-timeout	0.2.0	# MIT/Apache-2.0
MODCARGO_CRATES +=	walkdir	2.5.0	# Unlicense/MIT
MODCARGO_CRATES +=	wasi	0.11.0+wasi-snapshot-preview1	# Apache-2.0 WITH LLVM-exception OR Apache-2.0 OR MIT
MODCARGO_CRATES +=	winapi	0.3.9	# MIT/Apache-2.0
MODCARGO_CRATES +=	winapi-i686-pc-windows-gnu	0.4.0	# MIT/Apache-2.0
MODCARGO_CRATES +=	winapi-util	0.1.9	# Unlicense OR MIT
MODCARGO_CRATES +=	winapi-x86_64-pc-windows-gnu	0.4.0	# MIT/Apache-2.0
MODCARGO_CRATES +=	windows-sys	0.52.0	# MIT OR Apache-2.0
MODCARGO_CRATES +=	windows-sys	0.59.0	# MIT OR Apache-2.0
MODCARGO_CRATES +=	windows-targets	0.48.5	# MIT OR Apache-2.0
MODCARGO_CRATES +=	windows-targets	0.52.6	# MIT OR Apache-2.0
MODCARGO_CRATES +=	windows_aarch64_gnullvm	0.48.5	# MIT OR Apache-2.0
MODCARGO_CRATES +=	windows_aarch64_gnullvm	0.52.6	# MIT OR Apache-2.0
MODCARGO_CRATES +=	windows_aarch64_msvc	0.48.5	# MIT OR Apache-2.0
MODCARGO_CRATES +=	windows_aarch64_msvc	0.52.6	# MIT OR Apache-2.0
MODCARGO_CRATES +=	windows_i686_gnu	0.48.5	# MIT OR Apache-2.0
MODCARGO_CRATES +=	windows_i686_gnu	0.52.6	# MIT OR Apache-2.0
MODCARGO_CRATES +=	windows_i686_gnullvm	0.52.6	# MIT OR Apache-2.0
MODCARGO_CRATES +=	windows_i686_msvc	0.48.5	# MIT OR Apache-2.0
MODCARGO_CRATES +=	windows_i686_msvc	0.52.6	# MIT OR Apache-2.0
MODCARGO_CRATES +=	windows_x86_64_gnu	0.48.5	# MIT OR Apache-2.0
MODCARGO_CRATES +=	windows_x86_64_gnu	0.52.6	# MIT OR Apache-2.0
MODCARGO_CRATES +=	windows_x86_64_gnullvm	0.48.5	# MIT OR Apache-2.0
MODCARGO_CRATES +=	windows_x86_64_gnullvm	0.52.6	# MIT OR Apache-2.0
MODCARGO_CRATES +=	windows_x86_64_msvc	0.48.5	# MIT OR Apache-2.0
MODCARGO_CRATES +=	windows_x86_64_msvc	0.52.6	# MIT OR Apache-2.0
MODCARGO_CRATES +=	wu-diff	0.1.2	# MIT
MODCARGO_CRATES +=	yansi	1.0.1	# MIT OR Apache-2.0
MODCARGO_CRATES +=	zerocopy	0.7.32	# BSD-2-Clause OR Apache-2.0 OR MIT
MODCARGO_CRATES +=	zerocopy-derive	0.7.32	# BSD-2-Clause OR Apache-2.0 OR MIT
