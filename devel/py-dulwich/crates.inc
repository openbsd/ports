MODCARGO_CRATES +=	autocfg	1.5.0	# Apache-2.0 OR MIT
MODCARGO_CRATES +=	heck	0.5.0	# MIT OR Apache-2.0
MODCARGO_CRATES +=	indoc	2.0.6	# MIT OR Apache-2.0
MODCARGO_CRATES +=	libc	0.2.174	# MIT OR Apache-2.0
MODCARGO_CRATES +=	memchr	2.7.5	# Unlicense OR MIT
MODCARGO_CRATES +=	memoffset	0.9.1	# MIT
MODCARGO_CRATES +=	once_cell	1.21.3	# MIT OR Apache-2.0
MODCARGO_CRATES +=	portable-atomic	1.11.1	# Apache-2.0 OR MIT
MODCARGO_CRATES +=	proc-macro2	1.0.95	# MIT OR Apache-2.0
MODCARGO_CRATES +=	pyo3	0.25.1	# MIT OR Apache-2.0
MODCARGO_CRATES +=	pyo3-build-config	0.25.1	# MIT OR Apache-2.0
MODCARGO_CRATES +=	pyo3-ffi	0.25.1	# MIT OR Apache-2.0
MODCARGO_CRATES +=	pyo3-macros	0.25.1	# MIT OR Apache-2.0
MODCARGO_CRATES +=	pyo3-macros-backend	0.25.1	# MIT OR Apache-2.0
MODCARGO_CRATES +=	quote	1.0.40	# MIT OR Apache-2.0
MODCARGO_CRATES +=	syn	2.0.104	# MIT OR Apache-2.0
MODCARGO_CRATES +=	target-lexicon	0.13.2	# Apache-2.0 WITH LLVM-exception
MODCARGO_CRATES +=	unicode-ident	1.0.18	# (MIT OR Apache-2.0) AND Unicode-3.0
MODCARGO_CRATES +=	unindent	0.2.4	# MIT OR Apache-2.0
