MODCARGO_CRATES +=	addr2line	0.25.1	# Apache-2.0 OR MIT
MODCARGO_CRATES +=	adler2	2.0.1	# 0BSD OR MIT OR Apache-2.0
MODCARGO_CRATES +=	aho-corasick	1.1.4	# Unlicense OR MIT
MODCARGO_CRATES +=	allocator-api2	0.2.21	# MIT OR Apache-2.0
MODCARGO_CRATES +=	anes	0.1.6	# MIT OR Apache-2.0
MODCARGO_CRATES +=	anstyle	1.0.14	# MIT OR Apache-2.0
MODCARGO_CRATES +=	anyhow	1.0.102	# MIT OR Apache-2.0
MODCARGO_CRATES +=	arbitrary	1.4.2	# MIT OR Apache-2.0
MODCARGO_CRATES +=	arrayvec	0.7.6	# MIT OR Apache-2.0
MODCARGO_CRATES +=	autocfg	1.5.1	# Apache-2.0 OR MIT
MODCARGO_CRATES +=	backtrace	0.3.76	# MIT OR Apache-2.0
MODCARGO_CRATES +=	base64	0.22.1	# MIT OR Apache-2.0
MODCARGO_CRATES +=	bit-set	0.8.0	# Apache-2.0 OR MIT
MODCARGO_CRATES +=	bit-vec	0.8.0	# Apache-2.0 OR MIT
MODCARGO_CRATES +=	bitflags	2.12.1	# MIT OR Apache-2.0
MODCARGO_CRATES +=	block2	0.6.2	# MIT
MODCARGO_CRATES +=	borsh	1.6.1	# MIT OR Apache-2.0
MODCARGO_CRATES +=	boxcar	0.2.14	# MIT
MODCARGO_CRATES +=	bumpalo	3.20.3	# MIT OR Apache-2.0
MODCARGO_CRATES +=	bytes	1.11.1	# MIT
MODCARGO_CRATES +=	camino	1.2.2	# MIT OR Apache-2.0
MODCARGO_CRATES +=	cargo-platform	0.3.3	# MIT OR Apache-2.0
MODCARGO_CRATES +=	cargo_metadata	0.23.1	# MIT
MODCARGO_CRATES +=	cast	0.3.0	# MIT OR Apache-2.0
MODCARGO_CRATES +=	cc	1.2.63	# MIT OR Apache-2.0
MODCARGO_CRATES +=	cfg-if	1.0.4	# MIT OR Apache-2.0
MODCARGO_CRATES +=	cfg_aliases	0.2.1	# MIT
MODCARGO_CRATES +=	ciborium	0.2.2	# Apache-2.0
MODCARGO_CRATES +=	ciborium-io	0.2.2	# Apache-2.0
MODCARGO_CRATES +=	ciborium-ll	0.2.2	# Apache-2.0
MODCARGO_CRATES +=	clap	4.6.1	# MIT OR Apache-2.0
MODCARGO_CRATES +=	clap_builder	4.6.0	# MIT OR Apache-2.0
MODCARGO_CRATES +=	clap_lex	1.1.0	# MIT OR Apache-2.0
MODCARGO_CRATES +=	cobs	0.3.0	# MIT OR Apache-2.0
MODCARGO_CRATES +=	countme	3.0.1	# MIT OR Apache-2.0
MODCARGO_CRATES +=	cov-mark	2.2.0	# MIT OR Apache-2.0
MODCARGO_CRATES +=	crc32fast	1.5.0	# MIT OR Apache-2.0
MODCARGO_CRATES +=	criterion	0.7.0	# Apache-2.0 OR MIT
MODCARGO_CRATES +=	criterion-plot	0.6.0	# MIT OR Apache-2.0
MODCARGO_CRATES +=	crossbeam-channel	0.5.15	# MIT OR Apache-2.0
MODCARGO_CRATES +=	crossbeam-deque	0.8.6	# MIT OR Apache-2.0
MODCARGO_CRATES +=	crossbeam-epoch	0.9.18	# MIT OR Apache-2.0
MODCARGO_CRATES +=	crossbeam-queue	0.3.12	# MIT OR Apache-2.0
MODCARGO_CRATES +=	crossbeam-utils	0.8.21	# MIT OR Apache-2.0
MODCARGO_CRATES +=	crunchy	0.2.4	# MIT
MODCARGO_CRATES +=	ctrlc	3.5.2	# MIT/Apache-2.0
MODCARGO_CRATES +=	dashmap	6.2.1	# MIT
MODCARGO_CRATES +=	deranged	0.5.8	# MIT OR Apache-2.0
MODCARGO_CRATES +=	derive-where	1.6.1	# MIT OR Apache-2.0
MODCARGO_CRATES +=	derive_arbitrary	1.4.2	# MIT OR Apache-2.0
MODCARGO_CRATES +=	dhat	0.3.3	# MIT OR Apache-2.0
MODCARGO_CRATES +=	dirs	6.0.0	# MIT OR Apache-2.0
MODCARGO_CRATES +=	dirs-sys	0.5.0	# MIT OR Apache-2.0
MODCARGO_CRATES +=	dispatch2	0.3.1	# Zlib OR Apache-2.0 OR MIT
MODCARGO_CRATES +=	displaydoc	0.2.6	# MIT OR Apache-2.0
MODCARGO_CRATES +=	dissimilar	1.0.11	# Apache-2.0
MODCARGO_CRATES +=	dot	0.1.4	# MIT/Apache-2.0
MODCARGO_CRATES +=	drop_bomb	0.1.5	# MIT OR Apache-2.0
MODCARGO_CRATES +=	either	1.16.0	# MIT OR Apache-2.0
MODCARGO_CRATES +=	embedded-io	0.4.0	# MIT OR Apache-2.0
MODCARGO_CRATES +=	embedded-io	0.6.1	# MIT OR Apache-2.0
MODCARGO_CRATES +=	ena	0.14.4	# MIT OR Apache-2.0
MODCARGO_CRATES +=	equivalent	1.0.2	# Apache-2.0 OR MIT
MODCARGO_CRATES +=	errno	0.3.14	# MIT OR Apache-2.0
MODCARGO_CRATES +=	expect-test	1.5.1	# MIT OR Apache-2.0
MODCARGO_CRATES +=	fastrand	2.4.1	# Apache-2.0 OR MIT
MODCARGO_CRATES +=	find-msvc-tools	0.1.9	# MIT OR Apache-2.0
MODCARGO_CRATES +=	fixedbitset	0.5.7	# MIT OR Apache-2.0
MODCARGO_CRATES +=	flate2	1.1.9	# MIT OR Apache-2.0
MODCARGO_CRATES +=	fnv	1.0.7	# Apache-2.0 / MIT
MODCARGO_CRATES +=	foldhash	0.1.5	# Zlib
MODCARGO_CRATES +=	foldhash	0.2.0	# Zlib
MODCARGO_CRATES +=	form_urlencoded	1.2.2	# MIT OR Apache-2.0
MODCARGO_CRATES +=	fsevent-sys	4.1.0	# MIT
MODCARGO_CRATES +=	fst	0.4.7	# Unlicense/MIT
MODCARGO_CRATES +=	futures-core	0.3.32	# MIT OR Apache-2.0
MODCARGO_CRATES +=	futures-task	0.3.32	# MIT OR Apache-2.0
MODCARGO_CRATES +=	futures-util	0.3.32	# MIT OR Apache-2.0
MODCARGO_CRATES +=	gen-lsp-types	0.10.0	# MIT
MODCARGO_CRATES +=	getrandom	0.2.17	# MIT OR Apache-2.0
MODCARGO_CRATES +=	getrandom	0.3.4	# MIT OR Apache-2.0
MODCARGO_CRATES +=	getrandom	0.4.2	# MIT OR Apache-2.0
MODCARGO_CRATES +=	gimli	0.32.3	# MIT OR Apache-2.0
MODCARGO_CRATES +=	half	2.7.1	# MIT OR Apache-2.0
MODCARGO_CRATES +=	hashbrown	0.14.5	# MIT OR Apache-2.0
MODCARGO_CRATES +=	hashbrown	0.15.5	# MIT OR Apache-2.0
MODCARGO_CRATES +=	hashbrown	0.17.1	# MIT OR Apache-2.0
MODCARGO_CRATES +=	hashlink	0.12.0	# MIT OR Apache-2.0
MODCARGO_CRATES +=	heck	0.5.0	# MIT OR Apache-2.0
MODCARGO_CRATES +=	hermit-abi	0.5.2	# MIT OR Apache-2.0
MODCARGO_CRATES +=	icu_collections	2.2.0	# Unicode-3.0
MODCARGO_CRATES +=	icu_locale_core	2.2.0	# Unicode-3.0
MODCARGO_CRATES +=	icu_normalizer	2.2.0	# Unicode-3.0
MODCARGO_CRATES +=	icu_normalizer_data	2.2.0	# Unicode-3.0
MODCARGO_CRATES +=	icu_properties	2.2.0	# Unicode-3.0
MODCARGO_CRATES +=	icu_properties_data	2.2.0	# Unicode-3.0
MODCARGO_CRATES +=	icu_provider	2.2.0	# Unicode-3.0
MODCARGO_CRATES +=	id-arena	2.3.0	# MIT/Apache-2.0
MODCARGO_CRATES +=	idna	1.1.0	# MIT OR Apache-2.0
MODCARGO_CRATES +=	idna_adapter	1.2.2	# Apache-2.0 OR MIT
MODCARGO_CRATES +=	indexmap	2.14.0	# Apache-2.0 OR MIT
MODCARGO_CRATES +=	inotify	0.11.2	# ISC
MODCARGO_CRATES +=	inotify-sys	0.1.5	# ISC
MODCARGO_CRATES +=	intrusive-collections	0.10.1	# Apache-2.0/MIT
MODCARGO_CRATES +=	inventory	0.3.24	# MIT OR Apache-2.0
MODCARGO_CRATES +=	itertools	0.13.0	# MIT OR Apache-2.0
MODCARGO_CRATES +=	itertools	0.15.0	# MIT OR Apache-2.0
MODCARGO_CRATES +=	itoa	1.0.18	# MIT OR Apache-2.0
MODCARGO_CRATES +=	jod-thread	1.0.0	# MIT OR Apache-2.0
MODCARGO_CRATES +=	js-sys	0.3.99	# MIT OR Apache-2.0
MODCARGO_CRATES +=	kqueue	1.2.0	# MIT
MODCARGO_CRATES +=	kqueue-sys	1.1.2	# MIT
MODCARGO_CRATES +=	la-arena	0.3.1	# MIT OR Apache-2.0
MODCARGO_CRATES +=	lazy_static	1.5.0	# MIT OR Apache-2.0
MODCARGO_CRATES +=	leb128fmt	0.1.0	# MIT OR Apache-2.0
MODCARGO_CRATES +=	libc	0.2.186	# MIT OR Apache-2.0
MODCARGO_CRATES +=	libmimalloc-sys	0.1.49	# MIT
MODCARGO_CRATES +=	libredox	0.1.17	# MIT
MODCARGO_CRATES +=	line-index	0.1.2	# MIT OR Apache-2.0
MODCARGO_CRATES +=	linux-raw-sys	0.12.1	# Apache-2.0 WITH LLVM-exception OR Apache-2.0 OR MIT
MODCARGO_CRATES +=	litemap	0.8.2	# Unicode-3.0
MODCARGO_CRATES +=	lock_api	0.4.14	# MIT OR Apache-2.0
MODCARGO_CRATES +=	log	0.4.31	# MIT OR Apache-2.0
MODCARGO_CRATES +=	lsp-server	0.7.9	# MIT OR Apache-2.0
MODCARGO_CRATES +=	memchr	2.8.1	# Unlicense OR MIT
MODCARGO_CRATES +=	memoffset	0.9.1	# MIT
MODCARGO_CRATES +=	mimalloc	0.1.52	# MIT
MODCARGO_CRATES +=	miniz_oxide	0.8.9	# MIT OR Zlib OR Apache-2.0
MODCARGO_CRATES +=	mintex	0.1.4	# Apache-2.0
MODCARGO_CRATES +=	mio	1.2.1	# MIT
MODCARGO_CRATES +=	miow	0.6.1	# MIT OR Apache-2.0
MODCARGO_CRATES +=	nix	0.31.3	# MIT
MODCARGO_CRATES +=	nohash-hasher	0.2.0	# Apache-2.0 OR MIT
MODCARGO_CRATES +=	notify	8.2.0	# CC0-1.0
MODCARGO_CRATES +=	notify-types	2.1.0	# MIT OR Apache-2.0
MODCARGO_CRATES +=	nu-ansi-term	0.50.3	# MIT
MODCARGO_CRATES +=	num-conv	0.2.2	# MIT OR Apache-2.0
MODCARGO_CRATES +=	num-traits	0.2.19	# MIT OR Apache-2.0
MODCARGO_CRATES +=	num_cpus	1.17.0	# MIT OR Apache-2.0
MODCARGO_CRATES +=	num_threads	0.1.7	# MIT OR Apache-2.0
MODCARGO_CRATES +=	objc2	0.6.4	# MIT
MODCARGO_CRATES +=	objc2-encode	4.1.0	# MIT
MODCARGO_CRATES +=	object	0.37.3	# Apache-2.0 OR MIT
MODCARGO_CRATES +=	once_cell	1.21.4	# MIT OR Apache-2.0
MODCARGO_CRATES +=	oorandom	11.1.5	# MIT
MODCARGO_CRATES +=	option-ext	0.2.0	# MPL-2.0
MODCARGO_CRATES +=	parking_lot	0.12.5	# MIT OR Apache-2.0
MODCARGO_CRATES +=	parking_lot_core	0.9.12	# MIT OR Apache-2.0
MODCARGO_CRATES +=	paste	1.0.15	# MIT OR Apache-2.0
MODCARGO_CRATES +=	percent-encoding	2.3.2	# MIT OR Apache-2.0
MODCARGO_CRATES +=	perf-event	0.4.8	# MIT OR Apache-2.0
MODCARGO_CRATES +=	perf-event-open-sys	4.0.0	# MIT OR Apache-2.0
MODCARGO_CRATES +=	petgraph	0.8.3	# MIT OR Apache-2.0
MODCARGO_CRATES +=	pin-project-lite	0.2.17	# Apache-2.0 OR MIT
MODCARGO_CRATES +=	plotters	0.3.7	# MIT
MODCARGO_CRATES +=	plotters-backend	0.3.7	# MIT
MODCARGO_CRATES +=	plotters-svg	0.3.7	# MIT
MODCARGO_CRATES +=	portable-atomic	1.13.1	# Apache-2.0 OR MIT
MODCARGO_CRATES +=	postcard	1.1.3	# MIT OR Apache-2.0
MODCARGO_CRATES +=	potential_utf	0.1.5	# Unicode-3.0
MODCARGO_CRATES +=	powerfmt	0.2.0	# MIT OR Apache-2.0
MODCARGO_CRATES +=	ppv-lite86	0.2.21	# MIT OR Apache-2.0
MODCARGO_CRATES +=	prettyplease	0.2.37	# MIT OR Apache-2.0
MODCARGO_CRATES +=	proc-macro2	1.0.106	# MIT OR Apache-2.0
MODCARGO_CRATES +=	process-wrap	9.1.0	# Apache-2.0 OR MIT
MODCARGO_CRATES +=	proptest	1.11.0	# MIT OR Apache-2.0
MODCARGO_CRATES +=	protobuf	3.7.2	# MIT
MODCARGO_CRATES +=	protobuf-support	3.7.2	# MIT
MODCARGO_CRATES +=	pulldown-cmark	0.9.6	# MIT
MODCARGO_CRATES +=	pulldown-cmark-to-cmark	10.0.4	# Apache-2.0
MODCARGO_CRATES +=	quick-error	1.2.3	# MIT/Apache-2.0
MODCARGO_CRATES +=	quote	1.0.45	# MIT OR Apache-2.0
MODCARGO_CRATES +=	r-efi	5.3.0	# MIT OR Apache-2.0 OR LGPL-2.1-or-later
MODCARGO_CRATES +=	r-efi	6.0.0	# MIT OR Apache-2.0 OR LGPL-2.1-or-later
MODCARGO_CRATES +=	ra-ap-rustc_abi	0.165.0	# MIT / Apache-2.0
MODCARGO_CRATES +=	ra-ap-rustc_ast_ir	0.165.0	# MIT / Apache-2.0
MODCARGO_CRATES +=	ra-ap-rustc_hashes	0.165.0	# MIT / Apache-2.0
MODCARGO_CRATES +=	ra-ap-rustc_index	0.165.0	# MIT / Apache-2.0
MODCARGO_CRATES +=	ra-ap-rustc_index_macros	0.165.0	# MIT / Apache-2.0
MODCARGO_CRATES +=	ra-ap-rustc_lexer	0.165.0	# MIT / Apache-2.0
MODCARGO_CRATES +=	ra-ap-rustc_next_trait_solver	0.165.0	# MIT / Apache-2.0
MODCARGO_CRATES +=	ra-ap-rustc_parse_format	0.165.0	# MIT / Apache-2.0
MODCARGO_CRATES +=	ra-ap-rustc_pattern_analysis	0.165.0	# MIT / Apache-2.0
MODCARGO_CRATES +=	ra-ap-rustc_type_ir	0.165.0	# MIT / Apache-2.0
MODCARGO_CRATES +=	ra-ap-rustc_type_ir_macros	0.165.0	# MIT / Apache-2.0
MODCARGO_CRATES +=	rand	0.9.4	# MIT OR Apache-2.0
MODCARGO_CRATES +=	rand_chacha	0.9.0	# MIT OR Apache-2.0
MODCARGO_CRATES +=	rand_core	0.9.5	# MIT OR Apache-2.0
MODCARGO_CRATES +=	rand_xorshift	0.4.0	# MIT OR Apache-2.0
MODCARGO_CRATES +=	rayon	1.12.0	# MIT OR Apache-2.0
MODCARGO_CRATES +=	rayon-core	1.13.0	# MIT OR Apache-2.0
MODCARGO_CRATES +=	redox_syscall	0.5.18	# MIT
MODCARGO_CRATES +=	redox_users	0.5.2	# MIT
MODCARGO_CRATES +=	regex	1.12.3	# MIT OR Apache-2.0
MODCARGO_CRATES +=	regex-automata	0.4.14	# MIT OR Apache-2.0
MODCARGO_CRATES +=	regex-syntax	0.8.10	# MIT OR Apache-2.0
MODCARGO_CRATES +=	rowan	0.15.19	# MIT OR Apache-2.0
MODCARGO_CRATES +=	rustc-demangle	0.1.27	# MIT/Apache-2.0
MODCARGO_CRATES +=	rustc-hash	1.1.0	# Apache-2.0/MIT
MODCARGO_CRATES +=	rustc-hash	2.1.2	# Apache-2.0 OR MIT
MODCARGO_CRATES +=	rustc-literal-escaper	0.0.7	# Apache-2.0 OR MIT
MODCARGO_CRATES +=	rustc-stable-hash	0.1.2	# Apache-2.0 OR MIT
MODCARGO_CRATES +=	rustc_apfloat	0.2.3+llvm-462a31f5a5ab	# Apache-2.0 WITH LLVM-exception
MODCARGO_CRATES +=	rustix	1.1.4	# Apache-2.0 WITH LLVM-exception OR Apache-2.0 OR MIT
MODCARGO_CRATES +=	rustversion	1.0.22	# MIT OR Apache-2.0
MODCARGO_CRATES +=	rusty-fork	0.3.1	# MIT/Apache-2.0
MODCARGO_CRATES +=	salsa	0.27.2	# Apache-2.0 OR MIT
MODCARGO_CRATES +=	salsa-macro-rules	0.27.2	# Apache-2.0 OR MIT
MODCARGO_CRATES +=	salsa-macros	0.27.2	# Apache-2.0 OR MIT
MODCARGO_CRATES +=	same-file	1.0.6	# Unlicense/MIT
MODCARGO_CRATES +=	scip	0.7.1	# Apache-2.0
MODCARGO_CRATES +=	scopeguard	1.2.0	# MIT OR Apache-2.0
MODCARGO_CRATES +=	semver	1.0.28	# MIT OR Apache-2.0
MODCARGO_CRATES +=	serde	1.0.228	# MIT OR Apache-2.0
MODCARGO_CRATES +=	serde_core	1.0.228	# MIT OR Apache-2.0
MODCARGO_CRATES +=	serde_derive	1.0.228	# MIT OR Apache-2.0
MODCARGO_CRATES +=	serde_json	1.0.150	# MIT OR Apache-2.0
MODCARGO_CRATES +=	serde_spanned	1.1.1	# MIT OR Apache-2.0
MODCARGO_CRATES +=	serde_test	1.0.177	# MIT OR Apache-2.0
MODCARGO_CRATES +=	sharded-slab	0.1.7	# MIT
MODCARGO_CRATES +=	shlex	2.0.1	# MIT OR Apache-2.0
MODCARGO_CRATES +=	simd-adler32	0.3.9	# MIT
MODCARGO_CRATES +=	slab	0.4.12	# MIT
MODCARGO_CRATES +=	smallvec	1.15.1	# MIT OR Apache-2.0
MODCARGO_CRATES +=	smol_str	0.3.6	# MIT OR Apache-2.0
MODCARGO_CRATES +=	stable_deref_trait	1.2.1	# MIT OR Apache-2.0
MODCARGO_CRATES +=	static_assertions	1.1.0	# MIT OR Apache-2.0
MODCARGO_CRATES +=	syn	2.0.117	# MIT OR Apache-2.0
MODCARGO_CRATES +=	synstructure	0.13.2	# MIT
MODCARGO_CRATES +=	temp-dir	0.2.0	# Apache-2.0
MODCARGO_CRATES +=	tempfile	3.27.0	# MIT OR Apache-2.0
MODCARGO_CRATES +=	tenthash	1.1.0	# MIT OR Apache-2.0
MODCARGO_CRATES +=	text-size	1.1.1	# MIT OR Apache-2.0
MODCARGO_CRATES +=	thin-vec	0.2.18	# MIT OR Apache-2.0
MODCARGO_CRATES +=	thiserror	1.0.69	# MIT OR Apache-2.0
MODCARGO_CRATES +=	thiserror	2.0.18	# MIT OR Apache-2.0
MODCARGO_CRATES +=	thiserror-impl	1.0.69	# MIT OR Apache-2.0
MODCARGO_CRATES +=	thiserror-impl	2.0.18	# MIT OR Apache-2.0
MODCARGO_CRATES +=	thousands	0.2.0	# MIT/Apache-2.0
MODCARGO_CRATES +=	thread_local	1.1.9	# MIT OR Apache-2.0
MODCARGO_CRATES +=	tikv-jemalloc-ctl	0.5.4	# MIT/Apache-2.0
MODCARGO_CRATES +=	tikv-jemalloc-sys	0.5.4+5.3.0-patched	# MIT/Apache-2.0
MODCARGO_CRATES +=	tikv-jemallocator	0.5.4	# MIT/Apache-2.0
MODCARGO_CRATES +=	time	0.3.47	# MIT OR Apache-2.0
MODCARGO_CRATES +=	time-core	0.1.8	# MIT OR Apache-2.0
MODCARGO_CRATES +=	time-macros	0.2.27	# MIT OR Apache-2.0
MODCARGO_CRATES +=	tinystr	0.8.3	# Unicode-3.0
MODCARGO_CRATES +=	tinytemplate	1.2.1	# Apache-2.0 OR MIT
MODCARGO_CRATES +=	toml	1.1.2+spec-1.1.0	# MIT OR Apache-2.0
MODCARGO_CRATES +=	toml_datetime	1.1.1+spec-1.1.0	# MIT OR Apache-2.0
MODCARGO_CRATES +=	toml_parser	1.1.2+spec-1.1.0	# MIT OR Apache-2.0
MODCARGO_CRATES +=	toml_writer	1.1.1+spec-1.1.0	# MIT OR Apache-2.0
MODCARGO_CRATES +=	tracing	0.1.44	# MIT
MODCARGO_CRATES +=	tracing-attributes	0.1.31	# MIT
MODCARGO_CRATES +=	tracing-core	0.1.36	# MIT
MODCARGO_CRATES +=	tracing-log	0.2.0	# MIT
MODCARGO_CRATES +=	tracing-subscriber	0.3.23	# MIT
MODCARGO_CRATES +=	tracing-tree	0.4.1	# MIT OR Apache-2.0
MODCARGO_CRATES +=	triomphe	0.1.15	# MIT OR Apache-2.0
MODCARGO_CRATES +=	typed-arena	2.0.2	# MIT
MODCARGO_CRATES +=	typeid	1.0.3	# MIT OR Apache-2.0
MODCARGO_CRATES +=	unarray	0.1.4	# MIT OR Apache-2.0
MODCARGO_CRATES +=	ungrammar	1.16.1	# MIT OR Apache-2.0
MODCARGO_CRATES +=	unicase	2.9.0	# MIT OR Apache-2.0
MODCARGO_CRATES +=	unicode-ident	1.0.24	# (MIT OR Apache-2.0) AND Unicode-3.0
MODCARGO_CRATES +=	unicode-properties	0.1.4	# MIT/Apache-2.0
MODCARGO_CRATES +=	unicode-xid	0.2.6	# MIT OR Apache-2.0
MODCARGO_CRATES +=	url	2.5.8	# MIT OR Apache-2.0
MODCARGO_CRATES +=	utf8_iter	1.0.4	# Apache-2.0 OR MIT
MODCARGO_CRATES +=	valuable	0.1.1	# MIT
MODCARGO_CRATES +=	wait-timeout	0.2.1	# MIT/Apache-2.0
MODCARGO_CRATES +=	walkdir	2.5.0	# Unlicense/MIT
MODCARGO_CRATES +=	wasi	0.11.1+wasi-snapshot-preview1	# Apache-2.0 WITH LLVM-exception OR Apache-2.0 OR MIT
MODCARGO_CRATES +=	wasip2	1.0.3+wasi-0.2.9	# Apache-2.0 WITH LLVM-exception OR Apache-2.0 OR MIT
MODCARGO_CRATES +=	wasip3	0.4.0+wasi-0.3.0-rc-2026-01-06	# Apache-2.0 WITH LLVM-exception OR Apache-2.0 OR MIT
MODCARGO_CRATES +=	wasm-bindgen	0.2.122	# MIT OR Apache-2.0
MODCARGO_CRATES +=	wasm-bindgen-macro	0.2.122	# MIT OR Apache-2.0
MODCARGO_CRATES +=	wasm-bindgen-macro-support	0.2.122	# MIT OR Apache-2.0
MODCARGO_CRATES +=	wasm-bindgen-shared	0.2.122	# MIT OR Apache-2.0
MODCARGO_CRATES +=	wasm-encoder	0.244.0	# Apache-2.0 WITH LLVM-exception OR Apache-2.0 OR MIT
MODCARGO_CRATES +=	wasm-metadata	0.244.0	# Apache-2.0 WITH LLVM-exception OR Apache-2.0 OR MIT
MODCARGO_CRATES +=	wasmparser	0.244.0	# Apache-2.0 WITH LLVM-exception OR Apache-2.0 OR MIT
MODCARGO_CRATES +=	web-sys	0.3.99	# MIT OR Apache-2.0
MODCARGO_CRATES +=	winapi-util	0.1.11	# Unlicense OR MIT
MODCARGO_CRATES +=	windows	0.62.2	# MIT OR Apache-2.0
MODCARGO_CRATES +=	windows-collections	0.3.2	# MIT OR Apache-2.0
MODCARGO_CRATES +=	windows-core	0.62.2	# MIT OR Apache-2.0
MODCARGO_CRATES +=	windows-future	0.3.2	# MIT OR Apache-2.0
MODCARGO_CRATES +=	windows-implement	0.60.2	# MIT OR Apache-2.0
MODCARGO_CRATES +=	windows-interface	0.59.3	# MIT OR Apache-2.0
MODCARGO_CRATES +=	windows-link	0.2.1	# MIT OR Apache-2.0
MODCARGO_CRATES +=	windows-numerics	0.3.1	# MIT OR Apache-2.0
MODCARGO_CRATES +=	windows-result	0.4.1	# MIT OR Apache-2.0
MODCARGO_CRATES +=	windows-strings	0.5.1	# MIT OR Apache-2.0
MODCARGO_CRATES +=	windows-sys	0.60.2	# MIT OR Apache-2.0
MODCARGO_CRATES +=	windows-sys	0.61.2	# MIT OR Apache-2.0
MODCARGO_CRATES +=	windows-targets	0.53.5	# MIT OR Apache-2.0
MODCARGO_CRATES +=	windows-threading	0.2.1	# MIT OR Apache-2.0
MODCARGO_CRATES +=	windows_aarch64_gnullvm	0.53.1	# MIT OR Apache-2.0
MODCARGO_CRATES +=	windows_aarch64_msvc	0.53.1	# MIT OR Apache-2.0
MODCARGO_CRATES +=	windows_i686_gnu	0.53.1	# MIT OR Apache-2.0
MODCARGO_CRATES +=	windows_i686_gnullvm	0.53.1	# MIT OR Apache-2.0
MODCARGO_CRATES +=	windows_i686_msvc	0.53.1	# MIT OR Apache-2.0
MODCARGO_CRATES +=	windows_x86_64_gnu	0.53.1	# MIT OR Apache-2.0
MODCARGO_CRATES +=	windows_x86_64_gnullvm	0.53.1	# MIT OR Apache-2.0
MODCARGO_CRATES +=	windows_x86_64_msvc	0.53.1	# MIT OR Apache-2.0
MODCARGO_CRATES +=	winnow	0.7.15	# MIT
MODCARGO_CRATES +=	winnow	1.0.3	# MIT
MODCARGO_CRATES +=	wit-bindgen	0.51.0	# Apache-2.0 WITH LLVM-exception OR Apache-2.0 OR MIT
MODCARGO_CRATES +=	wit-bindgen	0.57.1	# Apache-2.0 WITH LLVM-exception OR Apache-2.0 OR MIT
MODCARGO_CRATES +=	wit-bindgen-core	0.51.0	# Apache-2.0 WITH LLVM-exception OR Apache-2.0 OR MIT
MODCARGO_CRATES +=	wit-bindgen-rust	0.51.0	# Apache-2.0 WITH LLVM-exception OR Apache-2.0 OR MIT
MODCARGO_CRATES +=	wit-bindgen-rust-macro	0.51.0	# Apache-2.0 WITH LLVM-exception OR Apache-2.0 OR MIT
MODCARGO_CRATES +=	wit-component	0.244.0	# Apache-2.0 WITH LLVM-exception OR Apache-2.0 OR MIT
MODCARGO_CRATES +=	wit-parser	0.244.0	# Apache-2.0 WITH LLVM-exception OR Apache-2.0 OR MIT
MODCARGO_CRATES +=	write-json	0.1.4	# MIT OR Apache-2.0
MODCARGO_CRATES +=	writeable	0.6.3	# Unicode-3.0
MODCARGO_CRATES +=	xflags	0.3.2	# MIT OR Apache-2.0
MODCARGO_CRATES +=	xflags-macros	0.3.2	# MIT OR Apache-2.0
MODCARGO_CRATES +=	xshell	0.2.7	# MIT OR Apache-2.0
MODCARGO_CRATES +=	xshell-macros	0.2.7	# MIT OR Apache-2.0
MODCARGO_CRATES +=	yoke	0.8.3	# Unicode-3.0
MODCARGO_CRATES +=	yoke-derive	0.8.2	# Unicode-3.0
MODCARGO_CRATES +=	zerocopy	0.8.50	# BSD-2-Clause OR Apache-2.0 OR MIT
MODCARGO_CRATES +=	zerocopy-derive	0.8.50	# BSD-2-Clause OR Apache-2.0 OR MIT
MODCARGO_CRATES +=	zerofrom	0.1.8	# Unicode-3.0
MODCARGO_CRATES +=	zerofrom-derive	0.1.7	# Unicode-3.0
MODCARGO_CRATES +=	zerotrie	0.2.4	# Unicode-3.0
MODCARGO_CRATES +=	zerovec	0.11.6	# Unicode-3.0
MODCARGO_CRATES +=	zerovec-derive	0.11.3	# Unicode-3.0
MODCARGO_CRATES +=	zip	4.6.1	# MIT
MODCARGO_CRATES +=	zmij	1.0.21	# MIT
