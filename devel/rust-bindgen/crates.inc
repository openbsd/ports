MODCARGO_CRATES +=	aho-corasick	1.1.3	# Unlicense OR MIT
MODCARGO_CRATES +=	annotate-snippets	0.11.4	# Apache-2.0/MIT
MODCARGO_CRATES +=	anstyle	1.0.10	# MIT OR Apache-2.0
MODCARGO_CRATES +=	autocfg	1.4.0	# Apache-2.0 OR MIT
MODCARGO_CRATES +=	bitflags	1.3.2	# MIT/Apache-2.0
MODCARGO_CRATES +=	bitflags	2.2.1	# MIT OR Apache-2.0
MODCARGO_CRATES +=	block	0.1.6	# MIT
MODCARGO_CRATES +=	cc	1.2.2	# MIT OR Apache-2.0
MODCARGO_CRATES +=	cexpr	0.6.0	# Apache-2.0/MIT
MODCARGO_CRATES +=	cfg-if	1.0.0	# MIT/Apache-2.0
MODCARGO_CRATES +=	clang-sys	1.8.1	# Apache-2.0
MODCARGO_CRATES +=	clap	4.1.4	# MIT OR Apache-2.0
MODCARGO_CRATES +=	clap_complete	4.2.0	# MIT OR Apache-2.0
MODCARGO_CRATES +=	clap_derive	4.1.0	# MIT OR Apache-2.0
MODCARGO_CRATES +=	clap_lex	0.3.1	# MIT OR Apache-2.0
MODCARGO_CRATES +=	either	1.13.0	# MIT OR Apache-2.0
MODCARGO_CRATES +=	env_logger	0.8.4	# MIT/Apache-2.0
MODCARGO_CRATES +=	env_logger	0.10.0	# MIT OR Apache-2.0
MODCARGO_CRATES +=	errno	0.3.10	# MIT OR Apache-2.0
MODCARGO_CRATES +=	fastrand	1.9.0	# Apache-2.0 OR MIT
MODCARGO_CRATES +=	getrandom	0.2.15	# MIT OR Apache-2.0
MODCARGO_CRATES +=	glob	0.3.1	# MIT OR Apache-2.0
MODCARGO_CRATES +=	heck	0.4.1	# MIT OR Apache-2.0
MODCARGO_CRATES +=	hermit-abi	0.3.9	# MIT OR Apache-2.0
MODCARGO_CRATES +=	hermit-abi	0.4.0	# MIT OR Apache-2.0
MODCARGO_CRATES +=	humantime	2.1.0	# MIT/Apache-2.0
MODCARGO_CRATES +=	instant	0.1.12	# BSD-3-Clause
MODCARGO_CRATES +=	io-lifetimes	1.0.11	# Apache-2.0 WITH LLVM-exception OR Apache-2.0 OR MIT
MODCARGO_CRATES +=	is-terminal	0.4.13	# MIT
MODCARGO_CRATES +=	itertools	0.13.0	# MIT OR Apache-2.0
MODCARGO_CRATES +=	libc	0.2.167	# MIT OR Apache-2.0
MODCARGO_CRATES +=	libloading	0.8.6	# ISC
MODCARGO_CRATES +=	linux-raw-sys	0.3.8	# Apache-2.0 WITH LLVM-exception OR Apache-2.0 OR MIT
MODCARGO_CRATES +=	log	0.4.22	# MIT OR Apache-2.0
MODCARGO_CRATES +=	malloc_buf	0.0.6	# MIT
MODCARGO_CRATES +=	memchr	2.7.4	# Unlicense OR MIT
MODCARGO_CRATES +=	minimal-lexical	0.2.1	# MIT/Apache-2.0
MODCARGO_CRATES +=	nom	7.1.3	# MIT
MODCARGO_CRATES +=	objc	0.2.7	# MIT
MODCARGO_CRATES +=	once_cell	1.20.2	# MIT OR Apache-2.0
MODCARGO_CRATES +=	os_str_bytes	6.4.1	# MIT OR Apache-2.0
MODCARGO_CRATES +=	owo-colors	4.1.0	# MIT
MODCARGO_CRATES +=	prettyplease	0.2.25	# MIT OR Apache-2.0
MODCARGO_CRATES +=	proc-macro-error	1.0.4	# MIT OR Apache-2.0
MODCARGO_CRATES +=	proc-macro-error-attr	1.0.4	# MIT OR Apache-2.0
MODCARGO_CRATES +=	proc-macro2	1.0.92	# MIT OR Apache-2.0
MODCARGO_CRATES +=	quickcheck	1.0.3	# Unlicense/MIT
MODCARGO_CRATES +=	quote	1.0.37	# MIT OR Apache-2.0
MODCARGO_CRATES +=	rand	0.8.5	# MIT OR Apache-2.0
MODCARGO_CRATES +=	rand_core	0.6.4	# MIT OR Apache-2.0
MODCARGO_CRATES +=	redox_syscall	0.3.5	# MIT
MODCARGO_CRATES +=	regex	1.11.1	# MIT OR Apache-2.0
MODCARGO_CRATES +=	regex-automata	0.4.9	# MIT OR Apache-2.0
MODCARGO_CRATES +=	regex-syntax	0.8.5	# MIT OR Apache-2.0
MODCARGO_CRATES +=	rustc-hash	2.1.0	# Apache-2.0 OR MIT
MODCARGO_CRATES +=	rustix	0.37.27	# Apache-2.0 WITH LLVM-exception OR Apache-2.0 OR MIT
MODCARGO_CRATES +=	shlex	1.3.0	# MIT OR Apache-2.0
MODCARGO_CRATES +=	similar	2.6.0	# Apache-2.0
MODCARGO_CRATES +=	strsim	0.10.0	# MIT
MODCARGO_CRATES +=	syn	1.0.109	# MIT OR Apache-2.0
MODCARGO_CRATES +=	syn	2.0.90	# MIT OR Apache-2.0
MODCARGO_CRATES +=	tempfile	3.6.0	# MIT OR Apache-2.0
MODCARGO_CRATES +=	termcolor	1.2.0	# Unlicense OR MIT
MODCARGO_CRATES +=	unicode-ident	1.0.14	# (MIT OR Apache-2.0) AND Unicode-3.0
MODCARGO_CRATES +=	unicode-width	0.1.14	# MIT OR Apache-2.0
MODCARGO_CRATES +=	version_check	0.9.4	# MIT/Apache-2.0
MODCARGO_CRATES +=	wasi	0.11.0+wasi-snapshot-preview1	# Apache-2.0 WITH LLVM-exception OR Apache-2.0 OR MIT
MODCARGO_CRATES +=	winapi	0.3.9	# MIT/Apache-2.0
MODCARGO_CRATES +=	winapi-i686-pc-windows-gnu	0.4.0	# MIT/Apache-2.0
MODCARGO_CRATES +=	winapi-util	0.1.5	# Unlicense/MIT
MODCARGO_CRATES +=	winapi-x86_64-pc-windows-gnu	0.4.0	# MIT/Apache-2.0
MODCARGO_CRATES +=	windows-sys	0.48.0	# MIT OR Apache-2.0
MODCARGO_CRATES +=	windows-sys	0.52.0	# MIT OR Apache-2.0
MODCARGO_CRATES +=	windows-targets	0.48.5	# MIT OR Apache-2.0
MODCARGO_CRATES +=	windows-targets	0.52.6	# MIT OR Apache-2.0
MODCARGO_CRATES +=	windows_aarch64_gnullvm	0.48.5	# MIT OR Apache-2.0
MODCARGO_CRATES +=	windows_aarch64_gnullvm	0.52.6	# MIT OR Apache-2.0
MODCARGO_CRATES +=	windows_aarch64_msvc	0.48.5	# MIT OR Apache-2.0
MODCARGO_CRATES +=	windows_aarch64_msvc	0.52.6	# MIT OR Apache-2.0
MODCARGO_CRATES +=	windows_i686_gnu	0.48.5	# MIT OR Apache-2.0
MODCARGO_CRATES +=	windows_i686_gnu	0.52.6	# MIT OR Apache-2.0
MODCARGO_CRATES +=	windows_i686_gnullvm	0.52.6	# MIT OR Apache-2.0
MODCARGO_CRATES +=	windows_i686_msvc	0.48.5	# MIT OR Apache-2.0
MODCARGO_CRATES +=	windows_i686_msvc	0.52.6	# MIT OR Apache-2.0
MODCARGO_CRATES +=	windows_x86_64_gnu	0.48.5	# MIT OR Apache-2.0
MODCARGO_CRATES +=	windows_x86_64_gnu	0.52.6	# MIT OR Apache-2.0
MODCARGO_CRATES +=	windows_x86_64_gnullvm	0.48.5	# MIT OR Apache-2.0
MODCARGO_CRATES +=	windows_x86_64_gnullvm	0.52.6	# MIT OR Apache-2.0
MODCARGO_CRATES +=	windows_x86_64_msvc	0.48.5	# MIT OR Apache-2.0
MODCARGO_CRATES +=	windows_x86_64_msvc	0.52.6	# MIT OR Apache-2.0
