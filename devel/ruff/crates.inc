MODCARGO_CRATES +=	adler2	2.0.1	# 0BSD OR MIT OR Apache-2.0
MODCARGO_CRATES +=	aho-corasick	1.1.3	# Unlicense OR MIT
MODCARGO_CRATES +=	allocator-api2	0.2.21	# MIT OR Apache-2.0
MODCARGO_CRATES +=	android_system_properties	0.1.5	# MIT/Apache-2.0
MODCARGO_CRATES +=	anes	0.1.6	# MIT OR Apache-2.0
MODCARGO_CRATES +=	annotate-snippets	0.11.5	# MIT OR Apache-2.0
MODCARGO_CRATES +=	anstream	0.6.21	# MIT OR Apache-2.0
MODCARGO_CRATES +=	anstyle	1.0.13	# MIT OR Apache-2.0
MODCARGO_CRATES +=	anstyle-lossy	1.1.4	# MIT OR Apache-2.0
MODCARGO_CRATES +=	anstyle-parse	0.2.7	# MIT OR Apache-2.0
MODCARGO_CRATES +=	anstyle-query	1.1.4	# MIT OR Apache-2.0
MODCARGO_CRATES +=	anstyle-svg	0.1.11	# MIT OR Apache-2.0
MODCARGO_CRATES +=	anstyle-wincon	3.0.10	# MIT OR Apache-2.0
MODCARGO_CRATES +=	anyhow	1.0.100	# MIT OR Apache-2.0
MODCARGO_CRATES +=	approx	0.5.1	# Apache-2.0
MODCARGO_CRATES +=	arc-swap	1.7.1	# MIT OR Apache-2.0
MODCARGO_CRATES +=	argfile	0.2.1	# MIT OR Apache-2.0
MODCARGO_CRATES +=	arrayvec	0.7.6	# MIT OR Apache-2.0
MODCARGO_CRATES +=	assert_fs	1.1.3	# MIT OR Apache-2.0
MODCARGO_CRATES +=	attribute-derive	0.10.3	# MIT OR Apache-2.0
MODCARGO_CRATES +=	attribute-derive-macro	0.10.3	# MIT
MODCARGO_CRATES +=	autocfg	1.5.0	# Apache-2.0 OR MIT
MODCARGO_CRATES +=	base64	0.13.1	# MIT/Apache-2.0
MODCARGO_CRATES +=	bincode	2.0.1	# MIT
MODCARGO_CRATES +=	bincode_derive	2.0.1	# MIT
MODCARGO_CRATES +=	bindgen	0.72.1	# BSD-3-Clause
MODCARGO_CRATES +=	bitflags	1.3.2	# MIT/Apache-2.0
MODCARGO_CRATES +=	bitflags	2.9.4	# MIT OR Apache-2.0
MODCARGO_CRATES +=	bitvec	1.0.1	# MIT
MODCARGO_CRATES +=	block-buffer	0.10.4	# MIT OR Apache-2.0
MODCARGO_CRATES +=	boxcar	0.2.14	# MIT
MODCARGO_CRATES +=	bstr	1.12.0	# MIT OR Apache-2.0
MODCARGO_CRATES +=	bumpalo	3.19.0	# MIT OR Apache-2.0
MODCARGO_CRATES +=	byteorder	1.5.0	# Unlicense OR MIT
MODCARGO_CRATES +=	cachedir	0.3.1	# MIT
MODCARGO_CRATES +=	camino	1.2.1	# MIT OR Apache-2.0
MODCARGO_CRATES +=	cast	0.3.0	# MIT OR Apache-2.0
MODCARGO_CRATES +=	castaway	0.2.4	# MIT
MODCARGO_CRATES +=	cc	1.2.38	# MIT OR Apache-2.0
MODCARGO_CRATES +=	cexpr	0.6.0	# Apache-2.0/MIT
MODCARGO_CRATES +=	cfg-if	1.0.3	# MIT OR Apache-2.0
MODCARGO_CRATES +=	cfg_aliases	0.2.1	# MIT
MODCARGO_CRATES +=	chrono	0.4.42	# MIT OR Apache-2.0
MODCARGO_CRATES +=	ciborium	0.2.2	# Apache-2.0
MODCARGO_CRATES +=	ciborium-io	0.2.2	# Apache-2.0
MODCARGO_CRATES +=	ciborium-ll	0.2.2	# Apache-2.0
MODCARGO_CRATES +=	clang-sys	1.8.1	# Apache-2.0
MODCARGO_CRATES +=	clap	4.5.48	# MIT OR Apache-2.0
MODCARGO_CRATES +=	clap_builder	4.5.48	# MIT OR Apache-2.0
MODCARGO_CRATES +=	clap_complete	4.5.58	# MIT OR Apache-2.0
MODCARGO_CRATES +=	clap_complete_command	0.6.1	# MIT
MODCARGO_CRATES +=	clap_complete_nushell	4.5.8	# MIT OR Apache-2.0
MODCARGO_CRATES +=	clap_derive	4.5.47	# MIT OR Apache-2.0
MODCARGO_CRATES +=	clap_lex	0.7.5	# MIT OR Apache-2.0
MODCARGO_CRATES +=	clearscreen	4.0.2	# Apache-2.0 OR MIT
MODCARGO_CRATES +=	codspeed	4.0.4	# MIT OR Apache-2.0
MODCARGO_CRATES +=	codspeed-criterion-compat	4.0.4	# MIT OR Apache-2.0
MODCARGO_CRATES +=	codspeed-criterion-compat-walltime	4.0.4	# Apache-2.0 OR MIT
MODCARGO_CRATES +=	codspeed-divan-compat	4.0.4	# MIT OR Apache-2.0
MODCARGO_CRATES +=	codspeed-divan-compat-macros	4.0.4	# MIT OR Apache-2.0
MODCARGO_CRATES +=	codspeed-divan-compat-walltime	4.0.4	# MIT OR Apache-2.0
MODCARGO_CRATES +=	collection_literals	1.0.2	# MIT
MODCARGO_CRATES +=	colorchoice	1.0.4	# MIT OR Apache-2.0
MODCARGO_CRATES +=	colored	2.2.0	# MPL-2.0
MODCARGO_CRATES +=	colored	3.0.0	# MPL-2.0
MODCARGO_CRATES +=	compact_str	0.9.0	# MIT
MODCARGO_CRATES +=	condtype	1.3.0	# MIT OR Apache-2.0
MODCARGO_CRATES +=	console	0.15.11	# MIT
MODCARGO_CRATES +=	console	0.16.1	# MIT
MODCARGO_CRATES +=	console_error_panic_hook	0.1.7	# Apache-2.0/MIT
MODCARGO_CRATES +=	console_log	1.0.0	# MIT/Apache-2.0
MODCARGO_CRATES +=	core-foundation-sys	0.8.7	# MIT OR Apache-2.0
MODCARGO_CRATES +=	countme	3.0.1	# MIT OR Apache-2.0
MODCARGO_CRATES +=	cpufeatures	0.2.17	# MIT OR Apache-2.0
MODCARGO_CRATES +=	crc32fast	1.5.0	# MIT OR Apache-2.0
MODCARGO_CRATES +=	criterion	0.7.0	# Apache-2.0 OR MIT
MODCARGO_CRATES +=	criterion-plot	0.5.0	# MIT/Apache-2.0
MODCARGO_CRATES +=	criterion-plot	0.6.0	# MIT OR Apache-2.0
MODCARGO_CRATES +=	crossbeam	0.8.4	# MIT OR Apache-2.0
MODCARGO_CRATES +=	crossbeam-channel	0.5.15	# MIT OR Apache-2.0
MODCARGO_CRATES +=	crossbeam-deque	0.8.6	# MIT OR Apache-2.0
MODCARGO_CRATES +=	crossbeam-epoch	0.9.18	# MIT OR Apache-2.0
MODCARGO_CRATES +=	crossbeam-queue	0.3.12	# MIT OR Apache-2.0
MODCARGO_CRATES +=	crossbeam-utils	0.8.21	# MIT OR Apache-2.0
MODCARGO_CRATES +=	crunchy	0.2.4	# MIT
MODCARGO_CRATES +=	crypto-common	0.1.6	# MIT OR Apache-2.0
MODCARGO_CRATES +=	csv	1.3.1	# Unlicense/MIT
MODCARGO_CRATES +=	csv-core	0.1.12	# Unlicense/MIT
MODCARGO_CRATES +=	ctrlc	3.5.0	# MIT/Apache-2.0
MODCARGO_CRATES +=	darling	0.21.3	# MIT
MODCARGO_CRATES +=	darling_core	0.21.3	# MIT
MODCARGO_CRATES +=	darling_macro	0.21.3	# MIT
MODCARGO_CRATES +=	dashmap	6.1.0	# MIT
MODCARGO_CRATES +=	derive-where	1.6.0	# MIT OR Apache-2.0
MODCARGO_CRATES +=	diff	0.1.13	# MIT OR Apache-2.0
MODCARGO_CRATES +=	difflib	0.4.0	# MIT
MODCARGO_CRATES +=	digest	0.10.7	# MIT OR Apache-2.0
MODCARGO_CRATES +=	dir-test	0.4.1	# Apache-2.0
MODCARGO_CRATES +=	dir-test-macros	0.4.1	# Apache-2.0
MODCARGO_CRATES +=	dirs	6.0.0	# MIT OR Apache-2.0
MODCARGO_CRATES +=	dirs-sys	0.5.0	# MIT OR Apache-2.0
MODCARGO_CRATES +=	dispatch	0.2.0	# MIT
MODCARGO_CRATES +=	displaydoc	0.2.5	# MIT OR Apache-2.0
MODCARGO_CRATES +=	divan-macros	0.1.17	# MIT OR Apache-2.0
MODCARGO_CRATES +=	doc-comment	0.3.3	# MIT
MODCARGO_CRATES +=	drop_bomb	0.1.5	# MIT OR Apache-2.0
MODCARGO_CRATES +=	dunce	1.0.5	# CC0-1.0 OR MIT-0 OR Apache-2.0
MODCARGO_CRATES +=	dyn-clone	1.0.20	# MIT OR Apache-2.0
MODCARGO_CRATES +=	either	1.15.0	# MIT OR Apache-2.0
MODCARGO_CRATES +=	encode_unicode	1.0.0	# Apache-2.0 OR MIT
MODCARGO_CRATES +=	env_home	0.1.0	# MIT OR Apache-2.0
MODCARGO_CRATES +=	equivalent	1.0.2	# Apache-2.0 OR MIT
MODCARGO_CRATES +=	errno	0.3.14	# MIT OR Apache-2.0
MODCARGO_CRATES +=	escape8259	0.5.3	# MIT
MODCARGO_CRATES +=	escargot	0.5.15	# MIT OR Apache-2.0
MODCARGO_CRATES +=	etcetera	0.10.0	# MIT OR Apache-2.0
MODCARGO_CRATES +=	fastrand	2.3.0	# Apache-2.0 OR MIT
MODCARGO_CRATES +=	fern	0.7.1	# MIT
MODCARGO_CRATES +=	filetime	0.2.26	# MIT/Apache-2.0
MODCARGO_CRATES +=	find-msvc-tools	0.1.2	# MIT OR Apache-2.0
MODCARGO_CRATES +=	flate2	1.1.2	# MIT OR Apache-2.0
MODCARGO_CRATES +=	fnv	1.0.7	# Apache-2.0 / MIT
MODCARGO_CRATES +=	foldhash	0.1.5	# Zlib
MODCARGO_CRATES +=	form_urlencoded	1.2.2	# MIT OR Apache-2.0
MODCARGO_CRATES +=	fs-err	2.11.0	# MIT/Apache-2.0
MODCARGO_CRATES +=	fsevent-sys	4.1.0	# MIT
MODCARGO_CRATES +=	funty	2.0.0	# MIT
MODCARGO_CRATES +=	generic-array	0.14.7	# MIT
MODCARGO_CRATES +=	get-size-derive2	0.7.0	# MIT OR Apache-2.0
MODCARGO_CRATES +=	get-size2	0.7.0	# MIT OR Apache-2.0
MODCARGO_CRATES +=	getopts	0.2.24	# MIT OR Apache-2.0
MODCARGO_CRATES +=	getrandom	0.2.16	# MIT OR Apache-2.0
MODCARGO_CRATES +=	getrandom	0.3.3	# MIT OR Apache-2.0
MODCARGO_CRATES +=	glob	0.3.3	# MIT OR Apache-2.0
MODCARGO_CRATES +=	globset	0.4.16	# Unlicense OR MIT
MODCARGO_CRATES +=	globwalk	0.9.1	# MIT
MODCARGO_CRATES +=	half	2.6.0	# MIT OR Apache-2.0
MODCARGO_CRATES +=	hashbrown	0.14.5	# MIT OR Apache-2.0
MODCARGO_CRATES +=	hashbrown	0.15.5	# MIT OR Apache-2.0
MODCARGO_CRATES +=	hashbrown	0.16.0	# MIT OR Apache-2.0
MODCARGO_CRATES +=	hashlink	0.10.0	# MIT OR Apache-2.0
MODCARGO_CRATES +=	heck	0.5.0	# MIT OR Apache-2.0
MODCARGO_CRATES +=	hermit-abi	0.5.2	# MIT OR Apache-2.0
MODCARGO_CRATES +=	home	0.5.11	# MIT OR Apache-2.0
MODCARGO_CRATES +=	html-escape	0.2.13	# MIT
MODCARGO_CRATES +=	iana-time-zone	0.1.64	# MIT OR Apache-2.0
MODCARGO_CRATES +=	iana-time-zone-haiku	0.1.2	# MIT OR Apache-2.0
MODCARGO_CRATES +=	icu_collections	2.0.0	# Unicode-3.0
MODCARGO_CRATES +=	icu_locale_core	2.0.0	# Unicode-3.0
MODCARGO_CRATES +=	icu_normalizer	2.0.0	# Unicode-3.0
MODCARGO_CRATES +=	icu_normalizer_data	2.0.0	# Unicode-3.0
MODCARGO_CRATES +=	icu_properties	2.0.1	# Unicode-3.0
MODCARGO_CRATES +=	icu_properties_data	2.0.1	# Unicode-3.0
MODCARGO_CRATES +=	icu_provider	2.0.0	# Unicode-3.0
MODCARGO_CRATES +=	ident_case	1.0.1	# MIT/Apache-2.0
MODCARGO_CRATES +=	idna	1.1.0	# MIT OR Apache-2.0
MODCARGO_CRATES +=	idna_adapter	1.2.1	# Apache-2.0 OR MIT
MODCARGO_CRATES +=	ignore	0.4.23	# Unlicense OR MIT
MODCARGO_CRATES +=	imara-diff	0.1.8	# Apache-2.0
MODCARGO_CRATES +=	imperative	1.0.6	# MIT OR Apache-2.0
MODCARGO_CRATES +=	indexmap	2.11.4	# Apache-2.0 OR MIT
MODCARGO_CRATES +=	indicatif	0.18.0	# MIT
MODCARGO_CRATES +=	indoc	2.0.6	# MIT OR Apache-2.0
MODCARGO_CRATES +=	inotify	0.11.0	# ISC
MODCARGO_CRATES +=	inotify-sys	0.1.5	# ISC
MODCARGO_CRATES +=	insta	1.43.2	# Apache-2.0
MODCARGO_CRATES +=	insta-cmd	0.6.0	# Apache-2.0
MODCARGO_CRATES +=	interpolator	0.5.0	# MIT OR Apache-2.0
MODCARGO_CRATES +=	intrusive-collections	0.9.7	# Apache-2.0/MIT
MODCARGO_CRATES +=	inventory	0.3.21	# MIT OR Apache-2.0
MODCARGO_CRATES +=	is-docker	0.2.0	# MIT
MODCARGO_CRATES +=	is-macro	0.3.7	# Apache-2.0
MODCARGO_CRATES +=	is-terminal	0.4.16	# MIT
MODCARGO_CRATES +=	is-wsl	0.4.0	# MIT
MODCARGO_CRATES +=	is_terminal_polyfill	1.70.1	# MIT OR Apache-2.0
MODCARGO_CRATES +=	itertools	0.10.5	# MIT/Apache-2.0
MODCARGO_CRATES +=	itertools	0.13.0	# MIT OR Apache-2.0
MODCARGO_CRATES +=	itertools	0.14.0	# MIT OR Apache-2.0
MODCARGO_CRATES +=	itoa	1.0.15	# MIT OR Apache-2.0
MODCARGO_CRATES +=	jiff	0.2.15	# Unlicense OR MIT
MODCARGO_CRATES +=	jiff-static	0.2.15	# Unlicense OR MIT
MODCARGO_CRATES +=	jiff-tzdb	0.1.4	# Unlicense OR MIT
MODCARGO_CRATES +=	jiff-tzdb-platform	0.1.3	# Unlicense OR MIT
MODCARGO_CRATES +=	jobserver	0.1.34	# MIT OR Apache-2.0
MODCARGO_CRATES +=	jod-thread	1.0.0	# MIT OR Apache-2.0
MODCARGO_CRATES +=	js-sys	0.3.80	# MIT OR Apache-2.0
MODCARGO_CRATES +=	kqueue	1.1.1	# MIT
MODCARGO_CRATES +=	kqueue-sys	1.0.4	# MIT
MODCARGO_CRATES +=	lazy_static	1.5.0	# MIT OR Apache-2.0
MODCARGO_CRATES +=	libc	0.2.177	# MIT OR Apache-2.0
MODCARGO_CRATES +=	libcst	1.8.5	# MIT AND (MIT AND PSF-2.0)
MODCARGO_CRATES +=	libcst_derive	1.8.5	# MIT
MODCARGO_CRATES +=	libloading	0.8.9	# ISC
MODCARGO_CRATES +=	libmimalloc-sys	0.1.44	# MIT
MODCARGO_CRATES +=	libredox	0.1.10	# MIT
MODCARGO_CRATES +=	libtest-mimic	0.7.3	# MIT/Apache-2.0
MODCARGO_CRATES +=	linux-raw-sys	0.11.0	# Apache-2.0 WITH LLVM-exception OR Apache-2.0 OR MIT
MODCARGO_CRATES +=	litemap	0.8.0	# Unicode-3.0
MODCARGO_CRATES +=	lock_api	0.4.13	# MIT OR Apache-2.0
MODCARGO_CRATES +=	log	0.4.28	# MIT OR Apache-2.0
MODCARGO_CRATES +=	lsp-server	0.7.9	# MIT OR Apache-2.0
MODCARGO_CRATES +=	manyhow	0.11.4	# MIT OR Apache-2.0
MODCARGO_CRATES +=	manyhow-macros	0.11.4	# MIT OR Apache-2.0
MODCARGO_CRATES +=	markdown	1.0.0	# MIT
MODCARGO_CRATES +=	matchers	0.2.0	# MIT
MODCARGO_CRATES +=	matches	0.1.10	# MIT
MODCARGO_CRATES +=	matchit	0.8.6	# MIT AND BSD-3-Clause
MODCARGO_CRATES +=	memchr	2.7.6	# Unlicense OR MIT
MODCARGO_CRATES +=	memoffset	0.9.1	# MIT
MODCARGO_CRATES +=	mimalloc	0.1.48	# MIT
MODCARGO_CRATES +=	minicov	0.3.7	# Apache-2.0/MIT
MODCARGO_CRATES +=	minimal-lexical	0.2.1	# MIT/Apache-2.0
MODCARGO_CRATES +=	miniz_oxide	0.8.9	# MIT OR Zlib OR Apache-2.0
MODCARGO_CRATES +=	mio	1.0.4	# MIT
MODCARGO_CRATES +=	natord	1.0.9	# MIT
MODCARGO_CRATES +=	newtype-uuid	1.2.4	# MIT OR Apache-2.0
MODCARGO_CRATES +=	nix	0.29.0	# MIT
MODCARGO_CRATES +=	nix	0.30.1	# MIT
MODCARGO_CRATES +=	nom	7.1.3	# MIT
MODCARGO_CRATES +=	normalize-line-endings	0.3.0	# Apache-2.0
MODCARGO_CRATES +=	notify	8.2.0	# CC0-1.0
MODCARGO_CRATES +=	notify-types	2.0.0	# MIT OR Apache-2.0
MODCARGO_CRATES +=	nu-ansi-term	0.50.1	# MIT
MODCARGO_CRATES +=	num-traits	0.2.19	# MIT OR Apache-2.0
MODCARGO_CRATES +=	num_cpus	1.17.0	# MIT OR Apache-2.0
MODCARGO_CRATES +=	once_cell	1.21.3	# MIT OR Apache-2.0
MODCARGO_CRATES +=	once_cell_polyfill	1.70.1	# MIT OR Apache-2.0
MODCARGO_CRATES +=	oorandom	11.1.5	# MIT
MODCARGO_CRATES +=	option-ext	0.2.0	# MPL-2.0
MODCARGO_CRATES +=	ordermap	0.5.12	# Apache-2.0 OR MIT
MODCARGO_CRATES +=	os_pipe	1.2.2	# MIT
MODCARGO_CRATES +=	os_str_bytes	7.1.1	# MIT OR Apache-2.0
MODCARGO_CRATES +=	parking_lot	0.12.4	# MIT OR Apache-2.0
MODCARGO_CRATES +=	parking_lot_core	0.9.11	# MIT OR Apache-2.0
MODCARGO_CRATES +=	paste	1.0.15	# MIT OR Apache-2.0
MODCARGO_CRATES +=	path-absolutize	3.1.1	# MIT
MODCARGO_CRATES +=	path-dedot	3.1.1	# MIT
MODCARGO_CRATES +=	path-slash	0.2.1	# MIT
MODCARGO_CRATES +=	pathdiff	0.2.3	# MIT/Apache-2.0
MODCARGO_CRATES +=	peg	0.8.5	# MIT
MODCARGO_CRATES +=	peg-macros	0.8.5	# MIT
MODCARGO_CRATES +=	peg-runtime	0.8.5	# MIT
MODCARGO_CRATES +=	pep440_rs	0.7.3	# Apache-2.0 OR BSD-2-Clause
MODCARGO_CRATES +=	pep508_rs	0.9.2	# Apache-2.0 OR BSD-2-Clause
MODCARGO_CRATES +=	percent-encoding	2.3.2	# MIT OR Apache-2.0
MODCARGO_CRATES +=	pest	2.8.2	# MIT OR Apache-2.0
MODCARGO_CRATES +=	pest_derive	2.8.2	# MIT OR Apache-2.0
MODCARGO_CRATES +=	pest_generator	2.8.2	# MIT OR Apache-2.0
MODCARGO_CRATES +=	pest_meta	2.8.2	# MIT OR Apache-2.0
MODCARGO_CRATES +=	phf	0.11.3	# MIT
MODCARGO_CRATES +=	phf_codegen	0.11.3	# MIT
MODCARGO_CRATES +=	phf_generator	0.11.3	# MIT
MODCARGO_CRATES +=	phf_shared	0.11.3	# MIT
MODCARGO_CRATES +=	pin-project-lite	0.2.16	# Apache-2.0 OR MIT
MODCARGO_CRATES +=	pkg-config	0.3.32	# MIT OR Apache-2.0
MODCARGO_CRATES +=	portable-atomic	1.11.1	# Apache-2.0 OR MIT
MODCARGO_CRATES +=	portable-atomic-util	0.2.4	# Apache-2.0 OR MIT
MODCARGO_CRATES +=	potential_utf	0.1.3	# Unicode-3.0
MODCARGO_CRATES +=	ppv-lite86	0.2.21	# MIT OR Apache-2.0
MODCARGO_CRATES +=	predicates	3.1.3	# MIT OR Apache-2.0
MODCARGO_CRATES +=	predicates-core	1.0.9	# MIT OR Apache-2.0
MODCARGO_CRATES +=	predicates-tree	1.0.12	# MIT OR Apache-2.0
MODCARGO_CRATES +=	pretty_assertions	1.4.1	# MIT OR Apache-2.0
MODCARGO_CRATES +=	prettyplease	0.2.37	# MIT OR Apache-2.0
MODCARGO_CRATES +=	proc-macro-crate	3.4.0	# MIT OR Apache-2.0
MODCARGO_CRATES +=	proc-macro-utils	0.10.0	# MIT OR Apache-2.0
MODCARGO_CRATES +=	proc-macro2	1.0.101	# MIT OR Apache-2.0
MODCARGO_CRATES +=	pyproject-toml	0.13.7	# MIT
MODCARGO_CRATES +=	quick-junit	0.5.1	# Apache-2.0 OR MIT
MODCARGO_CRATES +=	quick-xml	0.37.5	# MIT
MODCARGO_CRATES +=	quickcheck	1.0.3	# Unlicense/MIT
MODCARGO_CRATES +=	quickcheck_macros	1.1.0	# Unlicense OR MIT
MODCARGO_CRATES +=	quote	1.0.40	# MIT OR Apache-2.0
MODCARGO_CRATES +=	quote-use	0.8.4	# MIT
MODCARGO_CRATES +=	quote-use-macros	0.8.4	# MIT
MODCARGO_CRATES +=	r-efi	5.3.0	# MIT OR Apache-2.0 OR LGPL-2.1-or-later
MODCARGO_CRATES +=	radium	0.7.0	# MIT
MODCARGO_CRATES +=	rand	0.8.5	# MIT OR Apache-2.0
MODCARGO_CRATES +=	rand	0.9.2	# MIT OR Apache-2.0
MODCARGO_CRATES +=	rand_chacha	0.3.1	# MIT OR Apache-2.0
MODCARGO_CRATES +=	rand_chacha	0.9.0	# MIT OR Apache-2.0
MODCARGO_CRATES +=	rand_core	0.6.4	# MIT OR Apache-2.0
MODCARGO_CRATES +=	rand_core	0.9.3	# MIT OR Apache-2.0
MODCARGO_CRATES +=	rayon	1.11.0	# MIT OR Apache-2.0
MODCARGO_CRATES +=	rayon-core	1.13.0	# MIT OR Apache-2.0
MODCARGO_CRATES +=	redox_syscall	0.5.17	# MIT
MODCARGO_CRATES +=	redox_users	0.5.2	# MIT
MODCARGO_CRATES +=	regex	1.11.3	# MIT OR Apache-2.0
MODCARGO_CRATES +=	regex-automata	0.4.11	# MIT OR Apache-2.0
MODCARGO_CRATES +=	regex-lite	0.1.7	# MIT OR Apache-2.0
MODCARGO_CRATES +=	regex-syntax	0.8.6	# MIT OR Apache-2.0
MODCARGO_CRATES +=	ron	0.7.1	# MIT/Apache-2.0
MODCARGO_CRATES +=	rust-stemmers	1.2.0	# MIT/BSD-3-Clause
MODCARGO_CRATES +=	rustc-hash	2.1.1	# Apache-2.0 OR MIT
MODCARGO_CRATES +=	rustc-stable-hash	0.1.2	# Apache-2.0 OR MIT
MODCARGO_CRATES +=	rustix	1.1.2	# Apache-2.0 WITH LLVM-exception OR Apache-2.0 OR MIT
MODCARGO_CRATES +=	rustversion	1.0.22	# MIT OR Apache-2.0
MODCARGO_CRATES +=	ryu	1.0.20	# Apache-2.0 OR BSL-1.0
MODCARGO_CRATES +=	same-file	1.0.6	# Unlicense/MIT
MODCARGO_CRATES +=	schemars	0.8.22	# MIT
MODCARGO_CRATES +=	schemars_derive	0.8.22	# MIT
MODCARGO_CRATES +=	scopeguard	1.2.0	# MIT OR Apache-2.0
MODCARGO_CRATES +=	seahash	4.1.0	# MIT
MODCARGO_CRATES +=	serde	1.0.226	# MIT OR Apache-2.0
MODCARGO_CRATES +=	serde-wasm-bindgen	0.6.5	# MIT
MODCARGO_CRATES +=	serde_core	1.0.226	# MIT OR Apache-2.0
MODCARGO_CRATES +=	serde_derive	1.0.226	# MIT OR Apache-2.0
MODCARGO_CRATES +=	serde_derive_internals	0.29.1	# MIT OR Apache-2.0
MODCARGO_CRATES +=	serde_json	1.0.145	# MIT OR Apache-2.0
MODCARGO_CRATES +=	serde_repr	0.1.20	# MIT OR Apache-2.0
MODCARGO_CRATES +=	serde_spanned	1.0.2	# MIT OR Apache-2.0
MODCARGO_CRATES +=	serde_test	1.0.177	# MIT OR Apache-2.0
MODCARGO_CRATES +=	serde_with	3.14.1	# MIT OR Apache-2.0
MODCARGO_CRATES +=	serde_with_macros	3.14.1	# MIT OR Apache-2.0
MODCARGO_CRATES +=	sha2	0.10.9	# MIT OR Apache-2.0
MODCARGO_CRATES +=	sharded-slab	0.1.7	# MIT
MODCARGO_CRATES +=	shellexpand	3.1.1	# MIT/Apache-2.0
MODCARGO_CRATES +=	shlex	1.3.0	# MIT OR Apache-2.0
MODCARGO_CRATES +=	similar	2.7.0	# Apache-2.0
MODCARGO_CRATES +=	siphasher	1.0.1	# MIT/Apache-2.0
MODCARGO_CRATES +=	smallvec	1.15.1	# MIT OR Apache-2.0
MODCARGO_CRATES +=	snapbox	0.6.21	# MIT OR Apache-2.0
MODCARGO_CRATES +=	snapbox-macros	0.3.10	# MIT OR Apache-2.0
MODCARGO_CRATES +=	stable_deref_trait	1.2.0	# MIT/Apache-2.0
MODCARGO_CRATES +=	static_assertions	1.1.0	# MIT OR Apache-2.0
MODCARGO_CRATES +=	statrs	0.18.0	# MIT
MODCARGO_CRATES +=	strip-ansi-escapes	0.2.1	# Apache-2.0/MIT
MODCARGO_CRATES +=	strsim	0.11.1	# MIT
MODCARGO_CRATES +=	strum	0.27.2	# MIT
MODCARGO_CRATES +=	strum_macros	0.27.2	# MIT
MODCARGO_CRATES +=	syn	2.0.106	# MIT OR Apache-2.0
MODCARGO_CRATES +=	synstructure	0.13.2	# MIT
MODCARGO_CRATES +=	tap	1.0.1	# MIT
MODCARGO_CRATES +=	tempfile	3.22.0	# MIT OR Apache-2.0
MODCARGO_CRATES +=	termcolor	1.4.1	# Unlicense OR MIT
MODCARGO_CRATES +=	terminal_size	0.4.3	# MIT OR Apache-2.0
MODCARGO_CRATES +=	terminfo	0.9.0	# WTFPL
MODCARGO_CRATES +=	termtree	0.5.1	# MIT
MODCARGO_CRATES +=	test-case	3.3.1	# MIT
MODCARGO_CRATES +=	test-case-core	3.3.1	# MIT
MODCARGO_CRATES +=	test-case-macros	3.3.1	# MIT
MODCARGO_CRATES +=	thin-vec	0.2.14	# MIT/Apache-2.0
MODCARGO_CRATES +=	thiserror	1.0.69	# MIT OR Apache-2.0
MODCARGO_CRATES +=	thiserror	2.0.16	# MIT OR Apache-2.0
MODCARGO_CRATES +=	thiserror-impl	1.0.69	# MIT OR Apache-2.0
MODCARGO_CRATES +=	thiserror-impl	2.0.16	# MIT OR Apache-2.0
MODCARGO_CRATES +=	thread_local	1.1.9	# MIT OR Apache-2.0
MODCARGO_CRATES +=	threadpool	1.8.1	# MIT/Apache-2.0
MODCARGO_CRATES +=	tikv-jemalloc-sys	0.6.0+5.3.0-1-ge13ca993e8ccb9ba9847cc330696e02839f328f7	# MIT/Apache-2.0
MODCARGO_CRATES +=	tikv-jemallocator	0.6.0	# MIT/Apache-2.0
MODCARGO_CRATES +=	tinystr	0.8.1	# Unicode-3.0
MODCARGO_CRATES +=	tinytemplate	1.2.1	# Apache-2.0 OR MIT
MODCARGO_CRATES +=	tinyvec	1.10.0	# Zlib OR Apache-2.0 OR MIT
MODCARGO_CRATES +=	tinyvec_macros	0.1.1	# MIT OR Apache-2.0 OR Zlib
MODCARGO_CRATES +=	toml	0.9.7	# MIT OR Apache-2.0
MODCARGO_CRATES +=	toml_datetime	0.7.2	# MIT OR Apache-2.0
MODCARGO_CRATES +=	toml_edit	0.23.6	# MIT OR Apache-2.0
MODCARGO_CRATES +=	toml_parser	1.0.3	# MIT OR Apache-2.0
MODCARGO_CRATES +=	toml_writer	1.0.3	# MIT OR Apache-2.0
MODCARGO_CRATES +=	tracing	0.1.41	# MIT
MODCARGO_CRATES +=	tracing-attributes	0.1.30	# MIT
MODCARGO_CRATES +=	tracing-core	0.1.34	# MIT
MODCARGO_CRATES +=	tracing-flame	0.2.0	# MIT
MODCARGO_CRATES +=	tracing-indicatif	0.3.13	# MIT
MODCARGO_CRATES +=	tracing-log	0.2.0	# MIT
MODCARGO_CRATES +=	tracing-subscriber	0.3.20	# MIT
MODCARGO_CRATES +=	tryfn	0.2.3	# MIT OR Apache-2.0
MODCARGO_CRATES +=	typed-arena	2.0.2	# MIT
MODCARGO_CRATES +=	typenum	1.18.0	# MIT OR Apache-2.0
MODCARGO_CRATES +=	ucd-trie	0.1.7	# MIT OR Apache-2.0
MODCARGO_CRATES +=	unic-char-property	0.9.0	# MIT/Apache-2.0
MODCARGO_CRATES +=	unic-char-range	0.9.0	# MIT/Apache-2.0
MODCARGO_CRATES +=	unic-common	0.9.0	# MIT/Apache-2.0
MODCARGO_CRATES +=	unic-ucd-category	0.9.0	# MIT/Apache-2.0
MODCARGO_CRATES +=	unic-ucd-version	0.9.0	# MIT/Apache-2.0
MODCARGO_CRATES +=	unicode-id	0.3.6	# MIT OR Apache-2.0
MODCARGO_CRATES +=	unicode-ident	1.0.19	# (MIT OR Apache-2.0) AND Unicode-3.0
MODCARGO_CRATES +=	unicode-normalization	0.1.24	# MIT/Apache-2.0
MODCARGO_CRATES +=	unicode-width	0.1.14	# MIT OR Apache-2.0
MODCARGO_CRATES +=	unicode-width	0.2.1	# MIT OR Apache-2.0
MODCARGO_CRATES +=	unicode_names2	1.3.0	# (MIT OR Apache-2.0) AND Unicode-DFS-2016
MODCARGO_CRATES +=	unicode_names2_generator	1.3.0	# MIT OR Apache-2.0
MODCARGO_CRATES +=	unit-prefix	0.5.1	# MIT
MODCARGO_CRATES +=	unscanny	0.1.0	# MIT OR Apache-2.0
MODCARGO_CRATES +=	unty	0.0.4	# MIT OR Apache-2.0
MODCARGO_CRATES +=	url	2.5.7	# MIT OR Apache-2.0
MODCARGO_CRATES +=	urlencoding	2.1.3	# MIT
MODCARGO_CRATES +=	utf8-width	0.1.7	# MIT
MODCARGO_CRATES +=	utf8_iter	1.0.4	# Apache-2.0 OR MIT
MODCARGO_CRATES +=	utf8parse	0.2.2	# Apache-2.0 OR MIT
MODCARGO_CRATES +=	uuid	1.18.1	# Apache-2.0 OR MIT
MODCARGO_CRATES +=	uuid-macro-internal	1.18.1	# Apache-2.0 OR MIT
MODCARGO_CRATES +=	valuable	0.1.1	# MIT
MODCARGO_CRATES +=	version-ranges	0.1.1	# MPL-2.0
MODCARGO_CRATES +=	version_check	0.9.5	# MIT/Apache-2.0
MODCARGO_CRATES +=	virtue	0.0.18	# MIT
MODCARGO_CRATES +=	vt100	0.15.2	# MIT
MODCARGO_CRATES +=	vte	0.11.1	# Apache-2.0 OR MIT
MODCARGO_CRATES +=	vte	0.14.1	# Apache-2.0 OR MIT
MODCARGO_CRATES +=	vte_generate_state_changes	0.1.2	# Apache-2.0 OR MIT
MODCARGO_CRATES +=	wait-timeout	0.2.1	# MIT/Apache-2.0
MODCARGO_CRATES +=	walkdir	2.5.0	# Unlicense/MIT
MODCARGO_CRATES +=	wasi	0.11.1+wasi-snapshot-preview1	# Apache-2.0 WITH LLVM-exception OR Apache-2.0 OR MIT
MODCARGO_CRATES +=	wasi	0.14.7+wasi-0.2.4	# Apache-2.0 WITH LLVM-exception OR Apache-2.0 OR MIT
MODCARGO_CRATES +=	wasip2	1.0.1+wasi-0.2.4	# Apache-2.0 WITH LLVM-exception OR Apache-2.0 OR MIT
MODCARGO_CRATES +=	wasm-bindgen	0.2.103	# MIT OR Apache-2.0
MODCARGO_CRATES +=	wasm-bindgen-backend	0.2.103	# MIT OR Apache-2.0
MODCARGO_CRATES +=	wasm-bindgen-futures	0.4.53	# MIT OR Apache-2.0
MODCARGO_CRATES +=	wasm-bindgen-macro	0.2.103	# MIT OR Apache-2.0
MODCARGO_CRATES +=	wasm-bindgen-macro-support	0.2.103	# MIT OR Apache-2.0
MODCARGO_CRATES +=	wasm-bindgen-shared	0.2.103	# MIT OR Apache-2.0
MODCARGO_CRATES +=	wasm-bindgen-test	0.3.53	# MIT OR Apache-2.0
MODCARGO_CRATES +=	wasm-bindgen-test-macro	0.3.53	# MIT OR Apache-2.0
MODCARGO_CRATES +=	web-sys	0.3.80	# MIT OR Apache-2.0
MODCARGO_CRATES +=	web-time	1.1.0	# MIT OR Apache-2.0
MODCARGO_CRATES +=	which	8.0.0	# MIT
MODCARGO_CRATES +=	wild	2.2.1	# Apache-2.0 OR MIT
MODCARGO_CRATES +=	winapi-util	0.1.11	# Unlicense OR MIT
MODCARGO_CRATES +=	windows-core	0.62.0	# MIT OR Apache-2.0
MODCARGO_CRATES +=	windows-implement	0.60.0	# MIT OR Apache-2.0
MODCARGO_CRATES +=	windows-interface	0.59.1	# MIT OR Apache-2.0
MODCARGO_CRATES +=	windows-link	0.1.3	# MIT OR Apache-2.0
MODCARGO_CRATES +=	windows-link	0.2.0	# MIT OR Apache-2.0
MODCARGO_CRATES +=	windows-result	0.4.0	# MIT OR Apache-2.0
MODCARGO_CRATES +=	windows-strings	0.5.0	# MIT OR Apache-2.0
MODCARGO_CRATES +=	windows-sys	0.52.0	# MIT OR Apache-2.0
MODCARGO_CRATES +=	windows-sys	0.59.0	# MIT OR Apache-2.0
MODCARGO_CRATES +=	windows-sys	0.60.2	# MIT OR Apache-2.0
MODCARGO_CRATES +=	windows-sys	0.61.0	# MIT OR Apache-2.0
MODCARGO_CRATES +=	windows-targets	0.52.6	# MIT OR Apache-2.0
MODCARGO_CRATES +=	windows-targets	0.53.3	# MIT OR Apache-2.0
MODCARGO_CRATES +=	windows_aarch64_gnullvm	0.52.6	# MIT OR Apache-2.0
MODCARGO_CRATES +=	windows_aarch64_gnullvm	0.53.0	# MIT OR Apache-2.0
MODCARGO_CRATES +=	windows_aarch64_msvc	0.52.6	# MIT OR Apache-2.0
MODCARGO_CRATES +=	windows_aarch64_msvc	0.53.0	# MIT OR Apache-2.0
MODCARGO_CRATES +=	windows_i686_gnu	0.52.6	# MIT OR Apache-2.0
MODCARGO_CRATES +=	windows_i686_gnu	0.53.0	# MIT OR Apache-2.0
MODCARGO_CRATES +=	windows_i686_gnullvm	0.52.6	# MIT OR Apache-2.0
MODCARGO_CRATES +=	windows_i686_gnullvm	0.53.0	# MIT OR Apache-2.0
MODCARGO_CRATES +=	windows_i686_msvc	0.52.6	# MIT OR Apache-2.0
MODCARGO_CRATES +=	windows_i686_msvc	0.53.0	# MIT OR Apache-2.0
MODCARGO_CRATES +=	windows_x86_64_gnu	0.52.6	# MIT OR Apache-2.0
MODCARGO_CRATES +=	windows_x86_64_gnu	0.53.0	# MIT OR Apache-2.0
MODCARGO_CRATES +=	windows_x86_64_gnullvm	0.52.6	# MIT OR Apache-2.0
MODCARGO_CRATES +=	windows_x86_64_gnullvm	0.53.0	# MIT OR Apache-2.0
MODCARGO_CRATES +=	windows_x86_64_msvc	0.52.6	# MIT OR Apache-2.0
MODCARGO_CRATES +=	windows_x86_64_msvc	0.53.0	# MIT OR Apache-2.0
MODCARGO_CRATES +=	winnow	0.7.13	# MIT
MODCARGO_CRATES +=	winsafe	0.0.19	# MIT
MODCARGO_CRATES +=	wit-bindgen	0.46.0	# Apache-2.0 WITH LLVM-exception OR Apache-2.0 OR MIT
MODCARGO_CRATES +=	writeable	0.6.1	# Unicode-3.0
MODCARGO_CRATES +=	wyz	0.5.1	# MIT
MODCARGO_CRATES +=	yansi	1.0.1	# MIT OR Apache-2.0
MODCARGO_CRATES +=	yoke	0.8.0	# Unicode-3.0
MODCARGO_CRATES +=	yoke-derive	0.8.0	# Unicode-3.0
MODCARGO_CRATES +=	zerocopy	0.8.27	# BSD-2-Clause OR Apache-2.0 OR MIT
MODCARGO_CRATES +=	zerocopy-derive	0.8.27	# BSD-2-Clause OR Apache-2.0 OR MIT
MODCARGO_CRATES +=	zerofrom	0.1.6	# Unicode-3.0
MODCARGO_CRATES +=	zerofrom-derive	0.1.6	# Unicode-3.0
MODCARGO_CRATES +=	zerotrie	0.2.2	# Unicode-3.0
MODCARGO_CRATES +=	zerovec	0.11.4	# Unicode-3.0
MODCARGO_CRATES +=	zerovec-derive	0.11.1	# Unicode-3.0
MODCARGO_CRATES +=	zip	0.6.6	# MIT
MODCARGO_CRATES +=	zstd	0.11.2+zstd.1.5.2	# MIT
MODCARGO_CRATES +=	zstd-safe	5.0.2+zstd.1.5.2	# MIT/Apache-2.0
MODCARGO_CRATES +=	zstd-sys	2.0.16+zstd.1.5.7	# MIT/Apache-2.0
