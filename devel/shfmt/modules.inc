MODGO_MODULES =	\
	github.com/creack/pty		 v1.1.17 \
	github.com/frankban/quicktest	 v1.14.0 \
	github.com/google/go-cmp	 v0.5.6 \
	github.com/google/renameio	 v1.0.1 \
	github.com/kr/pretty		 v0.3.0 \
	github.com/kr/pty		 v1.1.1 \
	github.com/kr/text		 v0.2.0 \
	github.com/pkg/diff		 v0.0.0-20210226163009-20ebb0f2a09e \
	github.com/rogpeppe/go-internal	 v1.8.1 \
	golang.org/x/sync		 v0.0.0-20210220032951-036812b2e83c \
	golang.org/x/sys		 v0.0.0-20211216021012-1d35b9e2eb4e \
	golang.org/x/term		 v0.0.0-20210927222741-03fcf44c2211 \
	golang.org/x/xerrors		 v0.0.0-20200804184101-5ec99f83aff1 \
	gopkg.in/check.v1		 v1.0.0-20180628173108-788fd7840127 \
	gopkg.in/errgo.v2		 v2.1.0 \
	mvdan.cc/editorconfig		 v0.2.0

MODGO_MODFILES =	\
	github.com/creack/pty		 v1.1.9 \
	github.com/kr/pretty		 v0.1.0 \
	github.com/kr/text		 v0.1.0 \
	github.com/rogpeppe/go-internal	 v1.6.1 \
	golang.org/x/sys		 v0.0.0-20210615035016-665e8c7367d1 \
	golang.org/x/xerrors		 v0.0.0-20191204190536-9bdfabe68543

