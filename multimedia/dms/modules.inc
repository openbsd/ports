MODGO_MODULES =	\
	github.com/anacrolix/envpprof	 v1.0.0 \
	github.com/anacrolix/ffprobe	 v1.1.0 \
	github.com/anacrolix/generics	 v0.0.1 \
	github.com/anacrolix/log	 v0.15.2 \
	github.com/anacrolix/missinggo	 v1.1.0 \
	github.com/bradfitz/iter	 v0.0.0-20140124041915-454541ec3da2 \
	github.com/davecgh/go-spew	 v1.1.1 \
	github.com/frankban/quicktest	 v1.14.4 \
	github.com/google/go-cmp	 v0.6.0 \
	github.com/kr/pretty		 v0.3.1 \
	github.com/kr/text		 v0.2.0 \
	github.com/nfnt/resize		 v0.0.0-20180221191011-83c6a9932646 \
	github.com/pmezard/go-difflib	 v1.0.0 \
	github.com/rogpeppe/go-internal	 v1.9.0 \
	github.com/stretchr/testify	 v1.8.1 \
	golang.org/x/crypto		 v0.24.0 \
	golang.org/x/exp		 v0.0.0-20240613232115-7f521ea00fb8 \
	golang.org/x/mod		 v0.18.0 \
	golang.org/x/net		 v0.26.0 \
	golang.org/x/sync		 v0.7.0 \
	golang.org/x/sys		 v0.21.0 \
	golang.org/x/term		 v0.21.0 \
	golang.org/x/text		 v0.16.0 \
	golang.org/x/tools		 v0.22.0 \
	gopkg.in/check.v1		 v1.0.0-20190902080502-41f04d3bba15 \
	gopkg.in/yaml.v3		 v3.0.1

MODGO_MODFILES =	\
	github.com/anacrolix/generics	 v0.0.0-20230113004304-d6428d516633 \
	github.com/davecgh/go-spew	 v1.1.0 \
	github.com/google/go-cmp	 v0.5.9 \
	github.com/stretchr/testify	 v1.3.0 \
	golang.org/x/exp		 v0.0.0-20220428152302-39d4317da171

