MODCARGO_CRATES +=	addr2line	0.26.1	# Apache-2.0 OR MIT
MODCARGO_CRATES +=	adler2	2.0.1	# 0BSD OR MIT OR Apache-2.0
MODCARGO_CRATES +=	aho-corasick	1.1.4	# Unlicense OR MIT
MODCARGO_CRATES +=	alloc-no-stdlib	2.0.4	# BSD-3-Clause
MODCARGO_CRATES +=	alloc-no-stdlib	3.0.0	# BSD-3-Clause
MODCARGO_CRATES +=	alloc-stdlib	0.2.4	# BSD-3-Clause
MODCARGO_CRATES +=	alloc-stdlib	0.3.0	# BSD-3-Clause
MODCARGO_CRATES +=	allocator-api2	0.2.21	# MIT OR Apache-2.0
MODCARGO_CRATES +=	ambient-authority	0.0.2	# Apache-2.0 WITH LLVM-exception OR Apache-2.0 OR MIT
MODCARGO_CRATES +=	android_system_properties	0.1.5	# MIT/Apache-2.0
MODCARGO_CRATES +=	anstream	1.0.0	# MIT OR Apache-2.0
MODCARGO_CRATES +=	anstyle	1.0.14	# MIT OR Apache-2.0
MODCARGO_CRATES +=	anstyle-parse	1.0.0	# MIT OR Apache-2.0
MODCARGO_CRATES +=	anstyle-query	1.1.5	# MIT OR Apache-2.0
MODCARGO_CRATES +=	anstyle-wincon	3.0.11	# MIT OR Apache-2.0
MODCARGO_CRATES +=	anyhow	1.0.104	# MIT OR Apache-2.0
MODCARGO_CRATES +=	arbitrary	1.4.2	# MIT OR Apache-2.0
MODCARGO_CRATES +=	arraydeque	0.5.1	# MIT/Apache-2.0
MODCARGO_CRATES +=	async-compression	0.4.43	# MIT OR Apache-2.0
MODCARGO_CRATES +=	async-trait	0.1.92	# MIT OR Apache-2.0
MODCARGO_CRATES +=	atoi	2.0.0	# MIT
MODCARGO_CRATES +=	atomic-waker	1.1.2	# Apache-2.0 OR MIT
MODCARGO_CRATES +=	autocfg	1.5.1	# Apache-2.0 OR MIT
MODCARGO_CRATES +=	aws-lc-rs	1.18.1	# ISC AND (Apache-2.0 OR ISC)
MODCARGO_CRATES +=	aws-lc-sys	0.45.0	# ISC AND (Apache-2.0 OR ISC) AND Apache-2.0 AND MIT AND BSD-3-Clause AND (Apache-2.0 OR ISC OR MIT) AND (Apache-2.0 OR ISC OR MIT-0)
MODCARGO_CRATES +=	axum	0.8.9	# MIT
MODCARGO_CRATES +=	axum-core	0.5.6	# MIT
MODCARGO_CRATES +=	axum-extra	0.12.6	# MIT
MODCARGO_CRATES +=	axum-macros	0.5.1	# MIT
MODCARGO_CRATES +=	base64	0.22.1	# MIT OR Apache-2.0
MODCARGO_CRATES +=	base64	0.23.1	# MIT OR Apache-2.0
MODCARGO_CRATES +=	bit-set	0.8.0	# Apache-2.0 OR MIT
MODCARGO_CRATES +=	bit-vec	0.8.0	# Apache-2.0 OR MIT
MODCARGO_CRATES +=	bitflags	2.13.2	# MIT OR Apache-2.0
MODCARGO_CRATES +=	block-buffer	0.10.4	# MIT OR Apache-2.0
MODCARGO_CRATES +=	block-buffer	0.12.1	# MIT OR Apache-2.0
MODCARGO_CRATES +=	blurhash	0.2.3	# Apache-2.0/MIT
MODCARGO_CRATES +=	brotli	8.0.4	# BSD-3-Clause AND MIT
MODCARGO_CRATES +=	brotli	9.0.0	# BSD-3-Clause AND MIT
MODCARGO_CRATES +=	brotli-decompressor	5.0.3	# BSD-3-Clause/MIT
MODCARGO_CRATES +=	brotli-decompressor	6.0.1	# BSD-3-Clause/MIT
MODCARGO_CRATES +=	bumpalo	3.20.3	# MIT OR Apache-2.0
MODCARGO_CRATES +=	bytemuck	1.25.2	# Zlib OR Apache-2.0 OR MIT
MODCARGO_CRATES +=	byteorder	1.5.0	# Unlicense OR MIT
MODCARGO_CRATES +=	byteorder-lite	0.1.0	# Unlicense OR MIT
MODCARGO_CRATES +=	bytes	1.12.1	# MIT
MODCARGO_CRATES +=	cap-primitives	4.0.3	# Apache-2.0 WITH LLVM-exception OR Apache-2.0 OR MIT
MODCARGO_CRATES +=	cc	1.3.0	# MIT OR Apache-2.0
MODCARGO_CRATES +=	cfg-if	1.0.4	# MIT OR Apache-2.0
MODCARGO_CRATES +=	cfg_aliases	0.2.2	# MIT
MODCARGO_CRATES +=	chacha20	0.10.1	# MIT OR Apache-2.0
MODCARGO_CRATES +=	chardetng	0.1.17	# Apache-2.0 OR MIT
MODCARGO_CRATES +=	chrono	0.4.45	# MIT OR Apache-2.0
MODCARGO_CRATES +=	clap	4.6.7	# MIT OR Apache-2.0
MODCARGO_CRATES +=	clap_builder	4.6.7	# MIT OR Apache-2.0
MODCARGO_CRATES +=	clap_derive	4.6.7	# MIT OR Apache-2.0
MODCARGO_CRATES +=	clap_lex	1.1.0	# MIT OR Apache-2.0
MODCARGO_CRATES +=	cmake	0.1.58	# MIT OR Apache-2.0
MODCARGO_CRATES +=	cmov	0.5.4	# Apache-2.0 OR MIT
MODCARGO_CRATES +=	cobs	0.3.0	# MIT OR Apache-2.0
MODCARGO_CRATES +=	colorchoice	1.0.5	# MIT OR Apache-2.0
MODCARGO_CRATES +=	combine	4.6.8	# MIT
MODCARGO_CRATES +=	compression-codecs	0.4.43	# MIT OR Apache-2.0
MODCARGO_CRATES +=	compression-core	0.4.33	# MIT OR Apache-2.0
MODCARGO_CRATES +=	concurrent-queue	2.5.0	# Apache-2.0 OR MIT
MODCARGO_CRATES +=	config	0.15.26	# MIT OR Apache-2.0
MODCARGO_CRATES +=	console	0.16.4	# MIT
MODCARGO_CRATES +=	const-oid	0.10.2	# Apache-2.0 OR MIT
MODCARGO_CRATES +=	const-random	0.1.18	# MIT OR Apache-2.0
MODCARGO_CRATES +=	const-random-macro	0.1.16	# MIT OR Apache-2.0
MODCARGO_CRATES +=	convert_case	0.6.0	# MIT
MODCARGO_CRATES +=	core-foundation	0.10.1	# MIT OR Apache-2.0
MODCARGO_CRATES +=	core-foundation-sys	0.8.7	# MIT OR Apache-2.0
MODCARGO_CRATES +=	cpp_demangle	0.5.1	# MIT OR Apache-2.0
MODCARGO_CRATES +=	cpufeatures	0.2.17	# MIT OR Apache-2.0
MODCARGO_CRATES +=	cpufeatures	0.3.0	# MIT OR Apache-2.0
MODCARGO_CRATES +=	cranelift-assembler-x64	0.136.0	# Apache-2.0 WITH LLVM-exception
MODCARGO_CRATES +=	cranelift-assembler-x64-meta	0.136.0	# Apache-2.0 WITH LLVM-exception
MODCARGO_CRATES +=	cranelift-bforest	0.136.0	# Apache-2.0 WITH LLVM-exception
MODCARGO_CRATES +=	cranelift-bitset	0.136.0	# Apache-2.0 WITH LLVM-exception
MODCARGO_CRATES +=	cranelift-codegen	0.136.0	# Apache-2.0 WITH LLVM-exception
MODCARGO_CRATES +=	cranelift-codegen-meta	0.136.0	# Apache-2.0 WITH LLVM-exception
MODCARGO_CRATES +=	cranelift-codegen-shared	0.136.0	# Apache-2.0 WITH LLVM-exception
MODCARGO_CRATES +=	cranelift-control	0.136.0	# Apache-2.0 WITH LLVM-exception
MODCARGO_CRATES +=	cranelift-entity	0.136.0	# Apache-2.0 WITH LLVM-exception
MODCARGO_CRATES +=	cranelift-frontend	0.136.0	# Apache-2.0 WITH LLVM-exception
MODCARGO_CRATES +=	cranelift-isle	0.136.0	# Apache-2.0 WITH LLVM-exception
MODCARGO_CRATES +=	cranelift-native	0.136.0	# Apache-2.0 WITH LLVM-exception
MODCARGO_CRATES +=	cranelift-srcgen	0.136.0	# Apache-2.0 WITH LLVM-exception
MODCARGO_CRATES +=	crc	3.4.0	# MIT OR Apache-2.0
MODCARGO_CRATES +=	crc-catalog	2.5.0	# MIT OR Apache-2.0
MODCARGO_CRATES +=	crc32fast	1.5.2	# MIT OR Apache-2.0
MODCARGO_CRATES +=	crossbeam-channel	0.5.16	# MIT OR Apache-2.0
MODCARGO_CRATES +=	crossbeam-deque	0.8.7	# MIT OR Apache-2.0
MODCARGO_CRATES +=	crossbeam-epoch	0.9.20	# MIT OR Apache-2.0
MODCARGO_CRATES +=	crossbeam-queue	0.3.13	# MIT OR Apache-2.0
MODCARGO_CRATES +=	crossbeam-utils	0.8.22	# MIT OR Apache-2.0
MODCARGO_CRATES +=	crunchy	0.2.4	# MIT
MODCARGO_CRATES +=	crypto-common	0.1.7	# MIT OR Apache-2.0
MODCARGO_CRATES +=	crypto-common	0.2.2	# MIT OR Apache-2.0
MODCARGO_CRATES +=	ctutils	0.4.2	# Apache-2.0 OR MIT
MODCARGO_CRATES +=	data-encoding	2.11.0	# MIT
MODCARGO_CRATES +=	debugid	0.8.0	# Apache-2.0
MODCARGO_CRATES +=	deranged	0.5.8	# MIT OR Apache-2.0
MODCARGO_CRATES +=	derive_arbitrary	1.4.2	# MIT OR Apache-2.0
MODCARGO_CRATES +=	digest	0.10.7	# MIT OR Apache-2.0
MODCARGO_CRATES +=	digest	0.11.3	# MIT OR Apache-2.0
MODCARGO_CRATES +=	directories-next	2.0.0	# MIT OR Apache-2.0
MODCARGO_CRATES +=	dirs-sys-next	0.1.2	# MIT OR Apache-2.0
MODCARGO_CRATES +=	displaydoc	0.2.6	# MIT OR Apache-2.0
MODCARGO_CRATES +=	dlv-list	0.5.2	# MIT OR Apache-2.0
MODCARGO_CRATES +=	dotenvy	0.15.7	# MIT
MODCARGO_CRATES +=	dunce	1.0.5	# CC0-1.0 OR MIT-0 OR Apache-2.0
MODCARGO_CRATES +=	either	1.16.0	# MIT OR Apache-2.0
MODCARGO_CRATES +=	embedded-io	0.4.0	# MIT OR Apache-2.0
MODCARGO_CRATES +=	embedded-io	0.6.1	# MIT OR Apache-2.0
MODCARGO_CRATES +=	encode_unicode	1.0.0	# Apache-2.0 OR MIT
MODCARGO_CRATES +=	encoding_rs	0.8.35	# (Apache-2.0 OR MIT) AND BSD-3-Clause
MODCARGO_CRATES +=	equivalent	1.0.2	# Apache-2.0 OR MIT
MODCARGO_CRATES +=	erased-serde	0.4.10	# MIT OR Apache-2.0
MODCARGO_CRATES +=	errno	0.3.14	# MIT OR Apache-2.0
MODCARGO_CRATES +=	etcetera	0.11.0	# MIT OR Apache-2.0
MODCARGO_CRATES +=	event-listener	5.4.1	# Apache-2.0 OR MIT
MODCARGO_CRATES +=	fancy-regex	0.19.2	# MIT
MODCARGO_CRATES +=	fastrand	2.5.0	# Apache-2.0 OR MIT
MODCARGO_CRATES +=	fdeflate	0.3.7	# MIT OR Apache-2.0
MODCARGO_CRATES +=	find-msvc-tools	0.1.9	# MIT OR Apache-2.0
MODCARGO_CRATES +=	fixedbitset	0.4.2	# MIT/Apache-2.0
MODCARGO_CRATES +=	flate2	1.1.10	# MIT OR Apache-2.0
MODCARGO_CRATES +=	flume	0.12.0	# Apache-2.0/MIT
MODCARGO_CRATES +=	fnv	1.0.7	# Apache-2.0 / MIT
MODCARGO_CRATES +=	foldhash	0.2.0	# Zlib
MODCARGO_CRATES +=	form_urlencoded	1.2.2	# MIT OR Apache-2.0
MODCARGO_CRATES +=	fs-set-times	0.20.3	# Apache-2.0 WITH LLVM-exception OR Apache-2.0 OR MIT
MODCARGO_CRATES +=	fs_extra	1.3.0	# MIT
MODCARGO_CRATES +=	fsevent-sys	4.1.0	# MIT
MODCARGO_CRATES +=	futures	0.3.33	# MIT OR Apache-2.0
MODCARGO_CRATES +=	futures-channel	0.3.34	# MIT OR Apache-2.0
MODCARGO_CRATES +=	futures-core	0.3.34	# MIT OR Apache-2.0
MODCARGO_CRATES +=	futures-executor	0.3.33	# MIT OR Apache-2.0
MODCARGO_CRATES +=	futures-intrusive	0.5.0	# MIT OR Apache-2.0
MODCARGO_CRATES +=	futures-io	0.3.34	# MIT OR Apache-2.0
MODCARGO_CRATES +=	futures-macro	0.3.34	# MIT OR Apache-2.0
MODCARGO_CRATES +=	futures-sink	0.3.34	# MIT OR Apache-2.0
MODCARGO_CRATES +=	futures-task	0.3.34	# MIT OR Apache-2.0
MODCARGO_CRATES +=	futures-timer	3.0.4	# MIT/Apache-2.0
MODCARGO_CRATES +=	futures-util	0.3.34	# MIT OR Apache-2.0
MODCARGO_CRATES +=	fxprof-processed-profile	0.8.1	# MIT OR Apache-2.0
MODCARGO_CRATES +=	generic-array	0.14.7	# MIT
MODCARGO_CRATES +=	getrandom	0.2.17	# MIT OR Apache-2.0
MODCARGO_CRATES +=	getrandom	0.3.4	# MIT OR Apache-2.0
MODCARGO_CRATES +=	getrandom	0.4.3	# MIT OR Apache-2.0
MODCARGO_CRATES +=	gimli	0.33.0	# MIT OR Apache-2.0
MODCARGO_CRATES +=	glob	0.3.4	# MIT OR Apache-2.0
MODCARGO_CRATES +=	h2	0.4.15	# MIT
MODCARGO_CRATES +=	hashbrown	0.14.5	# MIT OR Apache-2.0
MODCARGO_CRATES +=	hashbrown	0.16.1	# MIT OR Apache-2.0
MODCARGO_CRATES +=	hashbrown	0.17.1	# MIT OR Apache-2.0
MODCARGO_CRATES +=	hashlink	0.11.1	# MIT OR Apache-2.0
MODCARGO_CRATES +=	headers	0.4.1	# MIT
MODCARGO_CRATES +=	headers-core	0.3.0	# MIT
MODCARGO_CRATES +=	heck	0.5.0	# MIT OR Apache-2.0
MODCARGO_CRATES +=	hex	0.4.3	# MIT OR Apache-2.0
MODCARGO_CRATES +=	hkdf	0.13.0	# MIT OR Apache-2.0
MODCARGO_CRATES +=	hmac	0.13.0	# MIT OR Apache-2.0
MODCARGO_CRATES +=	http	1.4.2	# MIT OR Apache-2.0
MODCARGO_CRATES +=	http-body	1.1.0	# MIT
MODCARGO_CRATES +=	http-body-util	0.1.4	# MIT
MODCARGO_CRATES +=	http-range-header	0.4.2	# MIT
MODCARGO_CRATES +=	httparse	1.10.1	# MIT OR Apache-2.0
MODCARGO_CRATES +=	httpdate	1.0.3	# MIT OR Apache-2.0
MODCARGO_CRATES +=	hybrid-array	0.4.15	# MIT OR Apache-2.0
MODCARGO_CRATES +=	hyper	1.11.0	# MIT
MODCARGO_CRATES +=	hyper-rustls	0.27.9	# Apache-2.0 OR ISC OR MIT
MODCARGO_CRATES +=	hyper-timeout	0.5.2	# MIT OR Apache-2.0
MODCARGO_CRATES +=	hyper-util	0.1.20	# MIT
MODCARGO_CRATES +=	iana-time-zone	0.1.65	# MIT OR Apache-2.0
MODCARGO_CRATES +=	iana-time-zone-haiku	0.1.2	# MIT OR Apache-2.0
MODCARGO_CRATES +=	icu_casemap	2.3.0	# Unicode-3.0
MODCARGO_CRATES +=	icu_casemap_data	2.3.0	# Unicode-3.0
MODCARGO_CRATES +=	icu_collator	2.3.1	# Unicode-3.0
MODCARGO_CRATES +=	icu_collator_data	2.3.0	# Unicode-3.0
MODCARGO_CRATES +=	icu_collections	2.3.0	# Unicode-3.0
MODCARGO_CRATES +=	icu_locale_core	2.3.0	# Unicode-3.0
MODCARGO_CRATES +=	icu_locale_fallback	2.3.0	# Unicode-3.0
MODCARGO_CRATES +=	icu_locale_fallback_data	2.3.0	# Unicode-3.0
MODCARGO_CRATES +=	icu_normalizer	2.3.0	# Unicode-3.0
MODCARGO_CRATES +=	icu_normalizer_data	2.3.0	# Unicode-3.0
MODCARGO_CRATES +=	icu_properties	2.3.0	# Unicode-3.0
MODCARGO_CRATES +=	icu_properties_data	2.3.0	# Unicode-3.0
MODCARGO_CRATES +=	icu_provider	2.3.1	# Unicode-3.0
MODCARGO_CRATES +=	id-arena	2.3.0	# MIT/Apache-2.0
MODCARGO_CRATES +=	idna	1.1.0	# MIT OR Apache-2.0
MODCARGO_CRATES +=	idna_adapter	1.2.2	# Apache-2.0 OR MIT
MODCARGO_CRATES +=	if-addrs	0.15.0	# MIT OR BSD-3-Clause
MODCARGO_CRATES +=	image	0.25.10	# MIT OR Apache-2.0
MODCARGO_CRATES +=	image-webp	0.2.4	# MIT OR Apache-2.0
MODCARGO_CRATES +=	indexmap	2.14.0	# Apache-2.0 OR MIT
MODCARGO_CRATES +=	inotify	0.11.4	# ISC
MODCARGO_CRATES +=	inotify-sys	0.1.8	# ISC
MODCARGO_CRATES +=	insta	1.48.0	# Apache-2.0
MODCARGO_CRATES +=	io-extras	0.19.0	# Apache-2.0 WITH LLVM-exception OR Apache-2.0 OR MIT
MODCARGO_CRATES +=	io-lifetimes	2.0.4	# Apache-2.0 WITH LLVM-exception OR Apache-2.0 OR MIT
MODCARGO_CRATES +=	io-lifetimes	3.0.1	# Apache-2.0 WITH LLVM-exception OR Apache-2.0 OR MIT
MODCARGO_CRATES +=	ipnet	2.12.0	# MIT OR Apache-2.0
MODCARGO_CRATES +=	is_terminal_polyfill	1.70.2	# MIT OR Apache-2.0
MODCARGO_CRATES +=	itertools	0.14.0	# MIT OR Apache-2.0
MODCARGO_CRATES +=	itoa	1.0.18	# MIT OR Apache-2.0
MODCARGO_CRATES +=	ittapi	0.4.0	# GPL-2.0-only OR BSD-3-Clause
MODCARGO_CRATES +=	ittapi-sys	0.4.0	# GPL-2.0-only OR BSD-3-Clause
MODCARGO_CRATES +=	jni	0.22.4	# MIT OR Apache-2.0
MODCARGO_CRATES +=	jni-macros	0.22.4	# MIT OR Apache-2.0
MODCARGO_CRATES +=	jni-sys	0.4.1	# MIT OR Apache-2.0
MODCARGO_CRATES +=	jni-sys-macros	0.4.1	# MIT OR Apache-2.0
MODCARGO_CRATES +=	jobserver	0.1.35	# MIT OR Apache-2.0
MODCARGO_CRATES +=	jpeg-encoder	0.7.1	# (MIT OR Apache-2.0) AND IJG
MODCARGO_CRATES +=	js-sys	0.3.103	# MIT OR Apache-2.0
MODCARGO_CRATES +=	json5	1.3.1	# MIT
MODCARGO_CRATES +=	kamadak-exif	0.6.1	# BSD-2-Clause
MODCARGO_CRATES +=	kqueue	1.2.1	# MIT
MODCARGO_CRATES +=	kqueue-sys	1.1.2	# MIT
MODCARGO_CRATES +=	lazy_static	1.5.0	# MIT OR Apache-2.0
MODCARGO_CRATES +=	leb128	0.2.7	# MIT OR Apache-2.0
MODCARGO_CRATES +=	leb128fmt	0.1.0	# MIT OR Apache-2.0
MODCARGO_CRATES +=	libc	0.2.189	# MIT OR Apache-2.0
MODCARGO_CRATES +=	libm	0.2.16	# MIT
MODCARGO_CRATES +=	libredox	0.1.18	# MIT
MODCARGO_CRATES +=	libsqlite3-sys	0.37.0	# MIT
MODCARGO_CRATES +=	libwebp-sys	0.9.6	# MIT
MODCARGO_CRATES +=	linux-raw-sys	0.12.1	# Apache-2.0 WITH LLVM-exception OR Apache-2.0 OR MIT
MODCARGO_CRATES +=	litemap	0.8.2	# Unicode-3.0
MODCARGO_CRATES +=	lock_api	0.4.14	# MIT OR Apache-2.0
MODCARGO_CRATES +=	log	0.4.33	# MIT OR Apache-2.0
MODCARGO_CRATES +=	lru-slab	0.1.2	# MIT OR Apache-2.0 OR Zlib
MODCARGO_CRATES +=	mach2	0.6.0	# BSD-2-Clause OR MIT OR Apache-2.0
MODCARGO_CRATES +=	matchers	0.2.0	# MIT
MODCARGO_CRATES +=	matchit	0.8.4	# MIT AND BSD-3-Clause
MODCARGO_CRATES +=	maybe-owned	0.3.4	# MIT OR Apache-2.0
MODCARGO_CRATES +=	md-5	0.11.0	# MIT OR Apache-2.0
MODCARGO_CRATES +=	memchr	2.8.3	# Unlicense OR MIT
MODCARGO_CRATES +=	memfd	0.6.5	# MIT OR Apache-2.0
MODCARGO_CRATES +=	mime	0.3.17	# MIT OR Apache-2.0
MODCARGO_CRATES +=	mime_guess	2.0.5	# MIT
MODCARGO_CRATES +=	miniz_oxide	0.8.9	# MIT OR Zlib OR Apache-2.0
MODCARGO_CRATES +=	miniz_oxide	0.9.1	# MIT OR Zlib OR Apache-2.0
MODCARGO_CRATES +=	mio	1.2.2	# MIT
MODCARGO_CRATES +=	moxcms	0.8.1	# BSD-3-Clause OR Apache-2.0
MODCARGO_CRATES +=	mutate_once	0.1.2	# BSD-2-Clause
MODCARGO_CRATES +=	notify	8.2.0	# CC0-1.0
MODCARGO_CRATES +=	notify-types	2.1.0	# MIT OR Apache-2.0
MODCARGO_CRATES +=	nu-ansi-term	0.50.3	# MIT
MODCARGO_CRATES +=	num-conv	0.2.2	# MIT OR Apache-2.0
MODCARGO_CRATES +=	num-traits	0.2.19	# MIT OR Apache-2.0
MODCARGO_CRATES +=	object	0.40.0	# Apache-2.0 OR MIT
MODCARGO_CRATES +=	once_cell	1.21.4	# MIT OR Apache-2.0
MODCARGO_CRATES +=	once_cell_polyfill	1.70.2	# MIT OR Apache-2.0
MODCARGO_CRATES +=	openssl-probe	0.2.1	# MIT OR Apache-2.0
MODCARGO_CRATES +=	opentelemetry	0.33.0	# Apache-2.0
MODCARGO_CRATES +=	opentelemetry-otlp	0.33.0	# Apache-2.0
MODCARGO_CRATES +=	opentelemetry-prometheus	0.33.0	# Apache-2.0
MODCARGO_CRATES +=	opentelemetry-proto	0.33.0	# Apache-2.0
MODCARGO_CRATES +=	opentelemetry_sdk	0.33.0	# Apache-2.0
MODCARGO_CRATES +=	ordered-multimap	0.7.3	# MIT
MODCARGO_CRATES +=	parking	2.2.1	# Apache-2.0 OR MIT
MODCARGO_CRATES +=	parking_lot	0.12.5	# MIT OR Apache-2.0
MODCARGO_CRATES +=	parking_lot_core	0.9.12	# MIT OR Apache-2.0
MODCARGO_CRATES +=	pathdiff	0.2.3	# MIT/Apache-2.0
MODCARGO_CRATES +=	pbkdf2	0.13.0	# MIT OR Apache-2.0
MODCARGO_CRATES +=	percent-encoding	2.3.2	# MIT OR Apache-2.0
MODCARGO_CRATES +=	petgraph	0.6.5	# MIT OR Apache-2.0
MODCARGO_CRATES +=	pin-project	1.1.13	# Apache-2.0 OR MIT
MODCARGO_CRATES +=	pin-project-internal	1.1.13	# Apache-2.0 OR MIT
MODCARGO_CRATES +=	pin-project-lite	0.2.17	# Apache-2.0 OR MIT
MODCARGO_CRATES +=	pkg-config	0.3.33	# MIT OR Apache-2.0
MODCARGO_CRATES +=	png	0.18.1	# MIT OR Apache-2.0
MODCARGO_CRATES +=	portable-atomic	1.14.0	# Apache-2.0 OR MIT
MODCARGO_CRATES +=	postcard	1.1.3	# MIT OR Apache-2.0
MODCARGO_CRATES +=	potential_utf	0.1.5	# Unicode-3.0
MODCARGO_CRATES +=	powerfmt	0.2.0	# MIT OR Apache-2.0
MODCARGO_CRATES +=	ppv-lite86	0.2.21	# MIT OR Apache-2.0
MODCARGO_CRATES +=	proc-macro-crate	3.5.0	# MIT OR Apache-2.0
MODCARGO_CRATES +=	proc-macro2	1.0.107	# MIT OR Apache-2.0
MODCARGO_CRATES +=	prometheus	0.14.0	# Apache-2.0
MODCARGO_CRATES +=	prost	0.14.4	# Apache-2.0
MODCARGO_CRATES +=	prost-derive	0.14.4	# Apache-2.0
MODCARGO_CRATES +=	prost-types	0.14.4	# Apache-2.0
MODCARGO_CRATES +=	pulley-interpreter	49.0.0	# Apache-2.0 WITH LLVM-exception
MODCARGO_CRATES +=	pulley-macros	49.0.0	# Apache-2.0 WITH LLVM-exception
MODCARGO_CRATES +=	pxfm	0.1.30	# BSD-3-Clause OR Apache-2.0
MODCARGO_CRATES +=	quick-error	2.0.1	# MIT/Apache-2.0
MODCARGO_CRATES +=	quick-xml	0.42.0	# MIT
MODCARGO_CRATES +=	quinn	0.11.11	# MIT OR Apache-2.0
MODCARGO_CRATES +=	quinn-proto	0.11.16	# MIT OR Apache-2.0
MODCARGO_CRATES +=	quinn-udp	0.5.15	# MIT OR Apache-2.0
MODCARGO_CRATES +=	quote	1.0.47	# MIT OR Apache-2.0
MODCARGO_CRATES +=	r-efi	5.3.0	# MIT OR Apache-2.0 OR LGPL-2.1-or-later
MODCARGO_CRATES +=	r-efi	6.0.0	# MIT OR Apache-2.0 OR LGPL-2.1-or-later
MODCARGO_CRATES +=	rand	0.8.7	# MIT OR Apache-2.0
MODCARGO_CRATES +=	rand	0.9.5	# MIT OR Apache-2.0
MODCARGO_CRATES +=	rand	0.10.2	# MIT OR Apache-2.0
MODCARGO_CRATES +=	rand_chacha	0.3.1	# MIT OR Apache-2.0
MODCARGO_CRATES +=	rand_chacha	0.9.0	# MIT OR Apache-2.0
MODCARGO_CRATES +=	rand_core	0.6.4	# MIT OR Apache-2.0
MODCARGO_CRATES +=	rand_core	0.9.5	# MIT OR Apache-2.0
MODCARGO_CRATES +=	rand_core	0.10.1	# MIT OR Apache-2.0
MODCARGO_CRATES +=	rand_pcg	0.10.2	# MIT OR Apache-2.0
MODCARGO_CRATES +=	rayon	1.12.0	# MIT OR Apache-2.0
MODCARGO_CRATES +=	rayon-core	1.13.0	# MIT OR Apache-2.0
MODCARGO_CRATES +=	redox_syscall	0.5.18	# MIT
MODCARGO_CRATES +=	redox_users	0.4.6	# MIT
MODCARGO_CRATES +=	regalloc2	0.15.2	# Apache-2.0 WITH LLVM-exception
MODCARGO_CRATES +=	regex	1.13.1	# MIT OR Apache-2.0
MODCARGO_CRATES +=	regex-automata	0.4.16	# MIT OR Apache-2.0
MODCARGO_CRATES +=	regex-syntax	0.8.11	# MIT OR Apache-2.0
MODCARGO_CRATES +=	relative-path	1.9.3	# MIT OR Apache-2.0
MODCARGO_CRATES +=	reqwest	0.13.5	# MIT OR Apache-2.0
MODCARGO_CRATES +=	ring	0.17.14	# Apache-2.0 AND ISC
MODCARGO_CRATES +=	ron	0.12.2	# MIT OR Apache-2.0
MODCARGO_CRATES +=	rstest	0.27.0	# MIT OR Apache-2.0
MODCARGO_CRATES +=	rstest_macros	0.27.0	# MIT OR Apache-2.0
MODCARGO_CRATES +=	rust-ini	0.21.3	# MIT
MODCARGO_CRATES +=	rustc-demangle	0.1.28	# MIT/Apache-2.0
MODCARGO_CRATES +=	rustc-hash	2.1.3	# Apache-2.0 OR MIT
MODCARGO_CRATES +=	rustc_version	0.4.1	# MIT OR Apache-2.0
MODCARGO_CRATES +=	rustix	1.1.4	# Apache-2.0 WITH LLVM-exception OR Apache-2.0 OR MIT
MODCARGO_CRATES +=	rustix-linux-procfs	0.1.1	# Apache-2.0 WITH LLVM-exception OR Apache-2.0 OR MIT
MODCARGO_CRATES +=	rustls	0.23.42	# Apache-2.0 OR ISC OR MIT
MODCARGO_CRATES +=	rustls-native-certs	0.8.4	# Apache-2.0 OR ISC OR MIT
MODCARGO_CRATES +=	rustls-pki-types	1.15.0	# MIT OR Apache-2.0
MODCARGO_CRATES +=	rustls-platform-verifier	0.7.0	# MIT OR Apache-2.0
MODCARGO_CRATES +=	rustls-platform-verifier-android	0.1.1	# MIT OR Apache-2.0
MODCARGO_CRATES +=	rustls-webpki	0.103.13	# ISC
MODCARGO_CRATES +=	rustversion	1.0.23	# MIT OR Apache-2.0
MODCARGO_CRATES +=	ryu	1.0.23	# Apache-2.0 OR BSL-1.0
MODCARGO_CRATES +=	same-file	1.0.6	# Unlicense/MIT
MODCARGO_CRATES +=	schannel	0.1.29	# MIT
MODCARGO_CRATES +=	scopeguard	1.2.0	# MIT OR Apache-2.0
MODCARGO_CRATES +=	secrecy	0.10.3	# Apache-2.0 OR MIT
MODCARGO_CRATES +=	security-framework	3.7.0	# MIT OR Apache-2.0
MODCARGO_CRATES +=	security-framework-sys	2.17.0	# MIT OR Apache-2.0
MODCARGO_CRATES +=	semver	1.0.28	# MIT OR Apache-2.0
MODCARGO_CRATES +=	serde	1.0.229	# MIT OR Apache-2.0
MODCARGO_CRATES +=	serde-untagged	0.1.9	# MIT OR Apache-2.0
MODCARGO_CRATES +=	serde_core	1.0.229	# MIT OR Apache-2.0
MODCARGO_CRATES +=	serde_derive	1.0.229	# MIT OR Apache-2.0
MODCARGO_CRATES +=	serde_json	1.0.151	# MIT OR Apache-2.0
MODCARGO_CRATES +=	serde_path_to_error	0.1.20	# MIT OR Apache-2.0
MODCARGO_CRATES +=	serde_spanned	1.1.1	# MIT OR Apache-2.0
MODCARGO_CRATES +=	serde_urlencoded	0.7.1	# MIT/Apache-2.0
MODCARGO_CRATES +=	sha1	0.10.7	# MIT OR Apache-2.0
MODCARGO_CRATES +=	sha1	0.11.0	# MIT OR Apache-2.0
MODCARGO_CRATES +=	sha1_smol	1.0.1	# BSD-3-Clause
MODCARGO_CRATES +=	sha2	0.10.9	# MIT OR Apache-2.0
MODCARGO_CRATES +=	sha2	0.11.0	# MIT OR Apache-2.0
MODCARGO_CRATES +=	sharded-slab	0.1.7	# MIT
MODCARGO_CRATES +=	shlex	1.3.0	# MIT OR Apache-2.0
MODCARGO_CRATES +=	shlex	2.0.1	# MIT OR Apache-2.0
MODCARGO_CRATES +=	signal-hook-registry	1.4.8	# MIT OR Apache-2.0
MODCARGO_CRATES +=	simd-adler32	0.3.10	# MIT
MODCARGO_CRATES +=	simd_cesu8	1.2.0	# Apache-2.0 OR MIT
MODCARGO_CRATES +=	simdutf8	0.1.5	# MIT OR Apache-2.0
MODCARGO_CRATES +=	similar	2.7.0	# Apache-2.0
MODCARGO_CRATES +=	slab	0.4.12	# MIT
MODCARGO_CRATES +=	smallvec	1.15.2	# MIT OR Apache-2.0
MODCARGO_CRATES +=	socket2	0.6.5	# MIT OR Apache-2.0
MODCARGO_CRATES +=	spin	0.9.9	# MIT
MODCARGO_CRATES +=	sqlx	0.9.0	# MIT OR Apache-2.0
MODCARGO_CRATES +=	sqlx-core	0.9.0	# MIT OR Apache-2.0
MODCARGO_CRATES +=	sqlx-macros	0.9.0	# MIT OR Apache-2.0
MODCARGO_CRATES +=	sqlx-macros-core	0.9.0	# MIT OR Apache-2.0
MODCARGO_CRATES +=	sqlx-mysql	0.9.0	# MIT OR Apache-2.0
MODCARGO_CRATES +=	sqlx-postgres	0.9.0	# MIT OR Apache-2.0
MODCARGO_CRATES +=	sqlx-sqlite	0.9.0	# MIT OR Apache-2.0
MODCARGO_CRATES +=	stable_deref_trait	1.2.1	# MIT OR Apache-2.0
MODCARGO_CRATES +=	stringprep	0.1.5	# MIT/Apache-2.0
MODCARGO_CRATES +=	strsim	0.11.1	# MIT
MODCARGO_CRATES +=	subtle	2.6.1	# BSD-3-Clause
MODCARGO_CRATES +=	symlink	0.1.0	# MIT/Apache-2.0
MODCARGO_CRATES +=	syn	2.0.119	# MIT OR Apache-2.0
MODCARGO_CRATES +=	syn	3.0.3	# MIT OR Apache-2.0
MODCARGO_CRATES +=	sync_wrapper	1.0.2	# Apache-2.0
MODCARGO_CRATES +=	synstructure	0.13.2	# MIT
MODCARGO_CRATES +=	target-lexicon	0.13.5	# Apache-2.0 WITH LLVM-exception
MODCARGO_CRATES +=	tempfile	3.27.0	# MIT OR Apache-2.0
MODCARGO_CRATES +=	termcolor	1.4.1	# Unlicense OR MIT
MODCARGO_CRATES +=	thiserror	1.0.69	# MIT OR Apache-2.0
MODCARGO_CRATES +=	thiserror	2.0.21	# MIT OR Apache-2.0
MODCARGO_CRATES +=	thiserror-impl	1.0.69	# MIT OR Apache-2.0
MODCARGO_CRATES +=	thiserror-impl	2.0.21	# MIT OR Apache-2.0
MODCARGO_CRATES +=	thread_local	1.1.10	# MIT OR Apache-2.0
MODCARGO_CRATES +=	tikv-jemalloc-sys	0.7.1+5.3.1-0-g81034ce1f1373e37dc865038e1bc8eeecf559ce8	# MIT/Apache-2.0
MODCARGO_CRATES +=	tikv-jemallocator	0.7.0	# MIT/Apache-2.0
MODCARGO_CRATES +=	time	0.3.54	# MIT OR Apache-2.0
MODCARGO_CRATES +=	time-core	0.1.9	# MIT OR Apache-2.0
MODCARGO_CRATES +=	time-macros	0.2.32	# MIT OR Apache-2.0
MODCARGO_CRATES +=	tiny-keccak	2.0.2	# CC0-1.0
MODCARGO_CRATES +=	tinystr	0.8.4	# Unicode-3.0
MODCARGO_CRATES +=	tinyvec	1.12.0	# Zlib OR Apache-2.0 OR MIT
MODCARGO_CRATES +=	tinyvec_macros	0.1.1	# MIT OR Apache-2.0 OR Zlib
MODCARGO_CRATES +=	tokio	1.53.1	# MIT
MODCARGO_CRATES +=	tokio-macros	2.7.1	# MIT
MODCARGO_CRATES +=	tokio-rustls	0.26.4	# MIT OR Apache-2.0
MODCARGO_CRATES +=	tokio-stream	0.1.19	# MIT
MODCARGO_CRATES +=	tokio-tungstenite	0.29.0	# MIT
MODCARGO_CRATES +=	tokio-tungstenite	0.30.0	# MIT
MODCARGO_CRATES +=	tokio-util	0.7.19	# MIT
MODCARGO_CRATES +=	toml	1.1.6+spec-1.1.0	# MIT OR Apache-2.0
MODCARGO_CRATES +=	toml_datetime	1.1.1+spec-1.1.0	# MIT OR Apache-2.0
MODCARGO_CRATES +=	toml_edit	0.25.13+spec-1.1.0	# MIT OR Apache-2.0
MODCARGO_CRATES +=	toml_parser	1.1.3+spec-1.1.0	# MIT OR Apache-2.0
MODCARGO_CRATES +=	toml_writer	1.1.2+spec-1.1.0	# MIT OR Apache-2.0
MODCARGO_CRATES +=	tonic	0.14.6	# MIT
MODCARGO_CRATES +=	tonic-prost	0.14.6	# MIT
MODCARGO_CRATES +=	tonic-types	0.14.6	# MIT
MODCARGO_CRATES +=	tower	0.5.3	# MIT
MODCARGO_CRATES +=	tower-http	0.6.11	# MIT
MODCARGO_CRATES +=	tower-http	0.7.1	# MIT
MODCARGO_CRATES +=	tower-layer	0.3.3	# MIT
MODCARGO_CRATES +=	tower-service	0.3.3	# MIT
MODCARGO_CRATES +=	tracing	0.1.44	# MIT
MODCARGO_CRATES +=	tracing-appender	0.2.5	# MIT
MODCARGO_CRATES +=	tracing-attributes	0.1.31	# MIT
MODCARGO_CRATES +=	tracing-core	0.1.36	# MIT
MODCARGO_CRATES +=	tracing-log	0.2.0	# MIT
MODCARGO_CRATES +=	tracing-opentelemetry	0.34.0	# MIT
MODCARGO_CRATES +=	tracing-serde	0.2.0	# MIT
MODCARGO_CRATES +=	tracing-subscriber	0.3.23	# MIT
MODCARGO_CRATES +=	try-lock	0.2.5	# MIT
MODCARGO_CRATES +=	tungstenite	0.29.0	# MIT OR Apache-2.0
MODCARGO_CRATES +=	tungstenite	0.30.0	# MIT OR Apache-2.0
MODCARGO_CRATES +=	typed-path	0.12.3	# MIT OR Apache-2.0
MODCARGO_CRATES +=	typeid	1.0.3	# MIT OR Apache-2.0
MODCARGO_CRATES +=	typenum	1.20.1	# MIT OR Apache-2.0
MODCARGO_CRATES +=	ucd-trie	0.1.7	# MIT OR Apache-2.0
MODCARGO_CRATES +=	unicase	2.9.0	# MIT OR Apache-2.0
MODCARGO_CRATES +=	unicode-bidi	0.3.18	# MIT OR Apache-2.0
MODCARGO_CRATES +=	unicode-ident	1.0.24	# (MIT OR Apache-2.0) AND Unicode-3.0
MODCARGO_CRATES +=	unicode-normalization	0.1.25	# MIT OR Apache-2.0
MODCARGO_CRATES +=	unicode-properties	0.1.4	# MIT/Apache-2.0
MODCARGO_CRATES +=	unicode-segmentation	1.13.3	# MIT OR Apache-2.0
MODCARGO_CRATES +=	unicode-width	0.2.2	# MIT OR Apache-2.0
MODCARGO_CRATES +=	untrusted	0.9.0	# ISC
MODCARGO_CRATES +=	url	2.5.8	# MIT OR Apache-2.0
MODCARGO_CRATES +=	utf16_iter	1.0.5	# Apache-2.0 OR MIT
MODCARGO_CRATES +=	utf8_iter	1.0.4	# Apache-2.0 OR MIT
MODCARGO_CRATES +=	utf8parse	0.2.2	# Apache-2.0 OR MIT
MODCARGO_CRATES +=	utoipa	6.0.0	# MIT OR Apache-2.0
MODCARGO_CRATES +=	utoipa-gen	6.0.1	# MIT OR Apache-2.0
MODCARGO_CRATES +=	uuid	1.26.1	# Apache-2.0 OR MIT
MODCARGO_CRATES +=	valuable	0.1.1	# MIT
MODCARGO_CRATES +=	vcpkg	0.2.15	# MIT/Apache-2.0
MODCARGO_CRATES +=	version_check	0.9.5	# MIT/Apache-2.0
MODCARGO_CRATES +=	walkdir	2.5.0	# Unlicense/MIT
MODCARGO_CRATES +=	want	0.3.1	# MIT
MODCARGO_CRATES +=	wasi	0.11.1+wasi-snapshot-preview1	# Apache-2.0 WITH LLVM-exception OR Apache-2.0 OR MIT
MODCARGO_CRATES +=	wasip2	1.0.4+wasi-0.2.12	# Apache-2.0 WITH LLVM-exception OR Apache-2.0 OR MIT
MODCARGO_CRATES +=	wasm-bindgen	0.2.126	# MIT OR Apache-2.0
MODCARGO_CRATES +=	wasm-bindgen-futures	0.4.76	# MIT OR Apache-2.0
MODCARGO_CRATES +=	wasm-bindgen-macro	0.2.126	# MIT OR Apache-2.0
MODCARGO_CRATES +=	wasm-bindgen-macro-support	0.2.126	# MIT OR Apache-2.0
MODCARGO_CRATES +=	wasm-bindgen-shared	0.2.126	# MIT OR Apache-2.0
MODCARGO_CRATES +=	wasm-compose	0.258.0	# Apache-2.0 WITH LLVM-exception OR Apache-2.0 OR MIT
MODCARGO_CRATES +=	wasm-encoder	0.258.0	# Apache-2.0 WITH LLVM-exception OR Apache-2.0 OR MIT
MODCARGO_CRATES +=	wasm-encoder	0.259.0	# Apache-2.0 WITH LLVM-exception OR Apache-2.0 OR MIT
MODCARGO_CRATES +=	wasm-metadata	0.258.0	# Apache-2.0 WITH LLVM-exception OR Apache-2.0 OR MIT
MODCARGO_CRATES +=	wasm-streams	0.5.0	# MIT OR Apache-2.0
MODCARGO_CRATES +=	wasmparser	0.258.0	# Apache-2.0 WITH LLVM-exception OR Apache-2.0 OR MIT
MODCARGO_CRATES +=	wasmparser	0.259.0	# Apache-2.0 WITH LLVM-exception OR Apache-2.0 OR MIT
MODCARGO_CRATES +=	wasmprinter	0.258.0	# Apache-2.0 WITH LLVM-exception OR Apache-2.0 OR MIT
MODCARGO_CRATES +=	wasmtime	49.0.0	# Apache-2.0 WITH LLVM-exception
MODCARGO_CRATES +=	wasmtime-environ	49.0.0	# Apache-2.0 WITH LLVM-exception
MODCARGO_CRATES +=	wasmtime-internal-cache	49.0.0	# Apache-2.0 WITH LLVM-exception
MODCARGO_CRATES +=	wasmtime-internal-component-macro	49.0.0	# Apache-2.0 WITH LLVM-exception
MODCARGO_CRATES +=	wasmtime-internal-component-util	49.0.0	# Apache-2.0 WITH LLVM-exception
MODCARGO_CRATES +=	wasmtime-internal-core	49.0.0	# Apache-2.0 WITH LLVM-exception
MODCARGO_CRATES +=	wasmtime-internal-cranelift	49.0.0	# Apache-2.0 WITH LLVM-exception
MODCARGO_CRATES +=	wasmtime-internal-fiber	49.0.0	# Apache-2.0 WITH LLVM-exception
MODCARGO_CRATES +=	wasmtime-internal-jit-debug	49.0.0	# Apache-2.0 WITH LLVM-exception
MODCARGO_CRATES +=	wasmtime-internal-jit-icache-coherence	49.0.0	# Apache-2.0 WITH LLVM-exception
MODCARGO_CRATES +=	wasmtime-internal-unwinder	49.0.0	# Apache-2.0 WITH LLVM-exception
MODCARGO_CRATES +=	wasmtime-internal-versioned-export-macros	49.0.0	# Apache-2.0 WITH LLVM-exception
MODCARGO_CRATES +=	wasmtime-internal-wit-bindgen	49.0.0	# Apache-2.0 WITH LLVM-exception
MODCARGO_CRATES +=	wasmtime-wasi	49.0.0	# Apache-2.0 WITH LLVM-exception
MODCARGO_CRATES +=	wasmtime-wasi-io	49.0.0	# Apache-2.0 WITH LLVM-exception
MODCARGO_CRATES +=	wast	35.0.2	# Apache-2.0 WITH LLVM-exception
MODCARGO_CRATES +=	wast	259.0.0	# Apache-2.0 WITH LLVM-exception OR Apache-2.0 OR MIT
MODCARGO_CRATES +=	wat	1.259.0	# Apache-2.0 WITH LLVM-exception OR Apache-2.0 OR MIT
MODCARGO_CRATES +=	web-sys	0.3.103	# MIT OR Apache-2.0
MODCARGO_CRATES +=	web-time	1.1.0	# MIT OR Apache-2.0
MODCARGO_CRATES +=	webp	0.3.1	# MIT OR Apache-2.0
MODCARGO_CRATES +=	webpki-root-certs	1.0.9	# CDLA-Permissive-2.0
MODCARGO_CRATES +=	webpki-roots	1.0.9	# CDLA-Permissive-2.0
MODCARGO_CRATES +=	whoami	2.1.3	# Apache-2.0 OR BSL-1.0 OR MIT
MODCARGO_CRATES +=	wiggle	49.0.0	# Apache-2.0 WITH LLVM-exception
MODCARGO_CRATES +=	wiggle-generate	49.0.0	# Apache-2.0 WITH LLVM-exception
MODCARGO_CRATES +=	wiggle-macro	49.0.0	# Apache-2.0 WITH LLVM-exception
MODCARGO_CRATES +=	winapi	0.3.9	# MIT/Apache-2.0
MODCARGO_CRATES +=	winapi-i686-pc-windows-gnu	0.4.0	# MIT/Apache-2.0
MODCARGO_CRATES +=	winapi-util	0.1.11	# Unlicense OR MIT
MODCARGO_CRATES +=	winapi-x86_64-pc-windows-gnu	0.4.0	# MIT/Apache-2.0
MODCARGO_CRATES +=	windows-core	0.62.2	# MIT OR Apache-2.0
MODCARGO_CRATES +=	windows-implement	0.60.2	# MIT OR Apache-2.0
MODCARGO_CRATES +=	windows-interface	0.59.3	# MIT OR Apache-2.0
MODCARGO_CRATES +=	windows-link	0.2.1	# MIT OR Apache-2.0
MODCARGO_CRATES +=	windows-result	0.4.1	# MIT OR Apache-2.0
MODCARGO_CRATES +=	windows-strings	0.5.1	# MIT OR Apache-2.0
MODCARGO_CRATES +=	windows-sys	0.52.0	# MIT OR Apache-2.0
MODCARGO_CRATES +=	windows-sys	0.60.2	# MIT OR Apache-2.0
MODCARGO_CRATES +=	windows-sys	0.61.2	# MIT OR Apache-2.0
MODCARGO_CRATES +=	windows-targets	0.52.6	# MIT OR Apache-2.0
MODCARGO_CRATES +=	windows-targets	0.53.5	# MIT OR Apache-2.0
MODCARGO_CRATES +=	windows_aarch64_gnullvm	0.52.6	# MIT OR Apache-2.0
MODCARGO_CRATES +=	windows_aarch64_gnullvm	0.53.1	# MIT OR Apache-2.0
MODCARGO_CRATES +=	windows_aarch64_msvc	0.52.6	# MIT OR Apache-2.0
MODCARGO_CRATES +=	windows_aarch64_msvc	0.53.1	# MIT OR Apache-2.0
MODCARGO_CRATES +=	windows_i686_gnu	0.52.6	# MIT OR Apache-2.0
MODCARGO_CRATES +=	windows_i686_gnu	0.53.1	# MIT OR Apache-2.0
MODCARGO_CRATES +=	windows_i686_gnullvm	0.52.6	# MIT OR Apache-2.0
MODCARGO_CRATES +=	windows_i686_gnullvm	0.53.1	# MIT OR Apache-2.0
MODCARGO_CRATES +=	windows_i686_msvc	0.52.6	# MIT OR Apache-2.0
MODCARGO_CRATES +=	windows_i686_msvc	0.53.1	# MIT OR Apache-2.0
MODCARGO_CRATES +=	windows_x86_64_gnu	0.52.6	# MIT OR Apache-2.0
MODCARGO_CRATES +=	windows_x86_64_gnu	0.53.1	# MIT OR Apache-2.0
MODCARGO_CRATES +=	windows_x86_64_gnullvm	0.52.6	# MIT OR Apache-2.0
MODCARGO_CRATES +=	windows_x86_64_gnullvm	0.53.1	# MIT OR Apache-2.0
MODCARGO_CRATES +=	windows_x86_64_msvc	0.52.6	# MIT OR Apache-2.0
MODCARGO_CRATES +=	windows_x86_64_msvc	0.53.1	# MIT OR Apache-2.0
MODCARGO_CRATES +=	winnow	1.0.4	# MIT
MODCARGO_CRATES +=	winx	0.36.4	# Apache-2.0 WITH LLVM-exception
MODCARGO_CRATES +=	wit-bindgen	0.57.1	# Apache-2.0 WITH LLVM-exception OR Apache-2.0 OR MIT
MODCARGO_CRATES +=	wit-component	0.258.0	# Apache-2.0 WITH LLVM-exception OR Apache-2.0 OR MIT
MODCARGO_CRATES +=	wit-parser	0.258.0	# Apache-2.0 WITH LLVM-exception OR Apache-2.0 OR MIT
MODCARGO_CRATES +=	witx	0.9.1	# Apache-2.0
MODCARGO_CRATES +=	write16	1.0.0	# Apache-2.0 OR MIT
MODCARGO_CRATES +=	writeable	0.6.4	# Unicode-3.0
MODCARGO_CRATES +=	yaml-rust2	0.11.0	# MIT OR Apache-2.0
MODCARGO_CRATES +=	yoke	0.8.3	# Unicode-3.0
MODCARGO_CRATES +=	yoke-derive	0.8.2	# Unicode-3.0
MODCARGO_CRATES +=	zerocopy	0.8.55	# BSD-2-Clause OR Apache-2.0 OR MIT
MODCARGO_CRATES +=	zerocopy-derive	0.8.55	# BSD-2-Clause OR Apache-2.0 OR MIT
MODCARGO_CRATES +=	zerofrom	0.1.8	# Unicode-3.0
MODCARGO_CRATES +=	zerofrom-derive	0.1.7	# Unicode-3.0
MODCARGO_CRATES +=	zeroize	1.9.0	# Apache-2.0 OR MIT
MODCARGO_CRATES +=	zerotrie	0.2.5	# Unicode-3.0
MODCARGO_CRATES +=	zerovec	0.11.8	# Unicode-3.0
MODCARGO_CRATES +=	zerovec-derive	0.11.6	# Unicode-3.0
MODCARGO_CRATES +=	zip	2.4.2	# MIT
MODCARGO_CRATES +=	zip	8.6.0	# MIT
MODCARGO_CRATES +=	zlib-rs	0.6.7	# Zlib
MODCARGO_CRATES +=	zmij	1.0.23	# MIT
MODCARGO_CRATES +=	zopfli	0.8.3	# Apache-2.0
MODCARGO_CRATES +=	zstd	0.13.3	# MIT
MODCARGO_CRATES +=	zstd-safe	7.2.4	# MIT OR Apache-2.0
MODCARGO_CRATES +=	zstd-sys	2.0.16+zstd.1.5.7	# MIT/Apache-2.0
MODCARGO_CRATES +=	zune-core	0.5.1	# MIT OR Apache-2.0 OR Zlib
MODCARGO_CRATES +=	zune-jpeg	0.5.15	# MIT OR Apache-2.0 OR Zlib
