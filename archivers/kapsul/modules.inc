MODGO_MODULES =	\
	codeberg.org/mhofmann/fastcdc				 v1.0.0 \
	github.com/!data!dog/zstd				 v1.5.7 \
	github.com/!hdr!histogram/hdrhistogram-go		 v1.1.2 \
	github.com/!nick!ball/go-aes-key-wrap			 v0.0.0-20170929221519-1c3aa3e4dfc5 \
	github.com/!plakar!korp/go-cdc-chunkers			 v0.0.12 \
	github.com/!plakar!korp/kloset				 v1.0.1-beta.2.0.20250702145050-aafc2807689f \
	github.com/!plakar!korp/plakar				 v1.0.3-devel.c7a66f1.0.20250707144457-ba575d2ae2cd \
	github.com/aclements/go-moremath			 v0.0.0-20210112150236-f10218a38794 \
	github.com/aclements/go-perfevent			 v0.0.0-20240301234650-f7843625020f \
	github.com/alecthomas/assert/v2				 v2.11.0 \
	github.com/alecthomas/chroma				 v0.10.0 \
	github.com/alecthomas/chroma/v2				 v2.19.0 \
	github.com/alecthomas/kingpin/v2			 v2.4.0 \
	github.com/alecthomas/repr				 v0.4.0 \
	github.com/alecthomas/units				 v0.0.0-20211218093645-b94a6e3cc137 \
	github.com/anacrolix/fuse				 v0.3.1 \
	github.com/askeladdk/fastcdc				 v0.0.2 \
	github.com/aws/aws-sdk-go				 v1.44.256 \
	github.com/aymanbagabas/go-osc52/v2			 v2.0.1 \
	github.com/aymanbagabas/go-udiff			 v0.2.0 \
	github.com/aymerick/douceur				 v0.2.0 \
	github.com/beorn7/perks					 v1.0.1 \
	github.com/bits-and-blooms/bitset			 v1.22.0 \
	github.com/cespare/xxhash/v2				 v2.3.0 \
	github.com/charmbracelet/bubbletea			 v1.3.4 \
	github.com/charmbracelet/colorprofile			 v0.3.1 \
	github.com/charmbracelet/glamour			 v0.10.0 \
	github.com/charmbracelet/lipgloss			 v1.1.1-0.20250404203927-76690c660834 \
	github.com/charmbracelet/log				 v0.4.2 \
	github.com/charmbracelet/x/ansi				 v0.9.3 \
	github.com/charmbracelet/x/cellbuf			 v0.0.13 \
	github.com/charmbracelet/x/exp/golden			 v0.0.0-20240815200342-61de596daa2b \
	github.com/charmbracelet/x/exp/slice			 v0.0.0-20250702191427-5bdfc8f2e4ff \
	github.com/charmbracelet/x/term				 v0.2.1 \
	github.com/cockroachdb/crlib				 v0.0.0-20250617202621-0794c595bbe6 \
	github.com/cockroachdb/datadriven			 v1.0.3-0.20240530155848-7682d40af056 \
	github.com/cockroachdb/errors				 v1.12.0 \
	github.com/cockroachdb/fifo				 v0.0.0-20240816210425-c5d0cb0b6fc0 \
	github.com/cockroachdb/logtags				 v0.0.0-20241215232642-bb51bb14a506 \
	github.com/cockroachdb/metamorphic			 v0.0.0-20231108215700-4ba948b56895 \
	github.com/cockroachdb/pebble/v2			 v2.0.6 \
	github.com/cockroachdb/redact				 v1.1.6 \
	github.com/cockroachdb/swiss				 v0.0.0-20251224182025-b0f6560f979b \
	github.com/cockroachdb/tokenbucket			 v0.0.0-20250429170803-42689b6311bb \
	github.com/creack/pty					 v1.1.9 \
	github.com/davecgh/go-spew				 v1.1.2-0.20180830191138-d8f796af33cc \
	github.com/denisbrodbeck/machineid			 v1.0.1 \
	github.com/dlclark/regexp2				 v1.11.5 \
	github.com/dustin/go-humanize				 v1.0.1 \
	github.com/erikgeiser/coninput				 v0.0.0-20211004153227-1c3628e74d0f \
	github.com/fsnotify/fsnotify				 v1.8.0 \
	github.com/gabriel-vasile/mimetype			 v1.4.9 \
	github.com/getsentry/sentry-go				 v0.34.0 \
	github.com/ghemawat/stream				 v0.0.0-20171120220530-696b145b53b9 \
	github.com/go-errors/errors				 v1.4.2 \
	github.com/go-ini/ini					 v1.67.0 \
	github.com/go-logfmt/logfmt				 v0.6.0 \
	github.com/go-playground/locales			 v0.14.1 \
	github.com/go-playground/universal-translator		 v0.18.1 \
	github.com/go-playground/validator/v10			 v10.25.0 \
	github.com/go-viper/mapstructure/v2			 v2.3.0 \
	github.com/gobwas/glob					 v0.2.3 \
	github.com/goccy/go-json				 v0.10.5 \
	github.com/gogo/googleapis				 v1.4.1 \
	github.com/gogo/protobuf				 v1.3.2 \
	github.com/gogo/status					 v1.1.0 \
	github.com/golang-jwt/jwt/v5				 v5.2.2 \
	github.com/golang/protobuf				 v1.5.3 \
	github.com/golang/snappy				 v1.0.0 \
	github.com/google/go-cmp				 v0.7.0 \
	github.com/google/uuid					 v1.6.0 \
	github.com/gorilla/css					 v1.0.1 \
	github.com/guptarohit/asciigraph			 v0.5.5 \
	github.com/hexops/gotextdiff				 v1.0.3 \
	github.com/hydrogen18/memlistener			 v1.0.0 \
	github.com/inconshreveable/mousetrap			 v1.0.0 \
	github.com/johannesboyne/gofakes3			 v0.0.0-20250106100439-5c39aecd6999 \
	github.com/jotfs/fastcdc-go				 v0.2.0 \
	github.com/jpillora/backoff				 v1.0.0 \
	github.com/json-iterator/go				 v1.1.12 \
	github.com/julienschmidt/httprouter			 v1.3.0 \
	github.com/kevinburke/ssh_config			 v1.2.0 \
	github.com/kisielk/errcheck				 v1.5.0 \
	github.com/kisielk/gotool				 v1.0.0 \
	github.com/klauspost/compress				 v1.18.0 \
	github.com/klauspost/cpuid/v2				 v2.2.11 \
	github.com/kr/fs					 v0.1.0 \
	github.com/kr/pretty					 v0.3.1 \
	github.com/kr/text					 v0.2.0 \
	github.com/kylelemons/godebug				 v1.1.0 \
	github.com/leodido/go-urn				 v1.4.0 \
	github.com/lucasb-eyer/go-colorful			 v1.2.0 \
	github.com/mattn/go-isatty				 v0.0.20 \
	github.com/mattn/go-localereader			 v0.0.1 \
	github.com/mattn/go-runewidth				 v0.0.16 \
	github.com/matttproud/golang_protobuf_extensions	 v1.0.4 \
	github.com/microcosm-cc/bluemonday			 v1.0.27 \
	github.com/minio/crc64nvme				 v1.0.1 \
	github.com/minio/md5-simd				 v1.1.2 \
	github.com/minio/minio-go/v7				 v7.0.89 \
	github.com/modern-go/concurrent				 v0.0.0-20180306012644-bacd9c7ef1dd \
	github.com/modern-go/reflect2				 v1.0.2 \
	github.com/muesli/ansi					 v0.0.0-20230316100256-276c6243b2f6 \
	github.com/muesli/cancelreader				 v0.2.2 \
	github.com/muesli/reflow				 v0.3.0 \
	github.com/muesli/termenv				 v0.16.0 \
	github.com/munnerz/goautoneg				 v0.0.0-20191010083416-a7dc8b61c822 \
	github.com/mwitkow/go-conntrack				 v0.0.0-20190716064945-2f068394615f \
	github.com/ncruces/go-strftime				 v0.1.9 \
	github.com/nickball/go-aes-key-wrap			 v0.0.0-20170929221519-1c3aa3e4dfc5 \
	github.com/pelletier/go-toml/v2				 v2.2.3 \
	github.com/pierrec/lz4/v4				 v4.1.22 \
	github.com/pingcap/errors				 v0.11.4 \
	github.com/pkg/diff					 v0.0.0-20210226163009-20ebb0f2a09e \
	github.com/pkg/errors					 v0.9.1 \
	github.com/pkg/sftp					 v1.13.9 \
	github.com/pkg/xattr					 v0.4.12 \
	github.com/pmezard/go-difflib				 v1.0.1-0.20181226105442-5d4384ee4fb2 \
	github.com/prometheus/client_golang			 v1.22.0 \
	github.com/prometheus/client_model			 v0.6.2 \
	github.com/prometheus/common				 v0.65.0 \
	github.com/prometheus/procfs				 v0.17.0 \
	github.com/remyoudompheng/bigfft			 v0.0.0-20230129092748-24d4a6f8daec \
	github.com/restic/chunker				 v0.4.0 \
	github.com/rivo/uniseg					 v0.4.7 \
	github.com/rogpeppe/go-internal				 v1.14.1 \
	github.com/rs/xid					 v1.6.0 \
	github.com/ryszard/goskiplist				 v0.0.0-20150312221310-2dfbae5fcf46 \
	github.com/sagikazarmark/locafero			 v0.9.0 \
	github.com/secsy/goftp					 v0.0.0-20200609142545-aa2de14babf4 \
	github.com/sourcegraph/conc				 v0.3.0 \
	github.com/spf13/afero					 v1.14.0 \
	github.com/spf13/cast					 v1.7.1 \
	github.com/spf13/cobra					 v1.0.0 \
	github.com/spf13/pflag					 v1.0.6 \
	github.com/spf13/viper					 v1.20.1 \
	github.com/stretchr/objx				 v0.5.2 \
	github.com/stretchr/testify				 v1.10.0 \
	github.com/subosito/gotenv				 v1.6.0 \
	github.com/tigerwill90/fastcdc				 v1.2.2 \
	github.com/tink-crypto/tink-go/v2			 v2.4.0 \
	github.com/vmihailenco/msgpack/v5			 v5.4.1 \
	github.com/vmihailenco/tagparser/v2			 v2.0.0 \
	github.com/wagslane/go-password-validator		 v0.3.0 \
	github.com/xhit/go-str2duration/v2			 v2.1.0 \
	github.com/xo/terminfo					 v0.0.0-20220910002029-abceb7e1c41e \
	github.com/yuin/goldmark				 v1.7.12 \
	github.com/yuin/goldmark-emoji				 v1.0.6 \
	github.com/zeebo/assert					 v1.1.0 \
	github.com/zeebo/blake3					 v0.2.4 \
	github.com/zeebo/pcg					 v1.0.1 \
	go.omarpolo.com/ttlmap					 v0.0.0-20231012080932-0154c95c7516 \
	go.shabbyrobe.org/gocovmerge				 v0.0.0-20230507111327-fa4f82cfbf4d \
	go.uber.org/goleak					 v1.3.0 \
	go.uber.org/multierr					 v1.11.0 \
	golang.org/x/crypto					 v0.39.0 \
	golang.org/x/exp					 v0.0.0-20250620022241-b7579e27df2b \
	golang.org/x/mod					 v0.25.0 \
	golang.org/x/net					 v0.41.0 \
	golang.org/x/oauth2					 v0.30.0 \
	golang.org/x/perf					 v0.0.0-20230113213139-801c7ef9e5c5 \
	golang.org/x/sync					 v0.15.0 \
	golang.org/x/sys					 v0.33.0 \
	golang.org/x/telemetry					 v0.0.0-20240521205824-bda55230c457 \
	golang.org/x/term					 v0.32.0 \
	golang.org/x/text					 v0.26.0 \
	golang.org/x/tools					 v0.34.0 \
	golang.org/x/xerrors					 v0.0.0-20200804184101-5ec99f83aff1 \
	google.golang.org/genproto				 v0.0.0-20250603155806-513f23925822 \
	google.golang.org/genproto/googleapis/rpc		 v0.0.0-20250528174236-200df99c418a \
	google.golang.org/grpc					 v1.73.0 \
	google.golang.org/protobuf				 v1.36.6 \
	gopkg.in/check.v1					 v1.0.0-20201130134442-10cb98267c6c \
	gopkg.in/yaml.v2					 v2.4.0 \
	gopkg.in/yaml.v3					 v3.0.1 \
	modernc.org/libc					 v1.62.0 \
	modernc.org/mathutil					 v1.7.1 \
	modernc.org/memory					 v1.9.1 \
	modernc.org/sqlite					 v1.36.3

MODGO_MODFILES =	\
	github.com/!data!dog/zstd		 v1.5.6 \
	github.com/!data!dog/zstd		 v1.5.6-0.20230824185856-869dae002e5e \
	github.com/!plakar!korp/go-cdc-chunkers	 v0.0.12-0.20250627142555-5621f83a0b1c \
	github.com/alecthomas/chroma/v2		 v2.14.0 \
	github.com/alecthomas/chroma/v2		 v2.15.0 \
	github.com/cespare/xxhash/v2		 v2.2.0 \
	github.com/charmbracelet/colorprofile	 v0.2.3-0.20250311203215-f60798e515dc \
	github.com/charmbracelet/colorprofile	 v0.3.0 \
	github.com/charmbracelet/glamour	 v0.9.1 \
	github.com/charmbracelet/lipgloss	 v1.1.0 \
	github.com/charmbracelet/log		 v0.4.1 \
	github.com/charmbracelet/x/ansi		 v0.8.0 \
	github.com/charmbracelet/x/cellbuf	 v0.0.13-0.20250311204145-2c3ea96c31dd \
	github.com/charmbracelet/x/exp/golden	 v0.0.0-20240806155701-69247e0abc2a \
	github.com/charmbracelet/x/exp/slice	 v0.0.0-20250327172914-2fdc97757edf \
	github.com/cockroachdb/crlib		 v0.0.0-20241015224233-894974b3ad94 \
	github.com/cockroachdb/crlib		 v0.0.0-20250110162118-b7c9be99e911 \
	github.com/cockroachdb/datadriven	 v1.0.2 \
	github.com/cockroachdb/errors		 v1.11.3 \
	github.com/cockroachdb/fifo		 v0.0.0-20240606204812-0bbfbd93a7ce \
	github.com/cockroachdb/logtags		 v0.0.0-20230118201751-21c54148d20b \
	github.com/cockroachdb/pebble/v2	 v2.0.3 \
	github.com/cockroachdb/redact		 v1.1.5 \
	github.com/cockroachdb/swiss		 v0.0.0-20250327203710-2932b022f6df \
	github.com/cockroachdb/tokenbucket	 v0.0.0-20230807174530-cc333fc44b06 \
	github.com/davecgh/go-spew		 v1.1.0 \
	github.com/davecgh/go-spew		 v1.1.1 \
	github.com/dlclark/regexp2		 v1.11.0 \
	github.com/dlclark/regexp2		 v1.4.0 \
	github.com/gabriel-vasile/mimetype	 v1.4.8 \
	github.com/getsentry/sentry-go		 v0.27.0 \
	github.com/getsentry/sentry-go		 v0.31.1 \
	github.com/golang/protobuf		 v1.5.0 \
	github.com/golang/snappy		 v0.0.5-0.20231225225746-43d5d4cd4e0e \
	github.com/google/go-cmp		 v0.5.5 \
	github.com/google/go-cmp		 v0.5.9 \
	github.com/google/go-cmp		 v0.6.0 \
	github.com/klauspost/compress		 v1.16.7 \
	github.com/klauspost/cpuid/v2		 v2.0.12 \
	github.com/klauspost/cpuid/v2		 v2.2.10 \
	github.com/kr/pretty			 v0.3.0 \
	github.com/mattn/go-runewidth		 v0.0.12 \
	github.com/pkg/xattr			 v0.4.10 \
	github.com/pmezard/go-difflib		 v1.0.0 \
	github.com/prometheus/client_golang	 v1.16.0 \
	github.com/prometheus/client_golang	 v1.20.4 \
	github.com/prometheus/client_golang	 v1.21.1 \
	github.com/prometheus/client_model	 v0.3.0 \
	github.com/prometheus/client_model	 v0.6.1 \
	github.com/prometheus/common		 v0.42.0 \
	github.com/prometheus/common		 v0.62.0 \
	github.com/prometheus/common		 v0.63.0 \
	github.com/prometheus/procfs		 v0.10.1 \
	github.com/prometheus/procfs		 v0.15.1 \
	github.com/prometheus/procfs		 v0.16.0 \
	github.com/rivo/uniseg			 v0.1.0 \
	github.com/rivo/uniseg			 v0.2.0 \
	github.com/rogpeppe/go-internal		 v1.10.0 \
	github.com/rogpeppe/go-internal		 v1.8.0 \
	github.com/rogpeppe/go-internal		 v1.9.0 \
	github.com/spf13/pflag			 v1.0.5 \
	github.com/stretchr/objx		 v0.1.0 \
	github.com/stretchr/objx		 v0.4.0 \
	github.com/stretchr/testify		 v1.6.1 \
	github.com/stretchr/testify		 v1.7.0 \
	github.com/stretchr/testify		 v1.7.1 \
	github.com/stretchr/testify		 v1.8.0 \
	github.com/stretchr/testify		 v1.8.2 \
	github.com/stretchr/testify		 v1.8.4 \
	github.com/stretchr/testify		 v1.9.0 \
	github.com/tink-crypto/tink-go/v2	 v2.3.0 \
	github.com/yuin/goldmark		 v1.1.27 \
	github.com/yuin/goldmark		 v1.2.1 \
	github.com/yuin/goldmark		 v1.4.13 \
	github.com/yuin/goldmark		 v1.7.10 \
	github.com/yuin/goldmark		 v1.7.8 \
	github.com/yuin/goldmark-emoji		 v1.0.5 \
	golang.org/x/crypto			 v0.0.0-20190308221718-c2843e01d9a2 \
	golang.org/x/crypto			 v0.0.0-20191011191535-87dc89f01550 \
	golang.org/x/crypto			 v0.0.0-20200622213623-75b288015ac9 \
	golang.org/x/crypto			 v0.0.0-20210921155107-089bfa567519 \
	golang.org/x/crypto			 v0.13.0 \
	golang.org/x/crypto			 v0.19.0 \
	golang.org/x/crypto			 v0.23.0 \
	golang.org/x/crypto			 v0.31.0 \
	golang.org/x/crypto			 v0.35.0 \
	golang.org/x/crypto			 v0.36.0 \
	golang.org/x/crypto			 v0.38.0 \
	golang.org/x/exp			 v0.0.0-20220909182711-5c715a9e8561 \
	golang.org/x/exp			 v0.0.0-20230626212559-97b1e661b5df \
	golang.org/x/exp			 v0.0.0-20231006140011-7918f672742d \
	golang.org/x/exp			 v0.0.0-20250305212735-054e65f0b394 \
	golang.org/x/mod			 v0.12.0 \
	golang.org/x/mod			 v0.15.0 \
	golang.org/x/mod			 v0.17.0 \
	golang.org/x/mod			 v0.2.0 \
	golang.org/x/mod			 v0.21.0 \
	golang.org/x/mod			 v0.24.0 \
	golang.org/x/mod			 v0.3.0 \
	golang.org/x/mod			 v0.6.0-dev.0.20220419223038-86c51ed26bb4 \
	golang.org/x/mod			 v0.8.0 \
	golang.org/x/net			 v0.0.0-20190404232315-eb5bcb51f2a3 \
	golang.org/x/net			 v0.0.0-20190620200207-3b0461eec859 \
	golang.org/x/net			 v0.0.0-20200226121028-0de0cce0169b \
	golang.org/x/net			 v0.0.0-20201021035429-f5854403a974 \
	golang.org/x/net			 v0.0.0-20210226172049-e18ecbb05110 \
	golang.org/x/net			 v0.0.0-20220722155237-a158d28d115b \
	golang.org/x/net			 v0.10.0 \
	golang.org/x/net			 v0.15.0 \
	golang.org/x/net			 v0.21.0 \
	golang.org/x/net			 v0.25.0 \
	golang.org/x/net			 v0.26.0 \
	golang.org/x/net			 v0.33.0 \
	golang.org/x/net			 v0.38.0 \
	golang.org/x/net			 v0.39.0 \
	golang.org/x/net			 v0.40.0 \
	golang.org/x/net			 v0.6.0 \
	golang.org/x/oauth2			 v0.24.0 \
	golang.org/x/sync			 v0.0.0-20190423024810-112230192c58 \
	golang.org/x/sync			 v0.0.0-20190911185100-cd5d95a43a6e \
	golang.org/x/sync			 v0.0.0-20201020160332-67f06af15bc9 \
	golang.org/x/sync			 v0.0.0-20220722155255-886fb9371eb4 \
	golang.org/x/sync			 v0.1.0 \
	golang.org/x/sync			 v0.10.0 \
	golang.org/x/sync			 v0.12.0 \
	golang.org/x/sync			 v0.14.0 \
	golang.org/x/sync			 v0.3.0 \
	golang.org/x/sync			 v0.6.0 \
	golang.org/x/sync			 v0.7.0 \
	golang.org/x/sys			 v0.0.0-20190215142949-d0b11bdaac8a \
	golang.org/x/sys			 v0.0.0-20190412213103-97732733099d \
	golang.org/x/sys			 v0.0.0-20200930185726-fdedc70b468f \
	golang.org/x/sys			 v0.0.0-20201119102817-f84b799fce68 \
	golang.org/x/sys			 v0.0.0-20210615035016-665e8c7367d1 \
	golang.org/x/sys			 v0.0.0-20220408201424-a24fb2fb8a0f \
	golang.org/x/sys			 v0.0.0-20220520151302-bc2c85ada10a \
	golang.org/x/sys			 v0.0.0-20220722155257-8c9f86f7a55f \
	golang.org/x/sys			 v0.12.0 \
	golang.org/x/sys			 v0.17.0 \
	golang.org/x/sys			 v0.18.0 \
	golang.org/x/sys			 v0.20.0 \
	golang.org/x/sys			 v0.26.0 \
	golang.org/x/sys			 v0.28.0 \
	golang.org/x/sys			 v0.30.0 \
	golang.org/x/sys			 v0.31.0 \
	golang.org/x/sys			 v0.32.0 \
	golang.org/x/sys			 v0.5.0 \
	golang.org/x/sys			 v0.6.0 \
	golang.org/x/sys			 v0.8.0 \
	golang.org/x/telemetry			 v0.0.0-20240228155512-f48c80bd79b2 \
	golang.org/x/term			 v0.0.0-20201126162022-7de9c90e9dd1 \
	golang.org/x/term			 v0.0.0-20210927222741-03fcf44c2211 \
	golang.org/x/term			 v0.12.0 \
	golang.org/x/term			 v0.17.0 \
	golang.org/x/term			 v0.20.0 \
	golang.org/x/term			 v0.27.0 \
	golang.org/x/term			 v0.31.0 \
	golang.org/x/term			 v0.5.0 \
	golang.org/x/term			 v0.8.0 \
	golang.org/x/text			 v0.13.0 \
	golang.org/x/text			 v0.14.0 \
	golang.org/x/text			 v0.15.0 \
	golang.org/x/text			 v0.21.0 \
	golang.org/x/text			 v0.23.0 \
	golang.org/x/text			 v0.24.0 \
	golang.org/x/text			 v0.25.0 \
	golang.org/x/text			 v0.3.0 \
	golang.org/x/text			 v0.3.3 \
	golang.org/x/text			 v0.3.7 \
	golang.org/x/text			 v0.7.0 \
	golang.org/x/text			 v0.9.0 \
	golang.org/x/tools			 v0.0.0-20180917221912-90fa682c2a6e \
	golang.org/x/tools			 v0.0.0-20191119224855-298f0cb1881e \
	golang.org/x/tools			 v0.0.0-20200619180055-7c47624df98f \
	golang.org/x/tools			 v0.0.0-20210106214847-113979e3529a \
	golang.org/x/tools			 v0.1.12 \
	golang.org/x/tools			 v0.13.0 \
	golang.org/x/tools			 v0.21.1-0.20240508182429-e35e4ccd0d2d \
	golang.org/x/tools			 v0.26.0 \
	golang.org/x/tools			 v0.31.0 \
	golang.org/x/tools			 v0.33.0 \
	golang.org/x/tools			 v0.6.0 \
	golang.org/x/xerrors			 v0.0.0-20190717185122-a985d3407aa7 \
	golang.org/x/xerrors			 v0.0.0-20191011141410-1b5146add898 \
	golang.org/x/xerrors			 v0.0.0-20191204190536-9bdfabe68543 \
	google.golang.org/genproto		 v0.0.0-20230410155749-daa745c078e1 \
	google.golang.org/grpc			 v1.56.3 \
	google.golang.org/protobuf		 v1.33.0 \
	google.golang.org/protobuf		 v1.36.5 \
	gopkg.in/check.v1			 v0.0.0-20161208181325-20d25e280405 \
	gopkg.in/yaml.v3			 v3.0.0-20200313102051-9f266ea9e77c

