MODCARGO_CRATES +=	adler32	1.2.0	# Zlib
MODCARGO_CRATES +=	ahash	0.7.6	# MIT OR Apache-2.0
MODCARGO_CRATES +=	aho-corasick	0.7.20	# Unlicense OR MIT
MODCARGO_CRATES +=	android_system_properties	0.1.5	# MIT/Apache-2.0
MODCARGO_CRATES +=	ansi_term	0.12.1	# MIT
MODCARGO_CRATES +=	anyhow	1.0.70	# MIT OR Apache-2.0
MODCARGO_CRATES +=	arrayvec	0.5.2	# MIT/Apache-2.0
MODCARGO_CRATES +=	atty	0.2.14	# MIT
MODCARGO_CRATES +=	autocfg	1.1.0	# Apache-2.0 OR MIT
MODCARGO_CRATES +=	bitflags	1.3.2	# MIT/Apache-2.0
MODCARGO_CRATES +=	bitflags	2.0.2	# MIT OR Apache-2.0
MODCARGO_CRATES +=	bumpalo	3.12.0	# MIT/Apache-2.0
MODCARGO_CRATES +=	cast	0.3.0	# MIT OR Apache-2.0
MODCARGO_CRATES +=	cc	1.0.79	# MIT OR Apache-2.0
MODCARGO_CRATES +=	cfg-if	1.0.0	# MIT/Apache-2.0
MODCARGO_CRATES +=	chrono	0.4.24	# MIT/Apache-2.0
MODCARGO_CRATES +=	clap	2.34.0	# MIT
MODCARGO_CRATES +=	codespan-reporting	0.11.1	# Apache-2.0
MODCARGO_CRATES +=	colored	2.0.0	# MPL-2.0
MODCARGO_CRATES +=	core-foundation-sys	0.8.4	# MIT / Apache-2.0
MODCARGO_CRATES +=	crc32fast	1.3.2	# MIT OR Apache-2.0
MODCARGO_CRATES +=	criterion	0.3.6	# Apache-2.0/MIT
MODCARGO_CRATES +=	criterion-plot	0.4.5	# MIT/Apache-2.0
MODCARGO_CRATES +=	crossbeam-channel	0.5.7	# MIT OR Apache-2.0
MODCARGO_CRATES +=	crossbeam-deque	0.8.3	# MIT OR Apache-2.0
MODCARGO_CRATES +=	crossbeam-epoch	0.9.14	# MIT OR Apache-2.0
MODCARGO_CRATES +=	crossbeam-utils	0.8.15	# MIT OR Apache-2.0
MODCARGO_CRATES +=	csv	1.2.1	# Unlicense/MIT
MODCARGO_CRATES +=	csv-core	0.1.10	# Unlicense/MIT
MODCARGO_CRATES +=	ctor	0.1.26	# Apache-2.0 OR MIT
MODCARGO_CRATES +=	cxx	1.0.94	# MIT OR Apache-2.0
MODCARGO_CRATES +=	cxx-build	1.0.94	# MIT OR Apache-2.0
MODCARGO_CRATES +=	cxxbridge-flags	1.0.94	# MIT OR Apache-2.0
MODCARGO_CRATES +=	cxxbridge-macro	1.0.94	# MIT OR Apache-2.0
MODCARGO_CRATES +=	derivative	2.2.0	# MIT/Apache-2.0
MODCARGO_CRATES +=	derive_more	0.99.17	# MIT
MODCARGO_CRATES +=	diff	0.1.13	# MIT OR Apache-2.0
MODCARGO_CRATES +=	dissimilar	1.0.6	# Apache-2.0
MODCARGO_CRATES +=	either	1.8.1	# MIT OR Apache-2.0
MODCARGO_CRATES +=	ena	0.14.2	# MIT OR Apache-2.0
MODCARGO_CRATES +=	env_logger	0.9.3	# MIT OR Apache-2.0
MODCARGO_CRATES +=	errno	0.3.0	# MIT OR Apache-2.0
MODCARGO_CRATES +=	errno-dragonfly	0.1.2	# MIT
MODCARGO_CRATES +=	expect-test	1.4.1	# MIT OR Apache-2.0
MODCARGO_CRATES +=	fallible-iterator	0.2.0	# MIT/Apache-2.0
MODCARGO_CRATES +=	fallible-streaming-iterator	0.1.9	# MIT/Apache-2.0
MODCARGO_CRATES +=	fastrand	1.9.0	# Apache-2.0 OR MIT
MODCARGO_CRATES +=	flatbuffers	22.12.6	# Apache-2.0
MODCARGO_CRATES +=	fnv	1.0.7	# Apache-2.0 / MIT
MODCARGO_CRATES +=	form_urlencoded	1.1.0	# MIT OR Apache-2.0
MODCARGO_CRATES +=	getrandom	0.2.8	# MIT OR Apache-2.0
MODCARGO_CRATES +=	half	1.8.2	# MIT OR Apache-2.0
MODCARGO_CRATES +=	hashbrown	0.12.3	# MIT OR Apache-2.0
MODCARGO_CRATES +=	hashlink	0.8.1	# MIT OR Apache-2.0
MODCARGO_CRATES +=	heck	0.3.3	# MIT OR Apache-2.0
MODCARGO_CRATES +=	hermit-abi	0.1.19	# MIT/Apache-2.0
MODCARGO_CRATES +=	hermit-abi	0.2.6	# MIT/Apache-2.0
MODCARGO_CRATES +=	hermit-abi	0.3.1	# MIT OR Apache-2.0
MODCARGO_CRATES +=	humantime	2.1.0	# MIT/Apache-2.0
MODCARGO_CRATES +=	iana-time-zone	0.1.56	# MIT OR Apache-2.0
MODCARGO_CRATES +=	iana-time-zone-haiku	0.1.1	# MIT OR Apache-2.0
MODCARGO_CRATES +=	idna	0.3.0	# MIT OR Apache-2.0
MODCARGO_CRATES +=	indexmap	1.9.3	# Apache-2.0 OR MIT
MODCARGO_CRATES +=	instant	0.1.12	# BSD-3-Clause
MODCARGO_CRATES +=	io-lifetimes	1.0.10	# Apache-2.0 WITH LLVM-exception OR Apache-2.0 OR MIT
MODCARGO_CRATES +=	itertools	0.10.5	# MIT/Apache-2.0
MODCARGO_CRATES +=	itoa	1.0.6	# MIT OR Apache-2.0
MODCARGO_CRATES +=	js-sys	0.3.61	# MIT/Apache-2.0
MODCARGO_CRATES +=	lazy_static	1.4.0	# MIT/Apache-2.0
MODCARGO_CRATES +=	libc	0.2.141	# MIT OR Apache-2.0
MODCARGO_CRATES +=	libflate	1.3.0	# MIT
MODCARGO_CRATES +=	libflate_lz77	1.2.0	# MIT
MODCARGO_CRATES +=	libsqlite3-sys	0.26.0	# MIT
MODCARGO_CRATES +=	link-cplusplus	1.0.8	# MIT OR Apache-2.0
MODCARGO_CRATES +=	linux-raw-sys	0.3.1	# Apache-2.0 WITH LLVM-exception OR Apache-2.0 OR MIT
MODCARGO_CRATES +=	lock_api	0.4.9	# MIT OR Apache-2.0
MODCARGO_CRATES +=	log	0.4.17	# MIT OR Apache-2.0
MODCARGO_CRATES +=	lsp-types	0.91.1	# MIT
MODCARGO_CRATES +=	maplit	1.0.2	# MIT/Apache-2.0
MODCARGO_CRATES +=	memchr	2.5.0	# Unlicense/MIT
MODCARGO_CRATES +=	memoffset	0.8.0	# MIT
MODCARGO_CRATES +=	num-integer	0.1.45	# MIT OR Apache-2.0
MODCARGO_CRATES +=	num-traits	0.2.15	# MIT OR Apache-2.0
MODCARGO_CRATES +=	num_cpus	1.15.0	# MIT OR Apache-2.0
MODCARGO_CRATES +=	once_cell	1.17.1	# MIT OR Apache-2.0
MODCARGO_CRATES +=	oorandom	11.1.3	# MIT
MODCARGO_CRATES +=	ordered-float	3.6.0	# MIT
MODCARGO_CRATES +=	output_vt100	0.1.3	# MIT
MODCARGO_CRATES +=	pad	0.1.6	# MIT
MODCARGO_CRATES +=	parking_lot	0.11.2	# Apache-2.0/MIT
MODCARGO_CRATES +=	parking_lot_core	0.8.6	# Apache-2.0/MIT
MODCARGO_CRATES +=	percent-encoding	2.2.0	# MIT OR Apache-2.0
MODCARGO_CRATES +=	pkg-config	0.3.26	# MIT OR Apache-2.0
MODCARGO_CRATES +=	plotters	0.3.4	# MIT
MODCARGO_CRATES +=	plotters-backend	0.3.4	# MIT
MODCARGO_CRATES +=	plotters-svg	0.3.3	# MIT
MODCARGO_CRATES +=	pretty	0.11.3	# MIT
MODCARGO_CRATES +=	pretty_assertions	1.3.0	# MIT OR Apache-2.0
MODCARGO_CRATES +=	proc-macro-error	1.0.4	# MIT OR Apache-2.0
MODCARGO_CRATES +=	proc-macro-error-attr	1.0.4	# MIT OR Apache-2.0
MODCARGO_CRATES +=	proc-macro2	1.0.56	# MIT OR Apache-2.0
MODCARGO_CRATES +=	pulldown-cmark	0.9.2	# MIT
MODCARGO_CRATES +=	quote	1.0.26	# MIT OR Apache-2.0
MODCARGO_CRATES +=	rayon	1.7.0	# MIT OR Apache-2.0
MODCARGO_CRATES +=	rayon-core	1.11.0	# MIT OR Apache-2.0
MODCARGO_CRATES +=	redox_syscall	0.2.16	# MIT
MODCARGO_CRATES +=	redox_syscall	0.3.5	# MIT
MODCARGO_CRATES +=	regex	1.7.3	# MIT OR Apache-2.0
MODCARGO_CRATES +=	regex-syntax	0.6.29	# MIT OR Apache-2.0
MODCARGO_CRATES +=	rle-decode-fast	1.0.3	# MIT OR Apache-2.0
MODCARGO_CRATES +=	rusqlite	0.29.0	# MIT
MODCARGO_CRATES +=	rustc-hash	1.1.0	# Apache-2.0/MIT
MODCARGO_CRATES +=	rustc_version	0.4.0	# MIT/Apache-2.0
MODCARGO_CRATES +=	rustix	0.37.7	# Apache-2.0 WITH LLVM-exception OR Apache-2.0 OR MIT
MODCARGO_CRATES +=	ryu	1.0.13	# Apache-2.0 OR BSL-1.0
MODCARGO_CRATES +=	salsa	0.17.0-pre.2	# Apache-2.0 OR MIT
MODCARGO_CRATES +=	salsa-macros	0.17.0-pre.2	# Apache-2.0 OR MIT
MODCARGO_CRATES +=	same-file	1.0.6	# Unlicense/MIT
MODCARGO_CRATES +=	scopeguard	1.1.0	# MIT/Apache-2.0
MODCARGO_CRATES +=	scratch	1.0.5	# MIT OR Apache-2.0
MODCARGO_CRATES +=	semver	1.0.17	# MIT OR Apache-2.0
MODCARGO_CRATES +=	serde	1.0.159	# MIT OR Apache-2.0
MODCARGO_CRATES +=	serde_cbor	0.11.2	# MIT/Apache-2.0
MODCARGO_CRATES +=	serde_derive	1.0.159	# MIT OR Apache-2.0
MODCARGO_CRATES +=	serde_json	1.0.95	# MIT OR Apache-2.0
MODCARGO_CRATES +=	serde_repr	0.1.12	# MIT OR Apache-2.0
MODCARGO_CRATES +=	smallvec	1.10.0	# MIT OR Apache-2.0
MODCARGO_CRATES +=	strsim	0.8.0	# MIT
MODCARGO_CRATES +=	structopt	0.3.26	# Apache-2.0 OR MIT
MODCARGO_CRATES +=	structopt-derive	0.4.18	# Apache-2.0/MIT
MODCARGO_CRATES +=	syn	1.0.109	# MIT OR Apache-2.0
MODCARGO_CRATES +=	syn	2.0.13	# MIT OR Apache-2.0
MODCARGO_CRATES +=	tempfile	3.5.0	# MIT OR Apache-2.0
MODCARGO_CRATES +=	termcolor	1.2.0	# Unlicense OR MIT
MODCARGO_CRATES +=	textwrap	0.11.0	# MIT
MODCARGO_CRATES +=	thiserror	1.0.40	# MIT OR Apache-2.0
MODCARGO_CRATES +=	thiserror-impl	1.0.40	# MIT OR Apache-2.0
MODCARGO_CRATES +=	tinytemplate	1.2.1	# Apache-2.0 OR MIT
MODCARGO_CRATES +=	tinyvec	1.6.0	# Zlib OR Apache-2.0 OR MIT
MODCARGO_CRATES +=	tinyvec_macros	0.1.1	# MIT OR Apache-2.0 OR Zlib
MODCARGO_CRATES +=	typed-arena	2.0.2	# MIT
MODCARGO_CRATES +=	unicase	2.6.0	# MIT/Apache-2.0
MODCARGO_CRATES +=	unicode-bidi	0.3.13	# MIT OR Apache-2.0
MODCARGO_CRATES +=	unicode-ident	1.0.8	# (MIT OR Apache-2.0) AND Unicode-DFS-2016
MODCARGO_CRATES +=	unicode-normalization	0.1.22	# MIT/Apache-2.0
MODCARGO_CRATES +=	unicode-segmentation	1.10.1	# MIT/Apache-2.0
MODCARGO_CRATES +=	unicode-width	0.1.10	# MIT/Apache-2.0
MODCARGO_CRATES +=	url	2.3.1	# MIT OR Apache-2.0
MODCARGO_CRATES +=	vcpkg	0.2.15	# MIT/Apache-2.0
MODCARGO_CRATES +=	vec_map	0.8.2	# MIT/Apache-2.0
MODCARGO_CRATES +=	version_check	0.9.4	# MIT/Apache-2.0
MODCARGO_CRATES +=	walkdir	2.3.3	# Unlicense/MIT
MODCARGO_CRATES +=	wasi	0.11.0+wasi-snapshot-preview1	# Apache-2.0 WITH LLVM-exception OR Apache-2.0 OR MIT
MODCARGO_CRATES +=	wasm-bindgen	0.2.84	# MIT/Apache-2.0
MODCARGO_CRATES +=	wasm-bindgen-backend	0.2.84	# MIT/Apache-2.0
MODCARGO_CRATES +=	wasm-bindgen-macro	0.2.84	# MIT/Apache-2.0
MODCARGO_CRATES +=	wasm-bindgen-macro-support	0.2.84	# MIT/Apache-2.0
MODCARGO_CRATES +=	wasm-bindgen-shared	0.2.84	# MIT/Apache-2.0
MODCARGO_CRATES +=	web-sys	0.3.61	# MIT/Apache-2.0
MODCARGO_CRATES +=	winapi	0.3.9	# MIT/Apache-2.0
MODCARGO_CRATES +=	winapi-i686-pc-windows-gnu	0.4.0	# MIT/Apache-2.0
MODCARGO_CRATES +=	winapi-util	0.1.5	# Unlicense/MIT
MODCARGO_CRATES +=	winapi-x86_64-pc-windows-gnu	0.4.0	# MIT/Apache-2.0
MODCARGO_CRATES +=	windows	0.48.0	# MIT OR Apache-2.0
MODCARGO_CRATES +=	windows-sys	0.45.0	# MIT OR Apache-2.0
MODCARGO_CRATES +=	windows-sys	0.48.0	# MIT OR Apache-2.0
MODCARGO_CRATES +=	windows-targets	0.42.2	# MIT OR Apache-2.0
MODCARGO_CRATES +=	windows-targets	0.48.0	# MIT OR Apache-2.0
MODCARGO_CRATES +=	windows_aarch64_gnullvm	0.42.2	# MIT OR Apache-2.0
MODCARGO_CRATES +=	windows_aarch64_gnullvm	0.48.0	# MIT OR Apache-2.0
MODCARGO_CRATES +=	windows_aarch64_msvc	0.42.2	# MIT OR Apache-2.0
MODCARGO_CRATES +=	windows_aarch64_msvc	0.48.0	# MIT OR Apache-2.0
MODCARGO_CRATES +=	windows_i686_gnu	0.42.2	# MIT OR Apache-2.0
MODCARGO_CRATES +=	windows_i686_gnu	0.48.0	# MIT OR Apache-2.0
MODCARGO_CRATES +=	windows_i686_msvc	0.42.2	# MIT OR Apache-2.0
MODCARGO_CRATES +=	windows_i686_msvc	0.48.0	# MIT OR Apache-2.0
MODCARGO_CRATES +=	windows_x86_64_gnu	0.42.2	# MIT OR Apache-2.0
MODCARGO_CRATES +=	windows_x86_64_gnu	0.48.0	# MIT OR Apache-2.0
MODCARGO_CRATES +=	windows_x86_64_gnullvm	0.42.2	# MIT OR Apache-2.0
MODCARGO_CRATES +=	windows_x86_64_gnullvm	0.48.0	# MIT OR Apache-2.0
MODCARGO_CRATES +=	windows_x86_64_msvc	0.42.2	# MIT OR Apache-2.0
MODCARGO_CRATES +=	windows_x86_64_msvc	0.48.0	# MIT OR Apache-2.0
MODCARGO_CRATES +=	yansi	0.5.1	# MIT/Apache-2.0
