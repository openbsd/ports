MODGO_MODULES =	\
	cloud.google.com/go						 v0.82.0 \
	cloud.google.com/go/bigquery					 v1.8.0 \
	cloud.google.com/go/bigtable					 v1.10.1 \
	github.com/!alec!aivazis/survey/v2				 v2.3.4 \
	github.com/!azure/azure-pipeline-go				 v0.2.3 \
	github.com/!azure/azure-storage-blob-go				 v0.14.0 \
	github.com/!azure/go-autorest					 v14.2.0+incompatible \
	github.com/!azure/go-autorest/autorest				 v0.11.9 \
	github.com/!azure/go-autorest/autorest/adal			 v0.9.13 \
	github.com/!azure/go-autorest/autorest/azure/auth		 v0.5.3 \
	github.com/!azure/go-autorest/autorest/azure/cli		 v0.4.2 \
	github.com/!azure/go-autorest/autorest/date			 v0.3.0 \
	github.com/!azure/go-autorest/logger				 v0.2.1 \
	github.com/!azure/go-autorest/tracing				 v0.6.0 \
	github.com/!burnt!sushi/toml					 v1.2.1 \
	github.com/!d!a!t!a-!d!o!g/go-sqlmock				 v1.4.1 \
	github.com/!make!now!just/heredoc/v2				 v2.0.1 \
	github.com/!masterminds/semver					 v1.4.2 \
	github.com/!masterminds/sprig					 v2.16.0+incompatible \
	github.com/!masterminds/squirrel				 v1.5.0 \
	github.com/!microsoft/go-winio					 v0.4.11 \
	github.com/!n!y!times/gziphandler				 v1.0.1 \
	github.com/!netflix/go-expect					 v0.0.0-20220104043353-73e0943537d2 \
	github.com/!roaring!bitmap/roaring				 v0.4.16 \
	github.com/!s!a!p/go-hdb					 v0.14.1 \
	github.com/andreyvit/diff					 v0.0.0-20170406064948-c7f18ee00883 \
	github.com/aokoli/goutils					 v1.0.1 \
	github.com/apache/arrow/go/arrow				 v0.0.0-20211112161151-bc219186db40 \
	github.com/apache/arrow/go/v7					 v7.0.0 \
	github.com/atotto/clipboard					 v0.1.4 \
	github.com/aws/aws-sdk-go					 v1.30.12 \
	github.com/aws/aws-sdk-go-v2					 v1.11.0 \
	github.com/aws/aws-sdk-go-v2/aws/protocol/eventstream		 v1.0.0 \
	github.com/aws/aws-sdk-go-v2/credentials			 v1.6.1 \
	github.com/aws/aws-sdk-go-v2/feature/s3/manager			 v1.7.1 \
	github.com/aws/aws-sdk-go-v2/internal/configsources		 v1.1.0 \
	github.com/aws/aws-sdk-go-v2/internal/endpoints/v2		 v2.0.0 \
	github.com/aws/aws-sdk-go-v2/service/internal/accept-encoding	 v1.5.0 \
	github.com/aws/aws-sdk-go-v2/service/internal/presigned-url	 v1.5.0 \
	github.com/aws/aws-sdk-go-v2/service/internal/s3shared		 v1.9.0 \
	github.com/aws/aws-sdk-go-v2/service/s3				 v1.19.0 \
	github.com/aws/smithy-go					 v1.9.0 \
	github.com/benbjohnson/clock					 v1.1.0 \
	github.com/benbjohnson/immutable				 v0.3.0 \
	github.com/benbjohnson/tmpl					 v1.0.0 \
	github.com/beorn7/perks						 v1.0.1 \
	github.com/bonitoo-io/go-sql-bigquery				 v0.3.4-1.4.0 \
	github.com/buger/jsonparser					 v1.1.1 \
	github.com/cespare/xxhash					 v1.1.0 \
	github.com/cespare/xxhash/v2					 v2.1.1 \
	github.com/charmbracelet/bubbles				 v0.11.0 \
	github.com/charmbracelet/bubbletea				 v0.21.0 \
	github.com/charmbracelet/harmonica				 v0.2.0 \
	github.com/charmbracelet/lipgloss				 v0.5.0 \
	github.com/containerd/console					 v1.0.3 \
	github.com/cpuguy83/go-md2man/v2				 v2.0.2 \
	github.com/creack/pty						 v1.1.17 \
	github.com/daixiang0/gci					 v0.10.1 \
	github.com/davecgh/go-spew					 v1.1.1 \
	github.com/deepmap/oapi-codegen					 v1.6.0 \
	github.com/denisenkom/go-mssqldb				 v0.10.0 \
	github.com/dgryski/go-bitstream					 v0.0.0-20180413035011-3522498ce2c8 \
	github.com/dimchansky/utfbom					 v1.1.0 \
	github.com/docker/distribution					 v2.7.0+incompatible \
	github.com/docker/docker					 v1.13.1 \
	github.com/docker/go-connections				 v0.4.0 \
	github.com/docker/go-units					 v0.3.3 \
	github.com/dustin/go-humanize					 v1.0.0 \
	github.com/eclipse/paho.mqtt.golang				 v1.2.0 \
	github.com/editorconfig-checker/editorconfig-checker		 v0.0.0-20190819115812-1474bdeaf2a2 \
	github.com/editorconfig/editorconfig-core-go/v2			 v2.1.1 \
	github.com/elazarl/go-bindata-assetfs				 v1.0.1 \
	github.com/evertras/bubble-table				 v0.13.7 \
	github.com/fatih/color						 v1.9.0 \
	github.com/form3tech-oss/jwt-go					 v3.2.5+incompatible \
	github.com/fsnotify/fsnotify					 v1.4.7 \
	github.com/fujiwara/shapeio					 v1.0.0 \
	github.com/gabriel-vasile/mimetype				 v1.4.0 \
	github.com/glycerine/go-unsnap-stream				 v0.0.0-20181221182339-f9677308dec2 \
	github.com/glycerine/goconvey					 v0.0.0-20180728074245-46e3a41ad493 \
	github.com/go-chi/chi						 v4.1.0+incompatible \
	github.com/go-sql-driver/mysql					 v1.5.0 \
	github.com/go-stack/stack					 v1.8.0 \
	github.com/gocarina/gocsv					 v0.0.0-20210408192840-02d7211d929d \
	github.com/goccy/go-json					 v0.7.10 \
	github.com/gofrs/uuid						 v3.3.0+incompatible \
	github.com/gogo/protobuf					 v1.3.2 \
	github.com/golang-jwt/jwt					 v3.2.1+incompatible \
	github.com/golang-sql/civil					 v0.0.0-20190719163853-cb61b32ac6fe \
	github.com/golang/gddo						 v0.0.0-20181116215533-9bd4a3295021 \
	github.com/golang/geo						 v0.0.0-20190916061304-5b978397cfec \
	github.com/golang/groupcache					 v0.0.0-20200121045136-8c9f03a8e57e \
	github.com/golang/mock						 v1.6.0 \
	github.com/golang/protobuf					 v1.5.2 \
	github.com/golang/snappy					 v0.0.4 \
	github.com/google/btree						 v1.0.1 \
	github.com/google/flatbuffers					 v2.0.5+incompatible \
	github.com/google/go-cmp					 v0.5.7 \
	github.com/google/go-jsonnet					 v0.17.0 \
	github.com/google/uuid						 v1.3.0 \
	github.com/googleapis/gax-go/v2					 v2.0.5 \
	github.com/hashicorp/errwrap					 v1.0.0 \
	github.com/hashicorp/go-cleanhttp				 v0.5.1 \
	github.com/hashicorp/go-multierror				 v1.0.0 \
	github.com/hashicorp/go-retryablehttp				 v0.6.4 \
	github.com/hashicorp/go-rootcerts				 v1.0.0 \
	github.com/hashicorp/go-sockaddr				 v1.0.2 \
	github.com/hashicorp/hcl					 v1.0.0 \
	github.com/hashicorp/vault/api					 v1.0.2 \
	github.com/hashicorp/vault/sdk					 v0.1.8 \
	github.com/hexops/gotextdiff					 v1.0.3 \
	github.com/hinshun/vt10x					 v0.0.0-20220119200601-820417d04eec \
	github.com/huandu/xstrings					 v1.0.0 \
	github.com/imdario/mergo					 v0.3.9 \
	github.com/inconshreveable/mousetrap				 v1.1.0 \
	github.com/influxdata/cron					 v0.0.0-20201006132531-4bb0a200dcbe \
	github.com/influxdata/flux					 v0.171.0 \
	github.com/influxdata/go-prompt					 v0.2.8 \
	github.com/influxdata/gosnowflake				 v1.6.9 \
	github.com/influxdata/httprouter				 v1.3.1-0.20191122104820-ee83e2772f69 \
	github.com/influxdata/influxdb-client-go/v2			 v2.3.1-0.20210518120617-5d1fff431040 \
	github.com/influxdata/influxdb/v2				 v2.3.0 \
	github.com/influxdata/influxql					 v1.1.1-0.20211004132434-7e7d61973256 \
	github.com/influxdata/line-protocol				 v0.0.0-20200327222509-2487e7298839 \
	github.com/influxdata/pkg-config				 v0.2.11 \
	github.com/influxdata/tdigest					 v0.0.2-0.20210216194612-fc98d27c9e8b \
	github.com/jmespath/go-jmespath					 v0.4.0 \
	github.com/jmoiron/sqlx						 v1.3.4 \
	github.com/jstemmer/go-junit-report				 v0.9.1 \
	github.com/jsternberg/zap-logfmt				 v1.2.0 \
	github.com/jwilder/encoding					 v0.0.0-20170811194829-b4e1701a28ef \
	github.com/kballard/go-shellquote				 v0.0.0-20180428030007-95032a82bc51 \
	github.com/kevinburke/go-bindata				 v3.22.0+incompatible \
	github.com/klauspost/compress					 v1.13.6 \
	github.com/kr/pretty						 v0.1.0 \
	github.com/kr/pty						 v1.1.1 \
	github.com/kr/text						 v0.2.0 \
	github.com/kylelemons/godebug					 v1.1.0 \
	github.com/lann/builder						 v0.0.0-20180802200727-47ae307949d0 \
	github.com/lann/ps						 v0.0.0-20150810152359-62de8c46ede0 \
	github.com/lib/pq						 v1.2.0 \
	github.com/lucasb-eyer/go-colorful				 v1.2.0 \
	github.com/magiconair/properties				 v1.8.1 \
	github.com/mattn/go-colorable					 v0.1.12 \
	github.com/mattn/go-ieproxy					 v0.0.1 \
	github.com/mattn/go-isatty					 v0.0.14 \
	github.com/mattn/go-runewidth					 v0.0.13 \
	github.com/mattn/go-sqlite3					 v1.14.7 \
	github.com/mattn/go-tty						 v0.0.4 \
	github.com/matttproud/golang_protobuf_extensions		 v1.0.1 \
	github.com/mgutz/ansi						 v0.0.0-20170206155736-9520e82c474b \
	github.com/mileusna/useragent					 v0.0.0-20190129205925-3e331f0949a5 \
	github.com/mitchellh/go-homedir					 v1.1.0 \
	github.com/mitchellh/mapstructure				 v1.1.2 \
	github.com/mna/pigeon						 v1.0.1-0.20180808201053-bb0192cfc2ae \
	github.com/mschoch/smat						 v0.0.0-20160514031455-90eadee771ae \
	github.com/muesli/ansi						 v0.0.0-20211031195517-c9f0611b6c70 \
	github.com/muesli/cancelreader					 v0.2.0 \
	github.com/muesli/reflow					 v0.3.0 \
	github.com/muesli/termenv					 v0.12.0 \
	github.com/olekukonko/tablewriter				 v0.0.5 \
	github.com/onsi/ginkgo						 v1.11.0 \
	github.com/onsi/gomega						 v1.8.1 \
	github.com/opencontainers/go-digest				 v1.0.0-rc1 \
	github.com/opentracing/opentracing-go				 v1.2.0 \
	github.com/pelletier/go-toml					 v1.2.0 \
	github.com/philhofer/fwd					 v1.0.0 \
	github.com/pierrec/lz4						 v2.0.5+incompatible \
	github.com/pierrec/lz4/v4					 v4.1.11 \
	github.com/pkg/browser						 v0.0.0-20210911075715-681adbf594b8 \
	github.com/pkg/errors						 v0.9.1 \
	github.com/pkg/term						 v1.2.0-beta.2 \
	github.com/pmezard/go-difflib					 v1.0.0 \
	github.com/prometheus/client_golang				 v1.5.1 \
	github.com/prometheus/client_model				 v0.2.0 \
	github.com/prometheus/common					 v0.9.1 \
	github.com/prometheus/procfs					 v0.0.11 \
	github.com/retailnext/hllpp					 v1.0.1-0.20180308014038-101a6d2f8b52 \
	github.com/rivo/uniseg						 v0.2.0 \
	github.com/russross/blackfriday/v2				 v2.1.0 \
	github.com/ryanuber/go-glob					 v1.0.0 \
	github.com/sahilm/fuzzy						 v0.1.0 \
	github.com/satori/go.uuid					 v1.2.1-0.20181028125025-b2ce2384e17b \
	github.com/segmentio/kafka-go					 v0.2.0 \
	github.com/sergi/go-diff					 v1.1.0 \
	github.com/shurcoo!l/sanitized_anchor_name			 v1.0.0 \
	github.com/sirupsen/logrus					 v1.8.1 \
	github.com/spf13/afero						 v1.1.2 \
	github.com/spf13/cast						 v1.3.0 \
	github.com/spf13/cobra						 v1.7.0 \
	github.com/spf13/jwalterweatherman				 v1.0.0 \
	github.com/spf13/pflag						 v1.0.5 \
	github.com/spf13/viper						 v1.6.1 \
	github.com/stretchr/objx					 v0.5.0 \
	github.com/stretchr/testify					 v1.8.1 \
	github.com/subosito/gotenv					 v1.2.0 \
	github.com/testcontainers/testcontainers-go			 v0.0.0-20190108154635-47c0da630f72 \
	github.com/tinylib/msgp						 v1.1.0 \
	github.com/uber-go/tally					 v3.3.15+incompatible \
	github.com/uber/athenadriver					 v1.1.4 \
	github.com/uber/jaeger-client-go				 v2.28.0+incompatible \
	github.com/uber/jaeger-lib					 v2.4.1+incompatible \
	github.com/urfave/cli						 v1.22.5 \
	github.com/vertica/vertica-sql-go				 v1.1.1 \
	github.com/willf/bitset						 v1.1.9 \
	github.com/xlab/treeprint					 v1.0.0 \
	github.com/yudai/gojsondiff					 v1.0.0 \
	github.com/yudai/golcs						 v0.0.0-20170316035057-ecda9a501e82 \
	github.com/yudai/pp						 v2.0.1+incompatible \
	github.com/yuin/goldmark					 v1.4.13 \
	go.etcd.io/bbolt						 v1.3.6 \
	go.opencensus.io						 v0.23.0 \
	go.uber.org/atomic						 v1.10.0 \
	go.uber.org/goleak						 v1.1.11 \
	go.uber.org/multierr						 v1.11.0 \
	go.uber.org/zap							 v1.24.0 \
	golang.org/x/crypto						 v0.0.0-20220331220935-ae2d96664a29 \
	golang.org/x/exp/typeparams					 v0.0.0-20230321023759-10a507213a29 \
	golang.org/x/lint						 v0.0.0-20210508222113-6edffad5e616 \
	golang.org/x/mod						 v0.10.0 \
	golang.org/x/net						 v0.9.0 \
	golang.org/x/oauth2						 v0.0.0-20210514164344-f6687ab2804c \
	golang.org/x/sync						 v0.1.0 \
	golang.org/x/sys						 v0.7.0 \
	golang.org/x/term						 v0.0.0-20220526004731-065cf7ba2467 \
	golang.org/x/text						 v0.3.8 \
	golang.org/x/time						 v0.0.0-20210220033141-f8bda1e9f3ba \
	golang.org/x/tools						 v0.8.0 \
	golang.org/x/xerrors						 v0.0.0-20220907171357-04be3eba64a2 \
	gonum.org/v1/gonum						 v0.9.3 \
	google.golang.org/api						 v0.47.0 \
	google.golang.org/appengine					 v1.6.7 \
	google.golang.org/genproto					 v0.0.0-20210630183607-d20f26d13c79 \
	google.golang.org/grpc						 v1.44.0 \
	google.golang.org/protobuf					 v1.30.0 \
	gopkg.in/check.v1						 v1.0.0-20190902080502-41f04d3bba15 \
	gopkg.in/ini.v1							 v1.51.0 \
	gopkg.in/square/go-jose.v2					 v2.3.1 \
	gopkg.in/yaml.v2						 v2.3.0 \
	gopkg.in/yaml.v3						 v3.0.1 \
	honnef.co/go/tools						 v0.4.3

MODGO_MODFILES =	\
	github.com/!alec!aivazis/survey/v2	 v2.2.9 \
	github.com/!burnt!sushi/toml		 v0.3.1 \
	github.com/!burnt!sushi/toml		 v0.4.1 \
	github.com/benbjohnson/clock		 v0.0.0-20161215174838-7dc76406b6d3 \
	github.com/cpuguy83/go-md2man/v2	 v2.0.0-20190314233015-f79a8a8ca69d \
	github.com/davecgh/go-spew		 v1.1.0 \
	github.com/golang/mock			 v1.5.0 \
	github.com/golang/protobuf		 v1.5.0 \
	github.com/google/go-cmp		 v0.5.5 \
	github.com/inconshreveable/mousetrap	 v1.0.0 \
	github.com/inconshreveable/mousetrap	 v1.0.1 \
	github.com/influxdata/influx-cli/v2	 v2.2.1-0.20220318222112-88ba3464cd07 \
	github.com/kr/text			 v0.1.0 \
	github.com/mattn/go-colorable		 v0.1.2 \
	github.com/mattn/go-colorable		 v0.1.4 \
	github.com/mattn/go-colorable		 v0.1.8 \
	github.com/mattn/go-isatty		 v0.0.10 \
	github.com/mattn/go-isatty		 v0.0.11 \
	github.com/mattn/go-isatty		 v0.0.13 \
	github.com/mattn/go-isatty		 v0.0.8 \
	github.com/mattn/go-runewidth		 v0.0.10 \
	github.com/mattn/go-runewidth		 v0.0.12 \
	github.com/mattn/go-runewidth		 v0.0.7 \
	github.com/mattn/go-runewidth		 v0.0.9 \
	github.com/muesli/ansi			 v0.0.0-20211018074035-2e021307bc4b \
	github.com/muesli/reflow		 v0.2.1-0.20210115123740-9e1d0d53df68 \
	github.com/muesli/termenv		 v0.11.1-0.20220204035834-5ac8409525e0 \
	github.com/muesli/termenv		 v0.11.1-0.20220212125758-44cd13922739 \
	github.com/pkg/errors			 v0.8.1 \
	github.com/rivo/uniseg			 v0.1.0 \
	github.com/russross/blackfriday/v2	 v2.0.1 \
	github.com/spf13/cobra			 v1.0.0 \
	github.com/spf13/cobra			 v1.6.1 \
	github.com/stretchr/objx		 v0.1.0 \
	github.com/stretchr/objx		 v0.1.1 \
	github.com/stretchr/objx		 v0.4.0 \
	github.com/stretchr/testify		 v1.3.0 \
	github.com/stretchr/testify		 v1.4.0 \
	github.com/stretchr/testify		 v1.6.1 \
	github.com/stretchr/testify		 v1.7.0 \
	github.com/stretchr/testify		 v1.7.1 \
	github.com/stretchr/testify		 v1.8.0 \
	github.com/yuin/goldmark		 v1.3.5 \
	go.uber.org/atomic			 v1.7.0 \
	go.uber.org/multierr			 v1.6.0 \
	go.uber.org/zap				 v1.16.0 \
	golang.org/x/crypto			 v0.0.0-20190308221718-c2843e01d9a2 \
	golang.org/x/crypto			 v0.0.0-20191011191535-87dc89f01550 \
	golang.org/x/exp/typeparams		 v0.0.0-20220218215828-6cf2b201936e \
	golang.org/x/exp/typeparams		 v0.0.0-20221208152030-732eee02a75a \
	golang.org/x/mod			 v0.4.2 \
	golang.org/x/mod			 v0.6.0-dev.0.20220106191415-9b9b3d81d5e3 \
	golang.org/x/mod			 v0.6.0-dev.0.20220419223038-86c51ed26bb4 \
	golang.org/x/mod			 v0.7.0 \
	golang.org/x/mod			 v0.8.0 \
	golang.org/x/net			 v0.0.0-20190404232315-eb5bcb51f2a3 \
	golang.org/x/net			 v0.0.0-20190620200207-3b0461eec859 \
	golang.org/x/net			 v0.0.0-20210405180319-a5a99cb37ef4 \
	golang.org/x/net			 v0.0.0-20220401154927-543a649e0bdd \
	golang.org/x/sync			 v0.0.0-20190423024810-112230192c58 \
	golang.org/x/sync			 v0.0.0-20210220032951-036812b2e83c \
	golang.org/x/sync			 v0.0.0-20220513210516-0976fa681c29 \
	golang.org/x/sys			 v0.0.0-20190215142949-d0b11bdaac8a \
	golang.org/x/sys			 v0.0.0-20190222072716-a9d3bda3a223 \
	golang.org/x/sys			 v0.0.0-20190412213103-97732733099d \
	golang.org/x/sys			 v0.0.0-20191008105621-543471e840be \
	golang.org/x/sys			 v0.0.0-20191026070338-33540a1f6037 \
	golang.org/x/sys			 v0.0.0-20191120155948-bd437916bb0e \
	golang.org/x/sys			 v0.0.0-20200909081042-eff7692f9009 \
	golang.org/x/sys			 v0.0.0-20200923182605-d9f96fdee20d \
	golang.org/x/sys			 v0.0.0-20201119102817-f84b799fce68 \
	golang.org/x/sys			 v0.0.0-20210124154548-22da62e12c0c \
	golang.org/x/sys			 v0.0.0-20210330210617-4fbd30eecc44 \
	golang.org/x/sys			 v0.0.0-20210510120138-977fb7262007 \
	golang.org/x/sys			 v0.0.0-20210615035016-665e8c7367d1 \
	golang.org/x/sys			 v0.0.0-20210630005230-0f9fa26af87c \
	golang.org/x/sys			 v0.0.0-20210927094055-39ccf1dd6fa6 \
	golang.org/x/sys			 v0.0.0-20220204135822-1c1b9b1eba6a \
	golang.org/x/sys			 v0.0.0-20220209214540-3681064d5158 \
	golang.org/x/sys			 v0.0.0-20220319134239-a9b59b0215f8 \
	golang.org/x/sys			 v0.0.0-20220520151302-bc2c85ada10a \
	golang.org/x/sys			 v0.0.0-20220722155257-8c9f86f7a55f \
	golang.org/x/sys			 v0.3.0 \
	golang.org/x/sys			 v0.5.0 \
	golang.org/x/term			 v0.0.0-20201126162022-7de9c90e9dd1 \
	golang.org/x/term			 v0.0.0-20210503060354-a79de5458b56 \
	golang.org/x/term			 v0.0.0-20210927222741-03fcf44c2211 \
	golang.org/x/text			 v0.3.0 \
	golang.org/x/text			 v0.3.3 \
	golang.org/x/text			 v0.3.7 \
	golang.org/x/tools			 v0.0.0-20180917221912-90fa682c2a6e \
	golang.org/x/tools			 v0.0.0-20191119224855-298f0cb1881e \
	golang.org/x/tools			 v0.1.1 \
	golang.org/x/tools			 v0.1.11-0.20220316014157-77aa08bb151a \
	golang.org/x/tools			 v0.1.12 \
	golang.org/x/tools			 v0.4.1-0.20221208213631-3f74d914ae6d \
	golang.org/x/tools			 v0.6.0 \
	golang.org/x/xerrors			 v0.0.0-20190717185122-a985d3407aa7 \
	golang.org/x/xerrors			 v0.0.0-20191011141410-1b5146add898 \
	golang.org/x/xerrors			 v0.0.0-20191204190536-9bdfabe68543 \
	golang.org/x/xerrors			 v0.0.0-20200804184101-5ec99f83aff1 \
	google.golang.org/protobuf		 v1.26.0-rc.1 \
	google.golang.org/protobuf		 v1.27.1 \
	gopkg.in/check.v1			 v0.0.0-20161208181325-20d25e280405 \
	gopkg.in/yaml.v2			 v2.2.2 \
	gopkg.in/yaml.v2			 v2.2.4 \
	gopkg.in/yaml.v3			 v3.0.0-20200313102051-9f266ea9e77c \
	honnef.co/go/tools			 v0.3.0

