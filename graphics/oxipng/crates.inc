MODCARGO_CRATES +=	adler2	2.0.1	# 0BSD OR MIT OR Apache-2.0
MODCARGO_CRATES +=	anstream	1.0.0	# MIT OR Apache-2.0
MODCARGO_CRATES +=	anstyle	1.0.14	# MIT OR Apache-2.0
MODCARGO_CRATES +=	anstyle-parse	1.0.0	# MIT OR Apache-2.0
MODCARGO_CRATES +=	anstyle-query	1.1.5	# MIT OR Apache-2.0
MODCARGO_CRATES +=	anstyle-wincon	3.0.11	# MIT OR Apache-2.0
MODCARGO_CRATES +=	autocfg	1.5.0	# Apache-2.0 OR MIT
MODCARGO_CRATES +=	bitflags	2.11.1	# MIT OR Apache-2.0
MODCARGO_CRATES +=	bitvec	1.0.1	# MIT
MODCARGO_CRATES +=	bumpalo	3.20.2	# MIT OR Apache-2.0
MODCARGO_CRATES +=	bytemuck	1.25.0	# Zlib OR Apache-2.0 OR MIT
MODCARGO_CRATES +=	byteorder-lite	0.1.0	# Unlicense OR MIT
MODCARGO_CRATES +=	cc	1.2.60	# MIT OR Apache-2.0
MODCARGO_CRATES +=	cfg-if	1.0.4	# MIT OR Apache-2.0
MODCARGO_CRATES +=	clap	4.6.1	# MIT OR Apache-2.0
MODCARGO_CRATES +=	clap_builder	4.6.0	# MIT OR Apache-2.0
MODCARGO_CRATES +=	clap_lex	1.1.0	# MIT OR Apache-2.0
MODCARGO_CRATES +=	colorchoice	1.0.5	# MIT OR Apache-2.0
MODCARGO_CRATES +=	crc32fast	1.5.0	# MIT OR Apache-2.0
MODCARGO_CRATES +=	crossbeam-deque	0.8.6	# MIT OR Apache-2.0
MODCARGO_CRATES +=	crossbeam-epoch	0.9.18	# MIT OR Apache-2.0
MODCARGO_CRATES +=	crossbeam-utils	0.8.21	# MIT OR Apache-2.0
MODCARGO_CRATES +=	either	1.15.0	# MIT OR Apache-2.0
MODCARGO_CRATES +=	env_filter	1.0.1	# MIT OR Apache-2.0
MODCARGO_CRATES +=	env_logger	0.11.10	# MIT OR Apache-2.0
MODCARGO_CRATES +=	equivalent	1.0.2	# Apache-2.0 OR MIT
MODCARGO_CRATES +=	errno	0.3.14	# MIT OR Apache-2.0
MODCARGO_CRATES +=	fdeflate	0.3.7	# MIT OR Apache-2.0
MODCARGO_CRATES +=	find-msvc-tools	0.1.9	# MIT OR Apache-2.0
MODCARGO_CRATES +=	flate2	1.1.9	# MIT OR Apache-2.0
MODCARGO_CRATES +=	funty	2.0.0	# MIT
MODCARGO_CRATES +=	glob	0.3.3	# MIT OR Apache-2.0
MODCARGO_CRATES +=	hashbrown	0.17.0	# MIT OR Apache-2.0
MODCARGO_CRATES +=	image	0.25.9	# MIT OR Apache-2.0
MODCARGO_CRATES +=	indexmap	2.14.0	# Apache-2.0 OR MIT
MODCARGO_CRATES +=	is_terminal_polyfill	1.70.2	# MIT OR Apache-2.0
MODCARGO_CRATES +=	itoa	1.0.18	# MIT OR Apache-2.0
MODCARGO_CRATES +=	libc	0.2.185	# MIT OR Apache-2.0
MODCARGO_CRATES +=	libdeflate-sys	1.25.2	# Apache-2.0
MODCARGO_CRATES +=	libdeflater	1.25.2	# Apache-2.0
MODCARGO_CRATES +=	linux-raw-sys	0.12.1	# Apache-2.0 WITH LLVM-exception OR Apache-2.0 OR MIT
MODCARGO_CRATES +=	log	0.4.29	# MIT OR Apache-2.0
MODCARGO_CRATES +=	memchr	2.8.0	# Unlicense OR MIT
MODCARGO_CRATES +=	miniz_oxide	0.8.9	# MIT OR Zlib OR Apache-2.0
MODCARGO_CRATES +=	moxcms	0.7.11	# BSD-3-Clause OR Apache-2.0
MODCARGO_CRATES +=	num-traits	0.2.19	# MIT OR Apache-2.0
MODCARGO_CRATES +=	once_cell_polyfill	1.70.2	# MIT OR Apache-2.0
MODCARGO_CRATES +=	parse-size	1.1.0	# MIT
MODCARGO_CRATES +=	pkg-config	0.3.33	# MIT OR Apache-2.0
MODCARGO_CRATES +=	png	0.18.1	# MIT OR Apache-2.0
MODCARGO_CRATES +=	proc-macro2	1.0.106	# MIT OR Apache-2.0
MODCARGO_CRATES +=	pxfm	0.1.29	# BSD-3-Clause OR Apache-2.0
MODCARGO_CRATES +=	quote	1.0.45	# MIT OR Apache-2.0
MODCARGO_CRATES +=	radium	0.7.0	# MIT
MODCARGO_CRATES +=	rayon	1.12.0	# MIT OR Apache-2.0
MODCARGO_CRATES +=	rayon-core	1.13.0	# MIT OR Apache-2.0
MODCARGO_CRATES +=	rgb	0.8.53	# MIT
MODCARGO_CRATES +=	rustc-hash	2.1.2	# Apache-2.0 OR MIT
MODCARGO_CRATES +=	rustix	1.1.4	# Apache-2.0 WITH LLVM-exception OR Apache-2.0 OR MIT
MODCARGO_CRATES +=	serde	1.0.228	# MIT OR Apache-2.0
MODCARGO_CRATES +=	serde_core	1.0.228	# MIT OR Apache-2.0
MODCARGO_CRATES +=	serde_derive	1.0.228	# MIT OR Apache-2.0
MODCARGO_CRATES +=	serde_json	1.0.149	# MIT OR Apache-2.0
MODCARGO_CRATES +=	shlex	1.3.0	# MIT OR Apache-2.0
MODCARGO_CRATES +=	simd-adler32	0.3.9	# MIT
MODCARGO_CRATES +=	strsim	0.11.1	# MIT
MODCARGO_CRATES +=	syn	2.0.117	# MIT OR Apache-2.0
MODCARGO_CRATES +=	tap	1.0.1	# MIT
MODCARGO_CRATES +=	terminal_size	0.4.4	# MIT OR Apache-2.0
MODCARGO_CRATES +=	unicode-ident	1.0.24	# (MIT OR Apache-2.0) AND Unicode-3.0
MODCARGO_CRATES +=	utf8parse	0.2.2	# Apache-2.0 OR MIT
MODCARGO_CRATES +=	windows-link	0.2.1	# MIT OR Apache-2.0
MODCARGO_CRATES +=	windows-sys	0.61.2	# MIT OR Apache-2.0
MODCARGO_CRATES +=	wyz	0.5.1	# MIT
MODCARGO_CRATES +=	zmij	1.0.21	# MIT
MODCARGO_CRATES +=	zopfli	0.8.3	# Apache-2.0
