MODCARGO_CRATES +=	aho-corasick	1.1.4	# Unlicense OR MIT
MODCARGO_CRATES +=	allocator-api2	0.2.21	# MIT OR Apache-2.0
MODCARGO_CRATES +=	anstream	1.0.0	# MIT OR Apache-2.0
MODCARGO_CRATES +=	anstyle	1.0.14	# MIT OR Apache-2.0
MODCARGO_CRATES +=	anstyle-parse	1.0.0	# MIT OR Apache-2.0
MODCARGO_CRATES +=	anstyle-query	1.1.5	# MIT OR Apache-2.0
MODCARGO_CRATES +=	anstyle-wincon	3.0.11	# MIT OR Apache-2.0
MODCARGO_CRATES +=	anyhow	1.0.102	# MIT OR Apache-2.0
MODCARGO_CRATES +=	assert_matches	1.5.0	# MIT/Apache-2.0
MODCARGO_CRATES +=	autocfg	1.5.1	# Apache-2.0 OR MIT
MODCARGO_CRATES +=	bitflags	2.11.1	# MIT OR Apache-2.0
MODCARGO_CRATES +=	block-buffer	0.10.4	# MIT OR Apache-2.0
MODCARGO_CRATES +=	bstr	1.12.1	# MIT OR Apache-2.0
MODCARGO_CRATES +=	cc	1.2.63	# MIT OR Apache-2.0
MODCARGO_CRATES +=	cfg-if	1.0.4	# MIT OR Apache-2.0
MODCARGO_CRATES +=	cfg_aliases	0.2.1	# MIT
MODCARGO_CRATES +=	chacha20	0.10.0	# MIT OR Apache-2.0
MODCARGO_CRATES +=	clap	4.6.1	# MIT OR Apache-2.0
MODCARGO_CRATES +=	clap_builder	4.6.0	# MIT OR Apache-2.0
MODCARGO_CRATES +=	clap_complete	4.6.5	# MIT OR Apache-2.0
MODCARGO_CRATES +=	clap_derive	4.6.1	# MIT OR Apache-2.0
MODCARGO_CRATES +=	clap_lex	1.1.0	# MIT OR Apache-2.0
MODCARGO_CRATES +=	colorchoice	1.0.5	# MIT OR Apache-2.0
MODCARGO_CRATES +=	cpufeatures	0.2.17	# MIT OR Apache-2.0
MODCARGO_CRATES +=	cpufeatures	0.3.0	# MIT OR Apache-2.0
MODCARGO_CRATES +=	crossbeam-deque	0.8.6	# MIT OR Apache-2.0
MODCARGO_CRATES +=	crossbeam-epoch	0.9.18	# MIT OR Apache-2.0
MODCARGO_CRATES +=	crossbeam-utils	0.8.21	# MIT OR Apache-2.0
MODCARGO_CRATES +=	crypto-common	0.1.7	# MIT OR Apache-2.0
MODCARGO_CRATES +=	digest	0.10.7	# MIT OR Apache-2.0
MODCARGO_CRATES +=	dirs	6.0.0	# MIT OR Apache-2.0
MODCARGO_CRATES +=	dirs-sys	0.5.0	# MIT OR Apache-2.0
MODCARGO_CRATES +=	displaydoc	0.2.6	# MIT OR Apache-2.0
MODCARGO_CRATES +=	either	1.16.0	# MIT OR Apache-2.0
MODCARGO_CRATES +=	equivalent	1.0.2	# Apache-2.0 OR MIT
MODCARGO_CRATES +=	errno	0.3.14	# MIT OR Apache-2.0
MODCARGO_CRATES +=	fastrand	2.4.1	# Apache-2.0 OR MIT
MODCARGO_CRATES +=	find-msvc-tools	0.1.9	# MIT OR Apache-2.0
MODCARGO_CRATES +=	fluent-langneg	0.13.1	# Apache-2.0 OR MIT
MODCARGO_CRATES +=	foldhash	0.1.5	# Zlib
MODCARGO_CRATES +=	foldhash	0.2.0	# Zlib
MODCARGO_CRATES +=	generic-array	0.14.7	# MIT
MODCARGO_CRATES +=	getrandom	0.2.17	# MIT OR Apache-2.0
MODCARGO_CRATES +=	getrandom	0.3.4	# MIT OR Apache-2.0
MODCARGO_CRATES +=	getrandom	0.4.2	# MIT OR Apache-2.0
MODCARGO_CRATES +=	globset	0.4.18	# Unlicense OR MIT
MODCARGO_CRATES +=	hashbrown	0.15.5	# MIT OR Apache-2.0
MODCARGO_CRATES +=	hashbrown	0.17.1	# MIT OR Apache-2.0
MODCARGO_CRATES +=	heck	0.5.0	# MIT OR Apache-2.0
MODCARGO_CRATES +=	id-arena	2.3.0	# MIT/Apache-2.0
MODCARGO_CRATES +=	ignore	0.4.25	# Unlicense OR MIT
MODCARGO_CRATES +=	indexmap	2.14.0	# Apache-2.0 OR MIT
MODCARGO_CRATES +=	intl_pluralrules	7.0.2	# Apache-2.0/MIT
MODCARGO_CRATES +=	is_executable	1.0.5	# MIT OR Apache-2.0
MODCARGO_CRATES +=	is_terminal_polyfill	1.70.2	# MIT OR Apache-2.0
MODCARGO_CRATES +=	itertools	0.14.0	# MIT OR Apache-2.0
MODCARGO_CRATES +=	itoa	1.0.18	# MIT OR Apache-2.0
MODCARGO_CRATES +=	jobserver	0.1.34	# MIT OR Apache-2.0
MODCARGO_CRATES +=	leb128fmt	0.1.0	# MIT OR Apache-2.0
MODCARGO_CRATES +=	libc	0.2.186	# MIT OR Apache-2.0
MODCARGO_CRATES +=	libredox	0.1.17	# MIT
MODCARGO_CRATES +=	lock_api	0.4.14	# MIT OR Apache-2.0
MODCARGO_CRATES +=	log	0.4.30	# MIT OR Apache-2.0
MODCARGO_CRATES +=	lru	0.18.0	# MIT
MODCARGO_CRATES +=	macro_rules_attribute	0.2.2	# Apache-2.0 OR MIT OR Zlib
MODCARGO_CRATES +=	macro_rules_attribute-proc_macro	0.2.2	# Apache-2.0 OR MIT OR Zlib
MODCARGO_CRATES +=	memchr	2.8.1	# Unlicense OR MIT
MODCARGO_CRATES +=	nix	0.30.1	# MIT
MODCARGO_CRATES +=	nix	0.31.3	# MIT
MODCARGO_CRATES +=	num-traits	0.2.19	# MIT OR Apache-2.0
MODCARGO_CRATES +=	once_cell	1.21.4	# MIT OR Apache-2.0
MODCARGO_CRATES +=	once_cell_polyfill	1.70.2	# MIT OR Apache-2.0
MODCARGO_CRATES +=	option-ext	0.2.0	# MPL-2.0
MODCARGO_CRATES +=	parking_lot	0.12.5	# MIT OR Apache-2.0
MODCARGO_CRATES +=	parking_lot_core	0.9.12	# MIT OR Apache-2.0
MODCARGO_CRATES +=	paste	1.0.15	# MIT OR Apache-2.0
MODCARGO_CRATES +=	phf	0.13.1	# MIT
MODCARGO_CRATES +=	phf_codegen	0.13.1	# MIT
MODCARGO_CRATES +=	phf_generator	0.13.1	# MIT
MODCARGO_CRATES +=	phf_shared	0.13.1	# MIT
MODCARGO_CRATES +=	pkg-config	0.3.33	# MIT OR Apache-2.0
MODCARGO_CRATES +=	portable-atomic	1.13.1	# Apache-2.0 OR MIT
MODCARGO_CRATES +=	prettyplease	0.2.37	# MIT OR Apache-2.0
MODCARGO_CRATES +=	proc-macro2	1.0.106	# MIT OR Apache-2.0
MODCARGO_CRATES +=	quote	1.0.45	# MIT OR Apache-2.0
MODCARGO_CRATES +=	r-efi	5.3.0	# MIT OR Apache-2.0 OR LGPL-2.1-or-later
MODCARGO_CRATES +=	r-efi	6.0.0	# MIT OR Apache-2.0 OR LGPL-2.1-or-later
MODCARGO_CRATES +=	rand	0.10.1	# MIT OR Apache-2.0
MODCARGO_CRATES +=	rand_core	0.10.1	# MIT OR Apache-2.0
MODCARGO_CRATES +=	redox_syscall	0.5.18	# MIT
MODCARGO_CRATES +=	redox_users	0.5.2	# MIT
MODCARGO_CRATES +=	regex-automata	0.4.14	# MIT OR Apache-2.0
MODCARGO_CRATES +=	regex-syntax	0.8.10	# MIT OR Apache-2.0
MODCARGO_CRATES +=	rsconf	0.3.0	# MIT OR Apache-2.0
MODCARGO_CRATES +=	rust-embed	8.11.0	# MIT
MODCARGO_CRATES +=	rust-embed-impl	8.11.0	# MIT
MODCARGO_CRATES +=	rust-embed-utils	8.11.0	# MIT
MODCARGO_CRATES +=	rustc-hash	2.1.2	# Apache-2.0 OR MIT
MODCARGO_CRATES +=	rustc_version	0.4.1	# MIT OR Apache-2.0
MODCARGO_CRATES +=	same-file	1.0.6	# Unlicense/MIT
MODCARGO_CRATES +=	scc	2.4.0	# Apache-2.0
MODCARGO_CRATES +=	scopeguard	1.2.0	# MIT OR Apache-2.0
MODCARGO_CRATES +=	sdd	3.0.10	# Apache-2.0
MODCARGO_CRATES +=	self_cell	1.2.2	# Apache-2.0 OR GPL-2.0-only
MODCARGO_CRATES +=	semver	1.0.28	# MIT OR Apache-2.0
MODCARGO_CRATES +=	serde	1.0.228	# MIT OR Apache-2.0
MODCARGO_CRATES +=	serde_core	1.0.228	# MIT OR Apache-2.0
MODCARGO_CRATES +=	serde_derive	1.0.228	# MIT OR Apache-2.0
MODCARGO_CRATES +=	serde_json	1.0.150	# MIT OR Apache-2.0
MODCARGO_CRATES +=	serial_test	3.4.0	# MIT
MODCARGO_CRATES +=	serial_test_derive	3.4.0	# MIT
MODCARGO_CRATES +=	sha2	0.10.9	# MIT OR Apache-2.0
MODCARGO_CRATES +=	shellexpand	3.1.2	# MIT/Apache-2.0
MODCARGO_CRATES +=	shlex	1.3.0	# MIT OR Apache-2.0
MODCARGO_CRATES +=	shlex	2.0.1	# MIT OR Apache-2.0
MODCARGO_CRATES +=	siphasher	1.0.3	# MIT/Apache-2.0
MODCARGO_CRATES +=	smallvec	1.15.1	# MIT OR Apache-2.0
MODCARGO_CRATES +=	strsim	0.11.1	# MIT
MODCARGO_CRATES +=	strum_macros	0.28.0	# MIT
MODCARGO_CRATES +=	syn	2.0.117	# MIT OR Apache-2.0
MODCARGO_CRATES +=	thiserror	2.0.18	# MIT OR Apache-2.0
MODCARGO_CRATES +=	thiserror-impl	2.0.18	# MIT OR Apache-2.0
MODCARGO_CRATES +=	tinystr	0.8.3	# Unicode-3.0
MODCARGO_CRATES +=	type-map	0.5.1	# MIT/Apache-2.0
MODCARGO_CRATES +=	typenum	1.20.1	# MIT OR Apache-2.0
MODCARGO_CRATES +=	unic-langid	0.9.6	# MIT OR Apache-2.0
MODCARGO_CRATES +=	unic-langid-impl	0.9.6	# MIT OR Apache-2.0
MODCARGO_CRATES +=	unicode-ident	1.0.24	# (MIT OR Apache-2.0) AND Unicode-3.0
MODCARGO_CRATES +=	unicode-segmentation	1.13.2	# MIT OR Apache-2.0
MODCARGO_CRATES +=	unicode-width	0.2.2	# MIT OR Apache-2.0
MODCARGO_CRATES +=	unicode-xid	0.2.6	# MIT OR Apache-2.0
MODCARGO_CRATES +=	unix_path	1.0.1	# MIT OR Apache-2.0
MODCARGO_CRATES +=	unix_str	1.0.0	# MIT OR Apache-2.0
MODCARGO_CRATES +=	utf8parse	0.2.2	# Apache-2.0 OR MIT
MODCARGO_CRATES +=	version_check	0.9.5	# MIT/Apache-2.0
MODCARGO_CRATES +=	walkdir	2.5.0	# Unlicense/MIT
MODCARGO_CRATES +=	wasi	0.11.1+wasi-snapshot-preview1	# Apache-2.0 WITH LLVM-exception OR Apache-2.0 OR MIT
MODCARGO_CRATES +=	wasip2	1.0.1+wasi-0.2.4	# Apache-2.0 WITH LLVM-exception OR Apache-2.0 OR MIT
MODCARGO_CRATES +=	wasip3	0.4.0+wasi-0.3.0-rc-2026-01-06	# Apache-2.0 WITH LLVM-exception OR Apache-2.0 OR MIT
MODCARGO_CRATES +=	wasm-encoder	0.244.0	# Apache-2.0 WITH LLVM-exception OR Apache-2.0 OR MIT
MODCARGO_CRATES +=	wasm-metadata	0.244.0	# Apache-2.0 WITH LLVM-exception OR Apache-2.0 OR MIT
MODCARGO_CRATES +=	wasmparser	0.244.0	# Apache-2.0 WITH LLVM-exception OR Apache-2.0 OR MIT
MODCARGO_CRATES +=	widestring	1.2.1	# MIT OR Apache-2.0
MODCARGO_CRATES +=	winapi-util	0.1.11	# Unlicense OR MIT
MODCARGO_CRATES +=	windows-link	0.2.1	# MIT OR Apache-2.0
MODCARGO_CRATES +=	windows-sys	0.60.2	# MIT OR Apache-2.0
MODCARGO_CRATES +=	windows-sys	0.61.2	# MIT OR Apache-2.0
MODCARGO_CRATES +=	windows-targets	0.53.5	# MIT OR Apache-2.0
MODCARGO_CRATES +=	windows_aarch64_gnullvm	0.53.1	# MIT OR Apache-2.0
MODCARGO_CRATES +=	windows_aarch64_msvc	0.53.1	# MIT OR Apache-2.0
MODCARGO_CRATES +=	windows_i686_gnu	0.53.1	# MIT OR Apache-2.0
MODCARGO_CRATES +=	windows_i686_gnullvm	0.53.1	# MIT OR Apache-2.0
MODCARGO_CRATES +=	windows_i686_msvc	0.53.1	# MIT OR Apache-2.0
MODCARGO_CRATES +=	windows_x86_64_gnu	0.53.1	# MIT OR Apache-2.0
MODCARGO_CRATES +=	windows_x86_64_gnullvm	0.53.1	# MIT OR Apache-2.0
MODCARGO_CRATES +=	windows_x86_64_msvc	0.53.1	# MIT OR Apache-2.0
MODCARGO_CRATES +=	wit-bindgen	0.46.0	# Apache-2.0 WITH LLVM-exception OR Apache-2.0 OR MIT
MODCARGO_CRATES +=	wit-bindgen	0.51.0	# Apache-2.0 WITH LLVM-exception OR Apache-2.0 OR MIT
MODCARGO_CRATES +=	wit-bindgen-core	0.51.0	# Apache-2.0 WITH LLVM-exception OR Apache-2.0 OR MIT
MODCARGO_CRATES +=	wit-bindgen-rust	0.51.0	# Apache-2.0 WITH LLVM-exception OR Apache-2.0 OR MIT
MODCARGO_CRATES +=	wit-bindgen-rust-macro	0.51.0	# Apache-2.0 WITH LLVM-exception OR Apache-2.0 OR MIT
MODCARGO_CRATES +=	wit-component	0.244.0	# Apache-2.0 WITH LLVM-exception OR Apache-2.0 OR MIT
MODCARGO_CRATES +=	wit-parser	0.244.0	# Apache-2.0 WITH LLVM-exception OR Apache-2.0 OR MIT
MODCARGO_CRATES +=	xterm-color	1.0.2	# MIT OR Apache-2.0
MODCARGO_CRATES +=	zerofrom	0.1.8	# Unicode-3.0
MODCARGO_CRATES +=	zerovec	0.11.6	# Unicode-3.0
MODCARGO_CRATES +=	zmij	1.0.21	# MIT
