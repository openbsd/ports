MODCARGO_CRATES +=	addr2line	0.21.0	# Apache-2.0 OR MIT
MODCARGO_CRATES +=	adler	1.0.2	# 0BSD OR MIT OR Apache-2.0
MODCARGO_CRATES +=	adler32	1.2.0	# Zlib
MODCARGO_CRATES +=	ahash	0.7.8	# MIT OR Apache-2.0
MODCARGO_CRATES +=	ahash	0.8.11	# MIT OR Apache-2.0
MODCARGO_CRATES +=	aho-corasick	1.1.3	# Unlicense OR MIT
MODCARGO_CRATES +=	alloc-no-stdlib	2.0.4	# BSD-3-Clause
MODCARGO_CRATES +=	alloc-stdlib	0.2.2	# BSD-3-Clause
MODCARGO_CRATES +=	allocator-api2	0.2.16	# MIT OR Apache-2.0
MODCARGO_CRATES +=	alphanumeric-sort	1.5.3	# MIT
MODCARGO_CRATES +=	android-tzdata	0.1.1	# MIT OR Apache-2.0
MODCARGO_CRATES +=	android_system_properties	0.1.5	# MIT/Apache-2.0
MODCARGO_CRATES +=	ansi-str	0.8.0	# MIT
MODCARGO_CRATES +=	ansitok	0.2.0	# MIT
MODCARGO_CRATES +=	anstream	0.6.13	# MIT OR Apache-2.0
MODCARGO_CRATES +=	anstyle	1.0.6	# MIT OR Apache-2.0
MODCARGO_CRATES +=	anstyle-parse	0.2.3	# MIT OR Apache-2.0
MODCARGO_CRATES +=	anstyle-query	1.0.2	# MIT OR Apache-2.0
MODCARGO_CRATES +=	anstyle-wincon	3.0.2	# MIT OR Apache-2.0
MODCARGO_CRATES +=	arboard	3.3.2	# MIT OR Apache-2.0
MODCARGO_CRATES +=	argminmax	0.6.2	# MIT
MODCARGO_CRATES +=	array-init-cursor	0.2.0	# MIT/Apache-2.0
MODCARGO_CRATES +=	arrayvec	0.5.2	# MIT/Apache-2.0
MODCARGO_CRATES +=	arrayvec	0.7.4	# MIT OR Apache-2.0
MODCARGO_CRATES +=	assert-json-diff	2.0.2	# MIT
MODCARGO_CRATES +=	assert_cmd	2.0.14	# MIT OR Apache-2.0
MODCARGO_CRATES +=	async-channel	2.2.0	# Apache-2.0 OR MIT
MODCARGO_CRATES +=	async-lock	3.3.0	# Apache-2.0 OR MIT
MODCARGO_CRATES +=	async-stream	0.3.5	# MIT
MODCARGO_CRATES +=	async-stream-impl	0.3.5	# MIT
MODCARGO_CRATES +=	async-task	4.7.0	# Apache-2.0 OR MIT
MODCARGO_CRATES +=	async-trait	0.1.79	# MIT OR Apache-2.0
MODCARGO_CRATES +=	atoi	2.0.0	# MIT
MODCARGO_CRATES +=	atoi_simd	0.15.6	# MIT OR Apache-2.0
MODCARGO_CRATES +=	atomic-waker	1.1.2	# Apache-2.0 OR MIT
MODCARGO_CRATES +=	autocfg	1.2.0	# Apache-2.0 OR MIT
MODCARGO_CRATES +=	avro-schema	0.3.0	# MIT/Apache-2.0
MODCARGO_CRATES +=	backtrace	0.3.71	# MIT OR Apache-2.0
MODCARGO_CRATES +=	backtrace-ext	0.2.1	# MIT OR Apache-2.0
MODCARGO_CRATES +=	base64	0.13.1	# MIT/Apache-2.0
MODCARGO_CRATES +=	base64	0.21.7	# MIT OR Apache-2.0
MODCARGO_CRATES +=	base64	0.22.0	# MIT OR Apache-2.0
MODCARGO_CRATES +=	bincode	1.3.3	# MIT
MODCARGO_CRATES +=	bindgen	0.69.4	# BSD-3-Clause
MODCARGO_CRATES +=	bit-set	0.5.3	# MIT/Apache-2.0
MODCARGO_CRATES +=	bit-vec	0.6.3	# MIT/Apache-2.0
MODCARGO_CRATES +=	bitflags	1.3.2	# MIT/Apache-2.0
MODCARGO_CRATES +=	bitflags	2.5.0	# MIT OR Apache-2.0
MODCARGO_CRATES +=	bitvec	1.0.1	# MIT
MODCARGO_CRATES +=	block	0.1.6	# MIT
MODCARGO_CRATES +=	block-buffer	0.10.4	# MIT OR Apache-2.0
MODCARGO_CRATES +=	blocking	1.5.1	# Apache-2.0 OR MIT
MODCARGO_CRATES +=	borsh	1.4.0	# MIT OR Apache-2.0
MODCARGO_CRATES +=	borsh-derive	1.4.0	# Apache-2.0
MODCARGO_CRATES +=	bracoxide	0.1.3	# MIT
MODCARGO_CRATES +=	brotli	3.5.0	# BSD-3-Clause OR MIT
MODCARGO_CRATES +=	brotli	5.0.0	# BSD-3-Clause OR MIT
MODCARGO_CRATES +=	brotli-decompressor	2.5.1	# BSD-3-Clause/MIT
MODCARGO_CRATES +=	brotli-decompressor	4.0.0	# BSD-3-Clause/MIT
MODCARGO_CRATES +=	bstr	1.9.1	# MIT OR Apache-2.0
MODCARGO_CRATES +=	bumpalo	3.16.0	# MIT OR Apache-2.0
MODCARGO_CRATES +=	byte-unit	5.1.4	# MIT
MODCARGO_CRATES +=	bytecheck	0.6.12	# MIT
MODCARGO_CRATES +=	bytecheck_derive	0.6.12	# MIT
MODCARGO_CRATES +=	bytecount	0.6.7	# Apache-2.0/MIT
MODCARGO_CRATES +=	bytemuck	1.15.0	# Zlib OR Apache-2.0 OR MIT
MODCARGO_CRATES +=	bytemuck_derive	1.6.0	# Zlib OR Apache-2.0 OR MIT
MODCARGO_CRATES +=	byteorder	1.5.0	# Unlicense OR MIT
MODCARGO_CRATES +=	bytes	1.6.0	# MIT
MODCARGO_CRATES +=	bytesize	1.3.0	# Apache-2.0
MODCARGO_CRATES +=	calamine	0.24.0	# MIT
MODCARGO_CRATES +=	cassowary	0.3.0	# MIT / Apache-2.0
MODCARGO_CRATES +=	castaway	0.2.2	# MIT
MODCARGO_CRATES +=	cc	1.0.92	# MIT OR Apache-2.0
MODCARGO_CRATES +=	cexpr	0.6.0	# Apache-2.0/MIT
MODCARGO_CRATES +=	cfg-if	1.0.0	# MIT/Apache-2.0
MODCARGO_CRATES +=	cfg_aliases	0.1.1	# MIT
MODCARGO_CRATES +=	chardetng	0.1.17	# Apache-2.0 OR MIT
MODCARGO_CRATES +=	charset	0.1.3	# MIT/Apache-2.0
MODCARGO_CRATES +=	chrono	0.4.37	# MIT OR Apache-2.0
MODCARGO_CRATES +=	chrono-humanize	0.2.3	# MIT/Apache-2.0
MODCARGO_CRATES +=	chrono-tz	0.8.6	# MIT OR Apache-2.0
MODCARGO_CRATES +=	chrono-tz	0.9.0	# MIT OR Apache-2.0
MODCARGO_CRATES +=	chrono-tz-build	0.2.1	# MIT OR Apache-2.0
MODCARGO_CRATES +=	chrono-tz-build	0.3.0	# MIT OR Apache-2.0
MODCARGO_CRATES +=	chumsky	0.9.3	# MIT
MODCARGO_CRATES +=	clang-sys	1.7.0	# Apache-2.0
MODCARGO_CRATES +=	clap	4.5.4	# MIT OR Apache-2.0
MODCARGO_CRATES +=	clap_builder	4.5.2	# MIT OR Apache-2.0
MODCARGO_CRATES +=	clap_lex	0.7.0	# MIT OR Apache-2.0
MODCARGO_CRATES +=	clipboard-win	5.3.0	# BSL-1.0
MODCARGO_CRATES +=	codepage	0.1.1	# MIT/Apache-2.0
MODCARGO_CRATES +=	colorchoice	1.0.0	# MIT OR Apache-2.0
MODCARGO_CRATES +=	comfy-table	7.1.1	# MIT
MODCARGO_CRATES +=	compact_str	0.7.1	# MIT
MODCARGO_CRATES +=	concurrent-queue	2.4.0	# Apache-2.0 OR MIT
MODCARGO_CRATES +=	condtype	1.3.0	# MIT OR Apache-2.0
MODCARGO_CRATES +=	console	0.15.8	# MIT
MODCARGO_CRATES +=	const-random	0.1.18	# MIT OR Apache-2.0
MODCARGO_CRATES +=	const-random-macro	0.1.16	# MIT OR Apache-2.0
MODCARGO_CRATES +=	const_format	0.2.32	# Zlib
MODCARGO_CRATES +=	const_format_proc_macros	0.2.32	# Zlib
MODCARGO_CRATES +=	core-foundation	0.9.4	# MIT OR Apache-2.0
MODCARGO_CRATES +=	core-foundation-sys	0.8.6	# MIT OR Apache-2.0
MODCARGO_CRATES +=	cpufeatures	0.2.12	# MIT OR Apache-2.0
MODCARGO_CRATES +=	crc	2.1.0	# MIT OR Apache-2.0
MODCARGO_CRATES +=	crc-catalog	1.1.1	# MIT OR Apache-2.0
MODCARGO_CRATES +=	crc32fast	1.4.0	# MIT OR Apache-2.0
MODCARGO_CRATES +=	crossbeam-channel	0.5.12	# MIT OR Apache-2.0
MODCARGO_CRATES +=	crossbeam-deque	0.8.5	# MIT OR Apache-2.0
MODCARGO_CRATES +=	crossbeam-epoch	0.9.18	# MIT OR Apache-2.0
MODCARGO_CRATES +=	crossbeam-queue	0.3.11	# MIT OR Apache-2.0
MODCARGO_CRATES +=	crossbeam-utils	0.8.19	# MIT OR Apache-2.0
MODCARGO_CRATES +=	crossterm	0.27.0	# MIT
MODCARGO_CRATES +=	crossterm_winapi	0.9.1	# MIT
MODCARGO_CRATES +=	crunchy	0.2.2	# MIT
MODCARGO_CRATES +=	crypto-common	0.1.6	# MIT OR Apache-2.0
MODCARGO_CRATES +=	cssparser	0.31.2	# MPL-2.0
MODCARGO_CRATES +=	cssparser-macros	0.6.1	# MPL-2.0
MODCARGO_CRATES +=	csv	1.3.0	# Unlicense/MIT
MODCARGO_CRATES +=	csv-core	0.1.11	# Unlicense/MIT
MODCARGO_CRATES +=	ctrlc	3.4.4	# MIT/Apache-2.0
MODCARGO_CRATES +=	deranged	0.3.11	# MIT OR Apache-2.0
MODCARGO_CRATES +=	derive-new	0.6.0	# MIT
MODCARGO_CRATES +=	derive_more	0.99.17	# MIT
MODCARGO_CRATES +=	dialoguer	0.11.0	# MIT
MODCARGO_CRATES +=	diff	0.1.13	# MIT OR Apache-2.0
MODCARGO_CRATES +=	difflib	0.4.0	# MIT
MODCARGO_CRATES +=	digest	0.10.7	# MIT OR Apache-2.0
MODCARGO_CRATES +=	dirs-next	2.0.0	# MIT OR Apache-2.0
MODCARGO_CRATES +=	dirs-sys-next	0.1.2	# MIT OR Apache-2.0
MODCARGO_CRATES +=	divan	0.1.14	# MIT OR Apache-2.0
MODCARGO_CRATES +=	divan-macros	0.1.14	# MIT OR Apache-2.0
MODCARGO_CRATES +=	dlib	0.5.2	# MIT
MODCARGO_CRATES +=	dlv-list	0.5.2	# MIT OR Apache-2.0
MODCARGO_CRATES +=	doc-comment	0.3.3	# MIT
MODCARGO_CRATES +=	downcast-rs	1.2.1	# MIT/Apache-2.0
MODCARGO_CRATES +=	dtoa	1.0.9	# MIT OR Apache-2.0
MODCARGO_CRATES +=	dtoa-short	0.3.4	# MPL-2.0
MODCARGO_CRATES +=	dtparse	2.0.0	# Apache-2.0
MODCARGO_CRATES +=	dunce	1.0.4	# CC0-1.0 OR MIT-0 OR Apache-2.0
MODCARGO_CRATES +=	dyn-clone	1.0.17	# MIT OR Apache-2.0
MODCARGO_CRATES +=	ego-tree	0.6.2	# ISC
MODCARGO_CRATES +=	either	1.10.0	# MIT OR Apache-2.0
MODCARGO_CRATES +=	eml-parser	0.1.4	# LICENSE
MODCARGO_CRATES +=	encode_unicode	0.3.6	# MIT/Apache-2.0
MODCARGO_CRATES +=	encoding_rs	0.8.33	# (Apache-2.0 OR MIT) AND BSD-3-Clause
MODCARGO_CRATES +=	enum_dispatch	0.3.13	# MIT OR Apache-2.0
MODCARGO_CRATES +=	env_logger	0.8.4	# MIT/Apache-2.0
MODCARGO_CRATES +=	equivalent	1.0.1	# Apache-2.0 OR MIT
MODCARGO_CRATES +=	erased-serde	0.4.4	# MIT OR Apache-2.0
MODCARGO_CRATES +=	errno	0.3.8	# MIT OR Apache-2.0
MODCARGO_CRATES +=	error-code	3.2.0	# BSL-1.0
MODCARGO_CRATES +=	ethnum	1.5.0	# MIT OR Apache-2.0
MODCARGO_CRATES +=	event-listener	4.0.3	# Apache-2.0 OR MIT
MODCARGO_CRATES +=	event-listener	5.3.0	# Apache-2.0 OR MIT
MODCARGO_CRATES +=	event-listener-strategy	0.4.0	# Apache-2.0 OR MIT
MODCARGO_CRATES +=	event-listener-strategy	0.5.1	# Apache-2.0 OR MIT
MODCARGO_CRATES +=	fallible-iterator	0.3.0	# MIT/Apache-2.0
MODCARGO_CRATES +=	fallible-streaming-iterator	0.1.9	# MIT/Apache-2.0
MODCARGO_CRATES +=	fancy-regex	0.13.0	# MIT
MODCARGO_CRATES +=	fast-float	0.2.0	# MIT OR Apache-2.0
MODCARGO_CRATES +=	fastrand	2.0.2	# Apache-2.0 OR MIT
MODCARGO_CRATES +=	fd-lock	4.0.2	# MIT OR Apache-2.0
MODCARGO_CRATES +=	file-id	0.2.1	# MIT OR Apache-2.0
MODCARGO_CRATES +=	filesize	0.2.0	# MIT
MODCARGO_CRATES +=	filetime	0.2.23	# MIT/Apache-2.0
MODCARGO_CRATES +=	fixedbitset	0.4.2	# MIT/Apache-2.0
MODCARGO_CRATES +=	flate2	1.0.28	# MIT OR Apache-2.0
MODCARGO_CRATES +=	float-cmp	0.9.0	# MIT
MODCARGO_CRATES +=	fnv	1.0.7	# Apache-2.0 / MIT
MODCARGO_CRATES +=	foreign-types	0.3.2	# MIT/Apache-2.0
MODCARGO_CRATES +=	foreign-types-shared	0.1.1	# MIT/Apache-2.0
MODCARGO_CRATES +=	foreign_vec	0.1.0	# MIT
MODCARGO_CRATES +=	form_urlencoded	1.2.1	# MIT OR Apache-2.0
MODCARGO_CRATES +=	fs_extra	1.3.0	# MIT
MODCARGO_CRATES +=	fsevent-sys	4.1.0	# MIT
MODCARGO_CRATES +=	funty	2.0.0	# MIT
MODCARGO_CRATES +=	futf	0.1.5	# MIT / Apache-2.0
MODCARGO_CRATES +=	futures	0.3.30	# MIT OR Apache-2.0
MODCARGO_CRATES +=	futures-channel	0.3.30	# MIT OR Apache-2.0
MODCARGO_CRATES +=	futures-core	0.3.30	# MIT OR Apache-2.0
MODCARGO_CRATES +=	futures-executor	0.3.30	# MIT OR Apache-2.0
MODCARGO_CRATES +=	futures-io	0.3.30	# MIT OR Apache-2.0
MODCARGO_CRATES +=	futures-lite	2.3.0	# Apache-2.0 OR MIT
MODCARGO_CRATES +=	futures-macro	0.3.30	# MIT OR Apache-2.0
MODCARGO_CRATES +=	futures-sink	0.3.30	# MIT OR Apache-2.0
MODCARGO_CRATES +=	futures-task	0.3.30	# MIT OR Apache-2.0
MODCARGO_CRATES +=	futures-util	0.3.30	# MIT OR Apache-2.0
MODCARGO_CRATES +=	fuzzy-matcher	0.3.7	# MIT
MODCARGO_CRATES +=	fxhash	0.2.1	# Apache-2.0/MIT
MODCARGO_CRATES +=	generic-array	0.14.7	# MIT
MODCARGO_CRATES +=	gethostname	0.4.3	# Apache-2.0
MODCARGO_CRATES +=	getrandom	0.2.14	# MIT OR Apache-2.0
MODCARGO_CRATES +=	gimli	0.28.1	# MIT OR Apache-2.0
MODCARGO_CRATES +=	git2	0.18.3	# MIT OR Apache-2.0
MODCARGO_CRATES +=	gjson	0.8.1	# MIT
MODCARGO_CRATES +=	glob	0.3.1	# MIT OR Apache-2.0
MODCARGO_CRATES +=	h2	0.3.26	# MIT
MODCARGO_CRATES +=	halfbrown	0.2.5	# Apache-2.0/MIT
MODCARGO_CRATES +=	hash32	0.3.1	# MIT OR Apache-2.0
MODCARGO_CRATES +=	hashbrown	0.12.3	# MIT OR Apache-2.0
MODCARGO_CRATES +=	hashbrown	0.14.3	# MIT OR Apache-2.0
MODCARGO_CRATES +=	hashlink	0.9.0	# MIT OR Apache-2.0
MODCARGO_CRATES +=	heapless	0.8.0	# MIT OR Apache-2.0
MODCARGO_CRATES +=	heck	0.4.1	# MIT OR Apache-2.0
MODCARGO_CRATES +=	heck	0.5.0	# MIT OR Apache-2.0
MODCARGO_CRATES +=	hermit-abi	0.3.9	# MIT OR Apache-2.0
MODCARGO_CRATES +=	hex	0.4.3	# MIT OR Apache-2.0
MODCARGO_CRATES +=	home	0.5.9	# MIT OR Apache-2.0
MODCARGO_CRATES +=	html5ever	0.26.0	# MIT OR Apache-2.0
MODCARGO_CRATES +=	http	0.2.12	# MIT OR Apache-2.0
MODCARGO_CRATES +=	http-body	0.4.6	# MIT
MODCARGO_CRATES +=	httparse	1.8.0	# MIT/Apache-2.0
MODCARGO_CRATES +=	httpdate	1.0.3	# MIT OR Apache-2.0
MODCARGO_CRATES +=	human-date-parser	0.1.2	# MIT
MODCARGO_CRATES +=	hyper	0.14.28	# MIT
MODCARGO_CRATES +=	iana-time-zone	0.1.60	# MIT OR Apache-2.0
MODCARGO_CRATES +=	iana-time-zone-haiku	0.1.2	# MIT OR Apache-2.0
MODCARGO_CRATES +=	ical	0.11.0	# ./LICENSE
MODCARGO_CRATES +=	idna	0.5.0	# MIT OR Apache-2.0
MODCARGO_CRATES +=	indexmap	2.2.6	# Apache-2.0 OR MIT
MODCARGO_CRATES +=	indicatif	0.17.8	# MIT
MODCARGO_CRATES +=	indoc	2.0.5	# MIT OR Apache-2.0
MODCARGO_CRATES +=	inotify	0.9.6	# ISC
MODCARGO_CRATES +=	inotify-sys	0.1.5	# ISC
MODCARGO_CRATES +=	instant	0.1.12	# BSD-3-Clause
MODCARGO_CRATES +=	interprocess	1.2.1	# MIT OR Apache-2.0
MODCARGO_CRATES +=	intmap	0.7.1	# MIT
MODCARGO_CRATES +=	inventory	0.3.15	# MIT OR Apache-2.0
MODCARGO_CRATES +=	is-docker	0.2.0	# MIT
MODCARGO_CRATES +=	is-wsl	0.4.0	# MIT
MODCARGO_CRATES +=	is_ci	1.2.0	# ISC
MODCARGO_CRATES +=	is_debug	1.0.1	# MIT AND Apache-2.0
MODCARGO_CRATES +=	is_executable	1.0.1	# Apache-2.0/MIT
MODCARGO_CRATES +=	itertools	0.11.0	# MIT OR Apache-2.0
MODCARGO_CRATES +=	itertools	0.12.1	# MIT OR Apache-2.0
MODCARGO_CRATES +=	itoa	1.0.11	# MIT OR Apache-2.0
MODCARGO_CRATES +=	itoap	1.0.1	# MIT
MODCARGO_CRATES +=	jobserver	0.1.28	# MIT OR Apache-2.0
MODCARGO_CRATES +=	joinery	2.1.0	# MIT
MODCARGO_CRATES +=	js-sys	0.3.69	# MIT OR Apache-2.0
MODCARGO_CRATES +=	jsonpath_lib_polars_vendor	0.0.1	# MIT
MODCARGO_CRATES +=	kqueue	1.0.8	# MIT
MODCARGO_CRATES +=	kqueue-sys	1.0.4	# MIT
MODCARGO_CRATES +=	lazy_static	1.4.0	# MIT/Apache-2.0
MODCARGO_CRATES +=	lazycell	1.3.0	# MIT/Apache-2.0
MODCARGO_CRATES +=	lexical-core	0.8.5	# MIT/Apache-2.0
MODCARGO_CRATES +=	lexical-parse-float	0.8.5	# MIT/Apache-2.0
MODCARGO_CRATES +=	lexical-parse-integer	0.8.6	# MIT/Apache-2.0
MODCARGO_CRATES +=	lexical-util	0.8.5	# MIT/Apache-2.0
MODCARGO_CRATES +=	lexical-write-float	0.8.5	# MIT/Apache-2.0
MODCARGO_CRATES +=	lexical-write-integer	0.8.5	# MIT/Apache-2.0
MODCARGO_CRATES +=	libc	0.2.153	# MIT OR Apache-2.0
MODCARGO_CRATES +=	libflate	1.4.0	# MIT
MODCARGO_CRATES +=	libflate_lz77	1.2.0	# MIT
MODCARGO_CRATES +=	libgit2-sys	0.16.2+1.7.2	# MIT OR Apache-2.0
MODCARGO_CRATES +=	libloading	0.8.3	# ISC
MODCARGO_CRATES +=	libm	0.2.8	# MIT OR Apache-2.0
MODCARGO_CRATES +=	libmimalloc-sys	0.1.35	# MIT
MODCARGO_CRATES +=	libproc	0.14.6	# MIT
MODCARGO_CRATES +=	libredox	0.1.3	# MIT
MODCARGO_CRATES +=	libsqlite3-sys	0.28.0	# MIT
MODCARGO_CRATES +=	libssh2-sys	0.3.0	# MIT/Apache-2.0
MODCARGO_CRATES +=	libz-sys	1.1.16	# MIT OR Apache-2.0
MODCARGO_CRATES +=	linked-hash-map	0.5.6	# MIT/Apache-2.0
MODCARGO_CRATES +=	linux-raw-sys	0.4.13	# Apache-2.0 WITH LLVM-exception OR Apache-2.0 OR MIT
MODCARGO_CRATES +=	lock_api	0.4.11	# MIT OR Apache-2.0
MODCARGO_CRATES +=	log	0.4.21	# MIT OR Apache-2.0
MODCARGO_CRATES +=	lru	0.12.3	# MIT
MODCARGO_CRATES +=	lscolors	0.17.0	# MIT/Apache-2.0
MODCARGO_CRATES +=	lsp-server	0.7.6	# MIT OR Apache-2.0
MODCARGO_CRATES +=	lsp-types	0.95.1	# MIT
MODCARGO_CRATES +=	lz4	1.24.0	# MIT
MODCARGO_CRATES +=	lz4-sys	1.9.4	# MIT
MODCARGO_CRATES +=	mac	0.1.1	# MIT/Apache-2.0
MODCARGO_CRATES +=	mach2	0.4.2	# BSD-2-Clause OR MIT OR Apache-2.0
MODCARGO_CRATES +=	malloc_buf	0.0.6	# MIT
MODCARGO_CRATES +=	markup5ever	0.11.0	# MIT OR Apache-2.0
MODCARGO_CRATES +=	md-5	0.10.6	# MIT OR Apache-2.0
MODCARGO_CRATES +=	memchr	2.7.2	# Unlicense OR MIT
MODCARGO_CRATES +=	memmap2	0.7.1	# MIT OR Apache-2.0
MODCARGO_CRATES +=	miette	7.2.0	# Apache-2.0
MODCARGO_CRATES +=	miette-derive	7.2.0	# Apache-2.0
MODCARGO_CRATES +=	mimalloc	0.1.39	# MIT
MODCARGO_CRATES +=	mime	0.3.17	# MIT OR Apache-2.0
MODCARGO_CRATES +=	mime_guess	2.0.4	# MIT
MODCARGO_CRATES +=	minimal-lexical	0.2.1	# MIT/Apache-2.0
MODCARGO_CRATES +=	miniz_oxide	0.7.2	# MIT OR Zlib OR Apache-2.0
MODCARGO_CRATES +=	mio	0.8.11	# MIT
MODCARGO_CRATES +=	mockito	1.4.0	# MIT
MODCARGO_CRATES +=	multiversion	0.7.4	# MIT OR Apache-2.0
MODCARGO_CRATES +=	multiversion-macros	0.7.4	# MIT OR Apache-2.0
MODCARGO_CRATES +=	native-tls	0.2.11	# MIT/Apache-2.0
MODCARGO_CRATES +=	new_debug_unreachable	1.0.6	# MIT
MODCARGO_CRATES +=	nix	0.28.0	# MIT
MODCARGO_CRATES +=	nom	7.1.3	# MIT
MODCARGO_CRATES +=	notify	6.1.1	# CC0-1.0
MODCARGO_CRATES +=	notify-debouncer-full	0.3.1	# MIT OR Apache-2.0
MODCARGO_CRATES +=	now	0.1.3	# MIT
MODCARGO_CRATES +=	ntapi	0.4.1	# Apache-2.0 OR MIT
MODCARGO_CRATES +=	nu-ansi-term	0.50.0	# MIT
MODCARGO_CRATES +=	num	0.4.1	# MIT OR Apache-2.0
MODCARGO_CRATES +=	num-bigint	0.4.4	# MIT OR Apache-2.0
MODCARGO_CRATES +=	num-complex	0.4.5	# MIT OR Apache-2.0
MODCARGO_CRATES +=	num-conv	0.1.0	# MIT OR Apache-2.0
MODCARGO_CRATES +=	num-format	0.4.4	# MIT/Apache-2.0
MODCARGO_CRATES +=	num-integer	0.1.46	# MIT OR Apache-2.0
MODCARGO_CRATES +=	num-iter	0.1.44	# MIT OR Apache-2.0
MODCARGO_CRATES +=	num-rational	0.4.1	# MIT OR Apache-2.0
MODCARGO_CRATES +=	num-traits	0.2.18	# MIT OR Apache-2.0
MODCARGO_CRATES +=	num_cpus	1.16.0	# MIT OR Apache-2.0
MODCARGO_CRATES +=	num_threads	0.1.7	# MIT OR Apache-2.0
MODCARGO_CRATES +=	number_prefix	0.4.0	# MIT
MODCARGO_CRATES +=	objc	0.2.7	# MIT
MODCARGO_CRATES +=	objc-foundation	0.1.1	# MIT
MODCARGO_CRATES +=	objc_id	0.1.1	# MIT
MODCARGO_CRATES +=	object	0.32.2	# Apache-2.0 OR MIT
MODCARGO_CRATES +=	omnipath	0.1.6	# MIT OR Apache-2.0
MODCARGO_CRATES +=	once_cell	1.19.0	# MIT OR Apache-2.0
MODCARGO_CRATES +=	open	5.1.2	# MIT
MODCARGO_CRATES +=	openssl	0.10.64	# Apache-2.0
MODCARGO_CRATES +=	openssl-macros	0.1.1	# MIT/Apache-2.0
MODCARGO_CRATES +=	openssl-probe	0.1.5	# MIT/Apache-2.0
MODCARGO_CRATES +=	openssl-src	300.2.3+3.2.1	# MIT/Apache-2.0
MODCARGO_CRATES +=	openssl-sys	0.9.102	# MIT
MODCARGO_CRATES +=	ordered-multimap	0.7.3	# MIT
MODCARGO_CRATES +=	os_display	0.1.3	# MIT
MODCARGO_CRATES +=	os_pipe	1.1.5	# MIT
MODCARGO_CRATES +=	owo-colors	4.0.0	# MIT
MODCARGO_CRATES +=	papergrid	0.10.0	# MIT
MODCARGO_CRATES +=	parking	2.2.0	# Apache-2.0 OR MIT
MODCARGO_CRATES +=	parking_lot	0.12.1	# MIT OR Apache-2.0
MODCARGO_CRATES +=	parking_lot_core	0.9.9	# MIT OR Apache-2.0
MODCARGO_CRATES +=	parquet-format-safe	0.2.4	# MIT/Apache-2.0
MODCARGO_CRATES +=	parse-zoneinfo	0.3.0	# MIT
MODCARGO_CRATES +=	paste	1.0.14	# MIT OR Apache-2.0
MODCARGO_CRATES +=	pathdiff	0.2.1	# MIT/Apache-2.0
MODCARGO_CRATES +=	percent-encoding	2.3.1	# MIT OR Apache-2.0
MODCARGO_CRATES +=	peresil	0.3.0	# MIT
MODCARGO_CRATES +=	pest	2.7.9	# MIT OR Apache-2.0
MODCARGO_CRATES +=	pest_derive	2.7.9	# MIT OR Apache-2.0
MODCARGO_CRATES +=	pest_generator	2.7.9	# MIT OR Apache-2.0
MODCARGO_CRATES +=	pest_meta	2.7.9	# MIT OR Apache-2.0
MODCARGO_CRATES +=	petgraph	0.6.4	# MIT OR Apache-2.0
MODCARGO_CRATES +=	phf	0.10.1	# MIT
MODCARGO_CRATES +=	phf	0.11.2	# MIT
MODCARGO_CRATES +=	phf_codegen	0.10.0	# MIT
MODCARGO_CRATES +=	phf_codegen	0.11.2	# MIT
MODCARGO_CRATES +=	phf_generator	0.10.0	# MIT
MODCARGO_CRATES +=	phf_generator	0.11.2	# MIT
MODCARGO_CRATES +=	phf_macros	0.11.2	# MIT
MODCARGO_CRATES +=	phf_shared	0.10.0	# MIT
MODCARGO_CRATES +=	phf_shared	0.11.2	# MIT
MODCARGO_CRATES +=	pin-project-lite	0.2.14	# Apache-2.0 OR MIT
MODCARGO_CRATES +=	pin-utils	0.1.0	# MIT OR Apache-2.0
MODCARGO_CRATES +=	piper	0.2.1	# MIT OR Apache-2.0
MODCARGO_CRATES +=	pkg-config	0.3.30	# MIT OR Apache-2.0
MODCARGO_CRATES +=	planus	0.3.1	# MIT/Apache-2.0
MODCARGO_CRATES +=	platform-info	2.0.2	# MIT
MODCARGO_CRATES +=	polars	0.39.1	# MIT
MODCARGO_CRATES +=	polars-arrow	0.39.1	# MIT AND Apache-2.0
MODCARGO_CRATES +=	polars-arrow-format	0.1.0	# ./LICENSE
MODCARGO_CRATES +=	polars-compute	0.39.1	# MIT
MODCARGO_CRATES +=	polars-core	0.39.1	# MIT
MODCARGO_CRATES +=	polars-error	0.39.1	# MIT
MODCARGO_CRATES +=	polars-io	0.39.1	# MIT
MODCARGO_CRATES +=	polars-json	0.39.1	# MIT
MODCARGO_CRATES +=	polars-lazy	0.39.1	# MIT
MODCARGO_CRATES +=	polars-ops	0.39.1	# MIT
MODCARGO_CRATES +=	polars-parquet	0.39.1	# MIT AND Apache-2.0
MODCARGO_CRATES +=	polars-pipe	0.39.1	# MIT
MODCARGO_CRATES +=	polars-plan	0.39.1	# MIT
MODCARGO_CRATES +=	polars-row	0.39.1	# MIT
MODCARGO_CRATES +=	polars-sql	0.39.1	# MIT
MODCARGO_CRATES +=	polars-time	0.39.1	# MIT
MODCARGO_CRATES +=	polars-utils	0.39.1	# MIT
MODCARGO_CRATES +=	pori	0.0.0	# MIT
MODCARGO_CRATES +=	portable-atomic	1.6.0	# Apache-2.0 OR MIT
MODCARGO_CRATES +=	powerfmt	0.2.0	# MIT OR Apache-2.0
MODCARGO_CRATES +=	ppv-lite86	0.2.17	# MIT/Apache-2.0
MODCARGO_CRATES +=	precomputed-hash	0.1.1	# MIT
MODCARGO_CRATES +=	predicates	3.1.0	# MIT OR Apache-2.0
MODCARGO_CRATES +=	predicates-core	1.0.6	# MIT OR Apache-2.0
MODCARGO_CRATES +=	predicates-tree	1.0.9	# MIT OR Apache-2.0
MODCARGO_CRATES +=	pretty_assertions	1.4.0	# MIT OR Apache-2.0
MODCARGO_CRATES +=	print-positions	0.6.1	# MIT OR Apache-2.0
MODCARGO_CRATES +=	proc-macro-crate	3.1.0	# MIT OR Apache-2.0
MODCARGO_CRATES +=	proc-macro-error	1.0.4	# MIT OR Apache-2.0
MODCARGO_CRATES +=	proc-macro-error-attr	1.0.4	# MIT OR Apache-2.0
MODCARGO_CRATES +=	proc-macro2	1.0.79	# MIT OR Apache-2.0
MODCARGO_CRATES +=	procfs	0.16.0	# MIT OR Apache-2.0
MODCARGO_CRATES +=	procfs-core	0.16.0	# MIT OR Apache-2.0
MODCARGO_CRATES +=	psm	0.1.21	# MIT OR Apache-2.0
MODCARGO_CRATES +=	ptr_meta	0.1.4	# MIT
MODCARGO_CRATES +=	ptr_meta_derive	0.1.4	# MIT
MODCARGO_CRATES +=	pure-rust-locales	0.8.1	# MIT OR Apache-2.0
MODCARGO_CRATES +=	pwd	1.4.0	# CC-PDDC
MODCARGO_CRATES +=	quick-error	1.2.3	# MIT/Apache-2.0
MODCARGO_CRATES +=	quick-error	2.0.1	# MIT/Apache-2.0
MODCARGO_CRATES +=	quick-xml	0.31.0	# MIT
MODCARGO_CRATES +=	quickcheck	1.0.3	# Unlicense/MIT
MODCARGO_CRATES +=	quickcheck_macros	1.0.0	# Unlicense/MIT
MODCARGO_CRATES +=	quote	1.0.35	# MIT OR Apache-2.0
MODCARGO_CRATES +=	quoted_printable	0.5.0	# 0BSD
MODCARGO_CRATES +=	radium	0.7.0	# MIT
MODCARGO_CRATES +=	rand	0.8.5	# MIT OR Apache-2.0
MODCARGO_CRATES +=	rand_chacha	0.3.1	# MIT OR Apache-2.0
MODCARGO_CRATES +=	rand_core	0.6.4	# MIT OR Apache-2.0
MODCARGO_CRATES +=	rand_distr	0.4.3	# MIT OR Apache-2.0
MODCARGO_CRATES +=	ratatui	0.26.2	# MIT
MODCARGO_CRATES +=	raw-cpuid	11.0.1	# MIT
MODCARGO_CRATES +=	rayon	1.10.0	# MIT OR Apache-2.0
MODCARGO_CRATES +=	rayon-core	1.12.1	# MIT OR Apache-2.0
MODCARGO_CRATES +=	recursive	0.1.1	# MIT
MODCARGO_CRATES +=	recursive-proc-macro-impl	0.1.1	# MIT
MODCARGO_CRATES +=	redox_syscall	0.4.1	# MIT
MODCARGO_CRATES +=	redox_users	0.4.5	# MIT
MODCARGO_CRATES +=	reedline	0.32.0	# MIT
MODCARGO_CRATES +=	ref-cast	1.0.22	# MIT OR Apache-2.0
MODCARGO_CRATES +=	ref-cast-impl	1.0.22	# MIT OR Apache-2.0
MODCARGO_CRATES +=	regex	1.10.4	# MIT OR Apache-2.0
MODCARGO_CRATES +=	regex-automata	0.4.6	# MIT OR Apache-2.0
MODCARGO_CRATES +=	regex-lite	0.1.5	# MIT OR Apache-2.0
MODCARGO_CRATES +=	regex-syntax	0.8.3	# MIT OR Apache-2.0
MODCARGO_CRATES +=	relative-path	1.9.2	# MIT OR Apache-2.0
MODCARGO_CRATES +=	rend	0.4.2	# MIT
MODCARGO_CRATES +=	rfc2047-decoder	1.0.5	# MIT
MODCARGO_CRATES +=	rkyv	0.7.44	# MIT
MODCARGO_CRATES +=	rkyv_derive	0.7.44	# MIT
MODCARGO_CRATES +=	rle-decode-fast	1.0.3	# MIT OR Apache-2.0
MODCARGO_CRATES +=	rmp	0.8.14	# MIT
MODCARGO_CRATES +=	rmp-serde	1.2.0	# MIT
MODCARGO_CRATES +=	ropey	1.6.1	# MIT
MODCARGO_CRATES +=	roxmltree	0.19.0	# MIT OR Apache-2.0
MODCARGO_CRATES +=	rstest	0.18.2	# MIT OR Apache-2.0
MODCARGO_CRATES +=	rstest_macros	0.18.2	# MIT OR Apache-2.0
MODCARGO_CRATES +=	rusqlite	0.31.0	# MIT
MODCARGO_CRATES +=	rust-embed	8.3.0	# MIT
MODCARGO_CRATES +=	rust-embed-impl	8.3.0	# MIT
MODCARGO_CRATES +=	rust-embed-utils	8.3.0	# MIT
MODCARGO_CRATES +=	rust-ini	0.21.0	# MIT
MODCARGO_CRATES +=	rust_decimal	1.35.0	# MIT
MODCARGO_CRATES +=	rustc-demangle	0.1.23	# MIT/Apache-2.0
MODCARGO_CRATES +=	rustc-hash	1.1.0	# Apache-2.0/MIT
MODCARGO_CRATES +=	rustc_version	0.4.0	# MIT/Apache-2.0
MODCARGO_CRATES +=	rustix	0.38.32	# Apache-2.0 WITH LLVM-exception OR Apache-2.0 OR MIT
MODCARGO_CRATES +=	rustversion	1.0.15	# MIT OR Apache-2.0
MODCARGO_CRATES +=	ryu	1.0.17	# Apache-2.0 OR BSL-1.0
MODCARGO_CRATES +=	same-file	1.0.6	# Unlicense/MIT
MODCARGO_CRATES +=	scc	2.1.0	# Apache-2.0
MODCARGO_CRATES +=	schannel	0.1.23	# MIT
MODCARGO_CRATES +=	scoped-tls	1.0.1	# MIT/Apache-2.0
MODCARGO_CRATES +=	scopeguard	1.2.0	# MIT OR Apache-2.0
MODCARGO_CRATES +=	scraper	0.19.0	# ISC
MODCARGO_CRATES +=	sdd	0.2.0	# Apache-2.0
MODCARGO_CRATES +=	seahash	4.1.0	# MIT
MODCARGO_CRATES +=	security-framework	2.10.0	# MIT OR Apache-2.0
MODCARGO_CRATES +=	security-framework-sys	2.10.0	# MIT OR Apache-2.0
MODCARGO_CRATES +=	selectors	0.25.0	# MPL-2.0
MODCARGO_CRATES +=	semver	1.0.22	# MIT OR Apache-2.0
MODCARGO_CRATES +=	seq-macro	0.3.5	# MIT OR Apache-2.0
MODCARGO_CRATES +=	serde	1.0.197	# MIT OR Apache-2.0
MODCARGO_CRATES +=	serde_derive	1.0.197	# MIT OR Apache-2.0
MODCARGO_CRATES +=	serde_json	1.0.115	# MIT OR Apache-2.0
MODCARGO_CRATES +=	serde_repr	0.1.19	# MIT OR Apache-2.0
MODCARGO_CRATES +=	serde_spanned	0.6.5	# MIT OR Apache-2.0
MODCARGO_CRATES +=	serde_urlencoded	0.7.1	# MIT/Apache-2.0
MODCARGO_CRATES +=	serde_yaml	0.9.34+deprecated	# MIT OR Apache-2.0
MODCARGO_CRATES +=	serial_test	3.1.0	# MIT
MODCARGO_CRATES +=	serial_test_derive	3.1.0	# MIT
MODCARGO_CRATES +=	servo_arc	0.3.0	# MIT/Apache-2.0
MODCARGO_CRATES +=	sha2	0.10.8	# MIT OR Apache-2.0
MODCARGO_CRATES +=	shadow-rs	0.27.1	# MIT AND Apache-2.0
MODCARGO_CRATES +=	shell-words	1.1.0	# MIT/Apache-2.0
MODCARGO_CRATES +=	shlex	1.3.0	# MIT OR Apache-2.0
MODCARGO_CRATES +=	signal-hook	0.3.17	# Apache-2.0/MIT
MODCARGO_CRATES +=	signal-hook-mio	0.2.3	# Apache-2.0/MIT
MODCARGO_CRATES +=	signal-hook-registry	1.4.1	# Apache-2.0/MIT
MODCARGO_CRATES +=	simd-json	0.13.9	# Apache-2.0 OR MIT
MODCARGO_CRATES +=	simdutf8	0.1.4	# MIT OR Apache-2.0
MODCARGO_CRATES +=	similar	2.5.0	# Apache-2.0
MODCARGO_CRATES +=	simplelog	0.12.2	# MIT OR Apache-2.0
MODCARGO_CRATES +=	siphasher	0.3.11	# MIT/Apache-2.0
MODCARGO_CRATES +=	slab	0.4.9	# MIT
MODCARGO_CRATES +=	smallvec	1.13.2	# MIT OR Apache-2.0
MODCARGO_CRATES +=	smartstring	1.0.1	# MPL-2.0+
MODCARGO_CRATES +=	smawk	0.3.2	# MIT
MODCARGO_CRATES +=	snap	1.1.1	# BSD-3-Clause
MODCARGO_CRATES +=	socket2	0.5.6	# MIT OR Apache-2.0
MODCARGO_CRATES +=	spinning	0.1.0	# MIT OR Apache-2.0
MODCARGO_CRATES +=	sqlparser	0.39.0	# Apache-2.0
MODCARGO_CRATES +=	sqlparser	0.45.0	# Apache-2.0
MODCARGO_CRATES +=	stability	0.2.0	# MIT
MODCARGO_CRATES +=	stable_deref_trait	1.2.0	# MIT/Apache-2.0
MODCARGO_CRATES +=	stacker	0.1.15	# MIT OR Apache-2.0
MODCARGO_CRATES +=	static_assertions	1.1.0	# MIT OR Apache-2.0
MODCARGO_CRATES +=	str_indices	0.4.3	# MIT OR Apache-2.0
MODCARGO_CRATES +=	streaming-decompression	0.1.2	# Apache-2.0
MODCARGO_CRATES +=	streaming-iterator	0.1.9	# MIT OR Apache-2.0
MODCARGO_CRATES +=	strength_reduce	0.2.4	# MIT OR Apache-2.0
MODCARGO_CRATES +=	string_cache	0.8.7	# MIT OR Apache-2.0
MODCARGO_CRATES +=	string_cache_codegen	0.5.2	# MIT OR Apache-2.0
MODCARGO_CRATES +=	strip-ansi-escapes	0.2.0	# Apache-2.0/MIT
MODCARGO_CRATES +=	strsim	0.11.1	# MIT
MODCARGO_CRATES +=	strum	0.26.2	# MIT
MODCARGO_CRATES +=	strum_macros	0.25.3	# MIT
MODCARGO_CRATES +=	strum_macros	0.26.2	# MIT
MODCARGO_CRATES +=	supports-color	3.0.0	# Apache-2.0
MODCARGO_CRATES +=	supports-hyperlinks	3.0.0	# Apache-2.0
MODCARGO_CRATES +=	supports-unicode	3.0.0	# Apache-2.0
MODCARGO_CRATES +=	sxd-document	0.3.2	# MIT
MODCARGO_CRATES +=	sxd-xpath	0.4.2	# MIT/Apache-2.0
MODCARGO_CRATES +=	syn	1.0.109	# MIT OR Apache-2.0
MODCARGO_CRATES +=	syn	2.0.58	# MIT OR Apache-2.0
MODCARGO_CRATES +=	syn_derive	0.1.8	# MIT OR Apache-2.0
MODCARGO_CRATES +=	sys-locale	0.3.1	# MIT OR Apache-2.0
MODCARGO_CRATES +=	sysinfo	0.30.9	# MIT
MODCARGO_CRATES +=	tabled	0.14.0	# MIT
MODCARGO_CRATES +=	tap	1.0.1	# MIT
MODCARGO_CRATES +=	target-features	0.1.6	# MIT OR Apache-2.0
MODCARGO_CRATES +=	tempfile	3.10.1	# MIT OR Apache-2.0
MODCARGO_CRATES +=	tendril	0.4.3	# MIT/Apache-2.0
MODCARGO_CRATES +=	termcolor	1.4.1	# Unlicense OR MIT
MODCARGO_CRATES +=	terminal_size	0.3.0	# MIT OR Apache-2.0
MODCARGO_CRATES +=	termtree	0.4.1	# MIT
MODCARGO_CRATES +=	textwrap	0.16.1	# MIT
MODCARGO_CRATES +=	thiserror	1.0.58	# MIT OR Apache-2.0
MODCARGO_CRATES +=	thiserror-impl	1.0.58	# MIT OR Apache-2.0
MODCARGO_CRATES +=	thread_local	1.1.8	# MIT OR Apache-2.0
MODCARGO_CRATES +=	time	0.3.34	# MIT OR Apache-2.0
MODCARGO_CRATES +=	time-core	0.1.2	# MIT OR Apache-2.0
MODCARGO_CRATES +=	time-macros	0.2.17	# MIT OR Apache-2.0
MODCARGO_CRATES +=	tiny-keccak	2.0.2	# CC0-1.0
MODCARGO_CRATES +=	tinyvec	1.6.0	# Zlib OR Apache-2.0 OR MIT
MODCARGO_CRATES +=	tinyvec_macros	0.1.1	# MIT OR Apache-2.0 OR Zlib
MODCARGO_CRATES +=	titlecase	2.2.1	# MIT
MODCARGO_CRATES +=	to_method	1.1.0	# CC0-1.0
MODCARGO_CRATES +=	tokio	1.37.0	# MIT
MODCARGO_CRATES +=	tokio-util	0.7.10	# MIT
MODCARGO_CRATES +=	toml	0.7.8	# MIT OR Apache-2.0
MODCARGO_CRATES +=	toml	0.8.12	# MIT OR Apache-2.0
MODCARGO_CRATES +=	toml_datetime	0.6.5	# MIT OR Apache-2.0
MODCARGO_CRATES +=	toml_edit	0.19.15	# MIT OR Apache-2.0
MODCARGO_CRATES +=	toml_edit	0.21.1	# MIT OR Apache-2.0
MODCARGO_CRATES +=	toml_edit	0.22.9	# MIT OR Apache-2.0
MODCARGO_CRATES +=	tower-service	0.3.2	# MIT
MODCARGO_CRATES +=	tracing	0.1.40	# MIT
MODCARGO_CRATES +=	tracing-core	0.1.32	# MIT
MODCARGO_CRATES +=	trash	3.3.1	# MIT
MODCARGO_CRATES +=	tree_magic_mini	3.1.4	# MIT
MODCARGO_CRATES +=	trim-in-place	0.1.7	# MIT
MODCARGO_CRATES +=	try-lock	0.2.5	# MIT
MODCARGO_CRATES +=	typed-arena	1.7.0	# MIT
MODCARGO_CRATES +=	typenum	1.17.0	# MIT OR Apache-2.0
MODCARGO_CRATES +=	typetag	0.2.16	# MIT OR Apache-2.0
MODCARGO_CRATES +=	typetag-impl	0.2.16	# MIT OR Apache-2.0
MODCARGO_CRATES +=	ucd-trie	0.1.6	# MIT OR Apache-2.0
MODCARGO_CRATES +=	umask	2.1.0	# MIT
MODCARGO_CRATES +=	unicase	2.7.0	# MIT/Apache-2.0
MODCARGO_CRATES +=	unicode-bidi	0.3.15	# MIT OR Apache-2.0
MODCARGO_CRATES +=	unicode-ident	1.0.12	# (MIT OR Apache-2.0) AND Unicode-DFS-2016
MODCARGO_CRATES +=	unicode-linebreak	0.1.5	# Apache-2.0
MODCARGO_CRATES +=	unicode-normalization	0.1.23	# MIT/Apache-2.0
MODCARGO_CRATES +=	unicode-reverse	1.0.9	# MIT OR Apache-2.0
MODCARGO_CRATES +=	unicode-segmentation	1.11.0	# MIT/Apache-2.0
MODCARGO_CRATES +=	unicode-width	0.1.11	# MIT/Apache-2.0
MODCARGO_CRATES +=	unicode-xid	0.2.4	# MIT OR Apache-2.0
MODCARGO_CRATES +=	unsafe-libyaml	0.2.11	# MIT
MODCARGO_CRATES +=	ureq	2.9.6	# MIT OR Apache-2.0
MODCARGO_CRATES +=	url	2.5.0	# MIT OR Apache-2.0
MODCARGO_CRATES +=	utf-8	0.7.6	# MIT OR Apache-2.0
MODCARGO_CRATES +=	utf8-width	0.1.7	# MIT
MODCARGO_CRATES +=	utf8parse	0.2.1	# Apache-2.0 OR MIT
MODCARGO_CRATES +=	uu_cp	0.0.25	# MIT
MODCARGO_CRATES +=	uu_mkdir	0.0.25	# MIT
MODCARGO_CRATES +=	uu_mktemp	0.0.25	# MIT
MODCARGO_CRATES +=	uu_mv	0.0.25	# MIT
MODCARGO_CRATES +=	uu_uname	0.0.25	# MIT
MODCARGO_CRATES +=	uu_whoami	0.0.25	# MIT
MODCARGO_CRATES +=	uucore	0.0.25	# MIT
MODCARGO_CRATES +=	uucore_procs	0.0.25	# MIT
MODCARGO_CRATES +=	uuhelp_parser	0.0.25	# MIT
MODCARGO_CRATES +=	uuid	1.8.0	# Apache-2.0 OR MIT
MODCARGO_CRATES +=	v_htmlescape	0.15.8	# MIT/Apache-2.0
MODCARGO_CRATES +=	value-trait	0.8.1	# Apache-2.0/MIT
MODCARGO_CRATES +=	vcpkg	0.2.15	# MIT/Apache-2.0
MODCARGO_CRATES +=	version_check	0.9.4	# MIT/Apache-2.0
MODCARGO_CRATES +=	vte	0.10.1	# Apache-2.0 OR MIT
MODCARGO_CRATES +=	vte	0.11.1	# Apache-2.0 OR MIT
MODCARGO_CRATES +=	vte_generate_state_changes	0.1.1	# Apache-2.0 OR MIT
MODCARGO_CRATES +=	wait-timeout	0.2.0	# MIT/Apache-2.0
MODCARGO_CRATES +=	walkdir	2.5.0	# Unlicense/MIT
MODCARGO_CRATES +=	want	0.3.1	# MIT
MODCARGO_CRATES +=	wasi	0.11.0+wasi-snapshot-preview1	# Apache-2.0 WITH LLVM-exception OR Apache-2.0 OR MIT
MODCARGO_CRATES +=	wasm-bindgen	0.2.92	# MIT OR Apache-2.0
MODCARGO_CRATES +=	wasm-bindgen-backend	0.2.92	# MIT OR Apache-2.0
MODCARGO_CRATES +=	wasm-bindgen-macro	0.2.92	# MIT OR Apache-2.0
MODCARGO_CRATES +=	wasm-bindgen-macro-support	0.2.92	# MIT OR Apache-2.0
MODCARGO_CRATES +=	wasm-bindgen-shared	0.2.92	# MIT OR Apache-2.0
MODCARGO_CRATES +=	wax	0.6.0	# MIT
MODCARGO_CRATES +=	wayland-backend	0.3.3	# MIT
MODCARGO_CRATES +=	wayland-client	0.31.2	# MIT
MODCARGO_CRATES +=	wayland-protocols	0.31.2	# MIT
MODCARGO_CRATES +=	wayland-protocols-wlr	0.2.0	# MIT
MODCARGO_CRATES +=	wayland-scanner	0.31.1	# MIT
MODCARGO_CRATES +=	wayland-sys	0.31.1	# MIT
MODCARGO_CRATES +=	which	6.0.1	# MIT
MODCARGO_CRATES +=	wild	2.2.1	# Apache-2.0 OR MIT
MODCARGO_CRATES +=	winapi	0.3.9	# MIT/Apache-2.0
MODCARGO_CRATES +=	winapi-i686-pc-windows-gnu	0.4.0	# MIT/Apache-2.0
MODCARGO_CRATES +=	winapi-util	0.1.6	# Unlicense/MIT
MODCARGO_CRATES +=	winapi-x86_64-pc-windows-gnu	0.4.0	# MIT/Apache-2.0
MODCARGO_CRATES +=	windows	0.44.0	# MIT OR Apache-2.0
MODCARGO_CRATES +=	windows	0.52.0	# MIT OR Apache-2.0
MODCARGO_CRATES +=	windows	0.54.0	# MIT OR Apache-2.0
MODCARGO_CRATES +=	windows-core	0.52.0	# MIT OR Apache-2.0
MODCARGO_CRATES +=	windows-core	0.54.0	# MIT OR Apache-2.0
MODCARGO_CRATES +=	windows-result	0.1.0	# MIT OR Apache-2.0
MODCARGO_CRATES +=	windows-sys	0.48.0	# MIT OR Apache-2.0
MODCARGO_CRATES +=	windows-sys	0.52.0	# MIT OR Apache-2.0
MODCARGO_CRATES +=	windows-targets	0.42.2	# MIT OR Apache-2.0
MODCARGO_CRATES +=	windows-targets	0.48.5	# MIT OR Apache-2.0
MODCARGO_CRATES +=	windows-targets	0.52.4	# MIT OR Apache-2.0
MODCARGO_CRATES +=	windows_aarch64_gnullvm	0.42.2	# MIT OR Apache-2.0
MODCARGO_CRATES +=	windows_aarch64_gnullvm	0.48.5	# MIT OR Apache-2.0
MODCARGO_CRATES +=	windows_aarch64_gnullvm	0.52.4	# MIT OR Apache-2.0
MODCARGO_CRATES +=	windows_aarch64_msvc	0.42.2	# MIT OR Apache-2.0
MODCARGO_CRATES +=	windows_aarch64_msvc	0.48.5	# MIT OR Apache-2.0
MODCARGO_CRATES +=	windows_aarch64_msvc	0.52.4	# MIT OR Apache-2.0
MODCARGO_CRATES +=	windows_i686_gnu	0.42.2	# MIT OR Apache-2.0
MODCARGO_CRATES +=	windows_i686_gnu	0.48.5	# MIT OR Apache-2.0
MODCARGO_CRATES +=	windows_i686_gnu	0.52.4	# MIT OR Apache-2.0
MODCARGO_CRATES +=	windows_i686_msvc	0.42.2	# MIT OR Apache-2.0
MODCARGO_CRATES +=	windows_i686_msvc	0.48.5	# MIT OR Apache-2.0
MODCARGO_CRATES +=	windows_i686_msvc	0.52.4	# MIT OR Apache-2.0
MODCARGO_CRATES +=	windows_x86_64_gnu	0.42.2	# MIT OR Apache-2.0
MODCARGO_CRATES +=	windows_x86_64_gnu	0.48.5	# MIT OR Apache-2.0
MODCARGO_CRATES +=	windows_x86_64_gnu	0.52.4	# MIT OR Apache-2.0
MODCARGO_CRATES +=	windows_x86_64_gnullvm	0.42.2	# MIT OR Apache-2.0
MODCARGO_CRATES +=	windows_x86_64_gnullvm	0.48.5	# MIT OR Apache-2.0
MODCARGO_CRATES +=	windows_x86_64_gnullvm	0.52.4	# MIT OR Apache-2.0
MODCARGO_CRATES +=	windows_x86_64_msvc	0.42.2	# MIT OR Apache-2.0
MODCARGO_CRATES +=	windows_x86_64_msvc	0.48.5	# MIT OR Apache-2.0
MODCARGO_CRATES +=	windows_x86_64_msvc	0.52.4	# MIT OR Apache-2.0
MODCARGO_CRATES +=	winnow	0.5.40	# MIT
MODCARGO_CRATES +=	winnow	0.6.5	# MIT
MODCARGO_CRATES +=	winreg	0.52.0	# MIT
MODCARGO_CRATES +=	winresource	0.1.17	# MIT
MODCARGO_CRATES +=	winsafe	0.0.19	# MIT
MODCARGO_CRATES +=	wl-clipboard-rs	0.8.1	# MIT/Apache-2.0
MODCARGO_CRATES +=	wyz	0.5.1	# MIT
MODCARGO_CRATES +=	x11rb	0.13.0	# MIT OR Apache-2.0
MODCARGO_CRATES +=	x11rb-protocol	0.13.0	# MIT OR Apache-2.0
MODCARGO_CRATES +=	xattr	1.3.1	# MIT/Apache-2.0
MODCARGO_CRATES +=	xxhash-rust	0.8.10	# BSL-1.0
MODCARGO_CRATES +=	yansi	0.5.1	# MIT/Apache-2.0
MODCARGO_CRATES +=	zerocopy	0.7.32	# BSD-2-Clause OR Apache-2.0 OR MIT
MODCARGO_CRATES +=	zerocopy-derive	0.7.32	# BSD-2-Clause OR Apache-2.0 OR MIT
MODCARGO_CRATES +=	zip	0.6.6	# MIT
MODCARGO_CRATES +=	zstd	0.13.1	# MIT
MODCARGO_CRATES +=	zstd-safe	7.1.0	# MIT/Apache-2.0
MODCARGO_CRATES +=	zstd-sys	2.0.10+zstd.1.5.6	# MIT/Apache-2.0
